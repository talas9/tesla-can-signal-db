VERSION "dbc-export 1 2026.26.6.5"

NS_ :

BS_:

BU_: ADSP APSB BB CMP CP DAS DPB EPASTP EPASTS GTW IDB OCS1P PTC RCM RCU TCU TCU2 UI UIS VCLEFT VCSEAT2L VCSEAT2R VCSEC

BO_ 1297 RCM_alertLog: 8 RCM
 SG_ RCM_alertID M : 0|10@1+ (1,0) [0|1023] "" Vector__XXX
 SG_ RCM_a026_eventFactoryMode m26 : 12|1@1+ (1,0) [0|1] "" Vector__XXX
 SG_ RCM_a026_eventDiagEnabled m26 : 13|1@1+ (1,0) [0|1] "" Vector__XXX
 SG_ RCM_a026_eventDriveOrientation m26 : 14|1@1+ (1,0) [0|1] "" Vector__XXX
 SG_ RCM_a026_kneeABPassSht2Gnd m26 : 16|1@1+ (1,0) [0|1] "" Vector__XXX
 SG_ RCM_a026_kneeABPassSht2Bat m26 : 17|1@1+ (1,0) [0|1] "" Vector__XXX
 SG_ RCM_a026_kneeABPassOpen m26 : 18|1@1+ (1,0) [0|1] "" Vector__XXX
 SG_ RCM_a026_kneeABPassShort m26 : 19|1@1+ (1,0) [0|1] "" Vector__XXX
 SG_ RCM_a026_kneeABPassCrossCoup m26 : 20|1@1+ (1,0) [0|1] "" Vector__XXX
 SG_ RCM_a026_kneeABPassConfig m26 : 21|1@1+ (1,0) [0|1] "" Vector__XXX
 SG_ RCM_a026_eventIDFsignal m26 : 25|1@1+ (1,0) [0|1] "" Vector__XXX
 SG_ RCM_a026_eventFrontLeftSeatbelt m26 : 26|1@1+ (1,0) [0|1] "" Vector__XXX
 SG_ RCM_a026_eventFrontRightSeatbelt m26 : 27|1@1+ (1,0) [0|1] "" Vector__XXX
 SG_ RCM_a026_eventVehicleSpeed m26 : 28|12@1+ (0.08,-40) [-40|287.6] "kph" Vector__XXX
 SG_ RCM_a026_eventSteeringAngle m26 : 45|14@0+ (0.1,-819.2) [-819.2|819.1] "deg" Vector__XXX
 SG_ RCM_a026_eventDriverBrakeApply m26 : 46|2@1+ (1,0) [0|2] "" Vector__XXX
 SG_ RCM_a026_eventAccelPedalPos m26 : 56|8@1+ (0.4,0) [0|101.6] "%" Vector__XXX
 SG_ RCM_a027_eventArmStatus m27 : 11|1@1+ (1,0) [0|1] "" Vector__XXX
 SG_ RCM_a027_eventFactoryMode m27 : 12|1@1+ (1,0) [0|1] "" Vector__XXX
 SG_ RCM_a027_eventDiagEnabled m27 : 13|1@1+ (1,0) [0|1] "" Vector__XXX
 SG_ RCM_a027_eventDriveOrientation m27 : 14|1@1+ (1,0) [0|1] "" Vector__XXX
 SG_ RCM_a027_sideAB1stRowLSht2Gnd m27 : 16|1@1+ (1,0) [0|1] "" Vector__XXX
 SG_ RCM_a027_sideAB1stRowLSht2Bat m27 : 17|1@1+ (1,0) [0|1] "" Vector__XXX
 SG_ RCM_a027_sideAB1stRowLOpen m27 : 18|1@1+ (1,0) [0|1] "" Vector__XXX
 SG_ RCM_a027_sideAB1stRowLShort m27 : 19|1@1+ (1,0) [0|1] "" Vector__XXX
 SG_ RCM_a027_sideAB1stRowLCrossCoup m27 : 20|1@1+ (1,0) [0|1] "" Vector__XXX
 SG_ RCM_a027_sideAB1stRowLConfig m27 : 21|1@1+ (1,0) [0|1] "" Vector__XXX
 SG_ RCM_a027_eventIDFsignal m27 : 25|1@1+ (1,0) [0|1] "" Vector__XXX
 SG_ RCM_a027_eventFrontLeftSeatbelt m27 : 26|1@1+ (1,0) [0|1] "" Vector__XXX
 SG_ RCM_a027_eventFrontRightSeatbelt m27 : 27|1@1+ (1,0) [0|1] "" Vector__XXX
 SG_ RCM_a027_eventVehicleSpeed m27 : 28|12@1+ (0.08,-40) [-40|287.6] "kph" Vector__XXX
 SG_ RCM_a027_eventSteeringAngle m27 : 45|14@0+ (0.1,-819.2) [-819.2|819.1] "deg" Vector__XXX
 SG_ RCM_a027_eventDriverBrakeApply m27 : 46|2@1+ (1,0) [0|2] "" Vector__XXX
 SG_ RCM_a027_eventAccelPedalPos m27 : 56|8@1+ (0.4,0) [0|101.6] "%" Vector__XXX
 SG_ RCM_a028_eventArmStatus m28 : 11|1@1+ (1,0) [0|1] "" Vector__XXX
 SG_ RCM_a028_eventFactoryMode m28 : 12|1@1+ (1,0) [0|1] "" Vector__XXX
 SG_ RCM_a028_eventDiagEnabled m28 : 13|1@1+ (1,0) [0|1] "" Vector__XXX
 SG_ RCM_a028_eventDriveOrientation m28 : 14|1@1+ (1,0) [0|1] "" Vector__XXX
 SG_ RCM_a028_sideAB1stRowRSht2Gnd m28 : 16|1@1+ (1,0) [0|1] "" Vector__XXX
 SG_ RCM_a028_sideAB1stRowRSht2Bat m28 : 17|1@1+ (1,0) [0|1] "" Vector__XXX
 SG_ RCM_a028_sideAB1stRowROpen m28 : 18|1@1+ (1,0) [0|1] "" Vector__XXX
 SG_ RCM_a028_sideAB1stRowRShort m28 : 19|1@1+ (1,0) [0|1] "" Vector__XXX
 SG_ RCM_a028_sideAB1stRowRCrossCoup m28 : 20|1@1+ (1,0) [0|1] "" Vector__XXX
 SG_ RCM_a028_sideAB1stRowRConfig m28 : 21|1@1+ (1,0) [0|1] "" Vector__XXX
 SG_ RCM_a028_eventIDFsignal m28 : 25|1@1+ (1,0) [0|1] "" Vector__XXX
 SG_ RCM_a028_eventFrontLeftSeatbelt m28 : 26|1@1+ (1,0) [0|1] "" Vector__XXX
 SG_ RCM_a028_eventFrontRightSeatbelt m28 : 27|1@1+ (1,0) [0|1] "" Vector__XXX
 SG_ RCM_a028_eventVehicleSpeed m28 : 28|12@1+ (0.08,-40) [-40|287.6] "kph" Vector__XXX
 SG_ RCM_a028_eventSteeringAngle m28 : 45|14@0+ (0.1,-819.2) [-819.2|819.1] "deg" Vector__XXX
 SG_ RCM_a028_eventDriverBrakeApply m28 : 46|2@1+ (1,0) [0|2] "" Vector__XXX
 SG_ RCM_a028_eventAccelPedalPos m28 : 56|8@1+ (0.4,0) [0|101.6] "%" Vector__XXX
 SG_ RCM_a029_eventArmStatus m29 : 11|1@1+ (1,0) [0|1] "" Vector__XXX
 SG_ RCM_a029_eventFactoryMode m29 : 12|1@1+ (1,0) [0|1] "" Vector__XXX
 SG_ RCM_a029_eventDiagEnabled m29 : 13|1@1+ (1,0) [0|1] "" Vector__XXX
 SG_ RCM_a029_eventDriveOrientation m29 : 14|1@1+ (1,0) [0|1] "" Vector__XXX
 SG_ RCM_a029_driverABAVSht2Gnd m29 : 16|1@1+ (1,0) [0|1] "" Vector__XXX
 SG_ RCM_a029_driverABAVSht2Bat m29 : 17|1@1+ (1,0) [0|1] "" Vector__XXX
 SG_ RCM_a029_driverABAVOpen m29 : 18|1@1+ (1,0) [0|1] "" Vector__XXX
 SG_ RCM_a029_driverABAVShort m29 : 19|1@1+ (1,0) [0|1] "" Vector__XXX
 SG_ RCM_a029_driverABAVCrossCoup m29 : 20|1@1+ (1,0) [0|1] "" Vector__XXX
 SG_ RCM_a029_driverABAVConfig m29 : 21|1@1+ (1,0) [0|1] "" Vector__XXX
 SG_ RCM_a029_eventIDFsignal m29 : 25|1@1+ (1,0) [0|1] "" Vector__XXX
 SG_ RCM_a029_eventFrontLeftSeatbelt m29 : 26|1@1+ (1,0) [0|1] "" Vector__XXX
 SG_ RCM_a029_eventFrontRightSeatbelt m29 : 27|1@1+ (1,0) [0|1] "" Vector__XXX
 SG_ RCM_a029_eventVehicleSpeed m29 : 28|12@1+ (0.08,-40) [-40|287.6] "kph" Vector__XXX
 SG_ RCM_a029_eventSteeringAngle m29 : 45|14@0+ (0.1,-819.2) [-819.2|819.1] "deg" Vector__XXX
 SG_ RCM_a029_eventDriverBrakeApply m29 : 46|2@1+ (1,0) [0|2] "" Vector__XXX
 SG_ RCM_a029_eventAccelPedalPos m29 : 56|8@1+ (0.4,0) [0|101.6] "%" Vector__XXX
 SG_ RCM_a030_eventArmStatus m30 : 11|1@1+ (1,0) [0|1] "" Vector__XXX
 SG_ RCM_a030_eventFactoryMode m30 : 12|1@1+ (1,0) [0|1] "" Vector__XXX
 SG_ RCM_a030_eventDiagEnabled m30 : 13|1@1+ (1,0) [0|1] "" Vector__XXX
 SG_ RCM_a030_eventDriveOrientation m30 : 14|1@1+ (1,0) [0|1] "" Vector__XXX
 SG_ RCM_a030_farsideABSht2Gnd m30 : 16|1@1+ (1,0) [0|1] "" Vector__XXX
 SG_ RCM_a030_farsideABSht2Bat m30 : 17|1@1+ (1,0) [0|1] "" Vector__XXX
 SG_ RCM_a030_farsideABOpen m30 : 18|1@1+ (1,0) [0|1] "" Vector__XXX
 SG_ RCM_a030_farsideABShort m30 : 19|1@1+ (1,0) [0|1] "" Vector__XXX
 SG_ RCM_a030_farsideABCrossCoup m30 : 20|1@1+ (1,0) [0|1] "" Vector__XXX
 SG_ RCM_a030_farsideABConfig m30 : 21|1@1+ (1,0) [0|1] "" Vector__XXX
 SG_ RCM_a030_eventIDFsignal m30 : 25|1@1+ (1,0) [0|1] "" Vector__XXX
 SG_ RCM_a030_eventFrontLeftSeatbelt m30 : 26|1@1+ (1,0) [0|1] "" Vector__XXX
 SG_ RCM_a030_eventFrontRightSeatbelt m30 : 27|1@1+ (1,0) [0|1] "" Vector__XXX
 SG_ RCM_a030_eventVehicleSpeed m30 : 28|12@1+ (0.08,-40) [-40|287.6] "kph" Vector__XXX
 SG_ RCM_a030_eventSteeringAngle m30 : 45|14@0+ (0.1,-819.2) [-819.2|819.1] "deg" Vector__XXX
 SG_ RCM_a030_eventDriverBrakeApply m30 : 46|2@1+ (1,0) [0|2] "" Vector__XXX
 SG_ RCM_a030_eventAccelPedalPos m30 : 56|8@1+ (0.4,0) [0|101.6] "%" Vector__XXX
 SG_ RCM_a031_eventArmStatus m31 : 11|1@1+ (1,0) [0|1] "" Vector__XXX
 SG_ RCM_a031_eventFactoryMode m31 : 12|1@1+ (1,0) [0|1] "" Vector__XXX
 SG_ RCM_a031_eventDiagEnabled m31 : 13|1@1+ (1,0) [0|1] "" Vector__XXX
 SG_ RCM_a031_eventDriveOrientation m31 : 14|1@1+ (1,0) [0|1] "" Vector__XXX
 SG_ RCM_a031_frntCentrABSht2Gnd m31 : 16|1@1+ (1,0) [0|1] "" Vector__XXX
 SG_ RCM_a031_frntCentrABSht2Bat m31 : 17|1@1+ (1,0) [0|1] "" Vector__XXX
 SG_ RCM_a031_frntCentrABOpen m31 : 18|1@1+ (1,0) [0|1] "" Vector__XXX
 SG_ RCM_a031_frntCentrABShort m31 : 19|1@1+ (1,0) [0|1] "" Vector__XXX
 SG_ RCM_a031_frntCentrABCrossCoup m31 : 20|1@1+ (1,0) [0|1] "" Vector__XXX
 SG_ RCM_a031_frntCentrABConfig m31 : 21|1@1+ (1,0) [0|1] "" Vector__XXX
 SG_ RCM_a031_eventIDFsignal m31 : 25|1@1+ (1,0) [0|1] "" Vector__XXX
 SG_ RCM_a031_eventFrontLeftSeatbelt m31 : 26|1@1+ (1,0) [0|1] "" Vector__XXX
 SG_ RCM_a031_eventFrontRightSeatbelt m31 : 27|1@1+ (1,0) [0|1] "" Vector__XXX
 SG_ RCM_a031_eventVehicleSpeed m31 : 28|12@1+ (0.08,-40) [-40|287.6] "kph" Vector__XXX
 SG_ RCM_a031_eventSteeringAngle m31 : 45|14@0+ (0.1,-819.2) [-819.2|819.1] "deg" Vector__XXX
 SG_ RCM_a031_eventDriverBrakeApply m31 : 46|2@1+ (1,0) [0|2] "" Vector__XXX
 SG_ RCM_a031_eventAccelPedalPos m31 : 56|8@1+ (0.4,0) [0|101.6] "%" Vector__XXX
 SG_ RCM_a032_eventArmStatus m32 : 11|1@1+ (1,0) [0|1] "" Vector__XXX
 SG_ RCM_a032_eventFactoryMode m32 : 12|1@1+ (1,0) [0|1] "" Vector__XXX
 SG_ RCM_a032_eventDiagEnabled m32 : 13|1@1+ (1,0) [0|1] "" Vector__XXX
 SG_ RCM_a032_eventDriveOrientation m32 : 14|1@1+ (1,0) [0|1] "" Vector__XXX
 SG_ RCM_a032_curABLeftSht2Gnd m32 : 16|1@1+ (1,0) [0|1] "" Vector__XXX
 SG_ RCM_a032_curABLeftSht2Bat m32 : 17|1@1+ (1,0) [0|1] "" Vector__XXX
 SG_ RCM_a032_curABLeftOpen m32 : 18|1@1+ (1,0) [0|1] "" Vector__XXX
 SG_ RCM_a032_curABLeftShort m32 : 19|1@1+ (1,0) [0|1] "" Vector__XXX
 SG_ RCM_a032_curABLeftCrossCoup m32 : 20|1@1+ (1,0) [0|1] "" Vector__XXX
 SG_ RCM_a032_curABLeftConfig m32 : 21|1@1+ (1,0) [0|1] "" Vector__XXX
 SG_ RCM_a032_eventIDFsignal m32 : 25|1@1+ (1,0) [0|1] "" Vector__XXX
 SG_ RCM_a032_eventFrontLeftSeatbelt m32 : 26|1@1+ (1,0) [0|1] "" Vector__XXX
 SG_ RCM_a032_eventFrontRightSeatbelt m32 : 27|1@1+ (1,0) [0|1] "" Vector__XXX
 SG_ RCM_a032_eventVehicleSpeed m32 : 28|12@1+ (0.08,-40) [-40|287.6] "kph" Vector__XXX
 SG_ RCM_a032_eventSteeringAngle m32 : 45|14@0+ (0.1,-819.2) [-819.2|819.1] "deg" Vector__XXX
 SG_ RCM_a032_eventDriverBrakeApply m32 : 46|2@1+ (1,0) [0|2] "" Vector__XXX
 SG_ RCM_a032_eventAccelPedalPos m32 : 56|8@1+ (0.4,0) [0|101.6] "%" Vector__XXX
 SG_ RCM_a033_eventArmStatus m33 : 11|1@1+ (1,0) [0|1] "" Vector__XXX
 SG_ RCM_a033_eventFactoryMode m33 : 12|1@1+ (1,0) [0|1] "" Vector__XXX
 SG_ RCM_a033_eventDiagEnabled m33 : 13|1@1+ (1,0) [0|1] "" Vector__XXX
 SG_ RCM_a033_eventDriveOrientation m33 : 14|1@1+ (1,0) [0|1] "" Vector__XXX
 SG_ RCM_a033_curABRightSht2Gnd m33 : 16|1@1+ (1,0) [0|1] "" Vector__XXX
 SG_ RCM_a033_curABRightSht2Bat m33 : 17|1@1+ (1,0) [0|1] "" Vector__XXX
 SG_ RCM_a033_curABRightOpen m33 : 18|1@1+ (1,0) [0|1] "" Vector__XXX
 SG_ RCM_a033_curABRightShort m33 : 19|1@1+ (1,0) [0|1] "" Vector__XXX
 SG_ RCM_a033_curABRightCrossCoup m33 : 20|1@1+ (1,0) [0|1] "" Vector__XXX
 SG_ RCM_a033_curABRightConfig m33 : 21|1@1+ (1,0) [0|1] "" Vector__XXX
 SG_ RCM_a033_eventIDFsignal m33 : 25|1@1+ (1,0) [0|1] "" Vector__XXX
 SG_ RCM_a033_eventFrontLeftSeatbelt m33 : 26|1@1+ (1,0) [0|1] "" Vector__XXX
 SG_ RCM_a033_eventFrontRightSeatbelt m33 : 27|1@1+ (1,0) [0|1] "" Vector__XXX
 SG_ RCM_a033_eventVehicleSpeed m33 : 28|12@1+ (0.08,-40) [-40|287.6] "kph" Vector__XXX
 SG_ RCM_a033_eventSteeringAngle m33 : 45|14@0+ (0.1,-819.2) [-819.2|819.1] "deg" Vector__XXX
 SG_ RCM_a033_eventDriverBrakeApply m33 : 46|2@1+ (1,0) [0|2] "" Vector__XXX
 SG_ RCM_a033_eventAccelPedalPos m33 : 56|8@1+ (0.4,0) [0|101.6] "%" Vector__XXX
 SG_ RCM_a034_eventArmStatus m34 : 11|1@1+ (1,0) [0|1] "" Vector__XXX
 SG_ RCM_a034_eventFactoryMode m34 : 12|1@1+ (1,0) [0|1] "" Vector__XXX
 SG_ RCM_a034_eventDiagEnabled m34 : 13|1@1+ (1,0) [0|1] "" Vector__XXX
 SG_ RCM_a034_eventDriveOrientation m34 : 14|1@1+ (1,0) [0|1] "" Vector__XXX
 SG_ RCM_a034_preten2ndRowLSht2Gnd m34 : 16|1@1+ (1,0) [0|1] "" Vector__XXX
 SG_ RCM_a034_preten2ndRowLSht2Bat m34 : 17|1@1+ (1,0) [0|1] "" Vector__XXX
 SG_ RCM_a034_preten2ndRowLOpen m34 : 18|1@1+ (1,0) [0|1] "" Vector__XXX
 SG_ RCM_a034_preten2ndRowLShort m34 : 19|1@1+ (1,0) [0|1] "" Vector__XXX
 SG_ RCM_a034_preten2ndRowLCrossCoup m34 : 20|1@1+ (1,0) [0|1] "" Vector__XXX
 SG_ RCM_a034_preten2ndRowLCgf m34 : 21|1@1+ (1,0) [0|1] "" Vector__XXX
 SG_ RCM_a034_eventIDFsignal m34 : 25|1@1+ (1,0) [0|1] "" Vector__XXX
 SG_ RCM_a034_eventFrontLeftSeatbelt m34 : 26|1@1+ (1,0) [0|1] "" Vector__XXX
 SG_ RCM_a034_eventFrontRightSeatbelt m34 : 27|1@1+ (1,0) [0|1] "" Vector__XXX
 SG_ RCM_a034_eventVehicleSpeed m34 : 28|12@1+ (0.08,-40) [-40|287.6] "kph" Vector__XXX
 SG_ RCM_a034_eventSteeringAngle m34 : 45|14@0+ (0.1,-819.2) [-819.2|819.1] "deg" Vector__XXX
 SG_ RCM_a034_eventDriverBrakeApply m34 : 46|2@1+ (1,0) [0|2] "" Vector__XXX
 SG_ RCM_a034_eventAccelPedalPos m34 : 56|8@1+ (0.4,0) [0|101.6] "%" Vector__XXX
 SG_ RCM_a035_eventArmStatus m35 : 11|1@1+ (1,0) [0|1] "" Vector__XXX
 SG_ RCM_a035_eventFactoryMode m35 : 12|1@1+ (1,0) [0|1] "" Vector__XXX
 SG_ RCM_a035_eventDiagEnabled m35 : 13|1@1+ (1,0) [0|1] "" Vector__XXX
 SG_ RCM_a035_eventDriveOrientation m35 : 14|1@1+ (1,0) [0|1] "" Vector__XXX
 SG_ RCM_a035_preten2ndRowRSht2Gnd m35 : 16|1@1+ (1,0) [0|1] "" Vector__XXX
 SG_ RCM_a035_preten2ndRowRSht2Bat m35 : 17|1@1+ (1,0) [0|1] "" Vector__XXX
 SG_ RCM_a035_preten2ndRowROpen m35 : 18|1@1+ (1,0) [0|1] "" Vector__XXX
 SG_ RCM_a035_preten2ndRowRShort m35 : 19|1@1+ (1,0) [0|1] "" Vector__XXX
 SG_ RCM_a035_preten2ndRowRCrossCoup m35 : 20|1@1+ (1,0) [0|1] "" Vector__XXX
 SG_ RCM_a035_preten2ndRowRCgf m35 : 21|1@1+ (1,0) [0|1] "" Vector__XXX
 SG_ RCM_a035_eventIDFsignal m35 : 25|1@1+ (1,0) [0|1] "" Vector__XXX
 SG_ RCM_a035_eventFrontLeftSeatbelt m35 : 26|1@1+ (1,0) [0|1] "" Vector__XXX
 SG_ RCM_a035_eventFrontRightSeatbelt m35 : 27|1@1+ (1,0) [0|1] "" Vector__XXX
 SG_ RCM_a035_eventVehicleSpeed m35 : 28|12@1+ (0.08,-40) [-40|287.6] "kph" Vector__XXX
 SG_ RCM_a035_eventSteeringAngle m35 : 45|14@0+ (0.1,-819.2) [-819.2|819.1] "deg" Vector__XXX
 SG_ RCM_a035_eventDriverBrakeApply m35 : 46|2@1+ (1,0) [0|2] "" Vector__XXX
 SG_ RCM_a035_eventAccelPedalPos m35 : 56|8@1+ (0.4,0) [0|101.6] "%" Vector__XXX
 SG_ RCM_a036_eventArmStatus m36 : 11|1@1+ (1,0) [0|1] "" Vector__XXX
 SG_ RCM_a036_eventFactoryMode m36 : 12|1@1+ (1,0) [0|1] "" Vector__XXX
 SG_ RCM_a036_eventDiagEnabled m36 : 13|1@1+ (1,0) [0|1] "" Vector__XXX
 SG_ RCM_a036_eventDriveOrientation m36 : 14|1@1+ (1,0) [0|1] "" Vector__XXX
 SG_ RCM_a036_curAB2ndRowLSht2Gnd m36 : 16|1@1+ (1,0) [0|1] "" Vector__XXX
 SG_ RCM_a036_curAB2ndRowLSht2Bat m36 : 17|1@1+ (1,0) [0|1] "" Vector__XXX
 SG_ RCM_a036_curAB2ndRowLOpen m36 : 18|1@1+ (1,0) [0|1] "" Vector__XXX
 SG_ RCM_a036_curAB2ndRowLShort m36 : 19|1@1+ (1,0) [0|1] "" Vector__XXX
 SG_ RCM_a036_curAB2ndRowLCrossCoup m36 : 20|1@1+ (1,0) [0|1] "" Vector__XXX
 SG_ RCM_a036_curAB2ndRowLConfig m36 : 21|1@1+ (1,0) [0|1] "" Vector__XXX
 SG_ RCM_a036_eventIDFsignal m36 : 25|1@1+ (1,0) [0|1] "" Vector__XXX
 SG_ RCM_a036_eventFrontLeftSeatbelt m36 : 26|1@1+ (1,0) [0|1] "" Vector__XXX
 SG_ RCM_a036_eventFrontRightSeatbelt m36 : 27|1@1+ (1,0) [0|1] "" Vector__XXX
 SG_ RCM_a036_eventVehicleSpeed m36 : 28|12@1+ (0.08,-40) [-40|287.6] "kph" Vector__XXX
 SG_ RCM_a036_eventSteeringAngle m36 : 45|14@0+ (0.1,-819.2) [-819.2|819.1] "deg" Vector__XXX
 SG_ RCM_a036_eventDriverBrakeApply m36 : 46|2@1+ (1,0) [0|2] "" Vector__XXX
 SG_ RCM_a036_eventAccelPedalPos m36 : 56|8@1+ (0.4,0) [0|101.6] "%" Vector__XXX
 SG_ RCM_a037_eventArmStatus m37 : 11|1@1+ (1,0) [0|1] "" Vector__XXX
 SG_ RCM_a037_eventFactoryMode m37 : 12|1@1+ (1,0) [0|1] "" Vector__XXX
 SG_ RCM_a037_eventDiagEnabled m37 : 13|1@1+ (1,0) [0|1] "" Vector__XXX
 SG_ RCM_a037_eventDriveOrientation m37 : 14|1@1+ (1,0) [0|1] "" Vector__XXX
 SG_ RCM_a037_curAB2ndRowRSht2Gnd m37 : 16|1@1+ (1,0) [0|1] "" Vector__XXX
 SG_ RCM_a037_curAB2ndRowRSht2Bat m37 : 17|1@1+ (1,0) [0|1] "" Vector__XXX
 SG_ RCM_a037_curAB2ndRowROpen m37 : 18|1@1+ (1,0) [0|1] "" Vector__XXX
 SG_ RCM_a037_curAB2ndRowRShort m37 : 19|1@1+ (1,0) [0|1] "" Vector__XXX
 SG_ RCM_a037_curAB2ndRowRCrossCoup m37 : 20|1@1+ (1,0) [0|1] "" Vector__XXX
 SG_ RCM_a037_curAB2ndRowRConfig m37 : 21|1@1+ (1,0) [0|1] "" Vector__XXX
 SG_ RCM_a037_eventIDFsignal m37 : 25|1@1+ (1,0) [0|1] "" Vector__XXX
 SG_ RCM_a037_eventFrontLeftSeatbelt m37 : 26|1@1+ (1,0) [0|1] "" Vector__XXX
 SG_ RCM_a037_eventFrontRightSeatbelt m37 : 27|1@1+ (1,0) [0|1] "" Vector__XXX
 SG_ RCM_a037_eventVehicleSpeed m37 : 28|12@1+ (0.08,-40) [-40|287.6] "kph" Vector__XXX
 SG_ RCM_a037_eventSteeringAngle m37 : 45|14@0+ (0.1,-819.2) [-819.2|819.1] "deg" Vector__XXX
 SG_ RCM_a037_eventDriverBrakeApply m37 : 46|2@1+ (1,0) [0|2] "" Vector__XXX
 SG_ RCM_a037_eventAccelPedalPos m37 : 56|8@1+ (0.4,0) [0|101.6] "%" Vector__XXX
 SG_ RCM_a040_eventArmStatus m40 : 11|1@1+ (1,0) [0|1] "" Vector__XXX
 SG_ RCM_a040_eventFactoryMode m40 : 12|1@1+ (1,0) [0|1] "" Vector__XXX
 SG_ RCM_a040_eventDiagEnabled m40 : 13|1@1+ (1,0) [0|1] "" Vector__XXX
 SG_ RCM_a040_eventDriveOrientation m40 : 14|1@1+ (1,0) [0|1] "" Vector__XXX
 SG_ RCM_a040_hoodActuatorRSht2Gnd m40 : 16|1@1+ (1,0) [0|1] "" Vector__XXX
 SG_ RCM_a040_hoodActuatorRSht2Bat m40 : 17|1@1+ (1,0) [0|1] "" Vector__XXX
 SG_ RCM_a040_hoodActuatorROpen m40 : 18|1@1+ (1,0) [0|1] "" Vector__XXX
 SG_ RCM_a040_hoodActuatorRShort m40 : 19|1@1+ (1,0) [0|1] "" Vector__XXX
 SG_ RCM_a040_hoodActuatorRCrossCoup m40 : 20|1@1+ (1,0) [0|1] "" Vector__XXX
 SG_ RCM_a040_hoodActuatorRConfig m40 : 21|1@1+ (1,0) [0|1] "" Vector__XXX
 SG_ RCM_a040_eventIDFsignal m40 : 25|1@1+ (1,0) [0|1] "" Vector__XXX
 SG_ RCM_a040_eventFrontLeftSeatbelt m40 : 26|1@1+ (1,0) [0|1] "" Vector__XXX
 SG_ RCM_a040_eventFrontRightSeatbelt m40 : 27|1@1+ (1,0) [0|1] "" Vector__XXX
 SG_ RCM_a040_eventVehicleSpeed m40 : 28|12@1+ (0.08,-40) [-40|287.6] "kph" Vector__XXX
 SG_ RCM_a040_eventSteeringAngle m40 : 45|14@0+ (0.1,-819.2) [-819.2|819.1] "deg" Vector__XXX
 SG_ RCM_a040_eventDriverBrakeApply m40 : 46|2@1+ (1,0) [0|2] "" Vector__XXX
 SG_ RCM_a040_eventAccelPedalPos m40 : 56|8@1+ (0.4,0) [0|101.6] "%" Vector__XXX
 SG_ RCM_a041_eventArmStatus m41 : 11|1@1+ (1,0) [0|1] "" Vector__XXX
 SG_ RCM_a041_eventFactoryMode m41 : 12|1@1+ (1,0) [0|1] "" Vector__XXX
 SG_ RCM_a041_eventDiagEnabled m41 : 13|1@1+ (1,0) [0|1] "" Vector__XXX
 SG_ RCM_a041_eventDriveOrientation m41 : 14|1@1+ (1,0) [0|1] "" Vector__XXX
 SG_ RCM_a041_hoodActuatorLSht2Gnd m41 : 16|1@1+ (1,0) [0|1] "" Vector__XXX
 SG_ RCM_a041_hoodActuatorLSht2Bat m41 : 17|1@1+ (1,0) [0|1] "" Vector__XXX
 SG_ RCM_a041_hoodActuatorLOpen m41 : 18|1@1+ (1,0) [0|1] "" Vector__XXX
 SG_ RCM_a041_hoodActuatorLShort m41 : 19|1@1+ (1,0) [0|1] "" Vector__XXX
 SG_ RCM_a041_hoodActuatorLCrossCoup m41 : 20|1@1+ (1,0) [0|1] "" Vector__XXX
 SG_ RCM_a041_hoodActuatorLConfig m41 : 21|1@1+ (1,0) [0|1] "" Vector__XXX
 SG_ RCM_a041_eventIDFsignal m41 : 25|1@1+ (1,0) [0|1] "" Vector__XXX
 SG_ RCM_a041_eventFrontLeftSeatbelt m41 : 26|1@1+ (1,0) [0|1] "" Vector__XXX
 SG_ RCM_a041_eventFrontRightSeatbelt m41 : 27|1@1+ (1,0) [0|1] "" Vector__XXX
 SG_ RCM_a041_eventVehicleSpeed m41 : 28|12@1+ (0.08,-40) [-40|287.6] "kph" Vector__XXX
 SG_ RCM_a041_eventSteeringAngle m41 : 45|14@0+ (0.1,-819.2) [-819.2|819.1] "deg" Vector__XXX
 SG_ RCM_a041_eventDriverBrakeApply m41 : 46|2@1+ (1,0) [0|2] "" Vector__XXX
 SG_ RCM_a041_eventAccelPedalPos m41 : 56|8@1+ (0.4,0) [0|101.6] "%" Vector__XXX
 SG_ RCM_a042_eventArmStatus m42 : 11|1@1+ (1,0) [0|1] "" Vector__XXX
 SG_ RCM_a042_eventFactoryMode m42 : 12|1@1+ (1,0) [0|1] "" Vector__XXX
 SG_ RCM_a042_eventDiagEnabled m42 : 13|1@1+ (1,0) [0|1] "" Vector__XXX
 SG_ RCM_a042_eventDriveOrientation m42 : 14|1@1+ (1,0) [0|1] "" Vector__XXX
 SG_ RCM_a042_ens1Sht2Bat m42 : 16|1@1+ (1,0) [0|1] "" Vector__XXX
 SG_ RCM_a042_ens1Sht2Gnd m42 : 17|1@1+ (1,0) [0|1] "" Vector__XXX
 SG_ RCM_a042_ens1Config m42 : 18|1@1+ (1,0) [0|1] "" Vector__XXX
 SG_ RCM_a042_eventIDFsignal m42 : 25|1@1+ (1,0) [0|1] "" Vector__XXX
 SG_ RCM_a042_eventFrontLeftSeatbelt m42 : 26|1@1+ (1,0) [0|1] "" Vector__XXX
 SG_ RCM_a042_eventFrontRightSeatbelt m42 : 27|1@1+ (1,0) [0|1] "" Vector__XXX
 SG_ RCM_a042_eventVehicleSpeed m42 : 28|12@1+ (0.08,-40) [-40|287.6] "kph" Vector__XXX
 SG_ RCM_a042_eventSteeringAngle m42 : 45|14@0+ (0.1,-819.2) [-819.2|819.1] "deg" Vector__XXX
 SG_ RCM_a042_eventDriverBrakeApply m42 : 46|2@1+ (1,0) [0|2] "" Vector__XXX
 SG_ RCM_a042_eventAccelPedalPos m42 : 56|8@1+ (0.4,0) [0|101.6] "%" Vector__XXX
 SG_ RCM_a043_eventArmStatus m43 : 11|1@1+ (1,0) [0|1] "" Vector__XXX
 SG_ RCM_a043_eventFactoryMode m43 : 12|1@1+ (1,0) [0|1] "" Vector__XXX
 SG_ RCM_a043_eventDiagEnabled m43 : 13|1@1+ (1,0) [0|1] "" Vector__XXX
 SG_ RCM_a043_eventDriveOrientation m43 : 14|1@1+ (1,0) [0|1] "" Vector__XXX
 SG_ RCM_a043_ens2Sht2Bat m43 : 16|1@1+ (1,0) [0|1] "" Vector__XXX
 SG_ RCM_a043_ens2Sht2Gnd m43 : 17|1@1+ (1,0) [0|1] "" Vector__XXX
 SG_ RCM_a043_ens2Config m43 : 18|1@1+ (1,0) [0|1] "" Vector__XXX
 SG_ RCM_a043_eventIDFsignal m43 : 25|1@1+ (1,0) [0|1] "" Vector__XXX
 SG_ RCM_a043_eventFrontLeftSeatbelt m43 : 26|1@1+ (1,0) [0|1] "" Vector__XXX
 SG_ RCM_a043_eventFrontRightSeatbelt m43 : 27|1@1+ (1,0) [0|1] "" Vector__XXX
 SG_ RCM_a043_eventVehicleSpeed m43 : 28|12@1+ (0.08,-40) [-40|287.6] "kph" Vector__XXX
 SG_ RCM_a043_eventSteeringAngle m43 : 45|14@0+ (0.1,-819.2) [-819.2|819.1] "deg" Vector__XXX
 SG_ RCM_a043_eventDriverBrakeApply m43 : 46|2@1+ (1,0) [0|2] "" Vector__XXX
 SG_ RCM_a043_eventAccelPedalPos m43 : 56|8@1+ (0.4,0) [0|101.6] "%" Vector__XXX
 SG_ RCM_a044_eventArmStatus m44 : 11|1@1+ (1,0) [0|1] "" Vector__XXX
 SG_ RCM_a044_eventFactoryMode m44 : 12|1@1+ (1,0) [0|1] "" Vector__XXX
 SG_ RCM_a044_eventDiagEnabled m44 : 13|1@1+ (1,0) [0|1] "" Vector__XXX
 SG_ RCM_a044_eventDriveOrientation m44 : 14|1@1+ (1,0) [0|1] "" Vector__XXX
 SG_ RCM_a044_upFrontSensorLSht2Gnd m44 : 16|1@1+ (1,0) [0|1] "" Vector__XXX
 SG_ RCM_a044_upFrontSensorLSht2Bat m44 : 17|1@1+ (1,0) [0|1] "" Vector__XXX
 SG_ RCM_a044_upFrontSensorLCrossCoup m44 : 18|1@1+ (1,0) [0|1] "" Vector__XXX
 SG_ RCM_a044_upFrontSensorLComm m44 : 19|1@1+ (1,0) [0|1] "" Vector__XXX
 SG_ RCM_a044_upFrontSensorLInitTyp m44 : 20|1@1+ (1,0) [0|1] "" Vector__XXX
 SG_ RCM_a044_upFrontSensorLOption m44 : 21|1@1+ (1,0) [0|1] "" Vector__XXX
 SG_ RCM_a044_upFrontSensorLplaus m44 : 22|1@1+ (1,0) [0|1] "" Vector__XXX
 SG_ RCM_a044_upFrontSensorLDefect m44 : 23|1@1+ (1,0) [0|1] "" Vector__XXX
 SG_ RCM_a044_eventIDFsignal m44 : 25|1@1+ (1,0) [0|1] "" Vector__XXX
 SG_ RCM_a044_eventFrontLeftSeatbelt m44 : 26|1@1+ (1,0) [0|1] "" Vector__XXX
 SG_ RCM_a044_eventFrontRightSeatbelt m44 : 27|1@1+ (1,0) [0|1] "" Vector__XXX
 SG_ RCM_a044_eventVehicleSpeed m44 : 28|12@1+ (0.08,-40) [-40|287.6] "kph" Vector__XXX
 SG_ RCM_a044_eventSteeringAngle m44 : 45|14@0+ (0.1,-819.2) [-819.2|819.1] "deg" Vector__XXX
 SG_ RCM_a044_eventDriverBrakeApply m44 : 46|2@1+ (1,0) [0|2] "" Vector__XXX
 SG_ RCM_a044_eventAccelPedalPos m44 : 56|8@1+ (0.4,0) [0|101.6] "%" Vector__XXX
 SG_ RCM_a045_eventArmStatus m45 : 11|1@1+ (1,0) [0|1] "" Vector__XXX
 SG_ RCM_a045_eventFactoryMode m45 : 12|1@1+ (1,0) [0|1] "" Vector__XXX
 SG_ RCM_a045_eventDiagEnabled m45 : 13|1@1+ (1,0) [0|1] "" Vector__XXX
 SG_ RCM_a045_eventDriveOrientation m45 : 14|1@1+ (1,0) [0|1] "" Vector__XXX
 SG_ RCM_a045_upFrontSensorRSht2Gnd m45 : 16|1@1+ (1,0) [0|1] "" Vector__XXX
 SG_ RCM_a045_upFrontSensorRSht2Bat m45 : 17|1@1+ (1,0) [0|1] "" Vector__XXX
 SG_ RCM_a045_upFrontSensorRCrossCoup m45 : 18|1@1+ (1,0) [0|1] "" Vector__XXX
 SG_ RCM_a045_upFrontSensorRComm m45 : 19|1@1+ (1,0) [0|1] "" Vector__XXX
 SG_ RCM_a045_upFrontSensorRInitTyp m45 : 20|1@1+ (1,0) [0|1] "" Vector__XXX
 SG_ RCM_a045_upFrontSensorROption m45 : 21|1@1+ (1,0) [0|1] "" Vector__XXX
 SG_ RCM_a045_upFrontSensorRplaus m45 : 22|1@1+ (1,0) [0|1] "" Vector__XXX
 SG_ RCM_a045_upFrontSensorRDefect m45 : 23|1@1+ (1,0) [0|1] "" Vector__XXX
 SG_ RCM_a045_eventIDFsignal m45 : 25|1@1+ (1,0) [0|1] "" Vector__XXX
 SG_ RCM_a045_eventFrontLeftSeatbelt m45 : 26|1@1+ (1,0) [0|1] "" Vector__XXX
 SG_ RCM_a045_eventFrontRightSeatbelt m45 : 27|1@1+ (1,0) [0|1] "" Vector__XXX
 SG_ RCM_a045_eventVehicleSpeed m45 : 28|12@1+ (0.08,-40) [-40|287.6] "kph" Vector__XXX
 SG_ RCM_a045_eventSteeringAngle m45 : 45|14@0+ (0.1,-819.2) [-819.2|819.1] "deg" Vector__XXX
 SG_ RCM_a045_eventDriverBrakeApply m45 : 46|2@1+ (1,0) [0|2] "" Vector__XXX
 SG_ RCM_a045_eventAccelPedalPos m45 : 56|8@1+ (0.4,0) [0|101.6] "%" Vector__XXX
 SG_ RCM_a046_eventArmStatus m46 : 11|1@1+ (1,0) [0|1] "" Vector__XXX
 SG_ RCM_a046_eventFactoryMode m46 : 12|1@1+ (1,0) [0|1] "" Vector__XXX
 SG_ RCM_a046_eventDiagEnabled m46 : 13|1@1+ (1,0) [0|1] "" Vector__XXX
 SG_ RCM_a046_eventDriveOrientation m46 : 14|1@1+ (1,0) [0|1] "" Vector__XXX
 SG_ RCM_a046_sideAccelBPilLSht2Gnd m46 : 16|1@1+ (1,0) [0|1] "" Vector__XXX
 SG_ RCM_a046_sideAccelBPilLSht2Bat m46 : 17|1@1+ (1,0) [0|1] "" Vector__XXX
 SG_ RCM_a046_sideAccelBPilLCLosCoup m46 : 18|1@1+ (1,0) [0|1] "" Vector__XXX
 SG_ RCM_a046_sideAccelBPilLComm m46 : 19|1@1+ (1,0) [0|1] "" Vector__XXX
 SG_ RCM_a046_sideAccelBPilLInitTyp m46 : 20|1@1+ (1,0) [0|1] "" Vector__XXX
 SG_ RCM_a046_sideAccelBPilLOption m46 : 21|1@1+ (1,0) [0|1] "" Vector__XXX
 SG_ RCM_a046_sideAccelBPilLplaus m46 : 22|1@1+ (1,0) [0|1] "" Vector__XXX
 SG_ RCM_a046_sideAccelBPilLDefect m46 : 23|1@1+ (1,0) [0|1] "" Vector__XXX
 SG_ RCM_a046_eventIDFsignal m46 : 25|1@1+ (1,0) [0|1] "" Vector__XXX
 SG_ RCM_a046_eventFrontLeftSeatbelt m46 : 26|1@1+ (1,0) [0|1] "" Vector__XXX
 SG_ RCM_a046_eventFrontRightSeatbelt m46 : 27|1@1+ (1,0) [0|1] "" Vector__XXX
 SG_ RCM_a046_eventVehicleSpeed m46 : 28|12@1+ (0.08,-40) [-40|287.6] "kph" Vector__XXX
 SG_ RCM_a046_eventSteeringAngle m46 : 45|14@0+ (0.1,-819.2) [-819.2|819.1] "deg" Vector__XXX
 SG_ RCM_a046_eventDriverBrakeApply m46 : 46|2@1+ (1,0) [0|2] "" Vector__XXX
 SG_ RCM_a046_eventAccelPedalPos m46 : 56|8@1+ (0.4,0) [0|101.6] "%" Vector__XXX
 SG_ RCM_a047_eventArmStatus m47 : 11|1@1+ (1,0) [0|1] "" Vector__XXX
 SG_ RCM_a047_eventFactoryMode m47 : 12|1@1+ (1,0) [0|1] "" Vector__XXX
 SG_ RCM_a047_eventDiagEnabled m47 : 13|1@1+ (1,0) [0|1] "" Vector__XXX
 SG_ RCM_a047_eventDriveOrientation m47 : 14|1@1+ (1,0) [0|1] "" Vector__XXX
 SG_ RCM_a047_sideAccelBPilRSht2Gnd m47 : 16|1@1+ (1,0) [0|1] "" Vector__XXX
 SG_ RCM_a047_sideAccelBPilRSht2Bat m47 : 17|1@1+ (1,0) [0|1] "" Vector__XXX
 SG_ RCM_a047_sideAccelBPilRCrossCoup m47 : 18|1@1+ (1,0) [0|1] "" Vector__XXX
 SG_ RCM_a047_sideAccelBPilRComm m47 : 19|1@1+ (1,0) [0|1] "" Vector__XXX
 SG_ RCM_a047_sideAccelBPilRInitTyp m47 : 20|1@1+ (1,0) [0|1] "" Vector__XXX
 SG_ RCM_a047_sideAccelBPilROption m47 : 21|1@1+ (1,0) [0|1] "" Vector__XXX
 SG_ RCM_a047_sideAccelBPilRplaus m47 : 22|1@1+ (1,0) [0|1] "" Vector__XXX
 SG_ RCM_a047_sideAccelBPilRDefect m47 : 23|1@1+ (1,0) [0|1] "" Vector__XXX
 SG_ RCM_a047_eventIDFsignal m47 : 25|1@1+ (1,0) [0|1] "" Vector__XXX
 SG_ RCM_a047_eventFrontLeftSeatbelt m47 : 26|1@1+ (1,0) [0|1] "" Vector__XXX
 SG_ RCM_a047_eventFrontRightSeatbelt m47 : 27|1@1+ (1,0) [0|1] "" Vector__XXX
 SG_ RCM_a047_eventVehicleSpeed m47 : 28|12@1+ (0.08,-40) [-40|287.6] "kph" Vector__XXX
 SG_ RCM_a047_eventSteeringAngle m47 : 45|14@0+ (0.1,-819.2) [-819.2|819.1] "deg" Vector__XXX
 SG_ RCM_a047_eventDriverBrakeApply m47 : 46|2@1+ (1,0) [0|2] "" Vector__XXX
 SG_ RCM_a047_eventAccelPedalPos m47 : 56|8@1+ (0.4,0) [0|101.6] "%" Vector__XXX
 SG_ RCM_a048_eventArmStatus m48 : 11|1@1+ (1,0) [0|1] "" Vector__XXX
 SG_ RCM_a048_eventFactoryMode m48 : 12|1@1+ (1,0) [0|1] "" Vector__XXX
 SG_ RCM_a048_eventDiagEnabled m48 : 13|1@1+ (1,0) [0|1] "" Vector__XXX
 SG_ RCM_a048_eventDriveOrientation m48 : 14|1@1+ (1,0) [0|1] "" Vector__XXX
 SG_ RCM_a048_sideAccelCPilLSht2Gnd m48 : 16|1@1+ (1,0) [0|1] "" Vector__XXX
 SG_ RCM_a048_sideAccelCPilLSht2Bat m48 : 17|1@1+ (1,0) [0|1] "" Vector__XXX
 SG_ RCM_a048_sideAccelCPilLCrossCoup m48 : 18|1@1+ (1,0) [0|1] "" Vector__XXX
 SG_ RCM_a048_sideAccelCPilLComm m48 : 19|1@1+ (1,0) [0|1] "" Vector__XXX
 SG_ RCM_a048_sideAccelCPilLInitTyp m48 : 20|1@1+ (1,0) [0|1] "" Vector__XXX
 SG_ RCM_a048_sideAccelCPilLOption m48 : 21|1@1+ (1,0) [0|1] "" Vector__XXX
 SG_ RCM_a048_sideAccelCPilLplaus m48 : 22|1@1+ (1,0) [0|1] "" Vector__XXX
 SG_ RCM_a048_sideAccelCPilLDefect m48 : 23|1@1+ (1,0) [0|1] "" Vector__XXX
 SG_ RCM_a048_eventIDFsignal m48 : 25|1@1+ (1,0) [0|1] "" Vector__XXX
 SG_ RCM_a048_eventFrontLeftSeatbelt m48 : 26|1@1+ (1,0) [0|1] "" Vector__XXX
 SG_ RCM_a048_eventFrontRightSeatbelt m48 : 27|1@1+ (1,0) [0|1] "" Vector__XXX
 SG_ RCM_a048_eventVehicleSpeed m48 : 28|12@1+ (0.08,-40) [-40|287.6] "kph" Vector__XXX
 SG_ RCM_a048_eventSteeringAngle m48 : 45|14@0+ (0.1,-819.2) [-819.2|819.1] "deg" Vector__XXX
 SG_ RCM_a048_eventDriverBrakeApply m48 : 46|2@1+ (1,0) [0|2] "" Vector__XXX
 SG_ RCM_a048_eventAccelPedalPos m48 : 56|8@1+ (0.4,0) [0|101.6] "%" Vector__XXX
 SG_ RCM_a049_eventArmStatus m49 : 11|1@1+ (1,0) [0|1] "" Vector__XXX
 SG_ RCM_a049_eventFactoryMode m49 : 12|1@1+ (1,0) [0|1] "" Vector__XXX
 SG_ RCM_a049_eventDiagEnabled m49 : 13|1@1+ (1,0) [0|1] "" Vector__XXX
 SG_ RCM_a049_eventDriveOrientation m49 : 14|1@1+ (1,0) [0|1] "" Vector__XXX
 SG_ RCM_a049_sideAccelCPilRSht2Gnd m49 : 16|1@1+ (1,0) [0|1] "" Vector__XXX
 SG_ RCM_a049_sideAccelCPilRSht2Bat m49 : 17|1@1+ (1,0) [0|1] "" Vector__XXX
 SG_ RCM_a049_sideAccelCPilRCrossCoup m49 : 18|1@1+ (1,0) [0|1] "" Vector__XXX
 SG_ RCM_a049_sideAccelCPilRComm m49 : 19|1@1+ (1,0) [0|1] "" Vector__XXX
 SG_ RCM_a049_sideAccelCPilRInitTyp m49 : 20|1@1+ (1,0) [0|1] "" Vector__XXX
 SG_ RCM_a049_sideAccelCPilROption m49 : 21|1@1+ (1,0) [0|1] "" Vector__XXX
 SG_ RCM_a049_sideAccelCPilRplaus m49 : 22|1@1+ (1,0) [0|1] "" Vector__XXX
 SG_ RCM_a049_sideAccelCPilRDefect m49 : 23|1@1+ (1,0) [0|1] "" Vector__XXX
 SG_ RCM_a049_eventIDFsignal m49 : 25|1@1+ (1,0) [0|1] "" Vector__XXX
 SG_ RCM_a049_eventFrontLeftSeatbelt m49 : 26|1@1+ (1,0) [0|1] "" Vector__XXX
 SG_ RCM_a049_eventFrontRightSeatbelt m49 : 27|1@1+ (1,0) [0|1] "" Vector__XXX
 SG_ RCM_a049_eventVehicleSpeed m49 : 28|12@1+ (0.08,-40) [-40|287.6] "kph" Vector__XXX
 SG_ RCM_a049_eventSteeringAngle m49 : 45|14@0+ (0.1,-819.2) [-819.2|819.1] "deg" Vector__XXX
 SG_ RCM_a049_eventDriverBrakeApply m49 : 46|2@1+ (1,0) [0|2] "" Vector__XXX
 SG_ RCM_a049_eventAccelPedalPos m49 : 56|8@1+ (0.4,0) [0|101.6] "%" Vector__XXX
 SG_ RCM_a050_eventArmStatus m50 : 11|1@1+ (1,0) [0|1] "" Vector__XXX
 SG_ RCM_a050_eventFactoryMode m50 : 12|1@1+ (1,0) [0|1] "" Vector__XXX
 SG_ RCM_a050_eventDiagEnabled m50 : 13|1@1+ (1,0) [0|1] "" Vector__XXX
 SG_ RCM_a050_eventDriveOrientation m50 : 14|1@1+ (1,0) [0|1] "" Vector__XXX
 SG_ RCM_a050_upFrontSensorCSht2Gnd m50 : 16|1@1+ (1,0) [0|1] "" Vector__XXX
 SG_ RCM_a050_upFrontSensorCSht2Bat m50 : 17|1@1+ (1,0) [0|1] "" Vector__XXX
 SG_ RCM_a050_upFrontSensorCCrossCoup m50 : 18|1@1+ (1,0) [0|1] "" Vector__XXX
 SG_ RCM_a050_upFrontSensorCComm m50 : 19|1@1+ (1,0) [0|1] "" Vector__XXX
 SG_ RCM_a050_upFrontSensorCInitTyp m50 : 20|1@1+ (1,0) [0|1] "" Vector__XXX
 SG_ RCM_a050_upFrontSensorCOption m50 : 21|1@1+ (1,0) [0|1] "" Vector__XXX
 SG_ RCM_a050_upFrontSensorCplaus m50 : 22|1@1+ (1,0) [0|1] "" Vector__XXX
 SG_ RCM_a050_upFrontSensorCDefect m50 : 23|1@1+ (1,0) [0|1] "" Vector__XXX
 SG_ RCM_a050_eventIDFsignal m50 : 25|1@1+ (1,0) [0|1] "" Vector__XXX
 SG_ RCM_a050_eventFrontLeftSeatbelt m50 : 26|1@1+ (1,0) [0|1] "" Vector__XXX
 SG_ RCM_a050_eventFrontRightSeatbelt m50 : 27|1@1+ (1,0) [0|1] "" Vector__XXX
 SG_ RCM_a050_eventVehicleSpeed m50 : 28|12@1+ (0.08,-40) [-40|287.6] "kph" Vector__XXX
 SG_ RCM_a050_eventSteeringAngle m50 : 45|14@0+ (0.1,-819.2) [-819.2|819.1] "deg" Vector__XXX
 SG_ RCM_a050_eventDriverBrakeApply m50 : 46|2@1+ (1,0) [0|2] "" Vector__XXX
 SG_ RCM_a050_eventAccelPedalPos m50 : 56|8@1+ (0.4,0) [0|101.6] "%" Vector__XXX
 SG_ RCM_a051_eventArmStatus m51 : 11|1@1+ (1,0) [0|1] "" Vector__XXX
 SG_ RCM_a051_eventFactoryMode m51 : 12|1@1+ (1,0) [0|1] "" Vector__XXX
 SG_ RCM_a051_eventDiagEnabled m51 : 13|1@1+ (1,0) [0|1] "" Vector__XXX
 SG_ RCM_a051_eventDriveOrientation m51 : 14|1@1+ (1,0) [0|1] "" Vector__XXX
 SG_ RCM_a051_presFrntLDoorComm m51 : 16|1@1+ (1,0) [0|1] "" Vector__XXX
 SG_ RCM_a051_presFrntLDoorInitTyp m51 : 17|1@1+ (1,0) [0|1] "" Vector__XXX
 SG_ RCM_a051_presFrntLDoorOption m51 : 18|1@1+ (1,0) [0|1] "" Vector__XXX
 SG_ RCM_a051_presFrntLDoorPlaus m51 : 19|1@1+ (1,0) [0|1] "" Vector__XXX
 SG_ RCM_a051_presFrntLDoorAbsPre m51 : 20|1@1+ (1,0) [0|1] "" Vector__XXX
 SG_ RCM_a051_presFrntLDoorDefect m51 : 21|1@1+ (1,0) [0|1] "" Vector__XXX
 SG_ RCM_a051_presFrntLDoorSht2Gnd m51 : 22|1@1+ (1,0) [0|1] "" Vector__XXX
 SG_ RCM_a051_presFrntLDoorSht2Bat m51 : 23|1@1+ (1,0) [0|1] "" Vector__XXX
 SG_ RCM_a051_presFrntLDoorCrossCoup m51 : 24|1@1+ (1,0) [0|1] "" Vector__XXX
 SG_ RCM_a051_eventIDFsignal m51 : 25|1@1+ (1,0) [0|1] "" Vector__XXX
 SG_ RCM_a051_eventFrontLeftSeatbelt m51 : 26|1@1+ (1,0) [0|1] "" Vector__XXX
 SG_ RCM_a051_eventFrontRightSeatbelt m51 : 27|1@1+ (1,0) [0|1] "" Vector__XXX
 SG_ RCM_a051_eventVehicleSpeed m51 : 28|12@1+ (0.08,-40) [-40|287.6] "kph" Vector__XXX
 SG_ RCM_a051_eventSteeringAngle m51 : 45|14@0+ (0.1,-819.2) [-819.2|819.1] "deg" Vector__XXX
 SG_ RCM_a051_eventDriverBrakeApply m51 : 46|2@1+ (1,0) [0|2] "" Vector__XXX
 SG_ RCM_a051_eventAccelPedalPos m51 : 56|8@1+ (0.4,0) [0|101.6] "%" Vector__XXX
 SG_ RCM_a052_eventArmStatus m52 : 11|1@1+ (1,0) [0|1] "" Vector__XXX
 SG_ RCM_a052_eventFactoryMode m52 : 12|1@1+ (1,0) [0|1] "" Vector__XXX
 SG_ RCM_a052_eventDiagEnabled m52 : 13|1@1+ (1,0) [0|1] "" Vector__XXX
 SG_ RCM_a052_eventDriveOrientation m52 : 14|1@1+ (1,0) [0|1] "" Vector__XXX
 SG_ RCM_a052_presFrntRDoorComm m52 : 16|1@1+ (1,0) [0|1] "" Vector__XXX
 SG_ RCM_a052_presFrntRDoorInitTyp m52 : 17|1@1+ (1,0) [0|1] "" Vector__XXX
 SG_ RCM_a052_presFrntRDoorOption m52 : 18|1@1+ (1,0) [0|1] "" Vector__XXX
 SG_ RCM_a052_presFrntRDoorPlaus m52 : 19|1@1+ (1,0) [0|1] "" Vector__XXX
 SG_ RCM_a052_presFrntRDoorAbsPre m52 : 20|1@1+ (1,0) [0|1] "" Vector__XXX
 SG_ RCM_a052_presFrntRDoorDefect m52 : 21|1@1+ (1,0) [0|1] "" Vector__XXX
 SG_ RCM_a052_presFrntRDoorSht2Gnd m52 : 22|1@1+ (1,0) [0|1] "" Vector__XXX
 SG_ RCM_a052_presFrntRDoorSht2Bat m52 : 23|1@1+ (1,0) [0|1] "" Vector__XXX
 SG_ RCM_a052_presFrntRDoorCrossCoup m52 : 24|1@1+ (1,0) [0|1] "" Vector__XXX
 SG_ RCM_a052_eventIDFsignal m52 : 25|1@1+ (1,0) [0|1] "" Vector__XXX
 SG_ RCM_a052_eventFrontLeftSeatbelt m52 : 26|1@1+ (1,0) [0|1] "" Vector__XXX
 SG_ RCM_a052_eventFrontRightSeatbelt m52 : 27|1@1+ (1,0) [0|1] "" Vector__XXX
 SG_ RCM_a052_eventVehicleSpeed m52 : 28|12@1+ (0.08,-40) [-40|287.6] "kph" Vector__XXX
 SG_ RCM_a052_eventSteeringAngle m52 : 45|14@0+ (0.1,-819.2) [-819.2|819.1] "deg" Vector__XXX
 SG_ RCM_a052_eventDriverBrakeApply m52 : 46|2@1+ (1,0) [0|2] "" Vector__XXX
 SG_ RCM_a052_eventAccelPedalPos m52 : 56|8@1+ (0.4,0) [0|101.6] "%" Vector__XXX
 SG_ RCM_a053_eventArmStatus m53 : 11|1@1+ (1,0) [0|1] "" Vector__XXX
 SG_ RCM_a053_eventFactoryMode m53 : 12|1@1+ (1,0) [0|1] "" Vector__XXX
 SG_ RCM_a053_eventDiagEnabled m53 : 13|1@1+ (1,0) [0|1] "" Vector__XXX
 SG_ RCM_a053_eventDriveOrientation m53 : 14|1@1+ (1,0) [0|1] "" Vector__XXX
 SG_ RCM_a053_presPedProLComm m53 : 16|1@1+ (1,0) [0|1] "" Vector__XXX
 SG_ RCM_a053_presPedProLInitTyp m53 : 17|1@1+ (1,0) [0|1] "" Vector__XXX
 SG_ RCM_a053_presPedProLOption m53 : 18|1@1+ (1,0) [0|1] "" Vector__XXX
 SG_ RCM_a053_presPedProLPlaus m53 : 19|1@1+ (1,0) [0|1] "" Vector__XXX
 SG_ RCM_a053_presPedProLAbsPre m53 : 20|1@1+ (1,0) [0|1] "" Vector__XXX
 SG_ RCM_a053_presPedProLDefect m53 : 21|1@1+ (1,0) [0|1] "" Vector__XXX
 SG_ RCM_a053_presPedProLSht2Gnd m53 : 22|1@1+ (1,0) [0|1] "" Vector__XXX
 SG_ RCM_a053_presPedProLSht2Bat m53 : 23|1@1+ (1,0) [0|1] "" Vector__XXX
 SG_ RCM_a053_presPedProLCrossCoup m53 : 24|1@1+ (1,0) [0|1] "" Vector__XXX
 SG_ RCM_a053_eventIDFsignal m53 : 25|1@1+ (1,0) [0|1] "" Vector__XXX
 SG_ RCM_a053_eventFrontLeftSeatbelt m53 : 26|1@1+ (1,0) [0|1] "" Vector__XXX
 SG_ RCM_a053_eventFrontRightSeatbelt m53 : 27|1@1+ (1,0) [0|1] "" Vector__XXX
 SG_ RCM_a053_eventVehicleSpeed m53 : 28|12@1+ (0.08,-40) [-40|287.6] "kph" Vector__XXX
 SG_ RCM_a053_eventSteeringAngle m53 : 45|14@0+ (0.1,-819.2) [-819.2|819.1] "deg" Vector__XXX
 SG_ RCM_a053_eventDriverBrakeApply m53 : 46|2@1+ (1,0) [0|2] "" Vector__XXX
 SG_ RCM_a053_eventAccelPedalPos m53 : 56|8@1+ (0.4,0) [0|101.6] "%" Vector__XXX
 SG_ RCM_a054_eventArmStatus m54 : 11|1@1+ (1,0) [0|1] "" Vector__XXX
 SG_ RCM_a054_eventFactoryMode m54 : 12|1@1+ (1,0) [0|1] "" Vector__XXX
 SG_ RCM_a054_eventDiagEnabled m54 : 13|1@1+ (1,0) [0|1] "" Vector__XXX
 SG_ RCM_a054_eventDriveOrientation m54 : 14|1@1+ (1,0) [0|1] "" Vector__XXX
 SG_ RCM_a054_presPedProRComm m54 : 16|1@1+ (1,0) [0|1] "" Vector__XXX
 SG_ RCM_a054_presPedProRInitTyp m54 : 17|1@1+ (1,0) [0|1] "" Vector__XXX
 SG_ RCM_a054_presPedProROption m54 : 18|1@1+ (1,0) [0|1] "" Vector__XXX
 SG_ RCM_a054_presPedProRPlaus m54 : 19|1@1+ (1,0) [0|1] "" Vector__XXX
 SG_ RCM_a054_presPedProRAbsPre m54 : 20|1@1+ (1,0) [0|1] "" Vector__XXX
 SG_ RCM_a054_presPedProRDefect m54 : 21|1@1+ (1,0) [0|1] "" Vector__XXX
 SG_ RCM_a054_presPedProRSht2Gnd m54 : 22|1@1+ (1,0) [0|1] "" Vector__XXX
 SG_ RCM_a054_presPedProRSht2Bat m54 : 23|1@1+ (1,0) [0|1] "" Vector__XXX
 SG_ RCM_a054_presPedProRCrossCoup m54 : 24|1@1+ (1,0) [0|1] "" Vector__XXX
 SG_ RCM_a054_eventIDFsignal m54 : 25|1@1+ (1,0) [0|1] "" Vector__XXX
 SG_ RCM_a054_eventFrontLeftSeatbelt m54 : 26|1@1+ (1,0) [0|1] "" Vector__XXX
 SG_ RCM_a054_eventFrontRightSeatbelt m54 : 27|1@1+ (1,0) [0|1] "" Vector__XXX
 SG_ RCM_a054_eventVehicleSpeed m54 : 28|12@1+ (0.08,-40) [-40|287.6] "kph" Vector__XXX
 SG_ RCM_a054_eventSteeringAngle m54 : 45|14@0+ (0.1,-819.2) [-819.2|819.1] "deg" Vector__XXX
 SG_ RCM_a054_eventDriverBrakeApply m54 : 46|2@1+ (1,0) [0|2] "" Vector__XXX
 SG_ RCM_a054_eventAccelPedalPos m54 : 56|8@1+ (0.4,0) [0|101.6] "%" Vector__XXX
 SG_ RCM_a055_eventArmStatus m55 : 11|1@1+ (1,0) [0|1] "" Vector__XXX
 SG_ RCM_a055_eventFactoryMode m55 : 12|1@1+ (1,0) [0|1] "" Vector__XXX
 SG_ RCM_a055_eventDiagEnabled m55 : 13|1@1+ (1,0) [0|1] "" Vector__XXX
 SG_ RCM_a055_eventDriveOrientation m55 : 14|1@1+ (1,0) [0|1] "" Vector__XXX
 SG_ RCM_a055_imuCalibrationNotDone m55 : 16|1@1+ (1,0) [0|1] "" Vector__XXX
 SG_ RCM_a055_imuCalibrationFailed m55 : 17|1@1+ (1,0) [0|1] "" Vector__XXX
 SG_ RCM_a055_eventIDFsignal m55 : 25|1@1+ (1,0) [0|1] "" Vector__XXX
 SG_ RCM_a055_eventFrontLeftSeatbelt m55 : 26|1@1+ (1,0) [0|1] "" Vector__XXX
 SG_ RCM_a055_eventFrontRightSeatbelt m55 : 27|1@1+ (1,0) [0|1] "" Vector__XXX
 SG_ RCM_a055_eventVehicleSpeed m55 : 28|12@1+ (0.08,-40) [-40|287.6] "kph" Vector__XXX
 SG_ RCM_a055_eventSteeringAngle m55 : 45|14@0+ (0.1,-819.2) [-819.2|819.1] "deg" Vector__XXX
 SG_ RCM_a055_eventDriverBrakeApply m55 : 46|2@1+ (1,0) [0|2] "" Vector__XXX
 SG_ RCM_a055_eventAccelPedalPos m55 : 56|8@1+ (0.4,0) [0|101.6] "%" Vector__XXX
 SG_ RCM_a056_eventArmStatus m56 : 11|1@1+ (1,0) [0|1] "" Vector__XXX
 SG_ RCM_a056_eventFactoryMode m56 : 12|1@1+ (1,0) [0|1] "" Vector__XXX
 SG_ RCM_a056_eventDiagEnabled m56 : 13|1@1+ (1,0) [0|1] "" Vector__XXX
 SG_ RCM_a056_eventDriveOrientation m56 : 14|1@1+ (1,0) [0|1] "" Vector__XXX
 SG_ RCM_a056_ocs1pFaulted m56 : 16|1@1+ (1,0) [0|1] "" Vector__XXX
 SG_ RCM_a056_ocs1pWrongCalD m56 : 17|1@1+ (1,0) [0|1] "" Vector__XXX
 SG_ RCM_a056_eventIDFsignal m56 : 25|1@1+ (1,0) [0|1] "" Vector__XXX
 SG_ RCM_a056_eventFrontLeftSeatbelt m56 : 26|1@1+ (1,0) [0|1] "" Vector__XXX
 SG_ RCM_a056_eventFrontRightSeatbelt m56 : 27|1@1+ (1,0) [0|1] "" Vector__XXX
 SG_ RCM_a056_eventVehicleSpeed m56 : 28|12@1+ (0.08,-40) [-40|287.6] "kph" Vector__XXX
 SG_ RCM_a056_eventSteeringAngle m56 : 45|14@0+ (0.1,-819.2) [-819.2|819.1] "deg" Vector__XXX
 SG_ RCM_a056_eventDriverBrakeApply m56 : 46|2@1+ (1,0) [0|2] "" Vector__XXX
 SG_ RCM_a056_eventAccelPedalPos m56 : 56|8@1+ (0.4,0) [0|101.6] "%" Vector__XXX
 SG_ RCM_a057_eventArmStatus m57 : 11|1@1+ (1,0) [0|1] "" Vector__XXX
 SG_ RCM_a057_eventFactoryMode m57 : 12|1@1+ (1,0) [0|1] "" Vector__XXX
 SG_ RCM_a057_eventDiagEnabled m57 : 13|1@1+ (1,0) [0|1] "" Vector__XXX
 SG_ RCM_a057_eventDriveOrientation m57 : 14|1@1+ (1,0) [0|1] "" Vector__XXX
 SG_ RCM_a057_ocs1dFaulted m57 : 16|1@1+ (1,0) [0|1] "" Vector__XXX
 SG_ RCM_a057_ocs1dWrongCalD m57 : 17|1@1+ (1,0) [0|1] "" Vector__XXX
 SG_ RCM_a057_eventIDFsignal m57 : 25|1@1+ (1,0) [0|1] "" Vector__XXX
 SG_ RCM_a057_eventFrontLeftSeatbelt m57 : 26|1@1+ (1,0) [0|1] "" Vector__XXX
 SG_ RCM_a057_eventFrontRightSeatbelt m57 : 27|1@1+ (1,0) [0|1] "" Vector__XXX
 SG_ RCM_a057_eventVehicleSpeed m57 : 28|12@1+ (0.08,-40) [-40|287.6] "kph" Vector__XXX
 SG_ RCM_a057_eventSteeringAngle m57 : 45|14@0+ (0.1,-819.2) [-819.2|819.1] "deg" Vector__XXX
 SG_ RCM_a057_eventDriverBrakeApply m57 : 46|2@1+ (1,0) [0|2] "" Vector__XXX
 SG_ RCM_a057_eventAccelPedalPos m57 : 56|8@1+ (0.4,0) [0|101.6] "%" Vector__XXX
 SG_ RCM_a058_eventArmStatus m58 : 11|1@1+ (1,0) [0|1] "" Vector__XXX
 SG_ RCM_a058_eventFactoryMode m58 : 12|1@1+ (1,0) [0|1] "" Vector__XXX
 SG_ RCM_a058_eventDiagEnabled m58 : 13|1@1+ (1,0) [0|1] "" Vector__XXX
 SG_ RCM_a058_eventDriveOrientation m58 : 14|1@1+ (1,0) [0|1] "" Vector__XXX
 SG_ RCM_a058_bucklHallLeftShort m58 : 16|1@1+ (1,0) [0|1] "" Vector__XXX
 SG_ RCM_a058_bucklHallLeftSht2Bat m58 : 17|1@1+ (1,0) [0|1] "" Vector__XXX
 SG_ RCM_a058_bucklHallLeftOpen m58 : 18|1@1+ (1,0) [0|1] "" Vector__XXX
 SG_ RCM_a058_bucklHallLeftUndef m58 : 19|1@1+ (1,0) [0|1] "" Vector__XXX
 SG_ RCM_a058_bucklHallLeftCrossCoup m58 : 20|1@1+ (1,0) [0|1] "" Vector__XXX
 SG_ RCM_a058_bucklHallLeftConfig m58 : 21|1@1+ (1,0) [0|1] "" Vector__XXX
 SG_ RCM_a058_eventIDFsignal m58 : 25|1@1+ (1,0) [0|1] "" Vector__XXX
 SG_ RCM_a058_eventFrontLeftSeatbelt m58 : 26|1@1+ (1,0) [0|1] "" Vector__XXX
 SG_ RCM_a058_eventFrontRightSeatbelt m58 : 27|1@1+ (1,0) [0|1] "" Vector__XXX
 SG_ RCM_a058_eventVehicleSpeed m58 : 28|12@1+ (0.08,-40) [-40|287.6] "kph" Vector__XXX
 SG_ RCM_a058_eventSteeringAngle m58 : 45|14@0+ (0.1,-819.2) [-819.2|819.1] "deg" Vector__XXX
 SG_ RCM_a058_eventDriverBrakeApply m58 : 46|2@1+ (1,0) [0|2] "" Vector__XXX
 SG_ RCM_a058_eventAccelPedalPos m58 : 56|8@1+ (0.4,0) [0|101.6] "%" Vector__XXX
 SG_ RCM_a059_eventArmStatus m59 : 11|1@1+ (1,0) [0|1] "" Vector__XXX
 SG_ RCM_a059_eventFactoryMode m59 : 12|1@1+ (1,0) [0|1] "" Vector__XXX
 SG_ RCM_a059_eventDiagEnabled m59 : 13|1@1+ (1,0) [0|1] "" Vector__XXX
 SG_ RCM_a059_eventDriveOrientation m59 : 14|1@1+ (1,0) [0|1] "" Vector__XXX
 SG_ RCM_a059_bucklHallRightShort m59 : 16|1@1+ (1,0) [0|1] "" Vector__XXX
 SG_ RCM_a059_bucklHallRightSht2Bat m59 : 17|1@1+ (1,0) [0|1] "" Vector__XXX
 SG_ RCM_a059_bucklHallRightOpen m59 : 18|1@1+ (1,0) [0|1] "" Vector__XXX
 SG_ RCM_a059_bucklHallRightUndef m59 : 19|1@1+ (1,0) [0|1] "" Vector__XXX
 SG_ RCM_a059_bucklHallRightCrossCoup m59 : 20|1@1+ (1,0) [0|1] "" Vector__XXX
 SG_ RCM_a059_bucklSwRightConfig m59 : 21|1@1+ (1,0) [0|1] "" Vector__XXX
 SG_ RCM_a059_eventIDFsignal m59 : 25|1@1+ (1,0) [0|1] "" Vector__XXX
 SG_ RCM_a059_eventFrontLeftSeatbelt m59 : 26|1@1+ (1,0) [0|1] "" Vector__XXX
 SG_ RCM_a059_eventFrontRightSeatbelt m59 : 27|1@1+ (1,0) [0|1] "" Vector__XXX
 SG_ RCM_a059_eventVehicleSpeed m59 : 28|12@1+ (0.08,-40) [-40|287.6] "kph" Vector__XXX
 SG_ RCM_a059_eventSteeringAngle m59 : 45|14@0+ (0.1,-819.2) [-819.2|819.1] "deg" Vector__XXX
 SG_ RCM_a059_eventDriverBrakeApply m59 : 46|2@1+ (1,0) [0|2] "" Vector__XXX
 SG_ RCM_a059_eventAccelPedalPos m59 : 56|8@1+ (0.4,0) [0|101.6] "%" Vector__XXX
 SG_ RCM_a060_eventArmStatus m60 : 11|1@1+ (1,0) [0|1] "" Vector__XXX
 SG_ RCM_a060_eventFactoryMode m60 : 12|1@1+ (1,0) [0|1] "" Vector__XXX
 SG_ RCM_a060_eventDiagEnabled m60 : 13|1@1+ (1,0) [0|1] "" Vector__XXX
 SG_ RCM_a060_eventDriveOrientation m60 : 14|1@1+ (1,0) [0|1] "" Vector__XXX
 SG_ RCM_a060_seaTrkPosLeftShort m60 : 16|1@1+ (1,0) [0|1] "" Vector__XXX
 SG_ RCM_a060_seaTrkPosLeftShort2Bat m60 : 17|1@1+ (1,0) [0|1] "" Vector__XXX
 SG_ RCM_a060_seaTrkPosLeftOpen m60 : 18|1@1+ (1,0) [0|1] "" Vector__XXX
 SG_ RCM_a060_seaTrkPosLeftUndefined m60 : 19|1@1+ (1,0) [0|1] "" Vector__XXX
 SG_ RCM_a060_seaTrkPosLeftCrossCoup m60 : 20|1@1+ (1,0) [0|1] "" Vector__XXX
 SG_ RCM_a060_seaTrkPosLeftConfig m60 : 21|1@1+ (1,0) [0|1] "" Vector__XXX
 SG_ RCM_a060_eventIDFsignal m60 : 25|1@1+ (1,0) [0|1] "" Vector__XXX
 SG_ RCM_a060_eventFrontLeftSeatbelt m60 : 26|1@1+ (1,0) [0|1] "" Vector__XXX
 SG_ RCM_a060_eventFrontRightSeatbelt m60 : 27|1@1+ (1,0) [0|1] "" Vector__XXX
 SG_ RCM_a060_eventVehicleSpeed m60 : 28|12@1+ (0.08,-40) [-40|287.6] "kph" Vector__XXX
 SG_ RCM_a060_eventSteeringAngle m60 : 45|14@0+ (0.1,-819.2) [-819.2|819.1] "deg" Vector__XXX
 SG_ RCM_a060_eventDriverBrakeApply m60 : 46|2@1+ (1,0) [0|2] "" Vector__XXX
 SG_ RCM_a060_eventAccelPedalPos m60 : 56|8@1+ (0.4,0) [0|101.6] "%" Vector__XXX
 SG_ RCM_a061_eventArmStatus m61 : 11|1@1+ (1,0) [0|1] "" Vector__XXX
 SG_ RCM_a061_eventFactoryMode m61 : 12|1@1+ (1,0) [0|1] "" Vector__XXX
 SG_ RCM_a061_eventDiagEnabled m61 : 13|1@1+ (1,0) [0|1] "" Vector__XXX
 SG_ RCM_a061_eventDriveOrientation m61 : 14|1@1+ (1,0) [0|1] "" Vector__XXX
 SG_ RCM_a061_seaTrkPosRightShort m61 : 16|1@1+ (1,0) [0|1] "" Vector__XXX
 SG_ RCM_a061_seaTrkPosRightSht2Bat m61 : 17|1@1+ (1,0) [0|1] "" Vector__XXX
 SG_ RCM_a061_seaTrkPosRightOpen m61 : 18|1@1+ (1,0) [0|1] "" Vector__XXX
 SG_ RCM_a061_seaTrkPosRightUndefined m61 : 19|1@1+ (1,0) [0|1] "" Vector__XXX
 SG_ RCM_a061_seaTrkPosRightCrossCoup m61 : 20|1@1+ (1,0) [0|1] "" Vector__XXX
 SG_ RCM_a061_seaTrkPosRightConfig m61 : 21|1@1+ (1,0) [0|1] "" Vector__XXX
 SG_ RCM_a061_eventIDFsignal m61 : 25|1@1+ (1,0) [0|1] "" Vector__XXX
 SG_ RCM_a061_eventFrontLeftSeatbelt m61 : 26|1@1+ (1,0) [0|1] "" Vector__XXX
 SG_ RCM_a061_eventFrontRightSeatbelt m61 : 27|1@1+ (1,0) [0|1] "" Vector__XXX
 SG_ RCM_a061_eventVehicleSpeed m61 : 28|12@1+ (0.08,-40) [-40|287.6] "kph" Vector__XXX
 SG_ RCM_a061_eventSteeringAngle m61 : 45|14@0+ (0.1,-819.2) [-819.2|819.1] "deg" Vector__XXX
 SG_ RCM_a061_eventDriverBrakeApply m61 : 46|2@1+ (1,0) [0|2] "" Vector__XXX
 SG_ RCM_a061_eventAccelPedalPos m61 : 56|8@1+ (0.4,0) [0|101.6] "%" Vector__XXX
 SG_ RCM_a062_eventArmStatus m62 : 11|1@1+ (1,0) [0|1] "" Vector__XXX
 SG_ RCM_a062_eventFactoryMode m62 : 12|1@1+ (1,0) [0|1] "" Vector__XXX
 SG_ RCM_a062_eventDiagEnabled m62 : 13|1@1+ (1,0) [0|1] "" Vector__XXX
 SG_ RCM_a062_eventDriveOrientation m62 : 14|1@1+ (1,0) [0|1] "" Vector__XXX
 SG_ RCM_a062_alrShort m62 : 16|1@1+ (1,0) [0|1] "" Vector__XXX
 SG_ RCM_a062_alrSht2Bat m62 : 17|1@1+ (1,0) [0|1] "" Vector__XXX
 SG_ RCM_a062_alrOpen m62 : 18|1@1+ (1,0) [0|1] "" Vector__XXX
 SG_ RCM_a062_alrUndefined m62 : 19|1@1+ (1,0) [0|1] "" Vector__XXX
 SG_ RCM_a062_alrCrossCoup m62 : 20|1@1+ (1,0) [0|1] "" Vector__XXX
 SG_ RCM_a062_alrConfig m62 : 21|1@1+ (1,0) [0|1] "" Vector__XXX
 SG_ RCM_a062_eventIDFsignal m62 : 25|1@1+ (1,0) [0|1] "" Vector__XXX
 SG_ RCM_a062_eventFrontLeftSeatbelt m62 : 26|1@1+ (1,0) [0|1] "" Vector__XXX
 SG_ RCM_a062_eventFrontRightSeatbelt m62 : 27|1@1+ (1,0) [0|1] "" Vector__XXX
 SG_ RCM_a062_eventVehicleSpeed m62 : 28|12@1+ (0.08,-40) [-40|287.6] "kph" Vector__XXX
 SG_ RCM_a062_eventSteeringAngle m62 : 45|14@0+ (0.1,-819.2) [-819.2|819.1] "deg" Vector__XXX
 SG_ RCM_a062_eventDriverBrakeApply m62 : 46|2@1+ (1,0) [0|2] "" Vector__XXX
 SG_ RCM_a062_eventAccelPedalPos m62 : 56|8@1+ (0.4,0) [0|101.6] "%" Vector__XXX
 SG_ RCM_a063_eventArmStatus m63 : 11|1@1+ (1,0) [0|1] "" Vector__XXX
 SG_ RCM_a063_eventFactoryMode m63 : 12|1@1+ (1,0) [0|1] "" Vector__XXX
 SG_ RCM_a063_eventDiagEnabled m63 : 13|1@1+ (1,0) [0|1] "" Vector__XXX
 SG_ RCM_a063_eventDriveOrientation m63 : 14|1@1+ (1,0) [0|1] "" Vector__XXX
 SG_ RCM_a063_sbsw2ndRowRSht2Gnd m63 : 16|1@1+ (1,0) [0|1] "" Vector__XXX
 SG_ RCM_a063_sbsw2ndRowRSht2Bat m63 : 17|1@1+ (1,0) [0|1] "" Vector__XXX
 SG_ RCM_a063_sbsw2ndRowROpen m63 : 18|1@1+ (1,0) [0|1] "" Vector__XXX
 SG_ RCM_a063_sbsw2ndRowRUndefined m63 : 19|1@1+ (1,0) [0|1] "" Vector__XXX
 SG_ RCM_a063_sbsw2ndRowRCrossCoup m63 : 20|1@1+ (1,0) [0|1] "" Vector__XXX
 SG_ RCM_a063_sbsw2ndRowRConfig m63 : 21|1@1+ (1,0) [0|1] "" Vector__XXX
 SG_ RCM_a063_eventIDFsignal m63 : 25|1@1+ (1,0) [0|1] "" Vector__XXX
 SG_ RCM_a063_eventFrontLeftSeatbelt m63 : 26|1@1+ (1,0) [0|1] "" Vector__XXX
 SG_ RCM_a063_eventFrontRightSeatbelt m63 : 27|1@1+ (1,0) [0|1] "" Vector__XXX
 SG_ RCM_a063_eventVehicleSpeed m63 : 28|12@1+ (0.08,-40) [-40|287.6] "kph" Vector__XXX
 SG_ RCM_a063_eventSteeringAngle m63 : 45|14@0+ (0.1,-819.2) [-819.2|819.1] "deg" Vector__XXX
 SG_ RCM_a063_eventDriverBrakeApply m63 : 46|2@1+ (1,0) [0|2] "" Vector__XXX
 SG_ RCM_a063_eventAccelPedalPos m63 : 56|8@1+ (0.4,0) [0|101.6] "%" Vector__XXX
 SG_ RCM_a064_eventArmStatus m64 : 11|1@1+ (1,0) [0|1] "" Vector__XXX
 SG_ RCM_a064_eventFactoryMode m64 : 12|1@1+ (1,0) [0|1] "" Vector__XXX
 SG_ RCM_a064_eventDiagEnabled m64 : 13|1@1+ (1,0) [0|1] "" Vector__XXX
 SG_ RCM_a064_eventDriveOrientation m64 : 14|1@1+ (1,0) [0|1] "" Vector__XXX
 SG_ RCM_a064_hwcp1CheckFail m64 : 16|1@1+ (1,0) [0|1] "" Vector__XXX
 SG_ RCM_a064_hwcp1Sht2Bat m64 : 17|1@1+ (1,0) [0|1] "" Vector__XXX
 SG_ RCM_a064_hwcp1CrossCoup m64 : 18|1@1+ (1,0) [0|1] "" Vector__XXX
 SG_ RCM_a064_hwcp1Config m64 : 19|1@1+ (1,0) [0|1] "" Vector__XXX
 SG_ RCM_a064_eventIDFsignal m64 : 25|1@1+ (1,0) [0|1] "" Vector__XXX
 SG_ RCM_a064_eventFrontLeftSeatbelt m64 : 26|1@1+ (1,0) [0|1] "" Vector__XXX
 SG_ RCM_a064_eventFrontRightSeatbelt m64 : 27|1@1+ (1,0) [0|1] "" Vector__XXX
 SG_ RCM_a064_eventVehicleSpeed m64 : 28|12@1+ (0.08,-40) [-40|287.6] "kph" Vector__XXX
 SG_ RCM_a064_eventSteeringAngle m64 : 45|14@0+ (0.1,-819.2) [-819.2|819.1] "deg" Vector__XXX
 SG_ RCM_a064_eventDriverBrakeApply m64 : 46|2@1+ (1,0) [0|2] "" Vector__XXX
 SG_ RCM_a064_eventAccelPedalPos m64 : 56|8@1+ (0.4,0) [0|101.6] "%" Vector__XXX
 SG_ RCM_a065_eventArmStatus m65 : 11|1@1+ (1,0) [0|1] "" Vector__XXX
 SG_ RCM_a065_eventFactoryMode m65 : 12|1@1+ (1,0) [0|1] "" Vector__XXX
 SG_ RCM_a065_eventDiagEnabled m65 : 13|1@1+ (1,0) [0|1] "" Vector__XXX
 SG_ RCM_a065_eventDriveOrientation m65 : 14|1@1+ (1,0) [0|1] "" Vector__XXX
 SG_ RCM_a065_swDrvrOrientCheck m65 : 16|1@1+ (1,0) [0|1] "" Vector__XXX
 SG_ RCM_a065_swDrvrOrientSht2Bat m65 : 17|1@1+ (1,0) [0|1] "" Vector__XXX
 SG_ RCM_a065_swDrvrOrientCrossCoup m65 : 18|1@1+ (1,0) [0|1] "" Vector__XXX
 SG_ RCM_a065_swDrvrOrientConfig m65 : 19|1@1+ (1,0) [0|1] "" Vector__XXX
 SG_ RCM_a065_eventIDFsignal m65 : 25|1@1+ (1,0) [0|1] "" Vector__XXX
 SG_ RCM_a065_eventFrontLeftSeatbelt m65 : 26|1@1+ (1,0) [0|1] "" Vector__XXX
 SG_ RCM_a065_eventFrontRightSeatbelt m65 : 27|1@1+ (1,0) [0|1] "" Vector__XXX
 SG_ RCM_a065_eventVehicleSpeed m65 : 28|12@1+ (0.08,-40) [-40|287.6] "kph" Vector__XXX
 SG_ RCM_a065_eventSteeringAngle m65 : 45|14@0+ (0.1,-819.2) [-819.2|819.1] "deg" Vector__XXX
 SG_ RCM_a065_eventDriverBrakeApply m65 : 46|2@1+ (1,0) [0|2] "" Vector__XXX
 SG_ RCM_a065_eventAccelPedalPos m65 : 56|8@1+ (0.4,0) [0|101.6] "%" Vector__XXX
 SG_ RCM_a066_eventArmStatus m66 : 11|1@1+ (1,0) [0|1] "" Vector__XXX
 SG_ RCM_a066_eventFactoryMode m66 : 12|1@1+ (1,0) [0|1] "" Vector__XXX
 SG_ RCM_a066_eventDiagEnabled m66 : 13|1@1+ (1,0) [0|1] "" Vector__XXX
 SG_ RCM_a066_eventDriveOrientation m66 : 14|1@1+ (1,0) [0|1] "" Vector__XXX
 SG_ RCM_a066_sbsw2ndRowLShort m66 : 16|1@1+ (1,0) [0|1] "" Vector__XXX
 SG_ RCM_a066_sbsw2ndRowLSht2Bat m66 : 17|1@1+ (1,0) [0|1] "" Vector__XXX
 SG_ RCM_a066_sbsw2ndRowLCrossCoup m66 : 18|1@1+ (1,0) [0|1] "" Vector__XXX
 SG_ RCM_a066_sbsw2ndRowLConfig m66 : 19|1@1+ (1,0) [0|1] "" Vector__XXX
 SG_ RCM_a066_eventIDFsignal m66 : 25|1@1+ (1,0) [0|1] "" Vector__XXX
 SG_ RCM_a066_eventFrontLeftSeatbelt m66 : 26|1@1+ (1,0) [0|1] "" Vector__XXX
 SG_ RCM_a066_eventFrontRightSeatbelt m66 : 27|1@1+ (1,0) [0|1] "" Vector__XXX
 SG_ RCM_a066_eventVehicleSpeed m66 : 28|12@1+ (0.08,-40) [-40|287.6] "kph" Vector__XXX
 SG_ RCM_a066_eventSteeringAngle m66 : 45|14@0+ (0.1,-819.2) [-819.2|819.1] "deg" Vector__XXX
 SG_ RCM_a066_eventDriverBrakeApply m66 : 46|2@1+ (1,0) [0|2] "" Vector__XXX
 SG_ RCM_a066_eventAccelPedalPos m66 : 56|8@1+ (0.4,0) [0|101.6] "%" Vector__XXX
 SG_ RCM_a067_eventArmStatus m67 : 11|1@1+ (1,0) [0|1] "" Vector__XXX
 SG_ RCM_a067_eventFactoryMode m67 : 12|1@1+ (1,0) [0|1] "" Vector__XXX
 SG_ RCM_a067_eventDiagEnabled m67 : 13|1@1+ (1,0) [0|1] "" Vector__XXX
 SG_ RCM_a067_eventDriveOrientation m67 : 14|1@1+ (1,0) [0|1] "" Vector__XXX
 SG_ RCM_a067_comCANInitialization m67 : 16|1@1+ (1,0) [0|1] "" Vector__XXX
 SG_ RCM_a067_eventIDFsignal m67 : 25|1@1+ (1,0) [0|1] "" Vector__XXX
 SG_ RCM_a067_eventFrontLeftSeatbelt m67 : 26|1@1+ (1,0) [0|1] "" Vector__XXX
 SG_ RCM_a067_eventFrontRightSeatbelt m67 : 27|1@1+ (1,0) [0|1] "" Vector__XXX
 SG_ RCM_a067_eventVehicleSpeed m67 : 28|12@1+ (0.08,-40) [-40|287.6] "kph" Vector__XXX
 SG_ RCM_a067_eventSteeringAngle m67 : 45|14@0+ (0.1,-819.2) [-819.2|819.1] "deg" Vector__XXX
 SG_ RCM_a067_eventDriverBrakeApply m67 : 46|2@1+ (1,0) [0|2] "" Vector__XXX
 SG_ RCM_a067_eventAccelPedalPos m67 : 56|8@1+ (0.4,0) [0|101.6] "%" Vector__XXX
 SG_ RCM_a068_eventArmStatus m68 : 11|1@1+ (1,0) [0|1] "" Vector__XXX
 SG_ RCM_a068_eventFactoryMode m68 : 12|1@1+ (1,0) [0|1] "" Vector__XXX
 SG_ RCM_a068_eventDiagEnabled m68 : 13|1@1+ (1,0) [0|1] "" Vector__XXX
 SG_ RCM_a068_eventDriveOrientation m68 : 14|1@1+ (1,0) [0|1] "" Vector__XXX
 SG_ RCM_a068_comChassisCANBusOff m68 : 16|1@1+ (1,0) [0|1] "" Vector__XXX
 SG_ RCM_a068_eventIDFsignal m68 : 25|1@1+ (1,0) [0|1] "" Vector__XXX
 SG_ RCM_a068_eventFrontLeftSeatbelt m68 : 26|1@1+ (1,0) [0|1] "" Vector__XXX
 SG_ RCM_a068_eventFrontRightSeatbelt m68 : 27|1@1+ (1,0) [0|1] "" Vector__XXX
 SG_ RCM_a068_eventVehicleSpeed m68 : 28|12@1+ (0.08,-40) [-40|287.6] "kph" Vector__XXX
 SG_ RCM_a068_eventSteeringAngle m68 : 45|14@0+ (0.1,-819.2) [-819.2|819.1] "deg" Vector__XXX
 SG_ RCM_a068_eventDriverBrakeApply m68 : 46|2@1+ (1,0) [0|2] "" Vector__XXX
 SG_ RCM_a068_eventAccelPedalPos m68 : 56|8@1+ (0.4,0) [0|101.6] "%" Vector__XXX
 SG_ RCM_a069_eventArmStatus m69 : 11|1@1+ (1,0) [0|1] "" Vector__XXX
 SG_ RCM_a069_eventFactoryMode m69 : 12|1@1+ (1,0) [0|1] "" Vector__XXX
 SG_ RCM_a069_eventDiagEnabled m69 : 13|1@1+ (1,0) [0|1] "" Vector__XXX
 SG_ RCM_a069_eventDriveOrientation m69 : 14|1@1+ (1,0) [0|1] "" Vector__XXX
 SG_ RCM_a069_comChassisCANPH7MIA m69 : 16|1@1+ (1,0) [0|1] "" Vector__XXX
 SG_ RCM_a069_comChassisCANPH7ChkSm m69 : 17|1@1+ (1,0) [0|1] "" Vector__XXX
 SG_ RCM_a069_comChassisCANPH7Cntr m69 : 18|1@1+ (1,0) [0|1] "" Vector__XXX
 SG_ RCM_a069_eventIDFsignal m69 : 25|1@1+ (1,0) [0|1] "" Vector__XXX
 SG_ RCM_a069_eventFrontLeftSeatbelt m69 : 26|1@1+ (1,0) [0|1] "" Vector__XXX
 SG_ RCM_a069_eventFrontRightSeatbelt m69 : 27|1@1+ (1,0) [0|1] "" Vector__XXX
 SG_ RCM_a069_eventVehicleSpeed m69 : 28|12@1+ (0.08,-40) [-40|287.6] "kph" Vector__XXX
 SG_ RCM_a069_eventSteeringAngle m69 : 45|14@0+ (0.1,-819.2) [-819.2|819.1] "deg" Vector__XXX
 SG_ RCM_a069_eventDriverBrakeApply m69 : 46|2@1+ (1,0) [0|2] "" Vector__XXX
 SG_ RCM_a069_eventAccelPedalPos m69 : 56|8@1+ (0.4,0) [0|101.6] "%" Vector__XXX
 SG_ RCM_a070_eventArmStatus m70 : 11|1@1+ (1,0) [0|1] "" Vector__XXX
 SG_ RCM_a070_eventFactoryMode m70 : 12|1@1+ (1,0) [0|1] "" Vector__XXX
 SG_ RCM_a070_eventDiagEnabled m70 : 13|1@1+ (1,0) [0|1] "" Vector__XXX
 SG_ RCM_a070_eventDriveOrientation m70 : 14|1@1+ (1,0) [0|1] "" Vector__XXX
 SG_ RCM_a070_comChassisCANPH8MIA m70 : 16|1@1+ (1,0) [0|1] "" Vector__XXX
 SG_ RCM_a070_comChassisCANPH8ChkSm m70 : 17|1@1+ (1,0) [0|1] "" Vector__XXX
 SG_ RCM_a070_comChassisCANPH8Cntr m70 : 18|1@1+ (1,0) [0|1] "" Vector__XXX
 SG_ RCM_a070_eventIDFsignal m70 : 25|1@1+ (1,0) [0|1] "" Vector__XXX
 SG_ RCM_a070_eventFrontLeftSeatbelt m70 : 26|1@1+ (1,0) [0|1] "" Vector__XXX
 SG_ RCM_a070_eventFrontRightSeatbelt m70 : 27|1@1+ (1,0) [0|1] "" Vector__XXX
 SG_ RCM_a070_eventVehicleSpeed m70 : 28|12@1+ (0.08,-40) [-40|287.6] "kph" Vector__XXX
 SG_ RCM_a070_eventSteeringAngle m70 : 45|14@0+ (0.1,-819.2) [-819.2|819.1] "deg" Vector__XXX
 SG_ RCM_a070_eventDriverBrakeApply m70 : 46|2@1+ (1,0) [0|2] "" Vector__XXX
 SG_ RCM_a070_eventAccelPedalPos m70 : 56|8@1+ (0.4,0) [0|101.6] "%" Vector__XXX
 SG_ RCM_a071_eventArmStatus m71 : 11|1@1+ (1,0) [0|1] "" Vector__XXX
 SG_ RCM_a071_eventFactoryMode m71 : 12|1@1+ (1,0) [0|1] "" Vector__XXX
 SG_ RCM_a071_eventDiagEnabled m71 : 13|1@1+ (1,0) [0|1] "" Vector__XXX
 SG_ RCM_a071_eventDriveOrientation m71 : 14|1@1+ (1,0) [0|1] "" Vector__XXX
 SG_ RCM_a071_comChassisCANPH9MIA m71 : 16|1@1+ (1,0) [0|1] "" Vector__XXX
 SG_ RCM_a071_comChassisCANPH9ChkSm m71 : 17|1@1+ (1,0) [0|1] "" Vector__XXX
 SG_ RCM_a071_comChassisCANPH9Cntr m71 : 18|1@1+ (1,0) [0|1] "" Vector__XXX
 SG_ RCM_a071_eventIDFsignal m71 : 25|1@1+ (1,0) [0|1] "" Vector__XXX
 SG_ RCM_a071_eventFrontLeftSeatbelt m71 : 26|1@1+ (1,0) [0|1] "" Vector__XXX
 SG_ RCM_a071_eventFrontRightSeatbelt m71 : 27|1@1+ (1,0) [0|1] "" Vector__XXX
 SG_ RCM_a071_eventVehicleSpeed m71 : 28|12@1+ (0.08,-40) [-40|287.6] "kph" Vector__XXX
 SG_ RCM_a071_eventSteeringAngle m71 : 45|14@0+ (0.1,-819.2) [-819.2|819.1] "deg" Vector__XXX
 SG_ RCM_a071_eventDriverBrakeApply m71 : 46|2@1+ (1,0) [0|2] "" Vector__XXX
 SG_ RCM_a071_eventAccelPedalPos m71 : 56|8@1+ (0.4,0) [0|101.6] "%" Vector__XXX
 SG_ RCM_a072_eventArmStatus m72 : 11|1@1+ (1,0) [0|1] "" Vector__XXX
 SG_ RCM_a072_eventFactoryMode m72 : 12|1@1+ (1,0) [0|1] "" Vector__XXX
 SG_ RCM_a072_eventDiagEnabled m72 : 13|1@1+ (1,0) [0|1] "" Vector__XXX
 SG_ RCM_a072_eventDriveOrientation m72 : 14|1@1+ (1,0) [0|1] "" Vector__XXX
 SG_ RCM_a072_comUnusedMIA m72 : 16|1@1+ (1,0) [0|1] "" Vector__XXX
 SG_ RCM_a072_comUnusedChkSm m72 : 17|1@1+ (1,0) [0|1] "" Vector__XXX
 SG_ RCM_a072_comUnusedCntr m72 : 18|1@1+ (1,0) [0|1] "" Vector__XXX
 SG_ RCM_a072_eventIDFsignal m72 : 25|1@1+ (1,0) [0|1] "" Vector__XXX
 SG_ RCM_a072_eventFrontLeftSeatbelt m72 : 26|1@1+ (1,0) [0|1] "" Vector__XXX
 SG_ RCM_a072_eventFrontRightSeatbelt m72 : 27|1@1+ (1,0) [0|1] "" Vector__XXX
 SG_ RCM_a072_eventVehicleSpeed m72 : 28|12@1+ (0.08,-40) [-40|287.6] "kph" Vector__XXX
 SG_ RCM_a072_eventSteeringAngle m72 : 45|14@0+ (0.1,-819.2) [-819.2|819.1] "deg" Vector__XXX
 SG_ RCM_a072_eventDriverBrakeApply m72 : 46|2@1+ (1,0) [0|2] "" Vector__XXX
 SG_ RCM_a072_eventAccelPedalPos m72 : 56|8@1+ (0.4,0) [0|101.6] "%" Vector__XXX
 SG_ RCM_a073_eventArmStatus m73 : 11|1@1+ (1,0) [0|1] "" Vector__XXX
 SG_ RCM_a073_eventFactoryMode m73 : 12|1@1+ (1,0) [0|1] "" Vector__XXX

CM_ SG_ 1297 RCM_a026_eventFactoryMode "Restraint control module: a026 event factory mode";
CM_ SG_ 1297 RCM_a026_eventDiagEnabled "Restraint control module: a026 event diag enabled";
CM_ SG_ 1297 RCM_a026_eventDriveOrientation "Restraint control module: a026 event drive orientation";
CM_ SG_ 1297 RCM_a026_kneeABPassSht2Gnd "Restraint control module: a026 knee AB pass sht2 gnd";
CM_ SG_ 1297 RCM_a026_kneeABPassSht2Bat "Restraint control module: a026 knee AB pass sht2 bat";
CM_ SG_ 1297 RCM_a026_kneeABPassOpen "Restraint control module: a026 knee AB pass open";
CM_ SG_ 1297 RCM_a026_kneeABPassShort "Restraint control module: a026 knee AB pass short";
CM_ SG_ 1297 RCM_a026_kneeABPassCrossCoup "Restraint control module: a026 knee AB pass cross coup";
CM_ SG_ 1297 RCM_a026_kneeABPassConfig "Restraint control module: a026 knee AB pass config";
CM_ SG_ 1297 RCM_a026_eventIDFsignal "Restraint control module: a026 event ID fsignal";
CM_ SG_ 1297 RCM_a026_eventFrontLeftSeatbelt "Restraint control module: a026 event front left seatbelt";
CM_ SG_ 1297 RCM_a026_eventFrontRightSeatbelt "Restraint control module: a026 event front right seatbelt";
CM_ SG_ 1297 RCM_a026_eventVehicleSpeed "Restraint control module: a026 event vehicle speed";
CM_ SG_ 1297 RCM_a026_eventSteeringAngle "Restraint control module: a026 event steering angle";
CM_ SG_ 1297 RCM_a026_eventDriverBrakeApply "Restraint control module: a026 event driver brake apply; raw 3 = signal not available (SNA)";
CM_ SG_ 1297 RCM_a026_eventAccelPedalPos "Restraint control module: a026 event accel pedal pos; raw 255 = signal not available (SNA)";
CM_ SG_ 1297 RCM_a027_eventArmStatus "Restraint control module: a027 event arm status";
CM_ SG_ 1297 RCM_a027_eventFactoryMode "Restraint control module: a027 event factory mode";
CM_ SG_ 1297 RCM_a027_eventDiagEnabled "Restraint control module: a027 event diag enabled";
CM_ SG_ 1297 RCM_a027_eventDriveOrientation "Restraint control module: a027 event drive orientation";
CM_ SG_ 1297 RCM_a027_sideAB1stRowLSht2Gnd "Restraint control module: a027 side ab1st row l sht2 gnd";
CM_ SG_ 1297 RCM_a027_sideAB1stRowLSht2Bat "Restraint control module: a027 side ab1st row l sht2 bat";
CM_ SG_ 1297 RCM_a027_sideAB1stRowLOpen "Restraint control module: a027 side ab1st row l open";
CM_ SG_ 1297 RCM_a027_sideAB1stRowLShort "Restraint control module: a027 side ab1st row l short";
CM_ SG_ 1297 RCM_a027_sideAB1stRowLCrossCoup "Restraint control module: a027 side ab1st row l cross coup";
CM_ SG_ 1297 RCM_a027_sideAB1stRowLConfig "Restraint control module: a027 side ab1st row l config";
CM_ SG_ 1297 RCM_a027_eventIDFsignal "Restraint control module: a027 event ID fsignal";
CM_ SG_ 1297 RCM_a027_eventFrontLeftSeatbelt "Restraint control module: a027 event front left seatbelt";
CM_ SG_ 1297 RCM_a027_eventFrontRightSeatbelt "Restraint control module: a027 event front right seatbelt";
CM_ SG_ 1297 RCM_a027_eventVehicleSpeed "Restraint control module: a027 event vehicle speed";
CM_ SG_ 1297 RCM_a027_eventSteeringAngle "Restraint control module: a027 event steering angle";
CM_ SG_ 1297 RCM_a027_eventDriverBrakeApply "Restraint control module: a027 event driver brake apply; raw 3 = signal not available (SNA)";
CM_ SG_ 1297 RCM_a027_eventAccelPedalPos "Restraint control module: a027 event accel pedal pos; raw 255 = signal not available (SNA)";
CM_ SG_ 1297 RCM_a028_eventArmStatus "Restraint control module: a028 event arm status";
CM_ SG_ 1297 RCM_a028_eventFactoryMode "Restraint control module: a028 event factory mode";
CM_ SG_ 1297 RCM_a028_eventDiagEnabled "Restraint control module: a028 event diag enabled";
CM_ SG_ 1297 RCM_a028_eventDriveOrientation "Restraint control module: a028 event drive orientation";
CM_ SG_ 1297 RCM_a028_sideAB1stRowRSht2Gnd "Restraint control module: a028 side ab1st row r sht2 gnd";
CM_ SG_ 1297 RCM_a028_sideAB1stRowRSht2Bat "Restraint control module: a028 side ab1st row r sht2 bat";
CM_ SG_ 1297 RCM_a028_sideAB1stRowROpen "Restraint control module: a028 side ab1st row r open";
CM_ SG_ 1297 RCM_a028_sideAB1stRowRShort "Restraint control module: a028 side ab1st row r short";
CM_ SG_ 1297 RCM_a028_sideAB1stRowRCrossCoup "Restraint control module: a028 side ab1st row r cross coup";
CM_ SG_ 1297 RCM_a028_sideAB1stRowRConfig "Restraint control module: a028 side ab1st row r config";
CM_ SG_ 1297 RCM_a028_eventIDFsignal "Restraint control module: a028 event ID fsignal";
CM_ SG_ 1297 RCM_a028_eventFrontLeftSeatbelt "Restraint control module: a028 event front left seatbelt";
CM_ SG_ 1297 RCM_a028_eventFrontRightSeatbelt "Restraint control module: a028 event front right seatbelt";
CM_ SG_ 1297 RCM_a028_eventVehicleSpeed "Restraint control module: a028 event vehicle speed";
CM_ SG_ 1297 RCM_a028_eventSteeringAngle "Restraint control module: a028 event steering angle";
CM_ SG_ 1297 RCM_a028_eventDriverBrakeApply "Restraint control module: a028 event driver brake apply; raw 3 = signal not available (SNA)";
CM_ SG_ 1297 RCM_a028_eventAccelPedalPos "Restraint control module: a028 event accel pedal pos; raw 255 = signal not available (SNA)";
CM_ SG_ 1297 RCM_a029_eventArmStatus "Restraint control module: a029 event arm status";
CM_ SG_ 1297 RCM_a029_eventFactoryMode "Restraint control module: a029 event factory mode";
CM_ SG_ 1297 RCM_a029_eventDiagEnabled "Restraint control module: a029 event diag enabled";
CM_ SG_ 1297 RCM_a029_eventDriveOrientation "Restraint control module: a029 event drive orientation";
CM_ SG_ 1297 RCM_a029_driverABAVSht2Gnd "Restraint control module: a029 driver ABAV sht2 gnd";
CM_ SG_ 1297 RCM_a029_driverABAVSht2Bat "Restraint control module: a029 driver ABAV sht2 bat";
CM_ SG_ 1297 RCM_a029_driverABAVOpen "Restraint control module: a029 driver ABAV open";
CM_ SG_ 1297 RCM_a029_driverABAVShort "Restraint control module: a029 driver ABAV short";
CM_ SG_ 1297 RCM_a029_driverABAVCrossCoup "Restraint control module: a029 driver ABAV cross coup";
CM_ SG_ 1297 RCM_a029_driverABAVConfig "Restraint control module: a029 driver ABAV config";
CM_ SG_ 1297 RCM_a029_eventIDFsignal "Restraint control module: a029 event ID fsignal";
CM_ SG_ 1297 RCM_a029_eventFrontLeftSeatbelt "Restraint control module: a029 event front left seatbelt";
CM_ SG_ 1297 RCM_a029_eventFrontRightSeatbelt "Restraint control module: a029 event front right seatbelt";
CM_ SG_ 1297 RCM_a029_eventVehicleSpeed "Restraint control module: a029 event vehicle speed";
CM_ SG_ 1297 RCM_a029_eventSteeringAngle "Restraint control module: a029 event steering angle";
CM_ SG_ 1297 RCM_a029_eventDriverBrakeApply "Restraint control module: a029 event driver brake apply; raw 3 = signal not available (SNA)";
CM_ SG_ 1297 RCM_a029_eventAccelPedalPos "Restraint control module: a029 event accel pedal pos; raw 255 = signal not available (SNA)";
CM_ SG_ 1297 RCM_a030_eventArmStatus "Restraint control module: a030 event arm status";
CM_ SG_ 1297 RCM_a030_eventFactoryMode "Restraint control module: a030 event factory mode";
CM_ SG_ 1297 RCM_a030_eventDiagEnabled "Restraint control module: a030 event diag enabled";
CM_ SG_ 1297 RCM_a030_eventDriveOrientation "Restraint control module: a030 event drive orientation";
CM_ SG_ 1297 RCM_a030_farsideABSht2Gnd "Restraint control module: a030 farside AB sht2 gnd";
CM_ SG_ 1297 RCM_a030_farsideABSht2Bat "Restraint control module: a030 farside AB sht2 bat";
CM_ SG_ 1297 RCM_a030_farsideABOpen "Restraint control module: a030 farside AB open";
CM_ SG_ 1297 RCM_a030_farsideABShort "Restraint control module: a030 farside AB short";
CM_ SG_ 1297 RCM_a030_farsideABCrossCoup "Restraint control module: a030 farside AB cross coup";
CM_ SG_ 1297 RCM_a030_farsideABConfig "Restraint control module: a030 farside AB config";
CM_ SG_ 1297 RCM_a030_eventIDFsignal "Restraint control module: a030 event ID fsignal";
CM_ SG_ 1297 RCM_a030_eventFrontLeftSeatbelt "Restraint control module: a030 event front left seatbelt";
CM_ SG_ 1297 RCM_a030_eventFrontRightSeatbelt "Restraint control module: a030 event front right seatbelt";
CM_ SG_ 1297 RCM_a030_eventVehicleSpeed "Restraint control module: a030 event vehicle speed";
CM_ SG_ 1297 RCM_a030_eventSteeringAngle "Restraint control module: a030 event steering angle";
CM_ SG_ 1297 RCM_a030_eventDriverBrakeApply "Restraint control module: a030 event driver brake apply; raw 3 = signal not available (SNA)";
CM_ SG_ 1297 RCM_a030_eventAccelPedalPos "Restraint control module: a030 event accel pedal pos; raw 255 = signal not available (SNA)";
CM_ SG_ 1297 RCM_a031_eventArmStatus "Restraint control module: a031 event arm status";
CM_ SG_ 1297 RCM_a031_eventFactoryMode "Restraint control module: a031 event factory mode";
CM_ SG_ 1297 RCM_a031_eventDiagEnabled "Restraint control module: a031 event diag enabled";
CM_ SG_ 1297 RCM_a031_eventDriveOrientation "Restraint control module: a031 event drive orientation";
CM_ SG_ 1297 RCM_a031_frntCentrABSht2Gnd "Restraint control module: a031 frnt centr AB sht2 gnd";
CM_ SG_ 1297 RCM_a031_frntCentrABSht2Bat "Restraint control module: a031 frnt centr AB sht2 bat";
CM_ SG_ 1297 RCM_a031_frntCentrABOpen "Restraint control module: a031 frnt centr AB open";
CM_ SG_ 1297 RCM_a031_frntCentrABShort "Restraint control module: a031 frnt centr AB short";
CM_ SG_ 1297 RCM_a031_frntCentrABCrossCoup "Restraint control module: a031 frnt centr AB cross coup";
CM_ SG_ 1297 RCM_a031_frntCentrABConfig "Restraint control module: a031 frnt centr AB config";
CM_ SG_ 1297 RCM_a031_eventIDFsignal "Restraint control module: a031 event ID fsignal";
CM_ SG_ 1297 RCM_a031_eventFrontLeftSeatbelt "Restraint control module: a031 event front left seatbelt";
CM_ SG_ 1297 RCM_a031_eventFrontRightSeatbelt "Restraint control module: a031 event front right seatbelt";
CM_ SG_ 1297 RCM_a031_eventVehicleSpeed "Restraint control module: a031 event vehicle speed";
CM_ SG_ 1297 RCM_a031_eventSteeringAngle "Restraint control module: a031 event steering angle";
CM_ SG_ 1297 RCM_a031_eventDriverBrakeApply "Restraint control module: a031 event driver brake apply; raw 3 = signal not available (SNA)";
CM_ SG_ 1297 RCM_a031_eventAccelPedalPos "Restraint control module: a031 event accel pedal pos; raw 255 = signal not available (SNA)";
CM_ SG_ 1297 RCM_a032_eventArmStatus "Restraint control module: a032 event arm status";
CM_ SG_ 1297 RCM_a032_eventFactoryMode "Restraint control module: a032 event factory mode";
CM_ SG_ 1297 RCM_a032_eventDiagEnabled "Restraint control module: a032 event diag enabled";
CM_ SG_ 1297 RCM_a032_eventDriveOrientation "Restraint control module: a032 event drive orientation";
CM_ SG_ 1297 RCM_a032_curABLeftSht2Gnd "Restraint control module: a032 cur AB left sht2 gnd";
CM_ SG_ 1297 RCM_a032_curABLeftSht2Bat "Restraint control module: a032 cur AB left sht2 bat";
CM_ SG_ 1297 RCM_a032_curABLeftOpen "Restraint control module: a032 cur AB left open";
CM_ SG_ 1297 RCM_a032_curABLeftShort "Restraint control module: a032 cur AB left short";
CM_ SG_ 1297 RCM_a032_curABLeftCrossCoup "Restraint control module: a032 cur AB left cross coup";
CM_ SG_ 1297 RCM_a032_curABLeftConfig "Restraint control module: a032 cur AB left config";
CM_ SG_ 1297 RCM_a032_eventIDFsignal "Restraint control module: a032 event ID fsignal";
CM_ SG_ 1297 RCM_a032_eventFrontLeftSeatbelt "Restraint control module: a032 event front left seatbelt";
CM_ SG_ 1297 RCM_a032_eventFrontRightSeatbelt "Restraint control module: a032 event front right seatbelt";
CM_ SG_ 1297 RCM_a032_eventVehicleSpeed "Restraint control module: a032 event vehicle speed";
CM_ SG_ 1297 RCM_a032_eventSteeringAngle "Restraint control module: a032 event steering angle";
CM_ SG_ 1297 RCM_a032_eventDriverBrakeApply "Restraint control module: a032 event driver brake apply; raw 3 = signal not available (SNA)";
CM_ SG_ 1297 RCM_a032_eventAccelPedalPos "Restraint control module: a032 event accel pedal pos; raw 255 = signal not available (SNA)";
CM_ SG_ 1297 RCM_a033_eventArmStatus "Restraint control module: a033 event arm status";
CM_ SG_ 1297 RCM_a033_eventFactoryMode "Restraint control module: a033 event factory mode";
CM_ SG_ 1297 RCM_a033_eventDiagEnabled "Restraint control module: a033 event diag enabled";
CM_ SG_ 1297 RCM_a033_eventDriveOrientation "Restraint control module: a033 event drive orientation";
CM_ SG_ 1297 RCM_a033_curABRightSht2Gnd "Restraint control module: a033 cur AB right sht2 gnd";
CM_ SG_ 1297 RCM_a033_curABRightSht2Bat "Restraint control module: a033 cur AB right sht2 bat";
CM_ SG_ 1297 RCM_a033_curABRightOpen "Restraint control module: a033 cur AB right open";
CM_ SG_ 1297 RCM_a033_curABRightShort "Restraint control module: a033 cur AB right short";
CM_ SG_ 1297 RCM_a033_curABRightCrossCoup "Restraint control module: a033 cur AB right cross coup";
CM_ SG_ 1297 RCM_a033_curABRightConfig "Restraint control module: a033 cur AB right config";
CM_ SG_ 1297 RCM_a033_eventIDFsignal "Restraint control module: a033 event ID fsignal";
CM_ SG_ 1297 RCM_a033_eventFrontLeftSeatbelt "Restraint control module: a033 event front left seatbelt";
CM_ SG_ 1297 RCM_a033_eventFrontRightSeatbelt "Restraint control module: a033 event front right seatbelt";
CM_ SG_ 1297 RCM_a033_eventVehicleSpeed "Restraint control module: a033 event vehicle speed";
CM_ SG_ 1297 RCM_a033_eventSteeringAngle "Restraint control module: a033 event steering angle";
CM_ SG_ 1297 RCM_a033_eventDriverBrakeApply "Restraint control module: a033 event driver brake apply; raw 3 = signal not available (SNA)";
CM_ SG_ 1297 RCM_a033_eventAccelPedalPos "Restraint control module: a033 event accel pedal pos; raw 255 = signal not available (SNA)";
CM_ SG_ 1297 RCM_a034_eventArmStatus "Restraint control module: a034 event arm status";
CM_ SG_ 1297 RCM_a034_eventFactoryMode "Restraint control module: a034 event factory mode";
CM_ SG_ 1297 RCM_a034_eventDiagEnabled "Restraint control module: a034 event diag enabled";
CM_ SG_ 1297 RCM_a034_eventDriveOrientation "Restraint control module: a034 event drive orientation";
CM_ SG_ 1297 RCM_a034_preten2ndRowLSht2Gnd "Restraint control module: a034 preten2nd row l sht2 gnd";
CM_ SG_ 1297 RCM_a034_preten2ndRowLSht2Bat "Restraint control module: a034 preten2nd row l sht2 bat";
CM_ SG_ 1297 RCM_a034_preten2ndRowLOpen "Restraint control module: a034 preten2nd row l open";
CM_ SG_ 1297 RCM_a034_preten2ndRowLShort "Restraint control module: a034 preten2nd row l short";
CM_ SG_ 1297 RCM_a034_preten2ndRowLCrossCoup "Restraint control module: a034 preten2nd row l cross coup";
CM_ SG_ 1297 RCM_a034_preten2ndRowLCgf "Restraint control module: a034 preten2nd row l cgf";
CM_ SG_ 1297 RCM_a034_eventIDFsignal "Restraint control module: a034 event ID fsignal";
CM_ SG_ 1297 RCM_a034_eventFrontLeftSeatbelt "Restraint control module: a034 event front left seatbelt";
CM_ SG_ 1297 RCM_a034_eventFrontRightSeatbelt "Restraint control module: a034 event front right seatbelt";
CM_ SG_ 1297 RCM_a034_eventVehicleSpeed "Restraint control module: a034 event vehicle speed";
CM_ SG_ 1297 RCM_a034_eventSteeringAngle "Restraint control module: a034 event steering angle";
CM_ SG_ 1297 RCM_a034_eventDriverBrakeApply "Restraint control module: a034 event driver brake apply; raw 3 = signal not available (SNA)";
CM_ SG_ 1297 RCM_a034_eventAccelPedalPos "Restraint control module: a034 event accel pedal pos; raw 255 = signal not available (SNA)";
CM_ SG_ 1297 RCM_a035_eventArmStatus "Restraint control module: a035 event arm status";
CM_ SG_ 1297 RCM_a035_eventFactoryMode "Restraint control module: a035 event factory mode";
CM_ SG_ 1297 RCM_a035_eventDiagEnabled "Restraint control module: a035 event diag enabled";
CM_ SG_ 1297 RCM_a035_eventDriveOrientation "Restraint control module: a035 event drive orientation";
CM_ SG_ 1297 RCM_a035_preten2ndRowRSht2Gnd "Restraint control module: a035 preten2nd row r sht2 gnd";
CM_ SG_ 1297 RCM_a035_preten2ndRowRSht2Bat "Restraint control module: a035 preten2nd row r sht2 bat";
CM_ SG_ 1297 RCM_a035_preten2ndRowROpen "Restraint control module: a035 preten2nd row r open";
CM_ SG_ 1297 RCM_a035_preten2ndRowRShort "Restraint control module: a035 preten2nd row r short";
CM_ SG_ 1297 RCM_a035_preten2ndRowRCrossCoup "Restraint control module: a035 preten2nd row r cross coup";
CM_ SG_ 1297 RCM_a035_preten2ndRowRCgf "Restraint control module: a035 preten2nd row r cgf";
CM_ SG_ 1297 RCM_a035_eventIDFsignal "Restraint control module: a035 event ID fsignal";
CM_ SG_ 1297 RCM_a035_eventFrontLeftSeatbelt "Restraint control module: a035 event front left seatbelt";
CM_ SG_ 1297 RCM_a035_eventFrontRightSeatbelt "Restraint control module: a035 event front right seatbelt";
CM_ SG_ 1297 RCM_a035_eventVehicleSpeed "Restraint control module: a035 event vehicle speed";
CM_ SG_ 1297 RCM_a035_eventSteeringAngle "Restraint control module: a035 event steering angle";
CM_ SG_ 1297 RCM_a035_eventDriverBrakeApply "Restraint control module: a035 event driver brake apply; raw 3 = signal not available (SNA)";
CM_ SG_ 1297 RCM_a035_eventAccelPedalPos "Restraint control module: a035 event accel pedal pos; raw 255 = signal not available (SNA)";
CM_ SG_ 1297 RCM_a036_eventArmStatus "Restraint control module: a036 event arm status";
CM_ SG_ 1297 RCM_a036_eventFactoryMode "Restraint control module: a036 event factory mode";
CM_ SG_ 1297 RCM_a036_eventDiagEnabled "Restraint control module: a036 event diag enabled";
CM_ SG_ 1297 RCM_a036_eventDriveOrientation "Restraint control module: a036 event drive orientation";
CM_ SG_ 1297 RCM_a036_curAB2ndRowLSht2Gnd "Restraint control module: a036 cur ab2nd row l sht2 gnd";
CM_ SG_ 1297 RCM_a036_curAB2ndRowLSht2Bat "Restraint control module: a036 cur ab2nd row l sht2 bat";
CM_ SG_ 1297 RCM_a036_curAB2ndRowLOpen "Restraint control module: a036 cur ab2nd row l open";
CM_ SG_ 1297 RCM_a036_curAB2ndRowLShort "Restraint control module: a036 cur ab2nd row l short";
CM_ SG_ 1297 RCM_a036_curAB2ndRowLCrossCoup "Restraint control module: a036 cur ab2nd row l cross coup";
CM_ SG_ 1297 RCM_a036_curAB2ndRowLConfig "Restraint control module: a036 cur ab2nd row l config";
CM_ SG_ 1297 RCM_a036_eventIDFsignal "Restraint control module: a036 event ID fsignal";
CM_ SG_ 1297 RCM_a036_eventFrontLeftSeatbelt "Restraint control module: a036 event front left seatbelt";
CM_ SG_ 1297 RCM_a036_eventFrontRightSeatbelt "Restraint control module: a036 event front right seatbelt";
CM_ SG_ 1297 RCM_a036_eventVehicleSpeed "Restraint control module: a036 event vehicle speed";
CM_ SG_ 1297 RCM_a036_eventSteeringAngle "Restraint control module: a036 event steering angle";
CM_ SG_ 1297 RCM_a036_eventDriverBrakeApply "Restraint control module: a036 event driver brake apply; raw 3 = signal not available (SNA)";
CM_ SG_ 1297 RCM_a036_eventAccelPedalPos "Restraint control module: a036 event accel pedal pos; raw 255 = signal not available (SNA)";
CM_ SG_ 1297 RCM_a037_eventArmStatus "Restraint control module: a037 event arm status";
CM_ SG_ 1297 RCM_a037_eventFactoryMode "Restraint control module: a037 event factory mode";
CM_ SG_ 1297 RCM_a037_eventDiagEnabled "Restraint control module: a037 event diag enabled";
CM_ SG_ 1297 RCM_a037_eventDriveOrientation "Restraint control module: a037 event drive orientation";
CM_ SG_ 1297 RCM_a037_curAB2ndRowRSht2Gnd "Restraint control module: a037 cur ab2nd row r sht2 gnd";
CM_ SG_ 1297 RCM_a037_curAB2ndRowRSht2Bat "Restraint control module: a037 cur ab2nd row r sht2 bat";
CM_ SG_ 1297 RCM_a037_curAB2ndRowROpen "Restraint control module: a037 cur ab2nd row r open";
CM_ SG_ 1297 RCM_a037_curAB2ndRowRShort "Restraint control module: a037 cur ab2nd row r short";
CM_ SG_ 1297 RCM_a037_curAB2ndRowRCrossCoup "Restraint control module: a037 cur ab2nd row r cross coup";
CM_ SG_ 1297 RCM_a037_curAB2ndRowRConfig "Restraint control module: a037 cur ab2nd row r config";
CM_ SG_ 1297 RCM_a037_eventIDFsignal "Restraint control module: a037 event ID fsignal";
CM_ SG_ 1297 RCM_a037_eventFrontLeftSeatbelt "Restraint control module: a037 event front left seatbelt";
CM_ SG_ 1297 RCM_a037_eventFrontRightSeatbelt "Restraint control module: a037 event front right seatbelt";
CM_ SG_ 1297 RCM_a037_eventVehicleSpeed "Restraint control module: a037 event vehicle speed";
CM_ SG_ 1297 RCM_a037_eventSteeringAngle "Restraint control module: a037 event steering angle";
CM_ SG_ 1297 RCM_a037_eventDriverBrakeApply "Restraint control module: a037 event driver brake apply; raw 3 = signal not available (SNA)";
CM_ SG_ 1297 RCM_a037_eventAccelPedalPos "Restraint control module: a037 event accel pedal pos; raw 255 = signal not available (SNA)";
CM_ SG_ 1297 RCM_a040_eventArmStatus "Restraint control module: a040 event arm status";
CM_ SG_ 1297 RCM_a040_eventFactoryMode "Restraint control module: a040 event factory mode";
CM_ SG_ 1297 RCM_a040_eventDiagEnabled "Restraint control module: a040 event diag enabled";
CM_ SG_ 1297 RCM_a040_eventDriveOrientation "Restraint control module: a040 event drive orientation";
CM_ SG_ 1297 RCM_a040_hoodActuatorRSht2Gnd "Restraint control module: a040 hood actuator r sht2 gnd";
CM_ SG_ 1297 RCM_a040_hoodActuatorRSht2Bat "Restraint control module: a040 hood actuator r sht2 bat";
CM_ SG_ 1297 RCM_a040_hoodActuatorROpen "Restraint control module: a040 hood actuator r open";
CM_ SG_ 1297 RCM_a040_hoodActuatorRShort "Restraint control module: a040 hood actuator r short";
CM_ SG_ 1297 RCM_a040_hoodActuatorRCrossCoup "Restraint control module: a040 hood actuator r cross coup";
CM_ SG_ 1297 RCM_a040_hoodActuatorRConfig "Restraint control module: a040 hood actuator r config";
CM_ SG_ 1297 RCM_a040_eventIDFsignal "Restraint control module: a040 event ID fsignal";
CM_ SG_ 1297 RCM_a040_eventFrontLeftSeatbelt "Restraint control module: a040 event front left seatbelt";
CM_ SG_ 1297 RCM_a040_eventFrontRightSeatbelt "Restraint control module: a040 event front right seatbelt";
CM_ SG_ 1297 RCM_a040_eventVehicleSpeed "Restraint control module: a040 event vehicle speed";
CM_ SG_ 1297 RCM_a040_eventSteeringAngle "Restraint control module: a040 event steering angle";
CM_ SG_ 1297 RCM_a040_eventDriverBrakeApply "Restraint control module: a040 event driver brake apply; raw 3 = signal not available (SNA)";
CM_ SG_ 1297 RCM_a040_eventAccelPedalPos "Restraint control module: a040 event accel pedal pos; raw 255 = signal not available (SNA)";
CM_ SG_ 1297 RCM_a041_eventArmStatus "Restraint control module: a041 event arm status";
CM_ SG_ 1297 RCM_a041_eventFactoryMode "Restraint control module: a041 event factory mode";
CM_ SG_ 1297 RCM_a041_eventDiagEnabled "Restraint control module: a041 event diag enabled";
CM_ SG_ 1297 RCM_a041_eventDriveOrientation "Restraint control module: a041 event drive orientation";
CM_ SG_ 1297 RCM_a041_hoodActuatorLSht2Gnd "Restraint control module: a041 hood actuator l sht2 gnd";
CM_ SG_ 1297 RCM_a041_hoodActuatorLSht2Bat "Restraint control module: a041 hood actuator l sht2 bat";
CM_ SG_ 1297 RCM_a041_hoodActuatorLOpen "Restraint control module: a041 hood actuator l open";
CM_ SG_ 1297 RCM_a041_hoodActuatorLShort "Restraint control module: a041 hood actuator l short";
CM_ SG_ 1297 RCM_a041_hoodActuatorLCrossCoup "Restraint control module: a041 hood actuator l cross coup";
CM_ SG_ 1297 RCM_a041_hoodActuatorLConfig "Restraint control module: a041 hood actuator l config";
CM_ SG_ 1297 RCM_a041_eventIDFsignal "Restraint control module: a041 event ID fsignal";
CM_ SG_ 1297 RCM_a041_eventFrontLeftSeatbelt "Restraint control module: a041 event front left seatbelt";
CM_ SG_ 1297 RCM_a041_eventFrontRightSeatbelt "Restraint control module: a041 event front right seatbelt";
CM_ SG_ 1297 RCM_a041_eventVehicleSpeed "Restraint control module: a041 event vehicle speed";
CM_ SG_ 1297 RCM_a041_eventSteeringAngle "Restraint control module: a041 event steering angle";
CM_ SG_ 1297 RCM_a041_eventDriverBrakeApply "Restraint control module: a041 event driver brake apply; raw 3 = signal not available (SNA)";
CM_ SG_ 1297 RCM_a041_eventAccelPedalPos "Restraint control module: a041 event accel pedal pos; raw 255 = signal not available (SNA)";
CM_ SG_ 1297 RCM_a042_eventArmStatus "Restraint control module: a042 event arm status";
CM_ SG_ 1297 RCM_a042_eventFactoryMode "Restraint control module: a042 event factory mode";
CM_ SG_ 1297 RCM_a042_eventDiagEnabled "Restraint control module: a042 event diag enabled";
CM_ SG_ 1297 RCM_a042_eventDriveOrientation "Restraint control module: a042 event drive orientation";
CM_ SG_ 1297 RCM_a042_ens1Sht2Bat "Restraint control module: a042 ens1 sht2 bat";
CM_ SG_ 1297 RCM_a042_ens1Sht2Gnd "Restraint control module: a042 ens1 sht2 gnd";
CM_ SG_ 1297 RCM_a042_ens1Config "Restraint control module: a042 ens1 config";
CM_ SG_ 1297 RCM_a042_eventIDFsignal "Restraint control module: a042 event ID fsignal";
CM_ SG_ 1297 RCM_a042_eventFrontLeftSeatbelt "Restraint control module: a042 event front left seatbelt";
CM_ SG_ 1297 RCM_a042_eventFrontRightSeatbelt "Restraint control module: a042 event front right seatbelt";
CM_ SG_ 1297 RCM_a042_eventVehicleSpeed "Restraint control module: a042 event vehicle speed";
CM_ SG_ 1297 RCM_a042_eventSteeringAngle "Restraint control module: a042 event steering angle";
CM_ SG_ 1297 RCM_a042_eventDriverBrakeApply "Restraint control module: a042 event driver brake apply; raw 3 = signal not available (SNA)";
CM_ SG_ 1297 RCM_a042_eventAccelPedalPos "Restraint control module: a042 event accel pedal pos; raw 255 = signal not available (SNA)";
CM_ SG_ 1297 RCM_a043_eventArmStatus "Restraint control module: a043 event arm status";
CM_ SG_ 1297 RCM_a043_eventFactoryMode "Restraint control module: a043 event factory mode";
CM_ SG_ 1297 RCM_a043_eventDiagEnabled "Restraint control module: a043 event diag enabled";
CM_ SG_ 1297 RCM_a043_eventDriveOrientation "Restraint control module: a043 event drive orientation";
CM_ SG_ 1297 RCM_a043_ens2Sht2Bat "Restraint control module: a043 ens2 sht2 bat";
CM_ SG_ 1297 RCM_a043_ens2Sht2Gnd "Restraint control module: a043 ens2 sht2 gnd";
CM_ SG_ 1297 RCM_a043_ens2Config "Restraint control module: a043 ens2 config";
CM_ SG_ 1297 RCM_a043_eventIDFsignal "Restraint control module: a043 event ID fsignal";
CM_ SG_ 1297 RCM_a043_eventFrontLeftSeatbelt "Restraint control module: a043 event front left seatbelt";
CM_ SG_ 1297 RCM_a043_eventFrontRightSeatbelt "Restraint control module: a043 event front right seatbelt";
CM_ SG_ 1297 RCM_a043_eventVehicleSpeed "Restraint control module: a043 event vehicle speed";
CM_ SG_ 1297 RCM_a043_eventSteeringAngle "Restraint control module: a043 event steering angle";
CM_ SG_ 1297 RCM_a043_eventDriverBrakeApply "Restraint control module: a043 event driver brake apply; raw 3 = signal not available (SNA)";
CM_ SG_ 1297 RCM_a043_eventAccelPedalPos "Restraint control module: a043 event accel pedal pos; raw 255 = signal not available (SNA)";
CM_ SG_ 1297 RCM_a044_eventArmStatus "Restraint control module: a044 event arm status";
CM_ SG_ 1297 RCM_a044_eventFactoryMode "Restraint control module: a044 event factory mode";
CM_ SG_ 1297 RCM_a044_eventDiagEnabled "Restraint control module: a044 event diag enabled";
CM_ SG_ 1297 RCM_a044_eventDriveOrientation "Restraint control module: a044 event drive orientation";
CM_ SG_ 1297 RCM_a044_upFrontSensorLSht2Gnd "Restraint control module: a044 up front sensor l sht2 gnd";
CM_ SG_ 1297 RCM_a044_upFrontSensorLSht2Bat "Restraint control module: a044 up front sensor l sht2 bat";
CM_ SG_ 1297 RCM_a044_upFrontSensorLCrossCoup "Restraint control module: a044 up front sensor l cross coup";
CM_ SG_ 1297 RCM_a044_upFrontSensorLComm "Restraint control module: a044 up front sensor l comm";
CM_ SG_ 1297 RCM_a044_upFrontSensorLInitTyp "Restraint control module: a044 up front sensor l init typ";
CM_ SG_ 1297 RCM_a044_upFrontSensorLOption "Restraint control module: a044 up front sensor l option";
CM_ SG_ 1297 RCM_a044_upFrontSensorLplaus "Restraint control module: a044 up front sensor lplaus";
CM_ SG_ 1297 RCM_a044_upFrontSensorLDefect "Restraint control module: a044 up front sensor l defect";
CM_ SG_ 1297 RCM_a044_eventIDFsignal "Restraint control module: a044 event ID fsignal";
CM_ SG_ 1297 RCM_a044_eventFrontLeftSeatbelt "Restraint control module: a044 event front left seatbelt";
CM_ SG_ 1297 RCM_a044_eventFrontRightSeatbelt "Restraint control module: a044 event front right seatbelt";
CM_ SG_ 1297 RCM_a044_eventVehicleSpeed "Restraint control module: a044 event vehicle speed";
CM_ SG_ 1297 RCM_a044_eventSteeringAngle "Restraint control module: a044 event steering angle";
CM_ SG_ 1297 RCM_a044_eventDriverBrakeApply "Restraint control module: a044 event driver brake apply; raw 3 = signal not available (SNA)";
CM_ SG_ 1297 RCM_a044_eventAccelPedalPos "Restraint control module: a044 event accel pedal pos; raw 255 = signal not available (SNA)";
CM_ SG_ 1297 RCM_a045_eventArmStatus "Restraint control module: a045 event arm status";
CM_ SG_ 1297 RCM_a045_eventFactoryMode "Restraint control module: a045 event factory mode";
CM_ SG_ 1297 RCM_a045_eventDiagEnabled "Restraint control module: a045 event diag enabled";
CM_ SG_ 1297 RCM_a045_eventDriveOrientation "Restraint control module: a045 event drive orientation";
CM_ SG_ 1297 RCM_a045_upFrontSensorRSht2Gnd "Restraint control module: a045 up front sensor r sht2 gnd";
CM_ SG_ 1297 RCM_a045_upFrontSensorRSht2Bat "Restraint control module: a045 up front sensor r sht2 bat";
CM_ SG_ 1297 RCM_a045_upFrontSensorRCrossCoup "Restraint control module: a045 up front sensor r cross coup";
CM_ SG_ 1297 RCM_a045_upFrontSensorRComm "Restraint control module: a045 up front sensor r comm";
CM_ SG_ 1297 RCM_a045_upFrontSensorRInitTyp "Restraint control module: a045 up front sensor r init typ";
CM_ SG_ 1297 RCM_a045_upFrontSensorROption "Restraint control module: a045 up front sensor r option";
CM_ SG_ 1297 RCM_a045_upFrontSensorRplaus "Restraint control module: a045 up front sensor rplaus";
CM_ SG_ 1297 RCM_a045_upFrontSensorRDefect "Restraint control module: a045 up front sensor r defect";
CM_ SG_ 1297 RCM_a045_eventIDFsignal "Restraint control module: a045 event ID fsignal";
CM_ SG_ 1297 RCM_a045_eventFrontLeftSeatbelt "Restraint control module: a045 event front left seatbelt";
CM_ SG_ 1297 RCM_a045_eventFrontRightSeatbelt "Restraint control module: a045 event front right seatbelt";
CM_ SG_ 1297 RCM_a045_eventVehicleSpeed "Restraint control module: a045 event vehicle speed";
CM_ SG_ 1297 RCM_a045_eventSteeringAngle "Restraint control module: a045 event steering angle";
CM_ SG_ 1297 RCM_a045_eventDriverBrakeApply "Restraint control module: a045 event driver brake apply; raw 3 = signal not available (SNA)";
CM_ SG_ 1297 RCM_a045_eventAccelPedalPos "Restraint control module: a045 event accel pedal pos; raw 255 = signal not available (SNA)";
CM_ SG_ 1297 RCM_a046_eventArmStatus "Restraint control module: a046 event arm status";
CM_ SG_ 1297 RCM_a046_eventFactoryMode "Restraint control module: a046 event factory mode";
CM_ SG_ 1297 RCM_a046_eventDiagEnabled "Restraint control module: a046 event diag enabled";
CM_ SG_ 1297 RCM_a046_eventDriveOrientation "Restraint control module: a046 event drive orientation";
CM_ SG_ 1297 RCM_a046_sideAccelBPilLSht2Gnd "Restraint control module: a046 side accel b pil l sht2 gnd";
CM_ SG_ 1297 RCM_a046_sideAccelBPilLSht2Bat "Restraint control module: a046 side accel b pil l sht2 bat";
CM_ SG_ 1297 RCM_a046_sideAccelBPilLCLosCoup "Restraint control module: a046 side accel b pil LC los coup";
CM_ SG_ 1297 RCM_a046_sideAccelBPilLComm "Restraint control module: a046 side accel b pil l comm";
CM_ SG_ 1297 RCM_a046_sideAccelBPilLInitTyp "Restraint control module: a046 side accel b pil l init typ";
CM_ SG_ 1297 RCM_a046_sideAccelBPilLOption "Restraint control module: a046 side accel b pil l option";
CM_ SG_ 1297 RCM_a046_sideAccelBPilLplaus "Restraint control module: a046 side accel b pil lplaus";
CM_ SG_ 1297 RCM_a046_sideAccelBPilLDefect "Restraint control module: a046 side accel b pil l defect";
CM_ SG_ 1297 RCM_a046_eventIDFsignal "Restraint control module: a046 event ID fsignal";
CM_ SG_ 1297 RCM_a046_eventFrontLeftSeatbelt "Restraint control module: a046 event front left seatbelt";
CM_ SG_ 1297 RCM_a046_eventFrontRightSeatbelt "Restraint control module: a046 event front right seatbelt";
CM_ SG_ 1297 RCM_a046_eventVehicleSpeed "Restraint control module: a046 event vehicle speed";
CM_ SG_ 1297 RCM_a046_eventSteeringAngle "Restraint control module: a046 event steering angle";
CM_ SG_ 1297 RCM_a046_eventDriverBrakeApply "Restraint control module: a046 event driver brake apply; raw 3 = signal not available (SNA)";
CM_ SG_ 1297 RCM_a046_eventAccelPedalPos "Restraint control module: a046 event accel pedal pos; raw 255 = signal not available (SNA)";
CM_ SG_ 1297 RCM_a047_eventArmStatus "Restraint control module: a047 event arm status";
CM_ SG_ 1297 RCM_a047_eventFactoryMode "Restraint control module: a047 event factory mode";
CM_ SG_ 1297 RCM_a047_eventDiagEnabled "Restraint control module: a047 event diag enabled";
CM_ SG_ 1297 RCM_a047_eventDriveOrientation "Restraint control module: a047 event drive orientation";
CM_ SG_ 1297 RCM_a047_sideAccelBPilRSht2Gnd "Restraint control module: a047 side accel b pil r sht2 gnd";
CM_ SG_ 1297 RCM_a047_sideAccelBPilRSht2Bat "Restraint control module: a047 side accel b pil r sht2 bat";
CM_ SG_ 1297 RCM_a047_sideAccelBPilRCrossCoup "Restraint control module: a047 side accel b pil r cross coup";
CM_ SG_ 1297 RCM_a047_sideAccelBPilRComm "Restraint control module: a047 side accel b pil r comm";
CM_ SG_ 1297 RCM_a047_sideAccelBPilRInitTyp "Restraint control module: a047 side accel b pil r init typ";
CM_ SG_ 1297 RCM_a047_sideAccelBPilROption "Restraint control module: a047 side accel b pil r option";
CM_ SG_ 1297 RCM_a047_sideAccelBPilRplaus "Restraint control module: a047 side accel b pil rplaus";
CM_ SG_ 1297 RCM_a047_sideAccelBPilRDefect "Restraint control module: a047 side accel b pil r defect";
CM_ SG_ 1297 RCM_a047_eventIDFsignal "Restraint control module: a047 event ID fsignal";
CM_ SG_ 1297 RCM_a047_eventFrontLeftSeatbelt "Restraint control module: a047 event front left seatbelt";
CM_ SG_ 1297 RCM_a047_eventFrontRightSeatbelt "Restraint control module: a047 event front right seatbelt";
CM_ SG_ 1297 RCM_a047_eventVehicleSpeed "Restraint control module: a047 event vehicle speed";
CM_ SG_ 1297 RCM_a047_eventSteeringAngle "Restraint control module: a047 event steering angle";
CM_ SG_ 1297 RCM_a047_eventDriverBrakeApply "Restraint control module: a047 event driver brake apply; raw 3 = signal not available (SNA)";
CM_ SG_ 1297 RCM_a047_eventAccelPedalPos "Restraint control module: a047 event accel pedal pos; raw 255 = signal not available (SNA)";
CM_ SG_ 1297 RCM_a048_eventArmStatus "Restraint control module: a048 event arm status";
CM_ SG_ 1297 RCM_a048_eventFactoryMode "Restraint control module: a048 event factory mode";
CM_ SG_ 1297 RCM_a048_eventDiagEnabled "Restraint control module: a048 event diag enabled";
CM_ SG_ 1297 RCM_a048_eventDriveOrientation "Restraint control module: a048 event drive orientation";
CM_ SG_ 1297 RCM_a048_sideAccelCPilLSht2Gnd "Restraint control module: a048 side accel c pil l sht2 gnd";
CM_ SG_ 1297 RCM_a048_sideAccelCPilLSht2Bat "Restraint control module: a048 side accel c pil l sht2 bat";
CM_ SG_ 1297 RCM_a048_sideAccelCPilLCrossCoup "Restraint control module: a048 side accel c pil l cross coup";
CM_ SG_ 1297 RCM_a048_sideAccelCPilLComm "Restraint control module: a048 side accel c pil l comm";
CM_ SG_ 1297 RCM_a048_sideAccelCPilLInitTyp "Restraint control module: a048 side accel c pil l init typ";
CM_ SG_ 1297 RCM_a048_sideAccelCPilLOption "Restraint control module: a048 side accel c pil l option";
CM_ SG_ 1297 RCM_a048_sideAccelCPilLplaus "Restraint control module: a048 side accel c pil lplaus";
CM_ SG_ 1297 RCM_a048_sideAccelCPilLDefect "Restraint control module: a048 side accel c pil l defect";
CM_ SG_ 1297 RCM_a048_eventIDFsignal "Restraint control module: a048 event ID fsignal";
CM_ SG_ 1297 RCM_a048_eventFrontLeftSeatbelt "Restraint control module: a048 event front left seatbelt";
CM_ SG_ 1297 RCM_a048_eventFrontRightSeatbelt "Restraint control module: a048 event front right seatbelt";
CM_ SG_ 1297 RCM_a048_eventVehicleSpeed "Restraint control module: a048 event vehicle speed";
CM_ SG_ 1297 RCM_a048_eventSteeringAngle "Restraint control module: a048 event steering angle";
CM_ SG_ 1297 RCM_a048_eventDriverBrakeApply "Restraint control module: a048 event driver brake apply; raw 3 = signal not available (SNA)";
CM_ SG_ 1297 RCM_a048_eventAccelPedalPos "Restraint control module: a048 event accel pedal pos; raw 255 = signal not available (SNA)";
CM_ SG_ 1297 RCM_a049_eventArmStatus "Restraint control module: a049 event arm status";
CM_ SG_ 1297 RCM_a049_eventFactoryMode "Restraint control module: a049 event factory mode";
CM_ SG_ 1297 RCM_a049_eventDiagEnabled "Restraint control module: a049 event diag enabled";
CM_ SG_ 1297 RCM_a049_eventDriveOrientation "Restraint control module: a049 event drive orientation";
CM_ SG_ 1297 RCM_a049_sideAccelCPilRSht2Gnd "Restraint control module: a049 side accel c pil r sht2 gnd";
CM_ SG_ 1297 RCM_a049_sideAccelCPilRSht2Bat "Restraint control module: a049 side accel c pil r sht2 bat";
CM_ SG_ 1297 RCM_a049_sideAccelCPilRCrossCoup "Restraint control module: a049 side accel c pil r cross coup";
CM_ SG_ 1297 RCM_a049_sideAccelCPilRComm "Restraint control module: a049 side accel c pil r comm";
CM_ SG_ 1297 RCM_a049_sideAccelCPilRInitTyp "Restraint control module: a049 side accel c pil r init typ";
CM_ SG_ 1297 RCM_a049_sideAccelCPilROption "Restraint control module: a049 side accel c pil r option";
CM_ SG_ 1297 RCM_a049_sideAccelCPilRplaus "Restraint control module: a049 side accel c pil rplaus";
CM_ SG_ 1297 RCM_a049_sideAccelCPilRDefect "Restraint control module: a049 side accel c pil r defect";
CM_ SG_ 1297 RCM_a049_eventIDFsignal "Restraint control module: a049 event ID fsignal";
CM_ SG_ 1297 RCM_a049_eventFrontLeftSeatbelt "Restraint control module: a049 event front left seatbelt";
CM_ SG_ 1297 RCM_a049_eventFrontRightSeatbelt "Restraint control module: a049 event front right seatbelt";
CM_ SG_ 1297 RCM_a049_eventVehicleSpeed "Restraint control module: a049 event vehicle speed";
CM_ SG_ 1297 RCM_a049_eventSteeringAngle "Restraint control module: a049 event steering angle";
CM_ SG_ 1297 RCM_a049_eventDriverBrakeApply "Restraint control module: a049 event driver brake apply; raw 3 = signal not available (SNA)";
CM_ SG_ 1297 RCM_a049_eventAccelPedalPos "Restraint control module: a049 event accel pedal pos; raw 255 = signal not available (SNA)";
CM_ SG_ 1297 RCM_a050_eventArmStatus "Restraint control module: a050 event arm status";
CM_ SG_ 1297 RCM_a050_eventFactoryMode "Restraint control module: a050 event factory mode";
CM_ SG_ 1297 RCM_a050_eventDiagEnabled "Restraint control module: a050 event diag enabled";
CM_ SG_ 1297 RCM_a050_eventDriveOrientation "Restraint control module: a050 event drive orientation";
CM_ SG_ 1297 RCM_a050_upFrontSensorCSht2Gnd "Restraint control module: a050 up front sensor c sht2 gnd";
CM_ SG_ 1297 RCM_a050_upFrontSensorCSht2Bat "Restraint control module: a050 up front sensor c sht2 bat";
CM_ SG_ 1297 RCM_a050_upFrontSensorCCrossCoup "Restraint control module: a050 up front sensor c cross coup";
CM_ SG_ 1297 RCM_a050_upFrontSensorCComm "Restraint control module: a050 up front sensor c comm";
CM_ SG_ 1297 RCM_a050_upFrontSensorCInitTyp "Restraint control module: a050 up front sensor c init typ";
CM_ SG_ 1297 RCM_a050_upFrontSensorCOption "Restraint control module: a050 up front sensor c option";
CM_ SG_ 1297 RCM_a050_upFrontSensorCplaus "Restraint control module: a050 up front sensor cplaus";
CM_ SG_ 1297 RCM_a050_upFrontSensorCDefect "Restraint control module: a050 up front sensor c defect";
CM_ SG_ 1297 RCM_a050_eventIDFsignal "Restraint control module: a050 event ID fsignal";
CM_ SG_ 1297 RCM_a050_eventFrontLeftSeatbelt "Restraint control module: a050 event front left seatbelt";
CM_ SG_ 1297 RCM_a050_eventFrontRightSeatbelt "Restraint control module: a050 event front right seatbelt";
CM_ SG_ 1297 RCM_a050_eventVehicleSpeed "Restraint control module: a050 event vehicle speed";
CM_ SG_ 1297 RCM_a050_eventSteeringAngle "Restraint control module: a050 event steering angle";
CM_ SG_ 1297 RCM_a050_eventDriverBrakeApply "Restraint control module: a050 event driver brake apply; raw 3 = signal not available (SNA)";
CM_ SG_ 1297 RCM_a050_eventAccelPedalPos "Restraint control module: a050 event accel pedal pos; raw 255 = signal not available (SNA)";
CM_ SG_ 1297 RCM_a051_eventArmStatus "Restraint control module: a051 event arm status";
CM_ SG_ 1297 RCM_a051_eventFactoryMode "Restraint control module: a051 event factory mode";
CM_ SG_ 1297 RCM_a051_eventDiagEnabled "Restraint control module: a051 event diag enabled";
CM_ SG_ 1297 RCM_a051_eventDriveOrientation "Restraint control module: a051 event drive orientation";
CM_ SG_ 1297 RCM_a051_presFrntLDoorComm "Restraint control module: a051 pres frnt l door comm";
CM_ SG_ 1297 RCM_a051_presFrntLDoorInitTyp "Restraint control module: a051 pres frnt l door init typ";
CM_ SG_ 1297 RCM_a051_presFrntLDoorOption "Restraint control module: a051 pres frnt l door option";
CM_ SG_ 1297 RCM_a051_presFrntLDoorPlaus "Restraint control module: a051 pres frnt l door plaus";
CM_ SG_ 1297 RCM_a051_presFrntLDoorAbsPre "Restraint control module: a051 pres frnt l door abs pre";
CM_ SG_ 1297 RCM_a051_presFrntLDoorDefect "Restraint control module: a051 pres frnt l door defect";
CM_ SG_ 1297 RCM_a051_presFrntLDoorSht2Gnd "Restraint control module: a051 pres frnt l door sht2 gnd";
CM_ SG_ 1297 RCM_a051_presFrntLDoorSht2Bat "Restraint control module: a051 pres frnt l door sht2 bat";
CM_ SG_ 1297 RCM_a051_presFrntLDoorCrossCoup "Restraint control module: a051 pres frnt l door cross coup";
CM_ SG_ 1297 RCM_a051_eventIDFsignal "Restraint control module: a051 event ID fsignal";
CM_ SG_ 1297 RCM_a051_eventFrontLeftSeatbelt "Restraint control module: a051 event front left seatbelt";
CM_ SG_ 1297 RCM_a051_eventFrontRightSeatbelt "Restraint control module: a051 event front right seatbelt";
CM_ SG_ 1297 RCM_a051_eventVehicleSpeed "Restraint control module: a051 event vehicle speed";
CM_ SG_ 1297 RCM_a051_eventSteeringAngle "Restraint control module: a051 event steering angle";
CM_ SG_ 1297 RCM_a051_eventDriverBrakeApply "Restraint control module: a051 event driver brake apply; raw 3 = signal not available (SNA)";
CM_ SG_ 1297 RCM_a051_eventAccelPedalPos "Restraint control module: a051 event accel pedal pos; raw 255 = signal not available (SNA)";
CM_ SG_ 1297 RCM_a052_eventArmStatus "Restraint control module: a052 event arm status";
CM_ SG_ 1297 RCM_a052_eventFactoryMode "Restraint control module: a052 event factory mode";
CM_ SG_ 1297 RCM_a052_eventDiagEnabled "Restraint control module: a052 event diag enabled";
CM_ SG_ 1297 RCM_a052_eventDriveOrientation "Restraint control module: a052 event drive orientation";
CM_ SG_ 1297 RCM_a052_presFrntRDoorComm "Restraint control module: a052 pres frnt r door comm";
CM_ SG_ 1297 RCM_a052_presFrntRDoorInitTyp "Restraint control module: a052 pres frnt r door init typ";
CM_ SG_ 1297 RCM_a052_presFrntRDoorOption "Restraint control module: a052 pres frnt r door option";
CM_ SG_ 1297 RCM_a052_presFrntRDoorPlaus "Restraint control module: a052 pres frnt r door plaus";
CM_ SG_ 1297 RCM_a052_presFrntRDoorAbsPre "Restraint control module: a052 pres frnt r door abs pre";
CM_ SG_ 1297 RCM_a052_presFrntRDoorDefect "Restraint control module: a052 pres frnt r door defect";
CM_ SG_ 1297 RCM_a052_presFrntRDoorSht2Gnd "Restraint control module: a052 pres frnt r door sht2 gnd";
CM_ SG_ 1297 RCM_a052_presFrntRDoorSht2Bat "Restraint control module: a052 pres frnt r door sht2 bat";
CM_ SG_ 1297 RCM_a052_presFrntRDoorCrossCoup "Restraint control module: a052 pres frnt r door cross coup";
CM_ SG_ 1297 RCM_a052_eventIDFsignal "Restraint control module: a052 event ID fsignal";
CM_ SG_ 1297 RCM_a052_eventFrontLeftSeatbelt "Restraint control module: a052 event front left seatbelt";
CM_ SG_ 1297 RCM_a052_eventFrontRightSeatbelt "Restraint control module: a052 event front right seatbelt";
CM_ SG_ 1297 RCM_a052_eventVehicleSpeed "Restraint control module: a052 event vehicle speed";
CM_ SG_ 1297 RCM_a052_eventSteeringAngle "Restraint control module: a052 event steering angle";
CM_ SG_ 1297 RCM_a052_eventDriverBrakeApply "Restraint control module: a052 event driver brake apply; raw 3 = signal not available (SNA)";
CM_ SG_ 1297 RCM_a052_eventAccelPedalPos "Restraint control module: a052 event accel pedal pos; raw 255 = signal not available (SNA)";
CM_ SG_ 1297 RCM_a053_eventArmStatus "Restraint control module: a053 event arm status";
CM_ SG_ 1297 RCM_a053_eventFactoryMode "Restraint control module: a053 event factory mode";
CM_ SG_ 1297 RCM_a053_eventDiagEnabled "Restraint control module: a053 event diag enabled";
CM_ SG_ 1297 RCM_a053_eventDriveOrientation "Restraint control module: a053 event drive orientation";
CM_ SG_ 1297 RCM_a053_presPedProLComm "Restraint control module: a053 pres ped pro l comm";
CM_ SG_ 1297 RCM_a053_presPedProLInitTyp "Restraint control module: a053 pres ped pro l init typ";
CM_ SG_ 1297 RCM_a053_presPedProLOption "Restraint control module: a053 pres ped pro l option";
CM_ SG_ 1297 RCM_a053_presPedProLPlaus "Restraint control module: a053 pres ped pro l plaus";
CM_ SG_ 1297 RCM_a053_presPedProLAbsPre "Restraint control module: a053 pres ped pro l abs pre";
CM_ SG_ 1297 RCM_a053_presPedProLDefect "Restraint control module: a053 pres ped pro l defect";
CM_ SG_ 1297 RCM_a053_presPedProLSht2Gnd "Restraint control module: a053 pres ped pro l sht2 gnd";
CM_ SG_ 1297 RCM_a053_presPedProLSht2Bat "Restraint control module: a053 pres ped pro l sht2 bat";
CM_ SG_ 1297 RCM_a053_presPedProLCrossCoup "Restraint control module: a053 pres ped pro l cross coup";
CM_ SG_ 1297 RCM_a053_eventIDFsignal "Restraint control module: a053 event ID fsignal";
CM_ SG_ 1297 RCM_a053_eventFrontLeftSeatbelt "Restraint control module: a053 event front left seatbelt";
CM_ SG_ 1297 RCM_a053_eventFrontRightSeatbelt "Restraint control module: a053 event front right seatbelt";
CM_ SG_ 1297 RCM_a053_eventVehicleSpeed "Restraint control module: a053 event vehicle speed";
CM_ SG_ 1297 RCM_a053_eventSteeringAngle "Restraint control module: a053 event steering angle";
CM_ SG_ 1297 RCM_a053_eventDriverBrakeApply "Restraint control module: a053 event driver brake apply; raw 3 = signal not available (SNA)";
CM_ SG_ 1297 RCM_a053_eventAccelPedalPos "Restraint control module: a053 event accel pedal pos; raw 255 = signal not available (SNA)";
CM_ SG_ 1297 RCM_a054_eventArmStatus "Restraint control module: a054 event arm status";
CM_ SG_ 1297 RCM_a054_eventFactoryMode "Restraint control module: a054 event factory mode";
CM_ SG_ 1297 RCM_a054_eventDiagEnabled "Restraint control module: a054 event diag enabled";
CM_ SG_ 1297 RCM_a054_eventDriveOrientation "Restraint control module: a054 event drive orientation";
CM_ SG_ 1297 RCM_a054_presPedProRComm "Restraint control module: a054 pres ped pro r comm";
CM_ SG_ 1297 RCM_a054_presPedProRInitTyp "Restraint control module: a054 pres ped pro r init typ";
CM_ SG_ 1297 RCM_a054_presPedProROption "Restraint control module: a054 pres ped pro r option";
CM_ SG_ 1297 RCM_a054_presPedProRPlaus "Restraint control module: a054 pres ped pro r plaus";
CM_ SG_ 1297 RCM_a054_presPedProRAbsPre "Restraint control module: a054 pres ped pro r abs pre";
CM_ SG_ 1297 RCM_a054_presPedProRDefect "Restraint control module: a054 pres ped pro r defect";
CM_ SG_ 1297 RCM_a054_presPedProRSht2Gnd "Restraint control module: a054 pres ped pro r sht2 gnd";
CM_ SG_ 1297 RCM_a054_presPedProRSht2Bat "Restraint control module: a054 pres ped pro r sht2 bat";
CM_ SG_ 1297 RCM_a054_presPedProRCrossCoup "Restraint control module: a054 pres ped pro r cross coup";
CM_ SG_ 1297 RCM_a054_eventIDFsignal "Restraint control module: a054 event ID fsignal";
CM_ SG_ 1297 RCM_a054_eventFrontLeftSeatbelt "Restraint control module: a054 event front left seatbelt";
CM_ SG_ 1297 RCM_a054_eventFrontRightSeatbelt "Restraint control module: a054 event front right seatbelt";
CM_ SG_ 1297 RCM_a054_eventVehicleSpeed "Restraint control module: a054 event vehicle speed";
CM_ SG_ 1297 RCM_a054_eventSteeringAngle "Restraint control module: a054 event steering angle";
CM_ SG_ 1297 RCM_a054_eventDriverBrakeApply "Restraint control module: a054 event driver brake apply; raw 3 = signal not available (SNA)";
CM_ SG_ 1297 RCM_a054_eventAccelPedalPos "Restraint control module: a054 event accel pedal pos; raw 255 = signal not available (SNA)";
CM_ SG_ 1297 RCM_a055_eventArmStatus "Restraint control module: a055 event arm status";
CM_ SG_ 1297 RCM_a055_eventFactoryMode "Restraint control module: a055 event factory mode";
CM_ SG_ 1297 RCM_a055_eventDiagEnabled "Restraint control module: a055 event diag enabled";
CM_ SG_ 1297 RCM_a055_eventDriveOrientation "Restraint control module: a055 event drive orientation";
CM_ SG_ 1297 RCM_a055_imuCalibrationNotDone "Restraint control module: a055 imu calibration not done";
CM_ SG_ 1297 RCM_a055_imuCalibrationFailed "Restraint control module: a055 imu calibration failed";
CM_ SG_ 1297 RCM_a055_eventIDFsignal "Restraint control module: a055 event ID fsignal";
CM_ SG_ 1297 RCM_a055_eventFrontLeftSeatbelt "Restraint control module: a055 event front left seatbelt";
CM_ SG_ 1297 RCM_a055_eventFrontRightSeatbelt "Restraint control module: a055 event front right seatbelt";
CM_ SG_ 1297 RCM_a055_eventVehicleSpeed "Restraint control module: a055 event vehicle speed";
CM_ SG_ 1297 RCM_a055_eventSteeringAngle "Restraint control module: a055 event steering angle";
CM_ SG_ 1297 RCM_a055_eventDriverBrakeApply "Restraint control module: a055 event driver brake apply; raw 3 = signal not available (SNA)";
CM_ SG_ 1297 RCM_a055_eventAccelPedalPos "Restraint control module: a055 event accel pedal pos; raw 255 = signal not available (SNA)";
CM_ SG_ 1297 RCM_a056_eventArmStatus "Restraint control module: a056 event arm status";
CM_ SG_ 1297 RCM_a056_eventFactoryMode "Restraint control module: a056 event factory mode";
CM_ SG_ 1297 RCM_a056_eventDiagEnabled "Restraint control module: a056 event diag enabled";
CM_ SG_ 1297 RCM_a056_eventDriveOrientation "Restraint control module: a056 event drive orientation";
CM_ SG_ 1297 RCM_a056_ocs1pFaulted "Restraint control module: a056 ocs1p faulted";
CM_ SG_ 1297 RCM_a056_ocs1pWrongCalD "Restraint control module: a056 ocs1p wrong cal d";
CM_ SG_ 1297 RCM_a056_eventIDFsignal "Restraint control module: a056 event ID fsignal";
CM_ SG_ 1297 RCM_a056_eventFrontLeftSeatbelt "Restraint control module: a056 event front left seatbelt";
CM_ SG_ 1297 RCM_a056_eventFrontRightSeatbelt "Restraint control module: a056 event front right seatbelt";
CM_ SG_ 1297 RCM_a056_eventVehicleSpeed "Restraint control module: a056 event vehicle speed";
CM_ SG_ 1297 RCM_a056_eventSteeringAngle "Restraint control module: a056 event steering angle";
CM_ SG_ 1297 RCM_a056_eventDriverBrakeApply "Restraint control module: a056 event driver brake apply; raw 3 = signal not available (SNA)";
CM_ SG_ 1297 RCM_a056_eventAccelPedalPos "Restraint control module: a056 event accel pedal pos; raw 255 = signal not available (SNA)";
CM_ SG_ 1297 RCM_a057_eventArmStatus "Restraint control module: a057 event arm status";
CM_ SG_ 1297 RCM_a057_eventFactoryMode "Restraint control module: a057 event factory mode";
CM_ SG_ 1297 RCM_a057_eventDiagEnabled "Restraint control module: a057 event diag enabled";
CM_ SG_ 1297 RCM_a057_eventDriveOrientation "Restraint control module: a057 event drive orientation";
CM_ SG_ 1297 RCM_a057_ocs1dFaulted "Restraint control module: a057 ocs1d faulted";
CM_ SG_ 1297 RCM_a057_ocs1dWrongCalD "Restraint control module: a057 ocs1d wrong cal d";
CM_ SG_ 1297 RCM_a057_eventIDFsignal "Restraint control module: a057 event ID fsignal";
CM_ SG_ 1297 RCM_a057_eventFrontLeftSeatbelt "Restraint control module: a057 event front left seatbelt";
CM_ SG_ 1297 RCM_a057_eventFrontRightSeatbelt "Restraint control module: a057 event front right seatbelt";
CM_ SG_ 1297 RCM_a057_eventVehicleSpeed "Restraint control module: a057 event vehicle speed";
CM_ SG_ 1297 RCM_a057_eventSteeringAngle "Restraint control module: a057 event steering angle";
CM_ SG_ 1297 RCM_a057_eventDriverBrakeApply "Restraint control module: a057 event driver brake apply; raw 3 = signal not available (SNA)";
CM_ SG_ 1297 RCM_a057_eventAccelPedalPos "Restraint control module: a057 event accel pedal pos; raw 255 = signal not available (SNA)";
CM_ SG_ 1297 RCM_a058_eventArmStatus "Restraint control module: a058 event arm status";
CM_ SG_ 1297 RCM_a058_eventFactoryMode "Restraint control module: a058 event factory mode";
CM_ SG_ 1297 RCM_a058_eventDiagEnabled "Restraint control module: a058 event diag enabled";
CM_ SG_ 1297 RCM_a058_eventDriveOrientation "Restraint control module: a058 event drive orientation";
CM_ SG_ 1297 RCM_a058_bucklHallLeftShort "Restraint control module: a058 buckl hall left short";
CM_ SG_ 1297 RCM_a058_bucklHallLeftSht2Bat "Restraint control module: a058 buckl hall left sht2 bat";
CM_ SG_ 1297 RCM_a058_bucklHallLeftOpen "Restraint control module: a058 buckl hall left open";
CM_ SG_ 1297 RCM_a058_bucklHallLeftUndef "Restraint control module: a058 buckl hall left undef";
CM_ SG_ 1297 RCM_a058_bucklHallLeftCrossCoup "Restraint control module: a058 buckl hall left cross coup";
CM_ SG_ 1297 RCM_a058_bucklHallLeftConfig "Restraint control module: a058 buckl hall left config";
CM_ SG_ 1297 RCM_a058_eventIDFsignal "Restraint control module: a058 event ID fsignal";
CM_ SG_ 1297 RCM_a058_eventFrontLeftSeatbelt "Restraint control module: a058 event front left seatbelt";
CM_ SG_ 1297 RCM_a058_eventFrontRightSeatbelt "Restraint control module: a058 event front right seatbelt";
CM_ SG_ 1297 RCM_a058_eventVehicleSpeed "Restraint control module: a058 event vehicle speed";
CM_ SG_ 1297 RCM_a058_eventSteeringAngle "Restraint control module: a058 event steering angle";
CM_ SG_ 1297 RCM_a058_eventDriverBrakeApply "Restraint control module: a058 event driver brake apply; raw 3 = signal not available (SNA)";
CM_ SG_ 1297 RCM_a058_eventAccelPedalPos "Restraint control module: a058 event accel pedal pos; raw 255 = signal not available (SNA)";
CM_ SG_ 1297 RCM_a059_eventArmStatus "Restraint control module: a059 event arm status";
CM_ SG_ 1297 RCM_a059_eventFactoryMode "Restraint control module: a059 event factory mode";
CM_ SG_ 1297 RCM_a059_eventDiagEnabled "Restraint control module: a059 event diag enabled";
CM_ SG_ 1297 RCM_a059_eventDriveOrientation "Restraint control module: a059 event drive orientation";
CM_ SG_ 1297 RCM_a059_bucklHallRightShort "Restraint control module: a059 buckl hall right short";
CM_ SG_ 1297 RCM_a059_bucklHallRightSht2Bat "Restraint control module: a059 buckl hall right sht2 bat";
CM_ SG_ 1297 RCM_a059_bucklHallRightOpen "Restraint control module: a059 buckl hall right open";
CM_ SG_ 1297 RCM_a059_bucklHallRightUndef "Restraint control module: a059 buckl hall right undef";
CM_ SG_ 1297 RCM_a059_bucklHallRightCrossCoup "Restraint control module: a059 buckl hall right cross coup";
CM_ SG_ 1297 RCM_a059_bucklSwRightConfig "Restraint control module: a059 buckl sw right config";
CM_ SG_ 1297 RCM_a059_eventIDFsignal "Restraint control module: a059 event ID fsignal";
CM_ SG_ 1297 RCM_a059_eventFrontLeftSeatbelt "Restraint control module: a059 event front left seatbelt";
CM_ SG_ 1297 RCM_a059_eventFrontRightSeatbelt "Restraint control module: a059 event front right seatbelt";
CM_ SG_ 1297 RCM_a059_eventVehicleSpeed "Restraint control module: a059 event vehicle speed";
CM_ SG_ 1297 RCM_a059_eventSteeringAngle "Restraint control module: a059 event steering angle";
CM_ SG_ 1297 RCM_a059_eventDriverBrakeApply "Restraint control module: a059 event driver brake apply; raw 3 = signal not available (SNA)";
CM_ SG_ 1297 RCM_a059_eventAccelPedalPos "Restraint control module: a059 event accel pedal pos; raw 255 = signal not available (SNA)";
CM_ SG_ 1297 RCM_a060_eventArmStatus "Restraint control module: a060 event arm status";
CM_ SG_ 1297 RCM_a060_eventFactoryMode "Restraint control module: a060 event factory mode";
CM_ SG_ 1297 RCM_a060_eventDiagEnabled "Restraint control module: a060 event diag enabled";
CM_ SG_ 1297 RCM_a060_eventDriveOrientation "Restraint control module: a060 event drive orientation";
CM_ SG_ 1297 RCM_a060_seaTrkPosLeftShort "Restraint control module: a060 sea trk pos left short";
CM_ SG_ 1297 RCM_a060_seaTrkPosLeftShort2Bat "Restraint control module: a060 sea trk pos left short2 bat";
CM_ SG_ 1297 RCM_a060_seaTrkPosLeftOpen "Restraint control module: a060 sea trk pos left open";
CM_ SG_ 1297 RCM_a060_seaTrkPosLeftUndefined "Restraint control module: a060 sea trk pos left undefined";
CM_ SG_ 1297 RCM_a060_seaTrkPosLeftCrossCoup "Restraint control module: a060 sea trk pos left cross coup";
CM_ SG_ 1297 RCM_a060_seaTrkPosLeftConfig "Restraint control module: a060 sea trk pos left config";
CM_ SG_ 1297 RCM_a060_eventIDFsignal "Restraint control module: a060 event ID fsignal";
CM_ SG_ 1297 RCM_a060_eventFrontLeftSeatbelt "Restraint control module: a060 event front left seatbelt";
CM_ SG_ 1297 RCM_a060_eventFrontRightSeatbelt "Restraint control module: a060 event front right seatbelt";
CM_ SG_ 1297 RCM_a060_eventVehicleSpeed "Restraint control module: a060 event vehicle speed";
CM_ SG_ 1297 RCM_a060_eventSteeringAngle "Restraint control module: a060 event steering angle";
CM_ SG_ 1297 RCM_a060_eventDriverBrakeApply "Restraint control module: a060 event driver brake apply; raw 3 = signal not available (SNA)";
CM_ SG_ 1297 RCM_a060_eventAccelPedalPos "Restraint control module: a060 event accel pedal pos; raw 255 = signal not available (SNA)";
CM_ SG_ 1297 RCM_a061_eventArmStatus "Restraint control module: a061 event arm status";
CM_ SG_ 1297 RCM_a061_eventFactoryMode "Restraint control module: a061 event factory mode";
CM_ SG_ 1297 RCM_a061_eventDiagEnabled "Restraint control module: a061 event diag enabled";
CM_ SG_ 1297 RCM_a061_eventDriveOrientation "Restraint control module: a061 event drive orientation";
CM_ SG_ 1297 RCM_a061_seaTrkPosRightShort "Restraint control module: a061 sea trk pos right short";
CM_ SG_ 1297 RCM_a061_seaTrkPosRightSht2Bat "Restraint control module: a061 sea trk pos right sht2 bat";
CM_ SG_ 1297 RCM_a061_seaTrkPosRightOpen "Restraint control module: a061 sea trk pos right open";
CM_ SG_ 1297 RCM_a061_seaTrkPosRightUndefined "Restraint control module: a061 sea trk pos right undefined";
CM_ SG_ 1297 RCM_a061_seaTrkPosRightCrossCoup "Restraint control module: a061 sea trk pos right cross coup";
CM_ SG_ 1297 RCM_a061_seaTrkPosRightConfig "Restraint control module: a061 sea trk pos right config";
CM_ SG_ 1297 RCM_a061_eventIDFsignal "Restraint control module: a061 event ID fsignal";
CM_ SG_ 1297 RCM_a061_eventFrontLeftSeatbelt "Restraint control module: a061 event front left seatbelt";
CM_ SG_ 1297 RCM_a061_eventFrontRightSeatbelt "Restraint control module: a061 event front right seatbelt";
CM_ SG_ 1297 RCM_a061_eventVehicleSpeed "Restraint control module: a061 event vehicle speed";
CM_ SG_ 1297 RCM_a061_eventSteeringAngle "Restraint control module: a061 event steering angle";
CM_ SG_ 1297 RCM_a061_eventDriverBrakeApply "Restraint control module: a061 event driver brake apply; raw 3 = signal not available (SNA)";
CM_ SG_ 1297 RCM_a061_eventAccelPedalPos "Restraint control module: a061 event accel pedal pos; raw 255 = signal not available (SNA)";
CM_ SG_ 1297 RCM_a062_eventArmStatus "Restraint control module: a062 event arm status";
CM_ SG_ 1297 RCM_a062_eventFactoryMode "Restraint control module: a062 event factory mode";
CM_ SG_ 1297 RCM_a062_eventDiagEnabled "Restraint control module: a062 event diag enabled";
CM_ SG_ 1297 RCM_a062_eventDriveOrientation "Restraint control module: a062 event drive orientation";
CM_ SG_ 1297 RCM_a062_alrShort "Restraint control module: a062 alr short";
CM_ SG_ 1297 RCM_a062_alrSht2Bat "Restraint control module: a062 alr sht2 bat";
CM_ SG_ 1297 RCM_a062_alrOpen "Restraint control module: a062 alr open";
CM_ SG_ 1297 RCM_a062_alrUndefined "Restraint control module: a062 alr undefined";
CM_ SG_ 1297 RCM_a062_alrCrossCoup "Restraint control module: a062 alr cross coup";
CM_ SG_ 1297 RCM_a062_alrConfig "Restraint control module: a062 alr config";
CM_ SG_ 1297 RCM_a062_eventIDFsignal "Restraint control module: a062 event ID fsignal";
CM_ SG_ 1297 RCM_a062_eventFrontLeftSeatbelt "Restraint control module: a062 event front left seatbelt";
CM_ SG_ 1297 RCM_a062_eventFrontRightSeatbelt "Restraint control module: a062 event front right seatbelt";
CM_ SG_ 1297 RCM_a062_eventVehicleSpeed "Restraint control module: a062 event vehicle speed";
CM_ SG_ 1297 RCM_a062_eventSteeringAngle "Restraint control module: a062 event steering angle";
CM_ SG_ 1297 RCM_a062_eventDriverBrakeApply "Restraint control module: a062 event driver brake apply; raw 3 = signal not available (SNA)";
CM_ SG_ 1297 RCM_a062_eventAccelPedalPos "Restraint control module: a062 event accel pedal pos; raw 255 = signal not available (SNA)";
CM_ SG_ 1297 RCM_a063_eventArmStatus "Restraint control module: a063 event arm status";
CM_ SG_ 1297 RCM_a063_eventFactoryMode "Restraint control module: a063 event factory mode";
CM_ SG_ 1297 RCM_a063_eventDiagEnabled "Restraint control module: a063 event diag enabled";
CM_ SG_ 1297 RCM_a063_eventDriveOrientation "Restraint control module: a063 event drive orientation";
CM_ SG_ 1297 RCM_a063_sbsw2ndRowRSht2Gnd "Restraint control module: a063 sbsw2nd row r sht2 gnd";
CM_ SG_ 1297 RCM_a063_sbsw2ndRowRSht2Bat "Restraint control module: a063 sbsw2nd row r sht2 bat";
CM_ SG_ 1297 RCM_a063_sbsw2ndRowROpen "Restraint control module: a063 sbsw2nd row r open";
CM_ SG_ 1297 RCM_a063_sbsw2ndRowRUndefined "Restraint control module: a063 sbsw2nd row r undefined";
CM_ SG_ 1297 RCM_a063_sbsw2ndRowRCrossCoup "Restraint control module: a063 sbsw2nd row r cross coup";
CM_ SG_ 1297 RCM_a063_sbsw2ndRowRConfig "Restraint control module: a063 sbsw2nd row r config";
CM_ SG_ 1297 RCM_a063_eventIDFsignal "Restraint control module: a063 event ID fsignal";
CM_ SG_ 1297 RCM_a063_eventFrontLeftSeatbelt "Restraint control module: a063 event front left seatbelt";
CM_ SG_ 1297 RCM_a063_eventFrontRightSeatbelt "Restraint control module: a063 event front right seatbelt";
CM_ SG_ 1297 RCM_a063_eventVehicleSpeed "Restraint control module: a063 event vehicle speed";
CM_ SG_ 1297 RCM_a063_eventSteeringAngle "Restraint control module: a063 event steering angle";
CM_ SG_ 1297 RCM_a063_eventDriverBrakeApply "Restraint control module: a063 event driver brake apply; raw 3 = signal not available (SNA)";
CM_ SG_ 1297 RCM_a063_eventAccelPedalPos "Restraint control module: a063 event accel pedal pos; raw 255 = signal not available (SNA)";
CM_ SG_ 1297 RCM_a064_eventArmStatus "Restraint control module: a064 event arm status";
CM_ SG_ 1297 RCM_a064_eventFactoryMode "Restraint control module: a064 event factory mode";
CM_ SG_ 1297 RCM_a064_eventDiagEnabled "Restraint control module: a064 event diag enabled";
CM_ SG_ 1297 RCM_a064_eventDriveOrientation "Restraint control module: a064 event drive orientation";
CM_ SG_ 1297 RCM_a064_hwcp1CheckFail "Restraint control module: a064 hwcp1 check fail";
CM_ SG_ 1297 RCM_a064_hwcp1Sht2Bat "Restraint control module: a064 hwcp1 sht2 bat";
CM_ SG_ 1297 RCM_a064_hwcp1CrossCoup "Restraint control module: a064 hwcp1 cross coup";
CM_ SG_ 1297 RCM_a064_hwcp1Config "Restraint control module: a064 hwcp1 config";
CM_ SG_ 1297 RCM_a064_eventIDFsignal "Restraint control module: a064 event ID fsignal";
CM_ SG_ 1297 RCM_a064_eventFrontLeftSeatbelt "Restraint control module: a064 event front left seatbelt";
CM_ SG_ 1297 RCM_a064_eventFrontRightSeatbelt "Restraint control module: a064 event front right seatbelt";
CM_ SG_ 1297 RCM_a064_eventVehicleSpeed "Restraint control module: a064 event vehicle speed";
CM_ SG_ 1297 RCM_a064_eventSteeringAngle "Restraint control module: a064 event steering angle";
CM_ SG_ 1297 RCM_a064_eventDriverBrakeApply "Restraint control module: a064 event driver brake apply; raw 3 = signal not available (SNA)";
CM_ SG_ 1297 RCM_a064_eventAccelPedalPos "Restraint control module: a064 event accel pedal pos; raw 255 = signal not available (SNA)";
CM_ SG_ 1297 RCM_a065_eventArmStatus "Restraint control module: a065 event arm status";
CM_ SG_ 1297 RCM_a065_eventFactoryMode "Restraint control module: a065 event factory mode";
CM_ SG_ 1297 RCM_a065_eventDiagEnabled "Restraint control module: a065 event diag enabled";
CM_ SG_ 1297 RCM_a065_eventDriveOrientation "Restraint control module: a065 event drive orientation";
CM_ SG_ 1297 RCM_a065_swDrvrOrientCheck "Restraint control module: a065 sw drvr orient check";
CM_ SG_ 1297 RCM_a065_swDrvrOrientSht2Bat "Restraint control module: a065 sw drvr orient sht2 bat";
CM_ SG_ 1297 RCM_a065_swDrvrOrientCrossCoup "Restraint control module: a065 sw drvr orient cross coup";
CM_ SG_ 1297 RCM_a065_swDrvrOrientConfig "Restraint control module: a065 sw drvr orient config";
CM_ SG_ 1297 RCM_a065_eventIDFsignal "Restraint control module: a065 event ID fsignal";
CM_ SG_ 1297 RCM_a065_eventFrontLeftSeatbelt "Restraint control module: a065 event front left seatbelt";
CM_ SG_ 1297 RCM_a065_eventFrontRightSeatbelt "Restraint control module: a065 event front right seatbelt";
CM_ SG_ 1297 RCM_a065_eventVehicleSpeed "Restraint control module: a065 event vehicle speed";
CM_ SG_ 1297 RCM_a065_eventSteeringAngle "Restraint control module: a065 event steering angle";
CM_ SG_ 1297 RCM_a065_eventDriverBrakeApply "Restraint control module: a065 event driver brake apply; raw 3 = signal not available (SNA)";
CM_ SG_ 1297 RCM_a065_eventAccelPedalPos "Restraint control module: a065 event accel pedal pos; raw 255 = signal not available (SNA)";
CM_ SG_ 1297 RCM_a066_eventArmStatus "Restraint control module: a066 event arm status";
CM_ SG_ 1297 RCM_a066_eventFactoryMode "Restraint control module: a066 event factory mode";
CM_ SG_ 1297 RCM_a066_eventDiagEnabled "Restraint control module: a066 event diag enabled";
CM_ SG_ 1297 RCM_a066_eventDriveOrientation "Restraint control module: a066 event drive orientation";
CM_ SG_ 1297 RCM_a066_sbsw2ndRowLShort "Restraint control module: a066 sbsw2nd row l short";
CM_ SG_ 1297 RCM_a066_sbsw2ndRowLSht2Bat "Restraint control module: a066 sbsw2nd row l sht2 bat";
CM_ SG_ 1297 RCM_a066_sbsw2ndRowLCrossCoup "Restraint control module: a066 sbsw2nd row l cross coup";
CM_ SG_ 1297 RCM_a066_sbsw2ndRowLConfig "Restraint control module: a066 sbsw2nd row l config";
CM_ SG_ 1297 RCM_a066_eventIDFsignal "Restraint control module: a066 event ID fsignal";
CM_ SG_ 1297 RCM_a066_eventFrontLeftSeatbelt "Restraint control module: a066 event front left seatbelt";
CM_ SG_ 1297 RCM_a066_eventFrontRightSeatbelt "Restraint control module: a066 event front right seatbelt";
CM_ SG_ 1297 RCM_a066_eventVehicleSpeed "Restraint control module: a066 event vehicle speed";
CM_ SG_ 1297 RCM_a066_eventSteeringAngle "Restraint control module: a066 event steering angle";
CM_ SG_ 1297 RCM_a066_eventDriverBrakeApply "Restraint control module: a066 event driver brake apply; raw 3 = signal not available (SNA)";
CM_ SG_ 1297 RCM_a066_eventAccelPedalPos "Restraint control module: a066 event accel pedal pos; raw 255 = signal not available (SNA)";
CM_ SG_ 1297 RCM_a067_eventArmStatus "Restraint control module: a067 event arm status";
CM_ SG_ 1297 RCM_a067_eventFactoryMode "Restraint control module: a067 event factory mode";
CM_ SG_ 1297 RCM_a067_eventDiagEnabled "Restraint control module: a067 event diag enabled";
CM_ SG_ 1297 RCM_a067_eventDriveOrientation "Restraint control module: a067 event drive orientation";
CM_ SG_ 1297 RCM_a067_comCANInitialization "Restraint control module: a067 com CAN initialization";
CM_ SG_ 1297 RCM_a067_eventIDFsignal "Restraint control module: a067 event ID fsignal";
CM_ SG_ 1297 RCM_a067_eventFrontLeftSeatbelt "Restraint control module: a067 event front left seatbelt";
CM_ SG_ 1297 RCM_a067_eventFrontRightSeatbelt "Restraint control module: a067 event front right seatbelt";
CM_ SG_ 1297 RCM_a067_eventVehicleSpeed "Restraint control module: a067 event vehicle speed";
CM_ SG_ 1297 RCM_a067_eventSteeringAngle "Restraint control module: a067 event steering angle";
CM_ SG_ 1297 RCM_a067_eventDriverBrakeApply "Restraint control module: a067 event driver brake apply; raw 3 = signal not available (SNA)";
CM_ SG_ 1297 RCM_a067_eventAccelPedalPos "Restraint control module: a067 event accel pedal pos; raw 255 = signal not available (SNA)";
CM_ SG_ 1297 RCM_a068_eventArmStatus "Restraint control module: a068 event arm status";
CM_ SG_ 1297 RCM_a068_eventFactoryMode "Restraint control module: a068 event factory mode";
CM_ SG_ 1297 RCM_a068_eventDiagEnabled "Restraint control module: a068 event diag enabled";
CM_ SG_ 1297 RCM_a068_eventDriveOrientation "Restraint control module: a068 event drive orientation";
CM_ SG_ 1297 RCM_a068_comChassisCANBusOff "Restraint control module: a068 com chassis CAN bus off";
CM_ SG_ 1297 RCM_a068_eventIDFsignal "Restraint control module: a068 event ID fsignal";
CM_ SG_ 1297 RCM_a068_eventFrontLeftSeatbelt "Restraint control module: a068 event front left seatbelt";
CM_ SG_ 1297 RCM_a068_eventFrontRightSeatbelt "Restraint control module: a068 event front right seatbelt";
CM_ SG_ 1297 RCM_a068_eventVehicleSpeed "Restraint control module: a068 event vehicle speed";
CM_ SG_ 1297 RCM_a068_eventSteeringAngle "Restraint control module: a068 event steering angle";
CM_ SG_ 1297 RCM_a068_eventDriverBrakeApply "Restraint control module: a068 event driver brake apply; raw 3 = signal not available (SNA)";
CM_ SG_ 1297 RCM_a068_eventAccelPedalPos "Restraint control module: a068 event accel pedal pos; raw 255 = signal not available (SNA)";
CM_ SG_ 1297 RCM_a069_eventArmStatus "Restraint control module: a069 event arm status";
CM_ SG_ 1297 RCM_a069_eventFactoryMode "Restraint control module: a069 event factory mode";
CM_ SG_ 1297 RCM_a069_eventDiagEnabled "Restraint control module: a069 event diag enabled";
CM_ SG_ 1297 RCM_a069_eventDriveOrientation "Restraint control module: a069 event drive orientation";
CM_ SG_ 1297 RCM_a069_comChassisCANPH7MIA "Restraint control module: a069 com chassis CANPH7 MIA";
CM_ SG_ 1297 RCM_a069_comChassisCANPH7ChkSm "Restraint control module: a069 com chassis CANPH7 chk sm";
CM_ SG_ 1297 RCM_a069_comChassisCANPH7Cntr "Restraint control module: a069 com chassis CANPH7 cntr";
CM_ SG_ 1297 RCM_a069_eventIDFsignal "Restraint control module: a069 event ID fsignal";
CM_ SG_ 1297 RCM_a069_eventFrontLeftSeatbelt "Restraint control module: a069 event front left seatbelt";
CM_ SG_ 1297 RCM_a069_eventFrontRightSeatbelt "Restraint control module: a069 event front right seatbelt";
CM_ SG_ 1297 RCM_a069_eventVehicleSpeed "Restraint control module: a069 event vehicle speed";
CM_ SG_ 1297 RCM_a069_eventSteeringAngle "Restraint control module: a069 event steering angle";
CM_ SG_ 1297 RCM_a069_eventDriverBrakeApply "Restraint control module: a069 event driver brake apply; raw 3 = signal not available (SNA)";
CM_ SG_ 1297 RCM_a069_eventAccelPedalPos "Restraint control module: a069 event accel pedal pos; raw 255 = signal not available (SNA)";
CM_ SG_ 1297 RCM_a070_eventArmStatus "Restraint control module: a070 event arm status";
CM_ SG_ 1297 RCM_a070_eventFactoryMode "Restraint control module: a070 event factory mode";
CM_ SG_ 1297 RCM_a070_eventDiagEnabled "Restraint control module: a070 event diag enabled";
CM_ SG_ 1297 RCM_a070_eventDriveOrientation "Restraint control module: a070 event drive orientation";
CM_ SG_ 1297 RCM_a070_comChassisCANPH8MIA "Restraint control module: a070 com chassis CANPH8 MIA";
CM_ SG_ 1297 RCM_a070_comChassisCANPH8ChkSm "Restraint control module: a070 com chassis CANPH8 chk sm";
CM_ SG_ 1297 RCM_a070_comChassisCANPH8Cntr "Restraint control module: a070 com chassis CANPH8 cntr";
CM_ SG_ 1297 RCM_a070_eventIDFsignal "Restraint control module: a070 event ID fsignal";
CM_ SG_ 1297 RCM_a070_eventFrontLeftSeatbelt "Restraint control module: a070 event front left seatbelt";
CM_ SG_ 1297 RCM_a070_eventFrontRightSeatbelt "Restraint control module: a070 event front right seatbelt";
CM_ SG_ 1297 RCM_a070_eventVehicleSpeed "Restraint control module: a070 event vehicle speed";
CM_ SG_ 1297 RCM_a070_eventSteeringAngle "Restraint control module: a070 event steering angle";
CM_ SG_ 1297 RCM_a070_eventDriverBrakeApply "Restraint control module: a070 event driver brake apply; raw 3 = signal not available (SNA)";
CM_ SG_ 1297 RCM_a070_eventAccelPedalPos "Restraint control module: a070 event accel pedal pos; raw 255 = signal not available (SNA)";
CM_ SG_ 1297 RCM_a071_eventArmStatus "Restraint control module: a071 event arm status";
CM_ SG_ 1297 RCM_a071_eventFactoryMode "Restraint control module: a071 event factory mode";
CM_ SG_ 1297 RCM_a071_eventDiagEnabled "Restraint control module: a071 event diag enabled";
CM_ SG_ 1297 RCM_a071_eventDriveOrientation "Restraint control module: a071 event drive orientation";
CM_ SG_ 1297 RCM_a071_comChassisCANPH9MIA "Restraint control module: a071 com chassis CANPH9 MIA";
CM_ SG_ 1297 RCM_a071_comChassisCANPH9ChkSm "Restraint control module: a071 com chassis CANPH9 chk sm";
CM_ SG_ 1297 RCM_a071_comChassisCANPH9Cntr "Restraint control module: a071 com chassis CANPH9 cntr";
CM_ SG_ 1297 RCM_a071_eventIDFsignal "Restraint control module: a071 event ID fsignal";
CM_ SG_ 1297 RCM_a071_eventFrontLeftSeatbelt "Restraint control module: a071 event front left seatbelt";
CM_ SG_ 1297 RCM_a071_eventFrontRightSeatbelt "Restraint control module: a071 event front right seatbelt";
CM_ SG_ 1297 RCM_a071_eventVehicleSpeed "Restraint control module: a071 event vehicle speed";
CM_ SG_ 1297 RCM_a071_eventSteeringAngle "Restraint control module: a071 event steering angle";
CM_ SG_ 1297 RCM_a071_eventDriverBrakeApply "Restraint control module: a071 event driver brake apply; raw 3 = signal not available (SNA)";
CM_ SG_ 1297 RCM_a071_eventAccelPedalPos "Restraint control module: a071 event accel pedal pos; raw 255 = signal not available (SNA)";
CM_ SG_ 1297 RCM_a072_eventArmStatus "Restraint control module: a072 event arm status";
CM_ SG_ 1297 RCM_a072_eventFactoryMode "Restraint control module: a072 event factory mode";
CM_ SG_ 1297 RCM_a072_eventDiagEnabled "Restraint control module: a072 event diag enabled";
CM_ SG_ 1297 RCM_a072_eventDriveOrientation "Restraint control module: a072 event drive orientation";
CM_ SG_ 1297 RCM_a072_comUnusedMIA "Restraint control module: a072 com unused MIA";
CM_ SG_ 1297 RCM_a072_comUnusedChkSm "Restraint control module: a072 com unused chk sm";
CM_ SG_ 1297 RCM_a072_comUnusedCntr "Restraint control module: a072 com unused cntr";
CM_ SG_ 1297 RCM_a072_eventIDFsignal "Restraint control module: a072 event ID fsignal";
CM_ SG_ 1297 RCM_a072_eventFrontLeftSeatbelt "Restraint control module: a072 event front left seatbelt";
CM_ SG_ 1297 RCM_a072_eventFrontRightSeatbelt "Restraint control module: a072 event front right seatbelt";
CM_ SG_ 1297 RCM_a072_eventVehicleSpeed "Restraint control module: a072 event vehicle speed";
CM_ SG_ 1297 RCM_a072_eventSteeringAngle "Restraint control module: a072 event steering angle";
CM_ SG_ 1297 RCM_a072_eventDriverBrakeApply "Restraint control module: a072 event driver brake apply; raw 3 = signal not available (SNA)";
CM_ SG_ 1297 RCM_a072_eventAccelPedalPos "Restraint control module: a072 event accel pedal pos; raw 255 = signal not available (SNA)";
CM_ SG_ 1297 RCM_a073_eventArmStatus "Restraint control module: a073 event arm status";
CM_ SG_ 1297 RCM_a073_eventFactoryMode "Restraint control module: a073 event factory mode";
BA_DEF_ BO_ "GenMsgCycleTime" INT 0 3600000;
BA_DEF_ BO_ "GenMsgSendType" ENUM "Cyclic","NotUsed","NotUsed","NotUsed","NotUsed","NotUsed","NotUsed","IfActive","NoMsgSendType","NotUsed";
BA_DEF_ BO_ "VFrameFormat" ENUM "StandardCAN","ExtendedCAN","reserved","J1939PG","reserved","reserved","reserved","reserved","reserved","reserved","reserved","reserved","reserved","reserved","StandardCAN_FD","ExtendedCAN_FD";
BA_DEF_ BO_ "CANFD_BRS" ENUM "0","1";
BA_DEF_ SG_ "GenSigSNA" STRING;
BA_DEF_ SG_ "SystemSignalLongSymbol" STRING;
BA_DEF_ SG_ "Confidence" ENUM "validated","plausible","layout-only","contradicted";
BA_DEF_DEF_ "GenMsgCycleTime" 0;
BA_DEF_DEF_ "GenMsgSendType" "NoMsgSendType";
BA_DEF_DEF_ "VFrameFormat" "StandardCAN";
BA_DEF_DEF_ "CANFD_BRS" "1";
BA_DEF_DEF_ "GenSigSNA" "";
BA_DEF_DEF_ "SystemSignalLongSymbol" "";
BA_DEF_DEF_ "Confidence" "layout-only";
BA_ "Confidence" SG_ 1297 RCM_a026_eventFactoryMode 1;
BA_ "Confidence" SG_ 1297 RCM_a026_eventDiagEnabled 1;
BA_ "Confidence" SG_ 1297 RCM_a026_eventDriveOrientation 1;
BA_ "Confidence" SG_ 1297 RCM_a026_eventIDFsignal 1;
BA_ "Confidence" SG_ 1297 RCM_a026_eventFrontLeftSeatbelt 1;
BA_ "Confidence" SG_ 1297 RCM_a026_eventFrontRightSeatbelt 1;
BA_ "Confidence" SG_ 1297 RCM_a026_eventVehicleSpeed 1;
BA_ "Confidence" SG_ 1297 RCM_a026_eventSteeringAngle 1;
BA_ "Confidence" SG_ 1297 RCM_a026_eventDriverBrakeApply 1;
BA_ "GenSigSNA" SG_ 1297 RCM_a026_eventDriverBrakeApply "3";
BA_ "Confidence" SG_ 1297 RCM_a026_eventAccelPedalPos 1;
BA_ "GenSigSNA" SG_ 1297 RCM_a026_eventAccelPedalPos "255";
BA_ "Confidence" SG_ 1297 RCM_a027_eventArmStatus 1;
BA_ "Confidence" SG_ 1297 RCM_a027_eventFactoryMode 1;
BA_ "Confidence" SG_ 1297 RCM_a027_eventDiagEnabled 1;
BA_ "Confidence" SG_ 1297 RCM_a027_eventDriveOrientation 1;
BA_ "Confidence" SG_ 1297 RCM_a027_eventIDFsignal 1;
BA_ "Confidence" SG_ 1297 RCM_a027_eventFrontLeftSeatbelt 1;
BA_ "Confidence" SG_ 1297 RCM_a027_eventFrontRightSeatbelt 1;
BA_ "Confidence" SG_ 1297 RCM_a027_eventVehicleSpeed 1;
BA_ "Confidence" SG_ 1297 RCM_a027_eventSteeringAngle 1;
BA_ "Confidence" SG_ 1297 RCM_a027_eventDriverBrakeApply 1;
BA_ "GenSigSNA" SG_ 1297 RCM_a027_eventDriverBrakeApply "3";
BA_ "Confidence" SG_ 1297 RCM_a027_eventAccelPedalPos 1;
BA_ "GenSigSNA" SG_ 1297 RCM_a027_eventAccelPedalPos "255";
BA_ "Confidence" SG_ 1297 RCM_a028_eventArmStatus 1;
BA_ "Confidence" SG_ 1297 RCM_a028_eventFactoryMode 1;
BA_ "Confidence" SG_ 1297 RCM_a028_eventDiagEnabled 1;
BA_ "Confidence" SG_ 1297 RCM_a028_eventDriveOrientation 1;
BA_ "Confidence" SG_ 1297 RCM_a028_eventIDFsignal 1;
BA_ "Confidence" SG_ 1297 RCM_a028_eventFrontLeftSeatbelt 1;
BA_ "Confidence" SG_ 1297 RCM_a028_eventFrontRightSeatbelt 1;
BA_ "Confidence" SG_ 1297 RCM_a028_eventVehicleSpeed 1;
BA_ "Confidence" SG_ 1297 RCM_a028_eventSteeringAngle 1;
BA_ "Confidence" SG_ 1297 RCM_a028_eventDriverBrakeApply 1;
BA_ "GenSigSNA" SG_ 1297 RCM_a028_eventDriverBrakeApply "3";
BA_ "Confidence" SG_ 1297 RCM_a028_eventAccelPedalPos 1;
BA_ "GenSigSNA" SG_ 1297 RCM_a028_eventAccelPedalPos "255";
BA_ "Confidence" SG_ 1297 RCM_a029_eventArmStatus 1;
BA_ "Confidence" SG_ 1297 RCM_a029_eventFactoryMode 1;
BA_ "Confidence" SG_ 1297 RCM_a029_eventDiagEnabled 1;
BA_ "Confidence" SG_ 1297 RCM_a029_eventDriveOrientation 1;
BA_ "Confidence" SG_ 1297 RCM_a029_eventIDFsignal 1;
BA_ "Confidence" SG_ 1297 RCM_a029_eventFrontLeftSeatbelt 1;
BA_ "Confidence" SG_ 1297 RCM_a029_eventFrontRightSeatbelt 1;
BA_ "Confidence" SG_ 1297 RCM_a029_eventVehicleSpeed 1;
BA_ "Confidence" SG_ 1297 RCM_a029_eventSteeringAngle 1;
BA_ "Confidence" SG_ 1297 RCM_a029_eventDriverBrakeApply 1;
BA_ "GenSigSNA" SG_ 1297 RCM_a029_eventDriverBrakeApply "3";
BA_ "Confidence" SG_ 1297 RCM_a029_eventAccelPedalPos 1;
BA_ "GenSigSNA" SG_ 1297 RCM_a029_eventAccelPedalPos "255";
BA_ "Confidence" SG_ 1297 RCM_a030_eventArmStatus 1;
BA_ "Confidence" SG_ 1297 RCM_a030_eventFactoryMode 1;
BA_ "Confidence" SG_ 1297 RCM_a030_eventDiagEnabled 1;
BA_ "Confidence" SG_ 1297 RCM_a030_eventDriveOrientation 1;
BA_ "Confidence" SG_ 1297 RCM_a030_eventIDFsignal 1;
BA_ "Confidence" SG_ 1297 RCM_a030_eventFrontLeftSeatbelt 1;
BA_ "Confidence" SG_ 1297 RCM_a030_eventFrontRightSeatbelt 1;
BA_ "Confidence" SG_ 1297 RCM_a030_eventVehicleSpeed 1;
BA_ "Confidence" SG_ 1297 RCM_a030_eventSteeringAngle 1;
BA_ "Confidence" SG_ 1297 RCM_a030_eventDriverBrakeApply 1;
BA_ "GenSigSNA" SG_ 1297 RCM_a030_eventDriverBrakeApply "3";
BA_ "Confidence" SG_ 1297 RCM_a030_eventAccelPedalPos 1;
BA_ "GenSigSNA" SG_ 1297 RCM_a030_eventAccelPedalPos "255";
BA_ "Confidence" SG_ 1297 RCM_a031_eventArmStatus 1;
BA_ "Confidence" SG_ 1297 RCM_a031_eventFactoryMode 1;
BA_ "Confidence" SG_ 1297 RCM_a031_eventDiagEnabled 1;
BA_ "Confidence" SG_ 1297 RCM_a031_eventDriveOrientation 1;
BA_ "Confidence" SG_ 1297 RCM_a031_eventIDFsignal 1;
BA_ "Confidence" SG_ 1297 RCM_a031_eventFrontLeftSeatbelt 1;
BA_ "Confidence" SG_ 1297 RCM_a031_eventFrontRightSeatbelt 1;
BA_ "Confidence" SG_ 1297 RCM_a031_eventVehicleSpeed 1;
BA_ "Confidence" SG_ 1297 RCM_a031_eventSteeringAngle 1;
BA_ "Confidence" SG_ 1297 RCM_a031_eventDriverBrakeApply 1;
BA_ "GenSigSNA" SG_ 1297 RCM_a031_eventDriverBrakeApply "3";
BA_ "Confidence" SG_ 1297 RCM_a031_eventAccelPedalPos 1;
BA_ "GenSigSNA" SG_ 1297 RCM_a031_eventAccelPedalPos "255";
BA_ "Confidence" SG_ 1297 RCM_a032_eventArmStatus 1;
BA_ "Confidence" SG_ 1297 RCM_a032_eventFactoryMode 1;
BA_ "Confidence" SG_ 1297 RCM_a032_eventDiagEnabled 1;
BA_ "Confidence" SG_ 1297 RCM_a032_eventDriveOrientation 1;
BA_ "Confidence" SG_ 1297 RCM_a032_eventIDFsignal 1;
BA_ "Confidence" SG_ 1297 RCM_a032_eventFrontLeftSeatbelt 1;
BA_ "Confidence" SG_ 1297 RCM_a032_eventFrontRightSeatbelt 1;
BA_ "Confidence" SG_ 1297 RCM_a032_eventVehicleSpeed 1;
BA_ "Confidence" SG_ 1297 RCM_a032_eventSteeringAngle 1;
BA_ "Confidence" SG_ 1297 RCM_a032_eventDriverBrakeApply 1;
BA_ "GenSigSNA" SG_ 1297 RCM_a032_eventDriverBrakeApply "3";
BA_ "Confidence" SG_ 1297 RCM_a032_eventAccelPedalPos 1;
BA_ "GenSigSNA" SG_ 1297 RCM_a032_eventAccelPedalPos "255";
BA_ "Confidence" SG_ 1297 RCM_a033_eventArmStatus 1;
BA_ "Confidence" SG_ 1297 RCM_a033_eventFactoryMode 1;
BA_ "Confidence" SG_ 1297 RCM_a033_eventDiagEnabled 1;
BA_ "Confidence" SG_ 1297 RCM_a033_eventDriveOrientation 1;
BA_ "Confidence" SG_ 1297 RCM_a033_eventIDFsignal 1;
BA_ "Confidence" SG_ 1297 RCM_a033_eventFrontLeftSeatbelt 1;
BA_ "Confidence" SG_ 1297 RCM_a033_eventFrontRightSeatbelt 1;
BA_ "Confidence" SG_ 1297 RCM_a033_eventVehicleSpeed 1;
BA_ "Confidence" SG_ 1297 RCM_a033_eventSteeringAngle 1;
BA_ "Confidence" SG_ 1297 RCM_a033_eventDriverBrakeApply 1;
BA_ "GenSigSNA" SG_ 1297 RCM_a033_eventDriverBrakeApply "3";
BA_ "Confidence" SG_ 1297 RCM_a033_eventAccelPedalPos 1;
BA_ "GenSigSNA" SG_ 1297 RCM_a033_eventAccelPedalPos "255";
BA_ "Confidence" SG_ 1297 RCM_a034_eventArmStatus 1;
BA_ "Confidence" SG_ 1297 RCM_a034_eventFactoryMode 1;
BA_ "Confidence" SG_ 1297 RCM_a034_eventDiagEnabled 1;
BA_ "Confidence" SG_ 1297 RCM_a034_eventDriveOrientation 1;
BA_ "Confidence" SG_ 1297 RCM_a034_eventIDFsignal 1;
BA_ "Confidence" SG_ 1297 RCM_a034_eventFrontLeftSeatbelt 1;
BA_ "Confidence" SG_ 1297 RCM_a034_eventFrontRightSeatbelt 1;
BA_ "Confidence" SG_ 1297 RCM_a034_eventVehicleSpeed 1;
BA_ "Confidence" SG_ 1297 RCM_a034_eventSteeringAngle 1;
BA_ "Confidence" SG_ 1297 RCM_a034_eventDriverBrakeApply 1;
BA_ "GenSigSNA" SG_ 1297 RCM_a034_eventDriverBrakeApply "3";
BA_ "Confidence" SG_ 1297 RCM_a034_eventAccelPedalPos 1;
BA_ "GenSigSNA" SG_ 1297 RCM_a034_eventAccelPedalPos "255";
BA_ "Confidence" SG_ 1297 RCM_a035_eventArmStatus 1;
BA_ "Confidence" SG_ 1297 RCM_a035_eventFactoryMode 1;
BA_ "Confidence" SG_ 1297 RCM_a035_eventDiagEnabled 1;
BA_ "Confidence" SG_ 1297 RCM_a035_eventDriveOrientation 1;
BA_ "Confidence" SG_ 1297 RCM_a035_eventIDFsignal 1;
BA_ "Confidence" SG_ 1297 RCM_a035_eventFrontLeftSeatbelt 1;
BA_ "Confidence" SG_ 1297 RCM_a035_eventFrontRightSeatbelt 1;
BA_ "Confidence" SG_ 1297 RCM_a035_eventVehicleSpeed 1;
BA_ "Confidence" SG_ 1297 RCM_a035_eventSteeringAngle 1;
BA_ "Confidence" SG_ 1297 RCM_a035_eventDriverBrakeApply 1;
BA_ "GenSigSNA" SG_ 1297 RCM_a035_eventDriverBrakeApply "3";
BA_ "Confidence" SG_ 1297 RCM_a035_eventAccelPedalPos 1;
BA_ "GenSigSNA" SG_ 1297 RCM_a035_eventAccelPedalPos "255";
BA_ "Confidence" SG_ 1297 RCM_a036_eventArmStatus 1;
BA_ "Confidence" SG_ 1297 RCM_a036_eventFactoryMode 1;
BA_ "Confidence" SG_ 1297 RCM_a036_eventDiagEnabled 1;
BA_ "Confidence" SG_ 1297 RCM_a036_eventDriveOrientation 1;
BA_ "Confidence" SG_ 1297 RCM_a036_eventIDFsignal 1;
BA_ "Confidence" SG_ 1297 RCM_a036_eventFrontLeftSeatbelt 1;
BA_ "Confidence" SG_ 1297 RCM_a036_eventFrontRightSeatbelt 1;
BA_ "Confidence" SG_ 1297 RCM_a036_eventVehicleSpeed 1;
BA_ "Confidence" SG_ 1297 RCM_a036_eventSteeringAngle 1;
BA_ "Confidence" SG_ 1297 RCM_a036_eventDriverBrakeApply 1;
BA_ "GenSigSNA" SG_ 1297 RCM_a036_eventDriverBrakeApply "3";
BA_ "Confidence" SG_ 1297 RCM_a036_eventAccelPedalPos 1;
BA_ "GenSigSNA" SG_ 1297 RCM_a036_eventAccelPedalPos "255";
BA_ "Confidence" SG_ 1297 RCM_a037_eventArmStatus 1;
BA_ "Confidence" SG_ 1297 RCM_a037_eventFactoryMode 1;
BA_ "Confidence" SG_ 1297 RCM_a037_eventDiagEnabled 1;
BA_ "Confidence" SG_ 1297 RCM_a037_eventDriveOrientation 1;
BA_ "Confidence" SG_ 1297 RCM_a037_eventIDFsignal 1;
BA_ "Confidence" SG_ 1297 RCM_a037_eventFrontLeftSeatbelt 1;
BA_ "Confidence" SG_ 1297 RCM_a037_eventFrontRightSeatbelt 1;
BA_ "Confidence" SG_ 1297 RCM_a037_eventVehicleSpeed 1;
BA_ "Confidence" SG_ 1297 RCM_a037_eventSteeringAngle 1;
BA_ "Confidence" SG_ 1297 RCM_a037_eventDriverBrakeApply 1;
BA_ "GenSigSNA" SG_ 1297 RCM_a037_eventDriverBrakeApply "3";
BA_ "Confidence" SG_ 1297 RCM_a037_eventAccelPedalPos 1;
BA_ "GenSigSNA" SG_ 1297 RCM_a037_eventAccelPedalPos "255";
BA_ "Confidence" SG_ 1297 RCM_a040_eventArmStatus 1;
BA_ "Confidence" SG_ 1297 RCM_a040_eventFactoryMode 1;
BA_ "Confidence" SG_ 1297 RCM_a040_eventDiagEnabled 1;
BA_ "Confidence" SG_ 1297 RCM_a040_eventDriveOrientation 1;
BA_ "Confidence" SG_ 1297 RCM_a040_eventIDFsignal 1;
BA_ "Confidence" SG_ 1297 RCM_a040_eventFrontLeftSeatbelt 1;
BA_ "Confidence" SG_ 1297 RCM_a040_eventFrontRightSeatbelt 1;
BA_ "Confidence" SG_ 1297 RCM_a040_eventVehicleSpeed 1;
BA_ "Confidence" SG_ 1297 RCM_a040_eventSteeringAngle 1;
BA_ "Confidence" SG_ 1297 RCM_a040_eventDriverBrakeApply 1;
BA_ "GenSigSNA" SG_ 1297 RCM_a040_eventDriverBrakeApply "3";
BA_ "Confidence" SG_ 1297 RCM_a040_eventAccelPedalPos 1;
BA_ "GenSigSNA" SG_ 1297 RCM_a040_eventAccelPedalPos "255";
BA_ "Confidence" SG_ 1297 RCM_a041_eventArmStatus 1;
BA_ "Confidence" SG_ 1297 RCM_a041_eventFactoryMode 1;
BA_ "Confidence" SG_ 1297 RCM_a041_eventDiagEnabled 1;
BA_ "Confidence" SG_ 1297 RCM_a041_eventDriveOrientation 1;
BA_ "Confidence" SG_ 1297 RCM_a041_eventIDFsignal 1;
BA_ "Confidence" SG_ 1297 RCM_a041_eventFrontLeftSeatbelt 1;
BA_ "Confidence" SG_ 1297 RCM_a041_eventFrontRightSeatbelt 1;
BA_ "Confidence" SG_ 1297 RCM_a041_eventVehicleSpeed 1;
BA_ "Confidence" SG_ 1297 RCM_a041_eventSteeringAngle 1;
BA_ "Confidence" SG_ 1297 RCM_a041_eventDriverBrakeApply 1;
BA_ "GenSigSNA" SG_ 1297 RCM_a041_eventDriverBrakeApply "3";
BA_ "Confidence" SG_ 1297 RCM_a041_eventAccelPedalPos 1;
BA_ "GenSigSNA" SG_ 1297 RCM_a041_eventAccelPedalPos "255";
BA_ "Confidence" SG_ 1297 RCM_a042_eventArmStatus 1;
BA_ "Confidence" SG_ 1297 RCM_a042_eventFactoryMode 1;
BA_ "Confidence" SG_ 1297 RCM_a042_eventDiagEnabled 1;
BA_ "Confidence" SG_ 1297 RCM_a042_eventDriveOrientation 1;
BA_ "Confidence" SG_ 1297 RCM_a042_eventIDFsignal 1;
BA_ "Confidence" SG_ 1297 RCM_a042_eventFrontLeftSeatbelt 1;
BA_ "Confidence" SG_ 1297 RCM_a042_eventFrontRightSeatbelt 1;
BA_ "Confidence" SG_ 1297 RCM_a042_eventVehicleSpeed 1;
BA_ "Confidence" SG_ 1297 RCM_a042_eventSteeringAngle 1;
BA_ "Confidence" SG_ 1297 RCM_a042_eventDriverBrakeApply 1;
BA_ "GenSigSNA" SG_ 1297 RCM_a042_eventDriverBrakeApply "3";
BA_ "Confidence" SG_ 1297 RCM_a042_eventAccelPedalPos 1;
BA_ "GenSigSNA" SG_ 1297 RCM_a042_eventAccelPedalPos "255";
BA_ "Confidence" SG_ 1297 RCM_a043_eventArmStatus 1;
BA_ "Confidence" SG_ 1297 RCM_a043_eventFactoryMode 1;
BA_ "Confidence" SG_ 1297 RCM_a043_eventDiagEnabled 1;
BA_ "Confidence" SG_ 1297 RCM_a043_eventDriveOrientation 1;
BA_ "Confidence" SG_ 1297 RCM_a043_eventIDFsignal 1;
BA_ "Confidence" SG_ 1297 RCM_a043_eventFrontLeftSeatbelt 1;
BA_ "Confidence" SG_ 1297 RCM_a043_eventFrontRightSeatbelt 1;
BA_ "Confidence" SG_ 1297 RCM_a043_eventVehicleSpeed 1;
BA_ "Confidence" SG_ 1297 RCM_a043_eventSteeringAngle 1;
BA_ "Confidence" SG_ 1297 RCM_a043_eventDriverBrakeApply 1;
BA_ "GenSigSNA" SG_ 1297 RCM_a043_eventDriverBrakeApply "3";
BA_ "Confidence" SG_ 1297 RCM_a043_eventAccelPedalPos 1;
BA_ "GenSigSNA" SG_ 1297 RCM_a043_eventAccelPedalPos "255";
BA_ "Confidence" SG_ 1297 RCM_a044_eventArmStatus 1;
BA_ "Confidence" SG_ 1297 RCM_a044_eventFactoryMode 1;
BA_ "Confidence" SG_ 1297 RCM_a044_eventDiagEnabled 1;
BA_ "Confidence" SG_ 1297 RCM_a044_eventDriveOrientation 1;
BA_ "Confidence" SG_ 1297 RCM_a044_eventIDFsignal 1;
BA_ "Confidence" SG_ 1297 RCM_a044_eventFrontLeftSeatbelt 1;
BA_ "Confidence" SG_ 1297 RCM_a044_eventFrontRightSeatbelt 1;
BA_ "Confidence" SG_ 1297 RCM_a044_eventVehicleSpeed 1;
BA_ "Confidence" SG_ 1297 RCM_a044_eventSteeringAngle 1;
BA_ "Confidence" SG_ 1297 RCM_a044_eventDriverBrakeApply 1;
BA_ "GenSigSNA" SG_ 1297 RCM_a044_eventDriverBrakeApply "3";
BA_ "Confidence" SG_ 1297 RCM_a044_eventAccelPedalPos 1;
BA_ "GenSigSNA" SG_ 1297 RCM_a044_eventAccelPedalPos "255";
BA_ "Confidence" SG_ 1297 RCM_a045_eventArmStatus 1;
BA_ "Confidence" SG_ 1297 RCM_a045_eventFactoryMode 1;
BA_ "Confidence" SG_ 1297 RCM_a045_eventDiagEnabled 1;
BA_ "Confidence" SG_ 1297 RCM_a045_eventDriveOrientation 1;
BA_ "Confidence" SG_ 1297 RCM_a045_eventIDFsignal 1;
BA_ "Confidence" SG_ 1297 RCM_a045_eventFrontLeftSeatbelt 1;
BA_ "Confidence" SG_ 1297 RCM_a045_eventFrontRightSeatbelt 1;
BA_ "Confidence" SG_ 1297 RCM_a045_eventVehicleSpeed 1;
BA_ "Confidence" SG_ 1297 RCM_a045_eventSteeringAngle 1;
BA_ "Confidence" SG_ 1297 RCM_a045_eventDriverBrakeApply 1;
BA_ "GenSigSNA" SG_ 1297 RCM_a045_eventDriverBrakeApply "3";
BA_ "Confidence" SG_ 1297 RCM_a045_eventAccelPedalPos 1;
BA_ "GenSigSNA" SG_ 1297 RCM_a045_eventAccelPedalPos "255";
BA_ "Confidence" SG_ 1297 RCM_a046_eventArmStatus 1;
BA_ "Confidence" SG_ 1297 RCM_a046_eventFactoryMode 1;
BA_ "Confidence" SG_ 1297 RCM_a046_eventDiagEnabled 1;
BA_ "Confidence" SG_ 1297 RCM_a046_eventDriveOrientation 1;
BA_ "Confidence" SG_ 1297 RCM_a046_eventIDFsignal 1;
BA_ "Confidence" SG_ 1297 RCM_a046_eventFrontLeftSeatbelt 1;
BA_ "Confidence" SG_ 1297 RCM_a046_eventFrontRightSeatbelt 1;
BA_ "Confidence" SG_ 1297 RCM_a046_eventVehicleSpeed 1;
BA_ "Confidence" SG_ 1297 RCM_a046_eventSteeringAngle 1;
BA_ "Confidence" SG_ 1297 RCM_a046_eventDriverBrakeApply 1;
BA_ "GenSigSNA" SG_ 1297 RCM_a046_eventDriverBrakeApply "3";
BA_ "Confidence" SG_ 1297 RCM_a046_eventAccelPedalPos 1;
BA_ "GenSigSNA" SG_ 1297 RCM_a046_eventAccelPedalPos "255";
BA_ "Confidence" SG_ 1297 RCM_a047_eventArmStatus 1;
BA_ "Confidence" SG_ 1297 RCM_a047_eventFactoryMode 1;
BA_ "Confidence" SG_ 1297 RCM_a047_eventDiagEnabled 1;
BA_ "Confidence" SG_ 1297 RCM_a047_eventDriveOrientation 1;
BA_ "Confidence" SG_ 1297 RCM_a047_eventIDFsignal 1;
BA_ "Confidence" SG_ 1297 RCM_a047_eventFrontLeftSeatbelt 1;
BA_ "Confidence" SG_ 1297 RCM_a047_eventFrontRightSeatbelt 1;
BA_ "Confidence" SG_ 1297 RCM_a047_eventVehicleSpeed 1;
BA_ "Confidence" SG_ 1297 RCM_a047_eventSteeringAngle 1;
BA_ "Confidence" SG_ 1297 RCM_a047_eventDriverBrakeApply 1;
BA_ "GenSigSNA" SG_ 1297 RCM_a047_eventDriverBrakeApply "3";
BA_ "Confidence" SG_ 1297 RCM_a047_eventAccelPedalPos 1;
BA_ "GenSigSNA" SG_ 1297 RCM_a047_eventAccelPedalPos "255";
BA_ "Confidence" SG_ 1297 RCM_a048_eventArmStatus 1;
BA_ "Confidence" SG_ 1297 RCM_a048_eventFactoryMode 1;
BA_ "Confidence" SG_ 1297 RCM_a048_eventDiagEnabled 1;
BA_ "Confidence" SG_ 1297 RCM_a048_eventDriveOrientation 1;
BA_ "Confidence" SG_ 1297 RCM_a048_eventIDFsignal 1;
BA_ "Confidence" SG_ 1297 RCM_a048_eventFrontLeftSeatbelt 1;
BA_ "Confidence" SG_ 1297 RCM_a048_eventFrontRightSeatbelt 1;
BA_ "Confidence" SG_ 1297 RCM_a048_eventVehicleSpeed 1;
BA_ "Confidence" SG_ 1297 RCM_a048_eventSteeringAngle 1;
BA_ "Confidence" SG_ 1297 RCM_a048_eventDriverBrakeApply 1;
BA_ "GenSigSNA" SG_ 1297 RCM_a048_eventDriverBrakeApply "3";
BA_ "Confidence" SG_ 1297 RCM_a048_eventAccelPedalPos 1;
BA_ "GenSigSNA" SG_ 1297 RCM_a048_eventAccelPedalPos "255";
BA_ "Confidence" SG_ 1297 RCM_a049_eventArmStatus 1;
BA_ "Confidence" SG_ 1297 RCM_a049_eventFactoryMode 1;
BA_ "Confidence" SG_ 1297 RCM_a049_eventDiagEnabled 1;
BA_ "Confidence" SG_ 1297 RCM_a049_eventDriveOrientation 1;
BA_ "Confidence" SG_ 1297 RCM_a049_eventIDFsignal 1;
BA_ "Confidence" SG_ 1297 RCM_a049_eventFrontLeftSeatbelt 1;
BA_ "Confidence" SG_ 1297 RCM_a049_eventFrontRightSeatbelt 1;
BA_ "Confidence" SG_ 1297 RCM_a049_eventVehicleSpeed 1;
BA_ "Confidence" SG_ 1297 RCM_a049_eventSteeringAngle 1;
BA_ "Confidence" SG_ 1297 RCM_a049_eventDriverBrakeApply 1;
BA_ "GenSigSNA" SG_ 1297 RCM_a049_eventDriverBrakeApply "3";
BA_ "Confidence" SG_ 1297 RCM_a049_eventAccelPedalPos 1;
BA_ "GenSigSNA" SG_ 1297 RCM_a049_eventAccelPedalPos "255";
BA_ "Confidence" SG_ 1297 RCM_a050_eventArmStatus 1;
BA_ "Confidence" SG_ 1297 RCM_a050_eventFactoryMode 1;
BA_ "Confidence" SG_ 1297 RCM_a050_eventDiagEnabled 1;
BA_ "Confidence" SG_ 1297 RCM_a050_eventDriveOrientation 1;
BA_ "Confidence" SG_ 1297 RCM_a050_eventIDFsignal 1;
BA_ "Confidence" SG_ 1297 RCM_a050_eventFrontLeftSeatbelt 1;
BA_ "Confidence" SG_ 1297 RCM_a050_eventFrontRightSeatbelt 1;
BA_ "Confidence" SG_ 1297 RCM_a050_eventVehicleSpeed 1;
BA_ "Confidence" SG_ 1297 RCM_a050_eventSteeringAngle 1;
BA_ "Confidence" SG_ 1297 RCM_a050_eventDriverBrakeApply 1;
BA_ "GenSigSNA" SG_ 1297 RCM_a050_eventDriverBrakeApply "3";
BA_ "Confidence" SG_ 1297 RCM_a050_eventAccelPedalPos 1;
BA_ "GenSigSNA" SG_ 1297 RCM_a050_eventAccelPedalPos "255";
BA_ "Confidence" SG_ 1297 RCM_a051_eventArmStatus 1;
BA_ "Confidence" SG_ 1297 RCM_a051_eventFactoryMode 1;
BA_ "Confidence" SG_ 1297 RCM_a051_eventDiagEnabled 1;
BA_ "Confidence" SG_ 1297 RCM_a051_eventDriveOrientation 1;
BA_ "Confidence" SG_ 1297 RCM_a051_eventIDFsignal 1;
BA_ "Confidence" SG_ 1297 RCM_a051_eventFrontLeftSeatbelt 1;
BA_ "Confidence" SG_ 1297 RCM_a051_eventFrontRightSeatbelt 1;
BA_ "Confidence" SG_ 1297 RCM_a051_eventVehicleSpeed 1;
BA_ "Confidence" SG_ 1297 RCM_a051_eventSteeringAngle 1;
BA_ "Confidence" SG_ 1297 RCM_a051_eventDriverBrakeApply 1;
BA_ "GenSigSNA" SG_ 1297 RCM_a051_eventDriverBrakeApply "3";
BA_ "Confidence" SG_ 1297 RCM_a051_eventAccelPedalPos 1;
BA_ "GenSigSNA" SG_ 1297 RCM_a051_eventAccelPedalPos "255";
BA_ "Confidence" SG_ 1297 RCM_a052_eventArmStatus 1;
BA_ "Confidence" SG_ 1297 RCM_a052_eventFactoryMode 1;
BA_ "Confidence" SG_ 1297 RCM_a052_eventDiagEnabled 1;
BA_ "Confidence" SG_ 1297 RCM_a052_eventDriveOrientation 1;
BA_ "Confidence" SG_ 1297 RCM_a052_eventIDFsignal 1;
BA_ "Confidence" SG_ 1297 RCM_a052_eventFrontLeftSeatbelt 1;
BA_ "Confidence" SG_ 1297 RCM_a052_eventFrontRightSeatbelt 1;
BA_ "Confidence" SG_ 1297 RCM_a052_eventVehicleSpeed 1;
BA_ "Confidence" SG_ 1297 RCM_a052_eventSteeringAngle 1;
BA_ "Confidence" SG_ 1297 RCM_a052_eventDriverBrakeApply 1;
BA_ "GenSigSNA" SG_ 1297 RCM_a052_eventDriverBrakeApply "3";
BA_ "Confidence" SG_ 1297 RCM_a052_eventAccelPedalPos 1;
BA_ "GenSigSNA" SG_ 1297 RCM_a052_eventAccelPedalPos "255";
BA_ "Confidence" SG_ 1297 RCM_a053_eventArmStatus 1;
BA_ "Confidence" SG_ 1297 RCM_a053_eventFactoryMode 1;
BA_ "Confidence" SG_ 1297 RCM_a053_eventDiagEnabled 1;
BA_ "Confidence" SG_ 1297 RCM_a053_eventDriveOrientation 1;
BA_ "Confidence" SG_ 1297 RCM_a053_eventIDFsignal 1;
BA_ "Confidence" SG_ 1297 RCM_a053_eventFrontLeftSeatbelt 1;
BA_ "Confidence" SG_ 1297 RCM_a053_eventFrontRightSeatbelt 1;
BA_ "Confidence" SG_ 1297 RCM_a053_eventVehicleSpeed 1;
BA_ "Confidence" SG_ 1297 RCM_a053_eventSteeringAngle 1;
BA_ "Confidence" SG_ 1297 RCM_a053_eventDriverBrakeApply 1;
BA_ "GenSigSNA" SG_ 1297 RCM_a053_eventDriverBrakeApply "3";
BA_ "Confidence" SG_ 1297 RCM_a053_eventAccelPedalPos 1;
BA_ "GenSigSNA" SG_ 1297 RCM_a053_eventAccelPedalPos "255";
BA_ "Confidence" SG_ 1297 RCM_a054_eventArmStatus 1;
BA_ "Confidence" SG_ 1297 RCM_a054_eventFactoryMode 1;
BA_ "Confidence" SG_ 1297 RCM_a054_eventDiagEnabled 1;
BA_ "Confidence" SG_ 1297 RCM_a054_eventDriveOrientation 1;
BA_ "Confidence" SG_ 1297 RCM_a054_eventIDFsignal 1;
BA_ "Confidence" SG_ 1297 RCM_a054_eventFrontLeftSeatbelt 1;
BA_ "Confidence" SG_ 1297 RCM_a054_eventFrontRightSeatbelt 1;
BA_ "Confidence" SG_ 1297 RCM_a054_eventVehicleSpeed 1;
BA_ "Confidence" SG_ 1297 RCM_a054_eventSteeringAngle 1;
BA_ "Confidence" SG_ 1297 RCM_a054_eventDriverBrakeApply 1;
BA_ "GenSigSNA" SG_ 1297 RCM_a054_eventDriverBrakeApply "3";
BA_ "Confidence" SG_ 1297 RCM_a054_eventAccelPedalPos 1;
BA_ "GenSigSNA" SG_ 1297 RCM_a054_eventAccelPedalPos "255";
BA_ "Confidence" SG_ 1297 RCM_a055_eventArmStatus 1;
BA_ "Confidence" SG_ 1297 RCM_a055_eventFactoryMode 1;
BA_ "Confidence" SG_ 1297 RCM_a055_eventDiagEnabled 1;
BA_ "Confidence" SG_ 1297 RCM_a055_eventDriveOrientation 1;
BA_ "Confidence" SG_ 1297 RCM_a055_eventIDFsignal 1;
BA_ "Confidence" SG_ 1297 RCM_a055_eventFrontLeftSeatbelt 1;
BA_ "Confidence" SG_ 1297 RCM_a055_eventFrontRightSeatbelt 1;
BA_ "Confidence" SG_ 1297 RCM_a055_eventVehicleSpeed 1;
BA_ "Confidence" SG_ 1297 RCM_a055_eventSteeringAngle 1;
BA_ "Confidence" SG_ 1297 RCM_a055_eventDriverBrakeApply 1;
BA_ "GenSigSNA" SG_ 1297 RCM_a055_eventDriverBrakeApply "3";
BA_ "Confidence" SG_ 1297 RCM_a055_eventAccelPedalPos 1;
BA_ "GenSigSNA" SG_ 1297 RCM_a055_eventAccelPedalPos "255";
BA_ "Confidence" SG_ 1297 RCM_a056_eventArmStatus 1;
BA_ "Confidence" SG_ 1297 RCM_a056_eventFactoryMode 1;
BA_ "Confidence" SG_ 1297 RCM_a056_eventDiagEnabled 1;
BA_ "Confidence" SG_ 1297 RCM_a056_eventDriveOrientation 1;
BA_ "Confidence" SG_ 1297 RCM_a056_eventIDFsignal 1;
BA_ "Confidence" SG_ 1297 RCM_a056_eventFrontLeftSeatbelt 1;
BA_ "Confidence" SG_ 1297 RCM_a056_eventFrontRightSeatbelt 1;
BA_ "Confidence" SG_ 1297 RCM_a056_eventVehicleSpeed 1;
BA_ "Confidence" SG_ 1297 RCM_a056_eventSteeringAngle 1;
BA_ "Confidence" SG_ 1297 RCM_a056_eventDriverBrakeApply 1;
BA_ "GenSigSNA" SG_ 1297 RCM_a056_eventDriverBrakeApply "3";
BA_ "Confidence" SG_ 1297 RCM_a056_eventAccelPedalPos 1;
BA_ "GenSigSNA" SG_ 1297 RCM_a056_eventAccelPedalPos "255";
BA_ "Confidence" SG_ 1297 RCM_a057_eventArmStatus 1;
BA_ "Confidence" SG_ 1297 RCM_a057_eventFactoryMode 1;
BA_ "Confidence" SG_ 1297 RCM_a057_eventDiagEnabled 1;
BA_ "Confidence" SG_ 1297 RCM_a057_eventDriveOrientation 1;
BA_ "Confidence" SG_ 1297 RCM_a057_eventIDFsignal 1;
BA_ "Confidence" SG_ 1297 RCM_a057_eventFrontLeftSeatbelt 1;
BA_ "Confidence" SG_ 1297 RCM_a057_eventFrontRightSeatbelt 1;
BA_ "Confidence" SG_ 1297 RCM_a057_eventVehicleSpeed 1;
BA_ "Confidence" SG_ 1297 RCM_a057_eventSteeringAngle 1;
BA_ "Confidence" SG_ 1297 RCM_a057_eventDriverBrakeApply 1;
BA_ "GenSigSNA" SG_ 1297 RCM_a057_eventDriverBrakeApply "3";
BA_ "Confidence" SG_ 1297 RCM_a057_eventAccelPedalPos 1;
BA_ "GenSigSNA" SG_ 1297 RCM_a057_eventAccelPedalPos "255";
BA_ "Confidence" SG_ 1297 RCM_a058_eventArmStatus 1;
BA_ "Confidence" SG_ 1297 RCM_a058_eventFactoryMode 1;
BA_ "Confidence" SG_ 1297 RCM_a058_eventDiagEnabled 1;
BA_ "Confidence" SG_ 1297 RCM_a058_eventDriveOrientation 1;
BA_ "Confidence" SG_ 1297 RCM_a058_eventIDFsignal 1;
BA_ "Confidence" SG_ 1297 RCM_a058_eventFrontLeftSeatbelt 1;
BA_ "Confidence" SG_ 1297 RCM_a058_eventFrontRightSeatbelt 1;
BA_ "Confidence" SG_ 1297 RCM_a058_eventVehicleSpeed 1;
BA_ "Confidence" SG_ 1297 RCM_a058_eventSteeringAngle 1;
BA_ "Confidence" SG_ 1297 RCM_a058_eventDriverBrakeApply 1;
BA_ "GenSigSNA" SG_ 1297 RCM_a058_eventDriverBrakeApply "3";
BA_ "Confidence" SG_ 1297 RCM_a058_eventAccelPedalPos 1;
BA_ "GenSigSNA" SG_ 1297 RCM_a058_eventAccelPedalPos "255";
BA_ "Confidence" SG_ 1297 RCM_a059_eventArmStatus 1;
BA_ "Confidence" SG_ 1297 RCM_a059_eventFactoryMode 1;
BA_ "Confidence" SG_ 1297 RCM_a059_eventDiagEnabled 1;
BA_ "Confidence" SG_ 1297 RCM_a059_eventDriveOrientation 1;
BA_ "Confidence" SG_ 1297 RCM_a059_eventIDFsignal 1;
BA_ "Confidence" SG_ 1297 RCM_a059_eventFrontLeftSeatbelt 1;
BA_ "Confidence" SG_ 1297 RCM_a059_eventFrontRightSeatbelt 1;
BA_ "Confidence" SG_ 1297 RCM_a059_eventVehicleSpeed 1;
BA_ "Confidence" SG_ 1297 RCM_a059_eventSteeringAngle 1;
BA_ "Confidence" SG_ 1297 RCM_a059_eventDriverBrakeApply 1;
BA_ "GenSigSNA" SG_ 1297 RCM_a059_eventDriverBrakeApply "3";
BA_ "Confidence" SG_ 1297 RCM_a059_eventAccelPedalPos 1;
BA_ "GenSigSNA" SG_ 1297 RCM_a059_eventAccelPedalPos "255";
BA_ "Confidence" SG_ 1297 RCM_a060_eventArmStatus 1;
BA_ "Confidence" SG_ 1297 RCM_a060_eventFactoryMode 1;
BA_ "Confidence" SG_ 1297 RCM_a060_eventDiagEnabled 1;
BA_ "Confidence" SG_ 1297 RCM_a060_eventDriveOrientation 1;
BA_ "Confidence" SG_ 1297 RCM_a060_eventIDFsignal 1;
BA_ "Confidence" SG_ 1297 RCM_a060_eventFrontLeftSeatbelt 1;
BA_ "Confidence" SG_ 1297 RCM_a060_eventFrontRightSeatbelt 1;
BA_ "Confidence" SG_ 1297 RCM_a060_eventVehicleSpeed 1;
BA_ "Confidence" SG_ 1297 RCM_a060_eventSteeringAngle 1;
BA_ "Confidence" SG_ 1297 RCM_a060_eventDriverBrakeApply 1;
BA_ "GenSigSNA" SG_ 1297 RCM_a060_eventDriverBrakeApply "3";
BA_ "Confidence" SG_ 1297 RCM_a060_eventAccelPedalPos 1;
BA_ "GenSigSNA" SG_ 1297 RCM_a060_eventAccelPedalPos "255";
BA_ "Confidence" SG_ 1297 RCM_a061_eventArmStatus 1;
BA_ "Confidence" SG_ 1297 RCM_a061_eventFactoryMode 1;
BA_ "Confidence" SG_ 1297 RCM_a061_eventDiagEnabled 1;
BA_ "Confidence" SG_ 1297 RCM_a061_eventDriveOrientation 1;
BA_ "Confidence" SG_ 1297 RCM_a061_eventIDFsignal 1;
BA_ "Confidence" SG_ 1297 RCM_a061_eventFrontLeftSeatbelt 1;
BA_ "Confidence" SG_ 1297 RCM_a061_eventFrontRightSeatbelt 1;
BA_ "Confidence" SG_ 1297 RCM_a061_eventVehicleSpeed 1;
BA_ "Confidence" SG_ 1297 RCM_a061_eventSteeringAngle 1;
BA_ "Confidence" SG_ 1297 RCM_a061_eventDriverBrakeApply 1;
BA_ "GenSigSNA" SG_ 1297 RCM_a061_eventDriverBrakeApply "3";
BA_ "Confidence" SG_ 1297 RCM_a061_eventAccelPedalPos 1;
BA_ "GenSigSNA" SG_ 1297 RCM_a061_eventAccelPedalPos "255";
BA_ "Confidence" SG_ 1297 RCM_a062_eventArmStatus 1;
BA_ "Confidence" SG_ 1297 RCM_a062_eventFactoryMode 1;
BA_ "Confidence" SG_ 1297 RCM_a062_eventDiagEnabled 1;
BA_ "Confidence" SG_ 1297 RCM_a062_eventDriveOrientation 1;
BA_ "Confidence" SG_ 1297 RCM_a062_eventIDFsignal 1;
BA_ "Confidence" SG_ 1297 RCM_a062_eventFrontLeftSeatbelt 1;
BA_ "Confidence" SG_ 1297 RCM_a062_eventFrontRightSeatbelt 1;
BA_ "Confidence" SG_ 1297 RCM_a062_eventVehicleSpeed 1;
BA_ "Confidence" SG_ 1297 RCM_a062_eventSteeringAngle 1;
BA_ "Confidence" SG_ 1297 RCM_a062_eventDriverBrakeApply 1;
BA_ "GenSigSNA" SG_ 1297 RCM_a062_eventDriverBrakeApply "3";
BA_ "Confidence" SG_ 1297 RCM_a062_eventAccelPedalPos 1;
BA_ "GenSigSNA" SG_ 1297 RCM_a062_eventAccelPedalPos "255";
BA_ "Confidence" SG_ 1297 RCM_a063_eventArmStatus 1;
BA_ "Confidence" SG_ 1297 RCM_a063_eventFactoryMode 1;
BA_ "Confidence" SG_ 1297 RCM_a063_eventDiagEnabled 1;
BA_ "Confidence" SG_ 1297 RCM_a063_eventDriveOrientation 1;
BA_ "Confidence" SG_ 1297 RCM_a063_eventIDFsignal 1;
BA_ "Confidence" SG_ 1297 RCM_a063_eventFrontLeftSeatbelt 1;
BA_ "Confidence" SG_ 1297 RCM_a063_eventFrontRightSeatbelt 1;
BA_ "Confidence" SG_ 1297 RCM_a063_eventVehicleSpeed 1;
BA_ "Confidence" SG_ 1297 RCM_a063_eventSteeringAngle 1;
BA_ "Confidence" SG_ 1297 RCM_a063_eventDriverBrakeApply 1;
BA_ "GenSigSNA" SG_ 1297 RCM_a063_eventDriverBrakeApply "3";
BA_ "Confidence" SG_ 1297 RCM_a063_eventAccelPedalPos 1;
BA_ "GenSigSNA" SG_ 1297 RCM_a063_eventAccelPedalPos "255";
BA_ "Confidence" SG_ 1297 RCM_a064_eventArmStatus 1;
BA_ "Confidence" SG_ 1297 RCM_a064_eventFactoryMode 1;
BA_ "Confidence" SG_ 1297 RCM_a064_eventDiagEnabled 1;
BA_ "Confidence" SG_ 1297 RCM_a064_eventDriveOrientation 1;
BA_ "Confidence" SG_ 1297 RCM_a064_eventIDFsignal 1;
BA_ "Confidence" SG_ 1297 RCM_a064_eventFrontLeftSeatbelt 1;
BA_ "Confidence" SG_ 1297 RCM_a064_eventFrontRightSeatbelt 1;
BA_ "Confidence" SG_ 1297 RCM_a064_eventVehicleSpeed 1;
BA_ "Confidence" SG_ 1297 RCM_a064_eventSteeringAngle 1;
BA_ "Confidence" SG_ 1297 RCM_a064_eventDriverBrakeApply 1;
BA_ "GenSigSNA" SG_ 1297 RCM_a064_eventDriverBrakeApply "3";
BA_ "Confidence" SG_ 1297 RCM_a064_eventAccelPedalPos 1;
BA_ "GenSigSNA" SG_ 1297 RCM_a064_eventAccelPedalPos "255";
BA_ "Confidence" SG_ 1297 RCM_a065_eventArmStatus 1;
BA_ "Confidence" SG_ 1297 RCM_a065_eventFactoryMode 1;
BA_ "Confidence" SG_ 1297 RCM_a065_eventDiagEnabled 1;
BA_ "Confidence" SG_ 1297 RCM_a065_eventDriveOrientation 1;
BA_ "Confidence" SG_ 1297 RCM_a065_eventIDFsignal 1;
BA_ "Confidence" SG_ 1297 RCM_a065_eventFrontLeftSeatbelt 1;
BA_ "Confidence" SG_ 1297 RCM_a065_eventFrontRightSeatbelt 1;
BA_ "Confidence" SG_ 1297 RCM_a065_eventVehicleSpeed 1;
BA_ "Confidence" SG_ 1297 RCM_a065_eventSteeringAngle 1;
BA_ "Confidence" SG_ 1297 RCM_a065_eventDriverBrakeApply 1;
BA_ "GenSigSNA" SG_ 1297 RCM_a065_eventDriverBrakeApply "3";
BA_ "Confidence" SG_ 1297 RCM_a065_eventAccelPedalPos 1;
BA_ "GenSigSNA" SG_ 1297 RCM_a065_eventAccelPedalPos "255";
BA_ "Confidence" SG_ 1297 RCM_a066_eventArmStatus 1;
BA_ "Confidence" SG_ 1297 RCM_a066_eventFactoryMode 1;
BA_ "Confidence" SG_ 1297 RCM_a066_eventDiagEnabled 1;
BA_ "Confidence" SG_ 1297 RCM_a066_eventDriveOrientation 1;
BA_ "Confidence" SG_ 1297 RCM_a066_eventIDFsignal 1;
BA_ "Confidence" SG_ 1297 RCM_a066_eventFrontLeftSeatbelt 1;
BA_ "Confidence" SG_ 1297 RCM_a066_eventFrontRightSeatbelt 1;
BA_ "Confidence" SG_ 1297 RCM_a066_eventVehicleSpeed 1;
BA_ "Confidence" SG_ 1297 RCM_a066_eventSteeringAngle 1;
BA_ "Confidence" SG_ 1297 RCM_a066_eventDriverBrakeApply 1;
BA_ "GenSigSNA" SG_ 1297 RCM_a066_eventDriverBrakeApply "3";
BA_ "Confidence" SG_ 1297 RCM_a066_eventAccelPedalPos 1;
BA_ "GenSigSNA" SG_ 1297 RCM_a066_eventAccelPedalPos "255";
BA_ "Confidence" SG_ 1297 RCM_a067_eventArmStatus 1;
BA_ "Confidence" SG_ 1297 RCM_a067_eventFactoryMode 1;
BA_ "Confidence" SG_ 1297 RCM_a067_eventDiagEnabled 1;
BA_ "Confidence" SG_ 1297 RCM_a067_eventDriveOrientation 1;
BA_ "Confidence" SG_ 1297 RCM_a067_eventIDFsignal 1;
BA_ "Confidence" SG_ 1297 RCM_a067_eventFrontLeftSeatbelt 1;
BA_ "Confidence" SG_ 1297 RCM_a067_eventFrontRightSeatbelt 1;
BA_ "Confidence" SG_ 1297 RCM_a067_eventVehicleSpeed 1;
BA_ "Confidence" SG_ 1297 RCM_a067_eventSteeringAngle 1;
BA_ "Confidence" SG_ 1297 RCM_a067_eventDriverBrakeApply 1;
BA_ "GenSigSNA" SG_ 1297 RCM_a067_eventDriverBrakeApply "3";
BA_ "Confidence" SG_ 1297 RCM_a067_eventAccelPedalPos 1;
BA_ "GenSigSNA" SG_ 1297 RCM_a067_eventAccelPedalPos "255";
BA_ "Confidence" SG_ 1297 RCM_a068_eventArmStatus 1;
BA_ "Confidence" SG_ 1297 RCM_a068_eventFactoryMode 1;
BA_ "Confidence" SG_ 1297 RCM_a068_eventDiagEnabled 1;
BA_ "Confidence" SG_ 1297 RCM_a068_eventDriveOrientation 1;
BA_ "Confidence" SG_ 1297 RCM_a068_eventIDFsignal 1;
BA_ "Confidence" SG_ 1297 RCM_a068_eventFrontLeftSeatbelt 1;
BA_ "Confidence" SG_ 1297 RCM_a068_eventFrontRightSeatbelt 1;
BA_ "Confidence" SG_ 1297 RCM_a068_eventVehicleSpeed 1;
BA_ "Confidence" SG_ 1297 RCM_a068_eventSteeringAngle 1;
BA_ "Confidence" SG_ 1297 RCM_a068_eventDriverBrakeApply 1;
BA_ "GenSigSNA" SG_ 1297 RCM_a068_eventDriverBrakeApply "3";
BA_ "Confidence" SG_ 1297 RCM_a068_eventAccelPedalPos 1;
BA_ "GenSigSNA" SG_ 1297 RCM_a068_eventAccelPedalPos "255";
BA_ "Confidence" SG_ 1297 RCM_a069_eventArmStatus 1;
BA_ "Confidence" SG_ 1297 RCM_a069_eventFactoryMode 1;
BA_ "Confidence" SG_ 1297 RCM_a069_eventDiagEnabled 1;
BA_ "Confidence" SG_ 1297 RCM_a069_eventDriveOrientation 1;
BA_ "Confidence" SG_ 1297 RCM_a069_eventIDFsignal 1;
BA_ "Confidence" SG_ 1297 RCM_a069_eventFrontLeftSeatbelt 1;
BA_ "Confidence" SG_ 1297 RCM_a069_eventFrontRightSeatbelt 1;
BA_ "Confidence" SG_ 1297 RCM_a069_eventVehicleSpeed 1;
BA_ "Confidence" SG_ 1297 RCM_a069_eventSteeringAngle 1;
BA_ "Confidence" SG_ 1297 RCM_a069_eventDriverBrakeApply 1;
BA_ "GenSigSNA" SG_ 1297 RCM_a069_eventDriverBrakeApply "3";
BA_ "Confidence" SG_ 1297 RCM_a069_eventAccelPedalPos 1;
BA_ "GenSigSNA" SG_ 1297 RCM_a069_eventAccelPedalPos "255";
BA_ "Confidence" SG_ 1297 RCM_a070_eventArmStatus 1;
BA_ "Confidence" SG_ 1297 RCM_a070_eventFactoryMode 1;
BA_ "Confidence" SG_ 1297 RCM_a070_eventDiagEnabled 1;
BA_ "Confidence" SG_ 1297 RCM_a070_eventDriveOrientation 1;
BA_ "Confidence" SG_ 1297 RCM_a070_eventIDFsignal 1;
BA_ "Confidence" SG_ 1297 RCM_a070_eventFrontLeftSeatbelt 1;
BA_ "Confidence" SG_ 1297 RCM_a070_eventFrontRightSeatbelt 1;
BA_ "Confidence" SG_ 1297 RCM_a070_eventVehicleSpeed 1;
BA_ "Confidence" SG_ 1297 RCM_a070_eventSteeringAngle 1;
BA_ "Confidence" SG_ 1297 RCM_a070_eventDriverBrakeApply 1;
BA_ "GenSigSNA" SG_ 1297 RCM_a070_eventDriverBrakeApply "3";
BA_ "Confidence" SG_ 1297 RCM_a070_eventAccelPedalPos 1;
BA_ "GenSigSNA" SG_ 1297 RCM_a070_eventAccelPedalPos "255";
BA_ "Confidence" SG_ 1297 RCM_a071_eventArmStatus 1;
BA_ "Confidence" SG_ 1297 RCM_a071_eventFactoryMode 1;
BA_ "Confidence" SG_ 1297 RCM_a071_eventDiagEnabled 1;
BA_ "Confidence" SG_ 1297 RCM_a071_eventDriveOrientation 1;
BA_ "Confidence" SG_ 1297 RCM_a071_eventIDFsignal 1;
BA_ "Confidence" SG_ 1297 RCM_a071_eventFrontLeftSeatbelt 1;
BA_ "Confidence" SG_ 1297 RCM_a071_eventFrontRightSeatbelt 1;
BA_ "Confidence" SG_ 1297 RCM_a071_eventVehicleSpeed 1;
BA_ "Confidence" SG_ 1297 RCM_a071_eventSteeringAngle 1;
BA_ "Confidence" SG_ 1297 RCM_a071_eventDriverBrakeApply 1;
BA_ "GenSigSNA" SG_ 1297 RCM_a071_eventDriverBrakeApply "3";
BA_ "Confidence" SG_ 1297 RCM_a071_eventAccelPedalPos 1;
BA_ "GenSigSNA" SG_ 1297 RCM_a071_eventAccelPedalPos "255";
BA_ "Confidence" SG_ 1297 RCM_a072_eventArmStatus 1;
BA_ "Confidence" SG_ 1297 RCM_a072_eventFactoryMode 1;
BA_ "Confidence" SG_ 1297 RCM_a072_eventDiagEnabled 1;
BA_ "Confidence" SG_ 1297 RCM_a072_eventDriveOrientation 1;
BA_ "Confidence" SG_ 1297 RCM_a072_eventIDFsignal 1;
BA_ "Confidence" SG_ 1297 RCM_a072_eventFrontLeftSeatbelt 1;
BA_ "Confidence" SG_ 1297 RCM_a072_eventFrontRightSeatbelt 1;
BA_ "Confidence" SG_ 1297 RCM_a072_eventVehicleSpeed 1;
BA_ "Confidence" SG_ 1297 RCM_a072_eventSteeringAngle 1;
BA_ "Confidence" SG_ 1297 RCM_a072_eventDriverBrakeApply 1;
BA_ "GenSigSNA" SG_ 1297 RCM_a072_eventDriverBrakeApply "3";
BA_ "Confidence" SG_ 1297 RCM_a072_eventAccelPedalPos 1;
BA_ "GenSigSNA" SG_ 1297 RCM_a072_eventAccelPedalPos "255";
BA_ "Confidence" SG_ 1297 RCM_a073_eventArmStatus 1;
BA_ "Confidence" SG_ 1297 RCM_a073_eventFactoryMode 1;
VAL_ 1297 RCM_a026_eventFactoryMode 1 "ENABLED" 0 "DISABLED" ;
VAL_ 1297 RCM_a026_eventDiagEnabled 1 "ENABLED" 0 "DISABLED" ;
VAL_ 1297 RCM_a026_eventDriveOrientation 1 "RIGHT_HAND_DRIVE" 0 "LEFT_HAND_DRIVE" ;
VAL_ 1297 RCM_a026_eventIDFsignal 1 "ACTIVE" 0 "NOT_ACTIVE" ;
VAL_ 1297 RCM_a026_eventFrontLeftSeatbelt 1 "LATCHED" 0 "UNLATCHED" ;
VAL_ 1297 RCM_a026_eventFrontRightSeatbelt 1 "LATCHED" 0 "UNLATCHED" ;
VAL_ 1297 RCM_a026_eventDriverBrakeApply 3 "Faulty_SNA" 2 "Driver_applying_brakes" 1 "Not_Applied" 0 "NotInit_orOff" ;
VAL_ 1297 RCM_a026_eventAccelPedalPos 255 "SNA" ;
VAL_ 1297 RCM_a027_eventArmStatus 1 "ARMED" 0 "UNARMED" ;
VAL_ 1297 RCM_a027_eventFactoryMode 1 "ENABLED" 0 "DISABLED" ;
VAL_ 1297 RCM_a027_eventDiagEnabled 1 "ENABLED" 0 "DISABLED" ;
VAL_ 1297 RCM_a027_eventDriveOrientation 1 "RIGHT_HAND_DRIVE" 0 "LEFT_HAND_DRIVE" ;
VAL_ 1297 RCM_a027_eventIDFsignal 1 "ACTIVE" 0 "NOT_ACTIVE" ;
VAL_ 1297 RCM_a027_eventFrontLeftSeatbelt 1 "LATCHED" 0 "UNLATCHED" ;
VAL_ 1297 RCM_a027_eventFrontRightSeatbelt 1 "LATCHED" 0 "UNLATCHED" ;
VAL_ 1297 RCM_a027_eventDriverBrakeApply 3 "Faulty_SNA" 2 "Driver_applying_brakes" 1 "Not_Applied" 0 "NotInit_orOff" ;
VAL_ 1297 RCM_a027_eventAccelPedalPos 255 "SNA" ;
VAL_ 1297 RCM_a028_eventArmStatus 1 "ARMED" 0 "UNARMED" ;
VAL_ 1297 RCM_a028_eventFactoryMode 1 "ENABLED" 0 "DISABLED" ;
VAL_ 1297 RCM_a028_eventDiagEnabled 1 "ENABLED" 0 "DISABLED" ;
VAL_ 1297 RCM_a028_eventDriveOrientation 1 "RIGHT_HAND_DRIVE" 0 "LEFT_HAND_DRIVE" ;
VAL_ 1297 RCM_a028_eventIDFsignal 1 "ACTIVE" 0 "NOT_ACTIVE" ;
VAL_ 1297 RCM_a028_eventFrontLeftSeatbelt 1 "LATCHED" 0 "UNLATCHED" ;
VAL_ 1297 RCM_a028_eventFrontRightSeatbelt 1 "LATCHED" 0 "UNLATCHED" ;
VAL_ 1297 RCM_a028_eventDriverBrakeApply 3 "Faulty_SNA" 2 "Driver_applying_brakes" 1 "Not_Applied" 0 "NotInit_orOff" ;
VAL_ 1297 RCM_a028_eventAccelPedalPos 255 "SNA" ;
VAL_ 1297 RCM_a029_eventArmStatus 1 "ARMED" 0 "UNARMED" ;
VAL_ 1297 RCM_a029_eventFactoryMode 1 "ENABLED" 0 "DISABLED" ;
VAL_ 1297 RCM_a029_eventDiagEnabled 1 "ENABLED" 0 "DISABLED" ;
VAL_ 1297 RCM_a029_eventDriveOrientation 1 "RIGHT_HAND_DRIVE" 0 "LEFT_HAND_DRIVE" ;
VAL_ 1297 RCM_a029_eventIDFsignal 1 "ACTIVE" 0 "NOT_ACTIVE" ;
VAL_ 1297 RCM_a029_eventFrontLeftSeatbelt 1 "LATCHED" 0 "UNLATCHED" ;
VAL_ 1297 RCM_a029_eventFrontRightSeatbelt 1 "LATCHED" 0 "UNLATCHED" ;
VAL_ 1297 RCM_a029_eventDriverBrakeApply 3 "Faulty_SNA" 2 "Driver_applying_brakes" 1 "Not_Applied" 0 "NotInit_orOff" ;
VAL_ 1297 RCM_a029_eventAccelPedalPos 255 "SNA" ;
VAL_ 1297 RCM_a030_eventArmStatus 1 "ARMED" 0 "UNARMED" ;
VAL_ 1297 RCM_a030_eventFactoryMode 1 "ENABLED" 0 "DISABLED" ;
VAL_ 1297 RCM_a030_eventDiagEnabled 1 "ENABLED" 0 "DISABLED" ;
VAL_ 1297 RCM_a030_eventDriveOrientation 1 "RIGHT_HAND_DRIVE" 0 "LEFT_HAND_DRIVE" ;
VAL_ 1297 RCM_a030_eventIDFsignal 1 "ACTIVE" 0 "NOT_ACTIVE" ;
VAL_ 1297 RCM_a030_eventFrontLeftSeatbelt 1 "LATCHED" 0 "UNLATCHED" ;
VAL_ 1297 RCM_a030_eventFrontRightSeatbelt 1 "LATCHED" 0 "UNLATCHED" ;
VAL_ 1297 RCM_a030_eventDriverBrakeApply 3 "Faulty_SNA" 2 "Driver_applying_brakes" 1 "Not_Applied" 0 "NotInit_orOff" ;
VAL_ 1297 RCM_a030_eventAccelPedalPos 255 "SNA" ;
VAL_ 1297 RCM_a031_eventArmStatus 1 "ARMED" 0 "UNARMED" ;
VAL_ 1297 RCM_a031_eventFactoryMode 1 "ENABLED" 0 "DISABLED" ;
VAL_ 1297 RCM_a031_eventDiagEnabled 1 "ENABLED" 0 "DISABLED" ;
VAL_ 1297 RCM_a031_eventDriveOrientation 1 "RIGHT_HAND_DRIVE" 0 "LEFT_HAND_DRIVE" ;
VAL_ 1297 RCM_a031_eventIDFsignal 1 "ACTIVE" 0 "NOT_ACTIVE" ;
VAL_ 1297 RCM_a031_eventFrontLeftSeatbelt 1 "LATCHED" 0 "UNLATCHED" ;
VAL_ 1297 RCM_a031_eventFrontRightSeatbelt 1 "LATCHED" 0 "UNLATCHED" ;
VAL_ 1297 RCM_a031_eventDriverBrakeApply 3 "Faulty_SNA" 2 "Driver_applying_brakes" 1 "Not_Applied" 0 "NotInit_orOff" ;
VAL_ 1297 RCM_a031_eventAccelPedalPos 255 "SNA" ;
VAL_ 1297 RCM_a032_eventArmStatus 1 "ARMED" 0 "UNARMED" ;
VAL_ 1297 RCM_a032_eventFactoryMode 1 "ENABLED" 0 "DISABLED" ;
VAL_ 1297 RCM_a032_eventDiagEnabled 1 "ENABLED" 0 "DISABLED" ;
VAL_ 1297 RCM_a032_eventDriveOrientation 1 "RIGHT_HAND_DRIVE" 0 "LEFT_HAND_DRIVE" ;
VAL_ 1297 RCM_a032_eventIDFsignal 1 "ACTIVE" 0 "NOT_ACTIVE" ;
VAL_ 1297 RCM_a032_eventFrontLeftSeatbelt 1 "LATCHED" 0 "UNLATCHED" ;
VAL_ 1297 RCM_a032_eventFrontRightSeatbelt 1 "LATCHED" 0 "UNLATCHED" ;
VAL_ 1297 RCM_a032_eventDriverBrakeApply 3 "Faulty_SNA" 2 "Driver_applying_brakes" 1 "Not_Applied" 0 "NotInit_orOff" ;
VAL_ 1297 RCM_a032_eventAccelPedalPos 255 "SNA" ;
VAL_ 1297 RCM_a033_eventArmStatus 1 "ARMED" 0 "UNARMED" ;
VAL_ 1297 RCM_a033_eventFactoryMode 1 "ENABLED" 0 "DISABLED" ;
VAL_ 1297 RCM_a033_eventDiagEnabled 1 "ENABLED" 0 "DISABLED" ;
VAL_ 1297 RCM_a033_eventDriveOrientation 1 "RIGHT_HAND_DRIVE" 0 "LEFT_HAND_DRIVE" ;
VAL_ 1297 RCM_a033_eventIDFsignal 1 "ACTIVE" 0 "NOT_ACTIVE" ;
VAL_ 1297 RCM_a033_eventFrontLeftSeatbelt 1 "LATCHED" 0 "UNLATCHED" ;
VAL_ 1297 RCM_a033_eventFrontRightSeatbelt 1 "LATCHED" 0 "UNLATCHED" ;
VAL_ 1297 RCM_a033_eventDriverBrakeApply 3 "Faulty_SNA" 2 "Driver_applying_brakes" 1 "Not_Applied" 0 "NotInit_orOff" ;
VAL_ 1297 RCM_a033_eventAccelPedalPos 255 "SNA" ;
VAL_ 1297 RCM_a034_eventArmStatus 1 "ARMED" 0 "UNARMED" ;
VAL_ 1297 RCM_a034_eventFactoryMode 1 "ENABLED" 0 "DISABLED" ;
VAL_ 1297 RCM_a034_eventDiagEnabled 1 "ENABLED" 0 "DISABLED" ;
VAL_ 1297 RCM_a034_eventDriveOrientation 1 "RIGHT_HAND_DRIVE" 0 "LEFT_HAND_DRIVE" ;
VAL_ 1297 RCM_a034_eventIDFsignal 1 "ACTIVE" 0 "NOT_ACTIVE" ;
VAL_ 1297 RCM_a034_eventFrontLeftSeatbelt 1 "LATCHED" 0 "UNLATCHED" ;
VAL_ 1297 RCM_a034_eventFrontRightSeatbelt 1 "LATCHED" 0 "UNLATCHED" ;
VAL_ 1297 RCM_a034_eventDriverBrakeApply 3 "Faulty_SNA" 2 "Driver_applying_brakes" 1 "Not_Applied" 0 "NotInit_orOff" ;
VAL_ 1297 RCM_a034_eventAccelPedalPos 255 "SNA" ;
VAL_ 1297 RCM_a035_eventArmStatus 1 "ARMED" 0 "UNARMED" ;
VAL_ 1297 RCM_a035_eventFactoryMode 1 "ENABLED" 0 "DISABLED" ;
VAL_ 1297 RCM_a035_eventDiagEnabled 1 "ENABLED" 0 "DISABLED" ;
VAL_ 1297 RCM_a035_eventDriveOrientation 1 "RIGHT_HAND_DRIVE" 0 "LEFT_HAND_DRIVE" ;
VAL_ 1297 RCM_a035_eventIDFsignal 1 "ACTIVE" 0 "NOT_ACTIVE" ;
VAL_ 1297 RCM_a035_eventFrontLeftSeatbelt 1 "LATCHED" 0 "UNLATCHED" ;
VAL_ 1297 RCM_a035_eventFrontRightSeatbelt 1 "LATCHED" 0 "UNLATCHED" ;
VAL_ 1297 RCM_a035_eventDriverBrakeApply 3 "Faulty_SNA" 2 "Driver_applying_brakes" 1 "Not_Applied" 0 "NotInit_orOff" ;
VAL_ 1297 RCM_a035_eventAccelPedalPos 255 "SNA" ;
VAL_ 1297 RCM_a036_eventArmStatus 1 "ARMED" 0 "UNARMED" ;
VAL_ 1297 RCM_a036_eventFactoryMode 1 "ENABLED" 0 "DISABLED" ;
VAL_ 1297 RCM_a036_eventDiagEnabled 1 "ENABLED" 0 "DISABLED" ;
VAL_ 1297 RCM_a036_eventDriveOrientation 1 "RIGHT_HAND_DRIVE" 0 "LEFT_HAND_DRIVE" ;
VAL_ 1297 RCM_a036_eventIDFsignal 1 "ACTIVE" 0 "NOT_ACTIVE" ;
VAL_ 1297 RCM_a036_eventFrontLeftSeatbelt 1 "LATCHED" 0 "UNLATCHED" ;
VAL_ 1297 RCM_a036_eventFrontRightSeatbelt 1 "LATCHED" 0 "UNLATCHED" ;
VAL_ 1297 RCM_a036_eventDriverBrakeApply 3 "Faulty_SNA" 2 "Driver_applying_brakes" 1 "Not_Applied" 0 "NotInit_orOff" ;
VAL_ 1297 RCM_a036_eventAccelPedalPos 255 "SNA" ;
VAL_ 1297 RCM_a037_eventArmStatus 1 "ARMED" 0 "UNARMED" ;
VAL_ 1297 RCM_a037_eventFactoryMode 1 "ENABLED" 0 "DISABLED" ;
VAL_ 1297 RCM_a037_eventDiagEnabled 1 "ENABLED" 0 "DISABLED" ;
VAL_ 1297 RCM_a037_eventDriveOrientation 1 "RIGHT_HAND_DRIVE" 0 "LEFT_HAND_DRIVE" ;
VAL_ 1297 RCM_a037_eventIDFsignal 1 "ACTIVE" 0 "NOT_ACTIVE" ;
VAL_ 1297 RCM_a037_eventFrontLeftSeatbelt 1 "LATCHED" 0 "UNLATCHED" ;
VAL_ 1297 RCM_a037_eventFrontRightSeatbelt 1 "LATCHED" 0 "UNLATCHED" ;
VAL_ 1297 RCM_a037_eventDriverBrakeApply 3 "Faulty_SNA" 2 "Driver_applying_brakes" 1 "Not_Applied" 0 "NotInit_orOff" ;
VAL_ 1297 RCM_a037_eventAccelPedalPos 255 "SNA" ;
VAL_ 1297 RCM_a040_eventArmStatus 1 "ARMED" 0 "UNARMED" ;
VAL_ 1297 RCM_a040_eventFactoryMode 1 "ENABLED" 0 "DISABLED" ;
VAL_ 1297 RCM_a040_eventDiagEnabled 1 "ENABLED" 0 "DISABLED" ;
VAL_ 1297 RCM_a040_eventDriveOrientation 1 "RIGHT_HAND_DRIVE" 0 "LEFT_HAND_DRIVE" ;
VAL_ 1297 RCM_a040_eventIDFsignal 1 "ACTIVE" 0 "NOT_ACTIVE" ;
VAL_ 1297 RCM_a040_eventFrontLeftSeatbelt 1 "LATCHED" 0 "UNLATCHED" ;
VAL_ 1297 RCM_a040_eventFrontRightSeatbelt 1 "LATCHED" 0 "UNLATCHED" ;
VAL_ 1297 RCM_a040_eventDriverBrakeApply 3 "Faulty_SNA" 2 "Driver_applying_brakes" 1 "Not_Applied" 0 "NotInit_orOff" ;
VAL_ 1297 RCM_a040_eventAccelPedalPos 255 "SNA" ;
VAL_ 1297 RCM_a041_eventArmStatus 1 "ARMED" 0 "UNARMED" ;
VAL_ 1297 RCM_a041_eventFactoryMode 1 "ENABLED" 0 "DISABLED" ;
VAL_ 1297 RCM_a041_eventDiagEnabled 1 "ENABLED" 0 "DISABLED" ;
VAL_ 1297 RCM_a041_eventDriveOrientation 1 "RIGHT_HAND_DRIVE" 0 "LEFT_HAND_DRIVE" ;
VAL_ 1297 RCM_a041_eventIDFsignal 1 "ACTIVE" 0 "NOT_ACTIVE" ;
VAL_ 1297 RCM_a041_eventFrontLeftSeatbelt 1 "LATCHED" 0 "UNLATCHED" ;
VAL_ 1297 RCM_a041_eventFrontRightSeatbelt 1 "LATCHED" 0 "UNLATCHED" ;
VAL_ 1297 RCM_a041_eventDriverBrakeApply 3 "Faulty_SNA" 2 "Driver_applying_brakes" 1 "Not_Applied" 0 "NotInit_orOff" ;
VAL_ 1297 RCM_a041_eventAccelPedalPos 255 "SNA" ;
VAL_ 1297 RCM_a042_eventArmStatus 1 "ARMED" 0 "UNARMED" ;
VAL_ 1297 RCM_a042_eventFactoryMode 1 "ENABLED" 0 "DISABLED" ;
VAL_ 1297 RCM_a042_eventDiagEnabled 1 "ENABLED" 0 "DISABLED" ;
VAL_ 1297 RCM_a042_eventDriveOrientation 1 "RIGHT_HAND_DRIVE" 0 "LEFT_HAND_DRIVE" ;
VAL_ 1297 RCM_a042_eventIDFsignal 1 "ACTIVE" 0 "NOT_ACTIVE" ;
VAL_ 1297 RCM_a042_eventFrontLeftSeatbelt 1 "LATCHED" 0 "UNLATCHED" ;
VAL_ 1297 RCM_a042_eventFrontRightSeatbelt 1 "LATCHED" 0 "UNLATCHED" ;
VAL_ 1297 RCM_a042_eventDriverBrakeApply 3 "Faulty_SNA" 2 "Driver_applying_brakes" 1 "Not_Applied" 0 "NotInit_orOff" ;
VAL_ 1297 RCM_a042_eventAccelPedalPos 255 "SNA" ;
VAL_ 1297 RCM_a043_eventArmStatus 1 "ARMED" 0 "UNARMED" ;
VAL_ 1297 RCM_a043_eventFactoryMode 1 "ENABLED" 0 "DISABLED" ;
VAL_ 1297 RCM_a043_eventDiagEnabled 1 "ENABLED" 0 "DISABLED" ;
VAL_ 1297 RCM_a043_eventDriveOrientation 1 "RIGHT_HAND_DRIVE" 0 "LEFT_HAND_DRIVE" ;
VAL_ 1297 RCM_a043_eventIDFsignal 1 "ACTIVE" 0 "NOT_ACTIVE" ;
VAL_ 1297 RCM_a043_eventFrontLeftSeatbelt 1 "LATCHED" 0 "UNLATCHED" ;
VAL_ 1297 RCM_a043_eventFrontRightSeatbelt 1 "LATCHED" 0 "UNLATCHED" ;
VAL_ 1297 RCM_a043_eventDriverBrakeApply 3 "Faulty_SNA" 2 "Driver_applying_brakes" 1 "Not_Applied" 0 "NotInit_orOff" ;
VAL_ 1297 RCM_a043_eventAccelPedalPos 255 "SNA" ;
VAL_ 1297 RCM_a044_eventArmStatus 1 "ARMED" 0 "UNARMED" ;
VAL_ 1297 RCM_a044_eventFactoryMode 1 "ENABLED" 0 "DISABLED" ;
VAL_ 1297 RCM_a044_eventDiagEnabled 1 "ENABLED" 0 "DISABLED" ;
VAL_ 1297 RCM_a044_eventDriveOrientation 1 "RIGHT_HAND_DRIVE" 0 "LEFT_HAND_DRIVE" ;
VAL_ 1297 RCM_a044_eventIDFsignal 1 "ACTIVE" 0 "NOT_ACTIVE" ;
VAL_ 1297 RCM_a044_eventFrontLeftSeatbelt 1 "LATCHED" 0 "UNLATCHED" ;
VAL_ 1297 RCM_a044_eventFrontRightSeatbelt 1 "LATCHED" 0 "UNLATCHED" ;
VAL_ 1297 RCM_a044_eventDriverBrakeApply 3 "Faulty_SNA" 2 "Driver_applying_brakes" 1 "Not_Applied" 0 "NotInit_orOff" ;
VAL_ 1297 RCM_a044_eventAccelPedalPos 255 "SNA" ;
VAL_ 1297 RCM_a045_eventArmStatus 1 "ARMED" 0 "UNARMED" ;
VAL_ 1297 RCM_a045_eventFactoryMode 1 "ENABLED" 0 "DISABLED" ;
VAL_ 1297 RCM_a045_eventDiagEnabled 1 "ENABLED" 0 "DISABLED" ;
VAL_ 1297 RCM_a045_eventDriveOrientation 1 "RIGHT_HAND_DRIVE" 0 "LEFT_HAND_DRIVE" ;
VAL_ 1297 RCM_a045_eventIDFsignal 1 "ACTIVE" 0 "NOT_ACTIVE" ;
VAL_ 1297 RCM_a045_eventFrontLeftSeatbelt 1 "LATCHED" 0 "UNLATCHED" ;
VAL_ 1297 RCM_a045_eventFrontRightSeatbelt 1 "LATCHED" 0 "UNLATCHED" ;
VAL_ 1297 RCM_a045_eventDriverBrakeApply 3 "Faulty_SNA" 2 "Driver_applying_brakes" 1 "Not_Applied" 0 "NotInit_orOff" ;
VAL_ 1297 RCM_a045_eventAccelPedalPos 255 "SNA" ;
VAL_ 1297 RCM_a046_eventArmStatus 1 "ARMED" 0 "UNARMED" ;
VAL_ 1297 RCM_a046_eventFactoryMode 1 "ENABLED" 0 "DISABLED" ;
VAL_ 1297 RCM_a046_eventDiagEnabled 1 "ENABLED" 0 "DISABLED" ;
VAL_ 1297 RCM_a046_eventDriveOrientation 1 "RIGHT_HAND_DRIVE" 0 "LEFT_HAND_DRIVE" ;
VAL_ 1297 RCM_a046_eventIDFsignal 1 "ACTIVE" 0 "NOT_ACTIVE" ;
VAL_ 1297 RCM_a046_eventFrontLeftSeatbelt 1 "LATCHED" 0 "UNLATCHED" ;
VAL_ 1297 RCM_a046_eventFrontRightSeatbelt 1 "LATCHED" 0 "UNLATCHED" ;
VAL_ 1297 RCM_a046_eventDriverBrakeApply 3 "Faulty_SNA" 2 "Driver_applying_brakes" 1 "Not_Applied" 0 "NotInit_orOff" ;
VAL_ 1297 RCM_a046_eventAccelPedalPos 255 "SNA" ;
VAL_ 1297 RCM_a047_eventArmStatus 1 "ARMED" 0 "UNARMED" ;
VAL_ 1297 RCM_a047_eventFactoryMode 1 "ENABLED" 0 "DISABLED" ;
VAL_ 1297 RCM_a047_eventDiagEnabled 1 "ENABLED" 0 "DISABLED" ;
VAL_ 1297 RCM_a047_eventDriveOrientation 1 "RIGHT_HAND_DRIVE" 0 "LEFT_HAND_DRIVE" ;
VAL_ 1297 RCM_a047_eventIDFsignal 1 "ACTIVE" 0 "NOT_ACTIVE" ;
VAL_ 1297 RCM_a047_eventFrontLeftSeatbelt 1 "LATCHED" 0 "UNLATCHED" ;
VAL_ 1297 RCM_a047_eventFrontRightSeatbelt 1 "LATCHED" 0 "UNLATCHED" ;
VAL_ 1297 RCM_a047_eventDriverBrakeApply 3 "Faulty_SNA" 2 "Driver_applying_brakes" 1 "Not_Applied" 0 "NotInit_orOff" ;
VAL_ 1297 RCM_a047_eventAccelPedalPos 255 "SNA" ;
VAL_ 1297 RCM_a048_eventArmStatus 1 "ARMED" 0 "UNARMED" ;
VAL_ 1297 RCM_a048_eventFactoryMode 1 "ENABLED" 0 "DISABLED" ;
VAL_ 1297 RCM_a048_eventDiagEnabled 1 "ENABLED" 0 "DISABLED" ;
VAL_ 1297 RCM_a048_eventDriveOrientation 1 "RIGHT_HAND_DRIVE" 0 "LEFT_HAND_DRIVE" ;
VAL_ 1297 RCM_a048_eventIDFsignal 1 "ACTIVE" 0 "NOT_ACTIVE" ;
VAL_ 1297 RCM_a048_eventFrontLeftSeatbelt 1 "LATCHED" 0 "UNLATCHED" ;
VAL_ 1297 RCM_a048_eventFrontRightSeatbelt 1 "LATCHED" 0 "UNLATCHED" ;
VAL_ 1297 RCM_a048_eventDriverBrakeApply 3 "Faulty_SNA" 2 "Driver_applying_brakes" 1 "Not_Applied" 0 "NotInit_orOff" ;
VAL_ 1297 RCM_a048_eventAccelPedalPos 255 "SNA" ;
VAL_ 1297 RCM_a049_eventArmStatus 1 "ARMED" 0 "UNARMED" ;
VAL_ 1297 RCM_a049_eventFactoryMode 1 "ENABLED" 0 "DISABLED" ;
VAL_ 1297 RCM_a049_eventDiagEnabled 1 "ENABLED" 0 "DISABLED" ;
VAL_ 1297 RCM_a049_eventDriveOrientation 1 "RIGHT_HAND_DRIVE" 0 "LEFT_HAND_DRIVE" ;
VAL_ 1297 RCM_a049_eventIDFsignal 1 "ACTIVE" 0 "NOT_ACTIVE" ;
VAL_ 1297 RCM_a049_eventFrontLeftSeatbelt 1 "LATCHED" 0 "UNLATCHED" ;
VAL_ 1297 RCM_a049_eventFrontRightSeatbelt 1 "LATCHED" 0 "UNLATCHED" ;
VAL_ 1297 RCM_a049_eventDriverBrakeApply 3 "Faulty_SNA" 2 "Driver_applying_brakes" 1 "Not_Applied" 0 "NotInit_orOff" ;
VAL_ 1297 RCM_a049_eventAccelPedalPos 255 "SNA" ;
VAL_ 1297 RCM_a050_eventArmStatus 1 "ARMED" 0 "UNARMED" ;
VAL_ 1297 RCM_a050_eventFactoryMode 1 "ENABLED" 0 "DISABLED" ;
VAL_ 1297 RCM_a050_eventDiagEnabled 1 "ENABLED" 0 "DISABLED" ;
VAL_ 1297 RCM_a050_eventDriveOrientation 1 "RIGHT_HAND_DRIVE" 0 "LEFT_HAND_DRIVE" ;
VAL_ 1297 RCM_a050_eventIDFsignal 1 "ACTIVE" 0 "NOT_ACTIVE" ;
VAL_ 1297 RCM_a050_eventFrontLeftSeatbelt 1 "LATCHED" 0 "UNLATCHED" ;
VAL_ 1297 RCM_a050_eventFrontRightSeatbelt 1 "LATCHED" 0 "UNLATCHED" ;
VAL_ 1297 RCM_a050_eventDriverBrakeApply 3 "Faulty_SNA" 2 "Driver_applying_brakes" 1 "Not_Applied" 0 "NotInit_orOff" ;
VAL_ 1297 RCM_a050_eventAccelPedalPos 255 "SNA" ;
VAL_ 1297 RCM_a051_eventArmStatus 1 "ARMED" 0 "UNARMED" ;
VAL_ 1297 RCM_a051_eventFactoryMode 1 "ENABLED" 0 "DISABLED" ;
VAL_ 1297 RCM_a051_eventDiagEnabled 1 "ENABLED" 0 "DISABLED" ;
VAL_ 1297 RCM_a051_eventDriveOrientation 1 "RIGHT_HAND_DRIVE" 0 "LEFT_HAND_DRIVE" ;
VAL_ 1297 RCM_a051_eventIDFsignal 1 "ACTIVE" 0 "NOT_ACTIVE" ;
VAL_ 1297 RCM_a051_eventFrontLeftSeatbelt 1 "LATCHED" 0 "UNLATCHED" ;
VAL_ 1297 RCM_a051_eventFrontRightSeatbelt 1 "LATCHED" 0 "UNLATCHED" ;
VAL_ 1297 RCM_a051_eventDriverBrakeApply 3 "Faulty_SNA" 2 "Driver_applying_brakes" 1 "Not_Applied" 0 "NotInit_orOff" ;
VAL_ 1297 RCM_a051_eventAccelPedalPos 255 "SNA" ;
VAL_ 1297 RCM_a052_eventArmStatus 1 "ARMED" 0 "UNARMED" ;
VAL_ 1297 RCM_a052_eventFactoryMode 1 "ENABLED" 0 "DISABLED" ;
VAL_ 1297 RCM_a052_eventDiagEnabled 1 "ENABLED" 0 "DISABLED" ;
VAL_ 1297 RCM_a052_eventDriveOrientation 1 "RIGHT_HAND_DRIVE" 0 "LEFT_HAND_DRIVE" ;
VAL_ 1297 RCM_a052_eventIDFsignal 1 "ACTIVE" 0 "NOT_ACTIVE" ;
VAL_ 1297 RCM_a052_eventFrontLeftSeatbelt 1 "LATCHED" 0 "UNLATCHED" ;
VAL_ 1297 RCM_a052_eventFrontRightSeatbelt 1 "LATCHED" 0 "UNLATCHED" ;
VAL_ 1297 RCM_a052_eventDriverBrakeApply 3 "Faulty_SNA" 2 "Driver_applying_brakes" 1 "Not_Applied" 0 "NotInit_orOff" ;
VAL_ 1297 RCM_a052_eventAccelPedalPos 255 "SNA" ;
VAL_ 1297 RCM_a053_eventArmStatus 1 "ARMED" 0 "UNARMED" ;
VAL_ 1297 RCM_a053_eventFactoryMode 1 "ENABLED" 0 "DISABLED" ;
VAL_ 1297 RCM_a053_eventDiagEnabled 1 "ENABLED" 0 "DISABLED" ;
VAL_ 1297 RCM_a053_eventDriveOrientation 1 "RIGHT_HAND_DRIVE" 0 "LEFT_HAND_DRIVE" ;
VAL_ 1297 RCM_a053_eventIDFsignal 1 "ACTIVE" 0 "NOT_ACTIVE" ;
VAL_ 1297 RCM_a053_eventFrontLeftSeatbelt 1 "LATCHED" 0 "UNLATCHED" ;
VAL_ 1297 RCM_a053_eventFrontRightSeatbelt 1 "LATCHED" 0 "UNLATCHED" ;
VAL_ 1297 RCM_a053_eventDriverBrakeApply 3 "Faulty_SNA" 2 "Driver_applying_brakes" 1 "Not_Applied" 0 "NotInit_orOff" ;
VAL_ 1297 RCM_a053_eventAccelPedalPos 255 "SNA" ;
VAL_ 1297 RCM_a054_eventArmStatus 1 "ARMED" 0 "UNARMED" ;
VAL_ 1297 RCM_a054_eventFactoryMode 1 "ENABLED" 0 "DISABLED" ;
VAL_ 1297 RCM_a054_eventDiagEnabled 1 "ENABLED" 0 "DISABLED" ;
VAL_ 1297 RCM_a054_eventDriveOrientation 1 "RIGHT_HAND_DRIVE" 0 "LEFT_HAND_DRIVE" ;
VAL_ 1297 RCM_a054_eventIDFsignal 1 "ACTIVE" 0 "NOT_ACTIVE" ;
VAL_ 1297 RCM_a054_eventFrontLeftSeatbelt 1 "LATCHED" 0 "UNLATCHED" ;
VAL_ 1297 RCM_a054_eventFrontRightSeatbelt 1 "LATCHED" 0 "UNLATCHED" ;
VAL_ 1297 RCM_a054_eventDriverBrakeApply 3 "Faulty_SNA" 2 "Driver_applying_brakes" 1 "Not_Applied" 0 "NotInit_orOff" ;
VAL_ 1297 RCM_a054_eventAccelPedalPos 255 "SNA" ;
VAL_ 1297 RCM_a055_eventArmStatus 1 "ARMED" 0 "UNARMED" ;
VAL_ 1297 RCM_a055_eventFactoryMode 1 "ENABLED" 0 "DISABLED" ;
VAL_ 1297 RCM_a055_eventDiagEnabled 1 "ENABLED" 0 "DISABLED" ;
VAL_ 1297 RCM_a055_eventDriveOrientation 1 "RIGHT_HAND_DRIVE" 0 "LEFT_HAND_DRIVE" ;
VAL_ 1297 RCM_a055_eventIDFsignal 1 "ACTIVE" 0 "NOT_ACTIVE" ;
VAL_ 1297 RCM_a055_eventFrontLeftSeatbelt 1 "LATCHED" 0 "UNLATCHED" ;
VAL_ 1297 RCM_a055_eventFrontRightSeatbelt 1 "LATCHED" 0 "UNLATCHED" ;
VAL_ 1297 RCM_a055_eventDriverBrakeApply 3 "Faulty_SNA" 2 "Driver_applying_brakes" 1 "Not_Applied" 0 "NotInit_orOff" ;
VAL_ 1297 RCM_a055_eventAccelPedalPos 255 "SNA" ;
VAL_ 1297 RCM_a056_eventArmStatus 1 "ARMED" 0 "UNARMED" ;
VAL_ 1297 RCM_a056_eventFactoryMode 1 "ENABLED" 0 "DISABLED" ;
VAL_ 1297 RCM_a056_eventDiagEnabled 1 "ENABLED" 0 "DISABLED" ;
VAL_ 1297 RCM_a056_eventDriveOrientation 1 "RIGHT_HAND_DRIVE" 0 "LEFT_HAND_DRIVE" ;
VAL_ 1297 RCM_a056_eventIDFsignal 1 "ACTIVE" 0 "NOT_ACTIVE" ;
VAL_ 1297 RCM_a056_eventFrontLeftSeatbelt 1 "LATCHED" 0 "UNLATCHED" ;
VAL_ 1297 RCM_a056_eventFrontRightSeatbelt 1 "LATCHED" 0 "UNLATCHED" ;
VAL_ 1297 RCM_a056_eventDriverBrakeApply 3 "Faulty_SNA" 2 "Driver_applying_brakes" 1 "Not_Applied" 0 "NotInit_orOff" ;
VAL_ 1297 RCM_a056_eventAccelPedalPos 255 "SNA" ;
VAL_ 1297 RCM_a057_eventArmStatus 1 "ARMED" 0 "UNARMED" ;
VAL_ 1297 RCM_a057_eventFactoryMode 1 "ENABLED" 0 "DISABLED" ;
VAL_ 1297 RCM_a057_eventDiagEnabled 1 "ENABLED" 0 "DISABLED" ;
VAL_ 1297 RCM_a057_eventDriveOrientation 1 "RIGHT_HAND_DRIVE" 0 "LEFT_HAND_DRIVE" ;
VAL_ 1297 RCM_a057_eventIDFsignal 1 "ACTIVE" 0 "NOT_ACTIVE" ;
VAL_ 1297 RCM_a057_eventFrontLeftSeatbelt 1 "LATCHED" 0 "UNLATCHED" ;
VAL_ 1297 RCM_a057_eventFrontRightSeatbelt 1 "LATCHED" 0 "UNLATCHED" ;
VAL_ 1297 RCM_a057_eventDriverBrakeApply 3 "Faulty_SNA" 2 "Driver_applying_brakes" 1 "Not_Applied" 0 "NotInit_orOff" ;
VAL_ 1297 RCM_a057_eventAccelPedalPos 255 "SNA" ;
VAL_ 1297 RCM_a058_eventArmStatus 1 "ARMED" 0 "UNARMED" ;
VAL_ 1297 RCM_a058_eventFactoryMode 1 "ENABLED" 0 "DISABLED" ;
VAL_ 1297 RCM_a058_eventDiagEnabled 1 "ENABLED" 0 "DISABLED" ;
VAL_ 1297 RCM_a058_eventDriveOrientation 1 "RIGHT_HAND_DRIVE" 0 "LEFT_HAND_DRIVE" ;
VAL_ 1297 RCM_a058_eventIDFsignal 1 "ACTIVE" 0 "NOT_ACTIVE" ;
VAL_ 1297 RCM_a058_eventFrontLeftSeatbelt 1 "LATCHED" 0 "UNLATCHED" ;
VAL_ 1297 RCM_a058_eventFrontRightSeatbelt 1 "LATCHED" 0 "UNLATCHED" ;
VAL_ 1297 RCM_a058_eventDriverBrakeApply 3 "Faulty_SNA" 2 "Driver_applying_brakes" 1 "Not_Applied" 0 "NotInit_orOff" ;
VAL_ 1297 RCM_a058_eventAccelPedalPos 255 "SNA" ;
VAL_ 1297 RCM_a059_eventArmStatus 1 "ARMED" 0 "UNARMED" ;
VAL_ 1297 RCM_a059_eventFactoryMode 1 "ENABLED" 0 "DISABLED" ;
VAL_ 1297 RCM_a059_eventDiagEnabled 1 "ENABLED" 0 "DISABLED" ;
VAL_ 1297 RCM_a059_eventDriveOrientation 1 "RIGHT_HAND_DRIVE" 0 "LEFT_HAND_DRIVE" ;
VAL_ 1297 RCM_a059_eventIDFsignal 1 "ACTIVE" 0 "NOT_ACTIVE" ;
VAL_ 1297 RCM_a059_eventFrontLeftSeatbelt 1 "LATCHED" 0 "UNLATCHED" ;
VAL_ 1297 RCM_a059_eventFrontRightSeatbelt 1 "LATCHED" 0 "UNLATCHED" ;
VAL_ 1297 RCM_a059_eventDriverBrakeApply 3 "Faulty_SNA" 2 "Driver_applying_brakes" 1 "Not_Applied" 0 "NotInit_orOff" ;
VAL_ 1297 RCM_a059_eventAccelPedalPos 255 "SNA" ;
VAL_ 1297 RCM_a060_eventArmStatus 1 "ARMED" 0 "UNARMED" ;
VAL_ 1297 RCM_a060_eventFactoryMode 1 "ENABLED" 0 "DISABLED" ;
VAL_ 1297 RCM_a060_eventDiagEnabled 1 "ENABLED" 0 "DISABLED" ;
VAL_ 1297 RCM_a060_eventDriveOrientation 1 "RIGHT_HAND_DRIVE" 0 "LEFT_HAND_DRIVE" ;
VAL_ 1297 RCM_a060_eventIDFsignal 1 "ACTIVE" 0 "NOT_ACTIVE" ;
VAL_ 1297 RCM_a060_eventFrontLeftSeatbelt 1 "LATCHED" 0 "UNLATCHED" ;
VAL_ 1297 RCM_a060_eventFrontRightSeatbelt 1 "LATCHED" 0 "UNLATCHED" ;
VAL_ 1297 RCM_a060_eventDriverBrakeApply 3 "Faulty_SNA" 2 "Driver_applying_brakes" 1 "Not_Applied" 0 "NotInit_orOff" ;
VAL_ 1297 RCM_a060_eventAccelPedalPos 255 "SNA" ;
VAL_ 1297 RCM_a061_eventArmStatus 1 "ARMED" 0 "UNARMED" ;
VAL_ 1297 RCM_a061_eventFactoryMode 1 "ENABLED" 0 "DISABLED" ;
VAL_ 1297 RCM_a061_eventDiagEnabled 1 "ENABLED" 0 "DISABLED" ;
VAL_ 1297 RCM_a061_eventDriveOrientation 1 "RIGHT_HAND_DRIVE" 0 "LEFT_HAND_DRIVE" ;
VAL_ 1297 RCM_a061_eventIDFsignal 1 "ACTIVE" 0 "NOT_ACTIVE" ;
VAL_ 1297 RCM_a061_eventFrontLeftSeatbelt 1 "LATCHED" 0 "UNLATCHED" ;
VAL_ 1297 RCM_a061_eventFrontRightSeatbelt 1 "LATCHED" 0 "UNLATCHED" ;
VAL_ 1297 RCM_a061_eventDriverBrakeApply 3 "Faulty_SNA" 2 "Driver_applying_brakes" 1 "Not_Applied" 0 "NotInit_orOff" ;
VAL_ 1297 RCM_a061_eventAccelPedalPos 255 "SNA" ;
VAL_ 1297 RCM_a062_eventArmStatus 1 "ARMED" 0 "UNARMED" ;
VAL_ 1297 RCM_a062_eventFactoryMode 1 "ENABLED" 0 "DISABLED" ;
VAL_ 1297 RCM_a062_eventDiagEnabled 1 "ENABLED" 0 "DISABLED" ;
VAL_ 1297 RCM_a062_eventDriveOrientation 1 "RIGHT_HAND_DRIVE" 0 "LEFT_HAND_DRIVE" ;
VAL_ 1297 RCM_a062_eventIDFsignal 1 "ACTIVE" 0 "NOT_ACTIVE" ;
VAL_ 1297 RCM_a062_eventFrontLeftSeatbelt 1 "LATCHED" 0 "UNLATCHED" ;
VAL_ 1297 RCM_a062_eventFrontRightSeatbelt 1 "LATCHED" 0 "UNLATCHED" ;
VAL_ 1297 RCM_a062_eventDriverBrakeApply 3 "Faulty_SNA" 2 "Driver_applying_brakes" 1 "Not_Applied" 0 "NotInit_orOff" ;
VAL_ 1297 RCM_a062_eventAccelPedalPos 255 "SNA" ;
VAL_ 1297 RCM_a063_eventArmStatus 1 "ARMED" 0 "UNARMED" ;
VAL_ 1297 RCM_a063_eventFactoryMode 1 "ENABLED" 0 "DISABLED" ;
VAL_ 1297 RCM_a063_eventDiagEnabled 1 "ENABLED" 0 "DISABLED" ;
VAL_ 1297 RCM_a063_eventDriveOrientation 1 "RIGHT_HAND_DRIVE" 0 "LEFT_HAND_DRIVE" ;
VAL_ 1297 RCM_a063_eventIDFsignal 1 "ACTIVE" 0 "NOT_ACTIVE" ;
VAL_ 1297 RCM_a063_eventFrontLeftSeatbelt 1 "LATCHED" 0 "UNLATCHED" ;
VAL_ 1297 RCM_a063_eventFrontRightSeatbelt 1 "LATCHED" 0 "UNLATCHED" ;
VAL_ 1297 RCM_a063_eventDriverBrakeApply 3 "Faulty_SNA" 2 "Driver_applying_brakes" 1 "Not_Applied" 0 "NotInit_orOff" ;
VAL_ 1297 RCM_a063_eventAccelPedalPos 255 "SNA" ;
VAL_ 1297 RCM_a064_eventArmStatus 1 "ARMED" 0 "UNARMED" ;
VAL_ 1297 RCM_a064_eventFactoryMode 1 "ENABLED" 0 "DISABLED" ;
VAL_ 1297 RCM_a064_eventDiagEnabled 1 "ENABLED" 0 "DISABLED" ;
VAL_ 1297 RCM_a064_eventDriveOrientation 1 "RIGHT_HAND_DRIVE" 0 "LEFT_HAND_DRIVE" ;
VAL_ 1297 RCM_a064_eventIDFsignal 1 "ACTIVE" 0 "NOT_ACTIVE" ;
VAL_ 1297 RCM_a064_eventFrontLeftSeatbelt 1 "LATCHED" 0 "UNLATCHED" ;
VAL_ 1297 RCM_a064_eventFrontRightSeatbelt 1 "LATCHED" 0 "UNLATCHED" ;
VAL_ 1297 RCM_a064_eventDriverBrakeApply 3 "Faulty_SNA" 2 "Driver_applying_brakes" 1 "Not_Applied" 0 "NotInit_orOff" ;
VAL_ 1297 RCM_a064_eventAccelPedalPos 255 "SNA" ;
VAL_ 1297 RCM_a065_eventArmStatus 1 "ARMED" 0 "UNARMED" ;
VAL_ 1297 RCM_a065_eventFactoryMode 1 "ENABLED" 0 "DISABLED" ;
VAL_ 1297 RCM_a065_eventDiagEnabled 1 "ENABLED" 0 "DISABLED" ;
VAL_ 1297 RCM_a065_eventDriveOrientation 1 "RIGHT_HAND_DRIVE" 0 "LEFT_HAND_DRIVE" ;
VAL_ 1297 RCM_a065_eventIDFsignal 1 "ACTIVE" 0 "NOT_ACTIVE" ;
VAL_ 1297 RCM_a065_eventFrontLeftSeatbelt 1 "LATCHED" 0 "UNLATCHED" ;
VAL_ 1297 RCM_a065_eventFrontRightSeatbelt 1 "LATCHED" 0 "UNLATCHED" ;
VAL_ 1297 RCM_a065_eventDriverBrakeApply 3 "Faulty_SNA" 2 "Driver_applying_brakes" 1 "Not_Applied" 0 "NotInit_orOff" ;
VAL_ 1297 RCM_a065_eventAccelPedalPos 255 "SNA" ;
VAL_ 1297 RCM_a066_eventArmStatus 1 "ARMED" 0 "UNARMED" ;
VAL_ 1297 RCM_a066_eventFactoryMode 1 "ENABLED" 0 "DISABLED" ;
VAL_ 1297 RCM_a066_eventDiagEnabled 1 "ENABLED" 0 "DISABLED" ;
VAL_ 1297 RCM_a066_eventDriveOrientation 1 "RIGHT_HAND_DRIVE" 0 "LEFT_HAND_DRIVE" ;
VAL_ 1297 RCM_a066_eventIDFsignal 1 "ACTIVE" 0 "NOT_ACTIVE" ;
VAL_ 1297 RCM_a066_eventFrontLeftSeatbelt 1 "LATCHED" 0 "UNLATCHED" ;
VAL_ 1297 RCM_a066_eventFrontRightSeatbelt 1 "LATCHED" 0 "UNLATCHED" ;
VAL_ 1297 RCM_a066_eventDriverBrakeApply 3 "Faulty_SNA" 2 "Driver_applying_brakes" 1 "Not_Applied" 0 "NotInit_orOff" ;
VAL_ 1297 RCM_a066_eventAccelPedalPos 255 "SNA" ;
VAL_ 1297 RCM_a067_eventArmStatus 1 "ARMED" 0 "UNARMED" ;
VAL_ 1297 RCM_a067_eventFactoryMode 1 "ENABLED" 0 "DISABLED" ;
VAL_ 1297 RCM_a067_eventDiagEnabled 1 "ENABLED" 0 "DISABLED" ;
VAL_ 1297 RCM_a067_eventDriveOrientation 1 "RIGHT_HAND_DRIVE" 0 "LEFT_HAND_DRIVE" ;
VAL_ 1297 RCM_a067_eventIDFsignal 1 "ACTIVE" 0 "NOT_ACTIVE" ;
VAL_ 1297 RCM_a067_eventFrontLeftSeatbelt 1 "LATCHED" 0 "UNLATCHED" ;
VAL_ 1297 RCM_a067_eventFrontRightSeatbelt 1 "LATCHED" 0 "UNLATCHED" ;
VAL_ 1297 RCM_a067_eventDriverBrakeApply 3 "Faulty_SNA" 2 "Driver_applying_brakes" 1 "Not_Applied" 0 "NotInit_orOff" ;
VAL_ 1297 RCM_a067_eventAccelPedalPos 255 "SNA" ;
VAL_ 1297 RCM_a068_eventArmStatus 1 "ARMED" 0 "UNARMED" ;
VAL_ 1297 RCM_a068_eventFactoryMode 1 "ENABLED" 0 "DISABLED" ;
VAL_ 1297 RCM_a068_eventDiagEnabled 1 "ENABLED" 0 "DISABLED" ;
VAL_ 1297 RCM_a068_eventDriveOrientation 1 "RIGHT_HAND_DRIVE" 0 "LEFT_HAND_DRIVE" ;
VAL_ 1297 RCM_a068_eventIDFsignal 1 "ACTIVE" 0 "NOT_ACTIVE" ;
VAL_ 1297 RCM_a068_eventFrontLeftSeatbelt 1 "LATCHED" 0 "UNLATCHED" ;
VAL_ 1297 RCM_a068_eventFrontRightSeatbelt 1 "LATCHED" 0 "UNLATCHED" ;
VAL_ 1297 RCM_a068_eventDriverBrakeApply 3 "Faulty_SNA" 2 "Driver_applying_brakes" 1 "Not_Applied" 0 "NotInit_orOff" ;
VAL_ 1297 RCM_a068_eventAccelPedalPos 255 "SNA" ;
VAL_ 1297 RCM_a069_eventArmStatus 1 "ARMED" 0 "UNARMED" ;
VAL_ 1297 RCM_a069_eventFactoryMode 1 "ENABLED" 0 "DISABLED" ;
VAL_ 1297 RCM_a069_eventDiagEnabled 1 "ENABLED" 0 "DISABLED" ;
VAL_ 1297 RCM_a069_eventDriveOrientation 1 "RIGHT_HAND_DRIVE" 0 "LEFT_HAND_DRIVE" ;
VAL_ 1297 RCM_a069_eventIDFsignal 1 "ACTIVE" 0 "NOT_ACTIVE" ;
VAL_ 1297 RCM_a069_eventFrontLeftSeatbelt 1 "LATCHED" 0 "UNLATCHED" ;
VAL_ 1297 RCM_a069_eventFrontRightSeatbelt 1 "LATCHED" 0 "UNLATCHED" ;
VAL_ 1297 RCM_a069_eventDriverBrakeApply 3 "Faulty_SNA" 2 "Driver_applying_brakes" 1 "Not_Applied" 0 "NotInit_orOff" ;
VAL_ 1297 RCM_a069_eventAccelPedalPos 255 "SNA" ;
VAL_ 1297 RCM_a070_eventArmStatus 1 "ARMED" 0 "UNARMED" ;
VAL_ 1297 RCM_a070_eventFactoryMode 1 "ENABLED" 0 "DISABLED" ;
VAL_ 1297 RCM_a070_eventDiagEnabled 1 "ENABLED" 0 "DISABLED" ;
VAL_ 1297 RCM_a070_eventDriveOrientation 1 "RIGHT_HAND_DRIVE" 0 "LEFT_HAND_DRIVE" ;
VAL_ 1297 RCM_a070_eventIDFsignal 1 "ACTIVE" 0 "NOT_ACTIVE" ;
VAL_ 1297 RCM_a070_eventFrontLeftSeatbelt 1 "LATCHED" 0 "UNLATCHED" ;
VAL_ 1297 RCM_a070_eventFrontRightSeatbelt 1 "LATCHED" 0 "UNLATCHED" ;
VAL_ 1297 RCM_a070_eventDriverBrakeApply 3 "Faulty_SNA" 2 "Driver_applying_brakes" 1 "Not_Applied" 0 "NotInit_orOff" ;
VAL_ 1297 RCM_a070_eventAccelPedalPos 255 "SNA" ;
VAL_ 1297 RCM_a071_eventArmStatus 1 "ARMED" 0 "UNARMED" ;
VAL_ 1297 RCM_a071_eventFactoryMode 1 "ENABLED" 0 "DISABLED" ;
VAL_ 1297 RCM_a071_eventDiagEnabled 1 "ENABLED" 0 "DISABLED" ;
VAL_ 1297 RCM_a071_eventDriveOrientation 1 "RIGHT_HAND_DRIVE" 0 "LEFT_HAND_DRIVE" ;
VAL_ 1297 RCM_a071_eventIDFsignal 1 "ACTIVE" 0 "NOT_ACTIVE" ;
VAL_ 1297 RCM_a071_eventFrontLeftSeatbelt 1 "LATCHED" 0 "UNLATCHED" ;
VAL_ 1297 RCM_a071_eventFrontRightSeatbelt 1 "LATCHED" 0 "UNLATCHED" ;
VAL_ 1297 RCM_a071_eventDriverBrakeApply 3 "Faulty_SNA" 2 "Driver_applying_brakes" 1 "Not_Applied" 0 "NotInit_orOff" ;
VAL_ 1297 RCM_a071_eventAccelPedalPos 255 "SNA" ;
VAL_ 1297 RCM_a072_eventArmStatus 1 "ARMED" 0 "UNARMED" ;
VAL_ 1297 RCM_a072_eventFactoryMode 1 "ENABLED" 0 "DISABLED" ;
VAL_ 1297 RCM_a072_eventDiagEnabled 1 "ENABLED" 0 "DISABLED" ;
VAL_ 1297 RCM_a072_eventDriveOrientation 1 "RIGHT_HAND_DRIVE" 0 "LEFT_HAND_DRIVE" ;
VAL_ 1297 RCM_a072_eventIDFsignal 1 "ACTIVE" 0 "NOT_ACTIVE" ;
VAL_ 1297 RCM_a072_eventFrontLeftSeatbelt 1 "LATCHED" 0 "UNLATCHED" ;
VAL_ 1297 RCM_a072_eventFrontRightSeatbelt 1 "LATCHED" 0 "UNLATCHED" ;
VAL_ 1297 RCM_a072_eventDriverBrakeApply 3 "Faulty_SNA" 2 "Driver_applying_brakes" 1 "Not_Applied" 0 "NotInit_orOff" ;
VAL_ 1297 RCM_a072_eventAccelPedalPos 255 "SNA" ;
VAL_ 1297 RCM_a073_eventArmStatus 1 "ARMED" 0 "UNARMED" ;
VAL_ 1297 RCM_a073_eventFactoryMode 1 "ENABLED" 0 "DISABLED" ;
