VERSION "dbc-export 1 2026.26.6.5"

NS_ :

BS_:

BU_: APB APP APS DAS DPB EPAS3S EPASTS ESP GTW IBST IDB PARK RADC RCM RCM2 RCM3 RCU TPMS TRCM USM

BO_ 920 EPASTS_alertMatrix: 8 EPASTS
 SG_ EPASTS_matrixIndex M : 0|4@1+ (1,0) [0|15] "" Vector__XXX
 SG_ EPASTS_a001_adcCalibrationOrInit m0 : 4|1@1+ (1,0) [0|1] "" Vector__XXX
 SG_ EPASTS_a002_adcMuxErr m0 : 5|1@1+ (1,0) [0|1] "" Vector__XXX
 SG_ EPASTS_a003_pspInvalidParamset m0 : 6|1@1+ (1,0) [0|1] "" Vector__XXX
 SG_ EPASTS_a004_scpInputMia m0 : 7|1@1+ (1,0) [0|1] "" Vector__XXX
 SG_ EPASTS_a005_scpUnknownResetSourc m0 : 8|1@1+ (1,0) [0|1] "" Vector__XXX
 SG_ EPASTS_a006_swrhResetByInvalidEr m0 : 9|1@1+ (1,0) [0|1] "" Vector__XXX
 SG_ EPASTS_a007_tsmcCoreTempDiff m0 : 10|1@1+ (1,0) [0|1] "" Vector__XXX
 SG_ EPASTS_a008_psdcPlatformShutdown m0 : 11|1@1+ (1,0) [0|1] "" Vector__XXX
 SG_ EPASTS_a009_mcusscLbistPermanent m0 : 12|1@1+ (1,0) [0|1] "" Vector__XXX
 SG_ EPASTS_a010_svcIncompatibleSwVer m0 : 13|1@1+ (1,0) [0|1] "" Vector__XXX
 SG_ EPASTS_a011_mcusscMonbistErr m0 : 14|1@1+ (1,0) [0|1] "" Vector__XXX
 SG_ EPASTS_a012_mcusscMbistEccErr m0 : 15|1@1+ (1,0) [0|1] "" Vector__XXX
 SG_ EPASTS_a013_mcusscSffMonitoringF m0 : 16|1@1+ (1,0) [0|1] "" Vector__XXX
 SG_ EPASTS_a014_mcusscSffMonitoringM m0 : 17|1@1+ (1,0) [0|1] "" Vector__XXX
 SG_ EPASTS_a015_mcusscCsErrorCheckFa m0 : 18|1@1+ (1,0) [0|1] "" Vector__XXX
 SG_ EPASTS_a016_mcufcCsErrorCheckFai m0 : 19|1@1+ (1,0) [0|1] "" Vector__XXX
 SG_ EPASTS_a017_stmdStmPlausibilityC m0 : 20|1@1+ (1,0) [0|1] "" Vector__XXX
 SG_ EPASTS_a018_exchCsErrorCheck m0 : 21|1@1+ (1,0) [0|1] "" Vector__XXX
 SG_ EPASTS_a019_rsthHwResetInfoCorru m0 : 22|1@1+ (1,0) [0|1] "" Vector__XXX
 SG_ EPASTS_a020_mcusscEolEcuIdIntegr m0 : 23|1@1+ (1,0) [0|1] "" Vector__XXX
 SG_ EPASTS_a021_osehCsErrorCheck m0 : 24|1@1+ (1,0) [0|1] "" Vector__XXX
 SG_ EPASTS_a022_swrhSwResetInfoCorru m0 : 25|1@1+ (1,0) [0|1] "" Vector__XXX
 SG_ EPASTS_a023_btarcCorruptionCheck m0 : 26|1@1+ (1,0) [0|1] "" Vector__XXX
 SG_ EPASTS_a024_srhCsErrorCheckFail m0 : 27|1@1+ (1,0) [0|1] "" Vector__XXX
 SG_ EPASTS_a025_btarcCorruptionCheck m0 : 28|1@1+ (1,0) [0|1] "" Vector__XXX
 SG_ EPASTS_a026_mrccCsErrorCheckFail m0 : 29|1@1+ (1,0) [0|1] "" Vector__XXX
 SG_ EPASTS_a027_mcusscDmuHfErr m0 : 30|1@1+ (1,0) [0|1] "" Vector__XXX
 SG_ EPASTS_a028_smuhNonInitDataCorru m0 : 31|1@1+ (1,0) [0|1] "" Vector__XXX
 SG_ EPASTS_a029_smuhSmuCoreCntErrorT m0 : 32|1@1+ (1,0) [0|1] "" Vector__XXX
 SG_ EPASTS_a030_rsthClockReset m0 : 33|1@1+ (1,0) [0|1] "" Vector__XXX
 SG_ EPASTS_a031_pmsProductionModeFai m0 : 34|1@1+ (1,0) [0|1] "" Vector__XXX
 SG_ EPASTS_a032_eolpEolCheckFailed m0 : 35|1@1+ (1,0) [0|1] "" Vector__XXX
 SG_ EPASTS_a033_icsvcPswVersionMisma m0 : 36|1@1+ (1,0) [0|1] "" Vector__XXX
 SG_ EPASTS_a034_sbchReadbackRegFail m0 : 37|1@1+ (1,0) [0|1] "" Vector__XXX
 SG_ EPASTS_a035_sbchChipIdFail m0 : 38|1@1+ (1,0) [0|1] "" Vector__XXX
 SG_ EPASTS_a036_sbcmSbcBistFailed m0 : 39|1@1+ (1,0) [0|1] "" Vector__XXX
 SG_ EPASTS_a037_epmV5P2Fail m0 : 40|1@1+ (1,0) [0|1] "" Vector__XXX
 SG_ EPASTS_a038_csohCh1CsErrorErrAtR m0 : 41|1@1+ (1,0) [0|1] "" Vector__XXX
 SG_ EPASTS_a039_csohCh2CsErrorErrAtR m0 : 42|1@1+ (1,0) [0|1] "" Vector__XXX
 SG_ EPASTS_a040_swrhLimitedResetRetr m0 : 43|1@1+ (1,0) [0|1] "" Vector__XXX
 SG_ EPASTS_a041_imcmCoreConfiguratio m0 : 44|1@1+ (1,0) [0|1] "" Vector__XXX
 SG_ EPASTS_a042_wdhWdTestFail m0 : 45|1@1+ (1,0) [0|1] "" Vector__XXX
 SG_ EPASTS_a043_sbcmWdStateDisabled m0 : 46|1@1+ (1,0) [0|1] "" Vector__XXX
 SG_ EPASTS_a044_sbcmSbcEepromFail m0 : 47|1@1+ (1,0) [0|1] "" Vector__XXX
 SG_ EPASTS_a045_psumSbcBandgapVoltEr m0 : 48|1@1+ (1,0) [0|1] "" Vector__XXX
 SG_ EPASTS_a046_mcusscOscillatorNotR m0 : 49|1@1+ (1,0) [0|1] "" Vector__XXX
 SG_ EPASTS_a047_epmVregVoltFail m0 : 50|1@1+ (1,0) [0|1] "" Vector__XXX
 SG_ EPASTS_a048_epmVcpVoltFail m0 : 51|1@1+ (1,0) [0|1] "" Vector__XXX
 SG_ EPASTS_a049_epmLgFail m0 : 52|1@1+ (1,0) [0|1] "" Vector__XXX
 SG_ EPASTS_a050_erlErr m0 : 53|1@1+ (1,0) [0|1] "" Vector__XXX
 SG_ EPASTS_a051_ermMessageErr m0 : 54|1@1+ (1,0) [0|1] "" Vector__XXX
 SG_ EPASTS_a052_ermSdcInputBufferOve m0 : 55|1@1+ (1,0) [0|1] "" Vector__XXX
 SG_ EPASTS_a053_adcUnexpectedNumOfDa m0 : 56|1@1+ (1,0) [0|1] "" Vector__XXX
 SG_ EPASTS_a054_adcUnexpectedData m0 : 57|1@1+ (1,0) [0|1] "" Vector__XXX
 SG_ EPASTS_a055_amExtendedGduTest m0 : 58|1@1+ (1,0) [0|1] "" Vector__XXX
 SG_ EPASTS_a056_amGduConfigCsErrorCh m0 : 59|1@1+ (1,0) [0|1] "" Vector__XXX
 SG_ EPASTS_a057_amGduVds m0 : 60|1@1+ (1,0) [0|1] "" Vector__XXX
 SG_ EPASTS_a058_amIntVgsUndervtgErr m0 : 61|1@1+ (1,0) [0|1] "" Vector__XXX
 SG_ EPASTS_a059_amStartupTestFailed m0 : 62|1@1+ (1,0) [0|1] "" Vector__XXX
 SG_ EPASTS_a060_amGduFail m0 : 63|1@1+ (1,0) [0|1] "" Vector__XXX
 SG_ EPASTS_a061_amIntSerialErr m1 : 4|1@1+ (1,0) [0|1] "" Vector__XXX
 SG_ EPASTS_a062_amPhaseBridgeCheck m1 : 5|1@1+ (1,0) [0|1] "" Vector__XXX
 SG_ EPASTS_a063_amIntRegulatorErr m1 : 6|1@1+ (1,0) [0|1] "" Vector__XXX
 SG_ EPASTS_a064_amBridgeShort m1 : 7|1@1+ (1,0) [0|1] "" Vector__XXX
 SG_ EPASTS_a065_amGduJuncTemp m1 : 8|1@1+ (1,0) [0|1] "" Vector__XXX
 SG_ EPASTS_a066_amVoltQfErr m1 : 9|1@1+ (1,0) [0|1] "" Vector__XXX
 SG_ EPASTS_a067_tspmPowermoduleTempI m1 : 10|1@1+ (1,0) [0|1] "" Vector__XXX
 SG_ EPASTS_a068_rsthCoreRedundancyEr m1 : 11|1@1+ (1,0) [0|1] "" Vector__XXX
 SG_ EPASTS_a069_rsthCoreTempOutOfRan m1 : 12|1@1+ (1,0) [0|1] "" Vector__XXX
 SG_ EPASTS_a070_rsthInternalLowVolt m1 : 13|1@1+ (1,0) [0|1] "" Vector__XXX
 SG_ EPASTS_a071_rsthInternalHighVolt m1 : 14|1@1+ (1,0) [0|1] "" Vector__XXX
 SG_ EPASTS_a072_rsthFlashUncorrEccOr m1 : 15|1@1+ (1,0) [0|1] "" Vector__XXX
 SG_ EPASTS_a073_rsthOtherEdcEcc m1 : 16|1@1+ (1,0) [0|1] "" Vector__XXX
 SG_ EPASTS_a074_rsthUnexpectedAlarm m1 : 17|1@1+ (1,0) [0|1] "" Vector__XXX
 SG_ EPASTS_a075_rsthUnusedOtherModul m1 : 18|1@1+ (1,0) [0|1] "" Vector__XXX
 SG_ EPASTS_a076_exchGeneralException m1 : 19|1@1+ (1,0) [0|1] "" Vector__XXX
 SG_ EPASTS_a077_dmDeadlineViolation m1 : 20|1@1+ (1,0) [0|1] "" Vector__XXX
 SG_ EPASTS_a078_dmDeadlineViolation m1 : 21|1@1+ (1,0) [0|1] "" Vector__XXX
 SG_ EPASTS_a079_gduhComErr m1 : 22|1@1+ (1,0) [0|1] "" Vector__XXX
 SG_ EPASTS_a080_pwmTimerSyncCheck m1 : 23|1@1+ (1,0) [0|1] "" Vector__XXX
 SG_ EPASTS_a081_exchFloatingPointExc m1 : 24|1@1+ (1,0) [0|1] "" Vector__XXX
 SG_ EPASTS_a082_adcTriggerTimeChk m1 : 25|1@1+ (1,0) [0|1] "" Vector__XXX
 SG_ EPASTS_a083_tdaDclinkcapacitorTe m1 : 26|1@1+ (1,0) [0|1] "" Vector__XXX
 SG_ EPASTS_a084_adcTriggerCheck m1 : 27|1@1+ (1,0) [0|1] "" Vector__XXX
 SG_ EPASTS_a085_amGduSwitchOffTestBy m1 : 28|1@1+ (1,0) [0|1] "" Vector__XXX
 SG_ EPASTS_a086_rsthRamUncorrEcc m1 : 29|1@1+ (1,0) [0|1] "" Vector__XXX
 SG_ EPASTS_a087_rsthFlashConfigErr m1 : 30|1@1+ (1,0) [0|1] "" Vector__XXX
 SG_ EPASTS_a088_tedMainboardTempChec m1 : 31|1@1+ (1,0) [0|1] "" Vector__XXX
 SG_ EPASTS_a089_tedRevercebattfetjun m1 : 32|1@1+ (1,0) [0|1] "" Vector__XXX
 SG_ EPASTS_a090_etsmWarning m1 : 33|1@1+ (1,0) [0|1] "" Vector__XXX
 SG_ EPASTS_a091_bvpBattVoltCrossChkF m1 : 34|1@1+ (1,0) [0|1] "" Vector__XXX
 SG_ EPASTS_a092_amGduSwitchOffTestBy m1 : 35|1@1+ (1,0) [0|1] "" Vector__XXX
 SG_ EPASTS_a093_sctpTsuSingleStaticF m1 : 36|1@1+ (1,0) [0|1] "" Vector__XXX
 SG_ EPASTS_a094_sctpTsuMultipleStati m1 : 37|1@1+ (1,0) [0|1] "" Vector__XXX
 SG_ EPASTS_a095_mdModelBasedMotorInt m1 : 38|1@1+ (1,0) [0|1] "" Vector__XXX
 SG_ EPASTS_a096_rppRpsSingleStaticFa m1 : 39|1@1+ (1,0) [0|1] "" Vector__XXX
 SG_ EPASTS_a097_rppRpsMultipleStatic m1 : 40|1@1+ (1,0) [0|1] "" Vector__XXX
 SG_ EPASTS_a098_invErr m1 : 41|1@1+ (1,0) [0|1] "" Vector__XXX
 SG_ EPASTS_a099_mcdTorqueMismatchFau m1 : 42|1@1+ (1,0) [0|1] "" Vector__XXX
 SG_ EPASTS_a100_amVbrgLssFault m1 : 43|1@1+ (1,0) [0|1] "" Vector__XXX
 SG_ EPASTS_a101_sdrvSpcIdMismatch m1 : 44|1@1+ (1,0) [0|1] "" Vector__XXX
 SG_ EPASTS_a102_amPhasecurrentQosErr m1 : 45|1@1+ (1,0) [0|1] "" Vector__XXX
 SG_ EPASTS_a103_exhaUnusedInterruptC m1 : 46|1@1+ (1,0) [0|1] "" Vector__XXX
 SG_ EPASTS_a104_exhaBusMpuException m1 : 47|1@1+ (1,0) [0|1] "" Vector__XXX
 SG_ EPASTS_a105_exhaSriBusErrExcepti m1 : 48|1@1+ (1,0) [0|1] "" Vector__XXX
 SG_ EPASTS_a106_exhaSpbBusErrExcepti m1 : 49|1@1+ (1,0) [0|1] "" Vector__XXX
 SG_ EPASTS_a107_exhaOtherNmiExceptio m1 : 50|1@1+ (1,0) [0|1] "" Vector__XXX
 SG_ EPASTS_a108_exhaInternalProtecti m1 : 51|1@1+ (1,0) [0|1] "" Vector__XXX
 SG_ EPASTS_a109_exhaSysBusOrPeriphEr m1 : 52|1@1+ (1,0) [0|1] "" Vector__XXX
 SG_ EPASTS_a110_amPhaseRelaySwitchOf m1 : 53|1@1+ (1,0) [0|1] "" Vector__XXX
 SG_ EPASTS_a111_amCurrentSensingDisc m1 : 54|1@1+ (1,0) [0|1] "" Vector__XXX
 SG_ EPASTS_a112_rsthSafetyFlipflopEr m1 : 55|1@1+ (1,0) [0|1] "" Vector__XXX
 SG_ EPASTS_a113_rsthUncorrectableEnd m1 : 56|1@1+ (1,0) [0|1] "" Vector__XXX
 SG_ EPASTS_a114_osehOsErr m1 : 57|1@1+ (1,0) [0|1] "" Vector__XXX
 SG_ EPASTS_a115_mcusscLbistSingleFai m1 : 58|1@1+ (1,0) [0|1] "" Vector__XXX
 SG_ EPASTS_a116_mrccStartupRegCsErro m1 : 59|1@1+ (1,0) [0|1] "" Vector__XXX
 SG_ EPASTS_a117_mrccStartupRegCsErro m1 : 60|1@1+ (1,0) [0|1] "" Vector__XXX
 SG_ EPASTS_a118_mcusscFlashCsErrorEr m1 : 61|1@1+ (1,0) [0|1] "" Vector__XXX
 SG_ EPASTS_a119_mcusscFlashEccCritic m1 : 62|1@1+ (1,0) [0|1] "" Vector__XXX
 SG_ EPASTS_a120_mcusscFlashEccLatent m1 : 63|1@1+ (1,0) [0|1] "" Vector__XXX
 SG_ EPASTS_a121_mcusscMbistEccErr m2 : 4|1@1+ (1,0) [0|1] "" Vector__XXX
 SG_ EPASTS_a122_pcpBridgeFetShort m2 : 5|1@1+ (1,0) [0|1] "" Vector__XXX
 SG_ EPASTS_a123_imcmCommErr m2 : 6|1@1+ (1,0) [0|1] "" Vector__XXX
 SG_ EPASTS_a124_mcusscMbistEccTransi m2 : 7|1@1+ (1,0) [0|1] "" Vector__XXX
 SG_ EPASTS_a125_mcusscMbistMiaErr m2 : 8|1@1+ (1,0) [0|1] "" Vector__XXX
 SG_ EPASTS_a126_mcusscMonbistMiaErr m2 : 9|1@1+ (1,0) [0|1] "" Vector__XXX
 SG_ EPASTS_a127_exchAdditionalExcept m2 : 10|1@1+ (1,0) [0|1] "" Vector__XXX
 SG_ EPASTS_a128_exchExceptionStopRes m2 : 11|1@1+ (1,0) [0|1] "" Vector__XXX
 SG_ EPASTS_a129_exchAdditionalExcept m2 : 12|1@1+ (1,0) [0|1] "" Vector__XXX
 SG_ EPASTS_a130_mrccConfigCsErrorErr m2 : 13|1@1+ (1,0) [0|1] "" Vector__XXX
 SG_ EPASTS_a131_exchGuardedResetAfte m2 : 14|1@1+ (1,0) [0|1] "" Vector__XXX
 SG_ EPASTS_a132_mcusscNotSupportedMc m2 : 15|1@1+ (1,0) [0|1] "" Vector__XXX
 SG_ EPASTS_a133_mcusscLbistEcuIdIsNo m2 : 16|1@1+ (1,0) [0|1] "" Vector__XXX
 SG_ EPASTS_a134_osehGuardedResetAfte m2 : 17|1@1+ (1,0) [0|1] "" Vector__XXX
 SG_ EPASTS_a135_tmpsfetjCalculationO m2 : 18|1@1+ (1,0) [0|1] "" Vector__XXX
 SG_ EPASTS_a136_ftElectricalAngleQf m2 : 19|1@1+ (1,0) [0|1] "" Vector__XXX
 SG_ EPASTS_a137_osehErrWithoutImmedi m2 : 20|1@1+ (1,0) [0|1] "" Vector__XXX
 SG_ EPASTS_a138_osehAdditionalErrWit m2 : 21|1@1+ (1,0) [0|1] "" Vector__XXX
 SG_ EPASTS_a139_osehAdditionalOsErr m2 : 22|1@1+ (1,0) [0|1] "" Vector__XXX
 SG_ EPASTS_a140_imcmConfigurationErr m2 : 23|1@1+ (1,0) [0|1] "" Vector__XXX
 SG_ EPASTS_a141_amFetShortTest m2 : 24|1@1+ (1,0) [0|1] "" Vector__XXX
 SG_ EPASTS_a142_tedEmifilterDmcTempC m2 : 25|1@1+ (1,0) [0|1] "" Vector__XXX
 SG_ EPASTS_a143_tedEmifilterCmcTempC m2 : 26|1@1+ (1,0) [0|1] "" Vector__XXX
 SG_ EPASTS_a144_mriCoreRaminitFailed m2 : 27|1@1+ (1,0) [0|1] "" Vector__XXX
 SG_ EPASTS_a145_mriPeripheralRaminit m2 : 28|1@1+ (1,0) [0|1] "" Vector__XXX
 SG_ EPASTS_a146_btarcRcCircuitCheck m2 : 29|1@1+ (1,0) [0|1] "" Vector__XXX
 SG_ EPASTS_a147_amDcLinkShortedFail m2 : 30|1@1+ (1,0) [0|1] "" Vector__XXX
 SG_ EPASTS_a148_mrccExitFromStandbyD m2 : 31|1@1+ (1,0) [0|1] "" Vector__XXX
 SG_ EPASTS_a149_amReversibleEmergenc m2 : 32|1@1+ (1,0) [0|1] "" Vector__XXX
 SG_ EPASTS_a150_amExternalEmergencyO m2 : 33|1@1+ (1,0) [0|1] "" Vector__XXX
 SG_ EPASTS_a151_amPermanentEmergency m2 : 34|1@1+ (1,0) [0|1] "" Vector__XXX
 SG_ EPASTS_a152_exchFlashEccExceptio m2 : 35|1@1+ (1,0) [0|1] "" Vector__XXX
 SG_ EPASTS_a153_sdsmBlockSelectorInv m2 : 36|1@1+ (1,0) [0|1] "" Vector__XXX
 SG_ EPASTS_a154_sdsmCsErrorInvalidPr m2 : 37|1@1+ (1,0) [0|1] "" Vector__XXX
 SG_ EPASTS_a155_sdsmDataInvalidAll m2 : 38|1@1+ (1,0) [0|1] "" Vector__XXX
 SG_ EPASTS_a156_amIntSerialErrSafety m2 : 39|1@1+ (1,0) [0|1] "" Vector__XXX
 SG_ EPASTS_a157_mcudcpInvalidEcuId m2 : 40|1@1+ (1,0) [0|1] "" Vector__XXX
 SG_ EPASTS_a158_amGduFailDuringRecov m2 : 41|1@1+ (1,0) [0|1] "" Vector__XXX
 SG_ EPASTS_a159_exchFlashWordlineTra m2 : 42|1@1+ (1,0) [0|1] "" Vector__XXX
 SG_ EPASTS_a160_rsthCpu1UnexpectedAl m2 : 43|1@1+ (1,0) [0|1] "" Vector__XXX
 SG_ EPASTS_a161_tdaRelayfetjunctionT m2 : 44|1@1+ (1,0) [0|1] "" Vector__XXX
 SG_ EPASTS_a162_tdaBridgefetjunction m2 : 45|1@1+ (1,0) [0|1] "" Vector__XXX
 SG_ EPASTS_a163_tdaPowermoduleTempCh m2 : 46|1@1+ (1,0) [0|1] "" Vector__XXX
 SG_ EPASTS_a164_tdaBattfetjunctionTe m2 : 47|1@1+ (1,0) [0|1] "" Vector__XXX
 SG_ EPASTS_a165_tdaDcbusshuntTempChe m2 : 48|1@1+ (1,0) [0|1] "" Vector__XXX
 SG_ EPASTS_a166_tdaPhasecurrentshunt m2 : 49|1@1+ (1,0) [0|1] "" Vector__XXX
 SG_ EPASTS_a167_iccd1ErrQueueOverflo m2 : 50|1@1+ (1,0) [0|1] "" Vector__XXX
 SG_ EPASTS_a168_c1csInvalidC1App m2 : 51|1@1+ (1,0) [0|1] "" Vector__XXX
 SG_ EPASTS_a169_scpSafetyReset m2 : 52|1@1+ (1,0) [0|1] "" Vector__XXX
 SG_ EPASTS_a170_pmpDcvoltAge m2 : 53|1@1+ (1,0) [0|1] "" Vector__XXX
 SG_ EPASTS_a171_pmpKgvalueAge m2 : 54|1@1+ (1,0) [0|1] "" Vector__XXX
 SG_ EPASTS_a172_pmpElangMotorcurrent m2 : 55|1@1+ (1,0) [0|1] "" Vector__XXX
 SG_ EPASTS_a173_pmpRotorspeedAge m2 : 56|1@1+ (1,0) [0|1] "" Vector__XXX
 SG_ EPASTS_a174_pmpPhasecurrentAge m2 : 57|1@1+ (1,0) [0|1] "" Vector__XXX
 SG_ EPASTS_a175_exchFlashStoredConfi m2 : 58|1@1+ (1,0) [0|1] "" Vector__XXX
 SG_ EPASTS_a176_exchCpu1ExceptionRes m2 : 59|1@1+ (1,0) [0|1] "" Vector__XXX
 SG_ EPASTS_a177_etsrInvalidated m2 : 60|1@1+ (1,0) [0|1] "" Vector__XXX
 SG_ EPASTS_a178_exchWdtException m2 : 61|1@1+ (1,0) [0|1] "" Vector__XXX
 SG_ EPASTS_a179_tedMotorcoilTempChec m2 : 62|1@1+ (1,0) [0|1] "" Vector__XXX
 SG_ EPASTS_a180_dmDeadlineViolationC m2 : 63|1@1+ (1,0) [0|1] "" Vector__XXX
 SG_ EPASTS_a181_dmDeadlineViolationC m3 : 4|1@1+ (1,0) [0|1] "" Vector__XXX
 SG_ EPASTS_a182_mcdInputMia m3 : 5|1@1+ (1,0) [0|1] "" Vector__XXX
 SG_ EPASTS_a183_sbchCommErrSbcToMcu m3 : 6|1@1+ (1,0) [0|1] "" Vector__XXX
 SG_ EPASTS_a184_sbcmCommBufferOverfl m3 : 7|1@1+ (1,0) [0|1] "" Vector__XXX
 SG_ EPASTS_a185_sbcscpQAWatchdogRese m3 : 8|1@1+ (1,0) [0|1] "" Vector__XXX
 SG_ EPASTS_a186_wdhCommBufferOverflo m3 : 9|1@1+ (1,0) [0|1] "" Vector__XXX
 SG_ EPASTS_a187_epmVoltFail m3 : 10|1@1+ (1,0) [0|1] "" Vector__XXX
 SG_ EPASTS_a188_epmCommBufferOverflo m3 : 11|1@1+ (1,0) [0|1] "" Vector__XXX
 SG_ EPASTS_a189_sbchCommErrMcuToSbc m3 : 12|1@1+ (1,0) [0|1] "" Vector__XXX
 SG_ EPASTS_a190_sbchCommBufferOverfl m3 : 13|1@1+ (1,0) [0|1] "" Vector__XXX
 SG_ EPASTS_a191_sbcscpVcp2VucVoltFai m3 : 14|1@1+ (1,0) [0|1] "" Vector__XXX
 SG_ EPASTS_a192_osumC0CsaNearFull m3 : 15|1@1+ (1,0) [0|1] "" Vector__XXX
 SG_ EPASTS_a193_osumC0StackNearFull m3 : 16|1@1+ (1,0) [0|1] "" Vector__XXX
 SG_ EPASTS_a194_amNvdataLoss m3 : 17|1@1+ (1,0) [0|1] "" Vector__XXX
 SG_ EPASTS_a195_imcmCommErrC1 m3 : 18|1@1+ (1,0) [0|1] "" Vector__XXX
 SG_ EPASTS_a196_topEolTasOffsetInval m3 : 19|1@1+ (1,0) [0|1] "" Vector__XXX
 SG_ EPASTS_a197_difpDifactorInvalid m3 : 20|1@1+ (1,0) [0|1] "" Vector__XXX
 SG_ EPASTS_a198_osumC1CsaNearFull m3 : 21|1@1+ (1,0) [0|1] "" Vector__XXX
 SG_ EPASTS_a199_osumC1StackNearFull m3 : 22|1@1+ (1,0) [0|1] "" Vector__XXX
 SG_ EPASTS_a200_ammInputBufferOverfl m3 : 23|1@1+ (1,0) [0|1] "" Vector__XXX
 SG_ EPASTS_a201_ammOutputBufferOverf m3 : 24|1@1+ (1,0) [0|1] "" Vector__XXX
 SG_ EPASTS_a202_ohnvmpStoredOffsetLo m3 : 25|1@1+ (1,0) [0|1] "" Vector__XXX
 SG_ EPASTS_a203_ctcInterfaceErr m3 : 26|1@1+ (1,0) [0|1] "" Vector__XXX
 SG_ EPASTS_a204_fdpPrevTrqErr m3 : 27|1@1+ (1,0) [0|1] "" Vector__XXX
 SG_ EPASTS_a205_fdrOclFail m3 : 28|1@1+ (1,0) [0|1] "" Vector__XXX
 SG_ EPASTS_a206_fdrOclPartialBlockin m3 : 29|1@1+ (1,0) [0|1] "" Vector__XXX
 SG_ EPASTS_a207_fdrOclFreezing m3 : 30|1@1+ (1,0) [0|1] "" Vector__XXX
 SG_ EPASTS_a208_fdrLowSeverityBlocki m3 : 31|1@1+ (1,0) [0|1] "" Vector__XXX
 SG_ EPASTS_a209_fdrLowSeverityFreezi m3 : 32|1@1+ (1,0) [0|1] "" Vector__XXX
 SG_ EPASTS_a210_fdrTotalBlocking m3 : 33|1@1+ (1,0) [0|1] "" Vector__XXX
 SG_ EPASTS_a211_frmInternalErr m3 : 34|1@1+ (1,0) [0|1] "" Vector__XXX
 SG_ EPASTS_a212_frmDataLost m3 : 35|1@1+ (1,0) [0|1] "" Vector__XXX
 SG_ EPASTS_a213_frmHighFrictionDetec m3 : 36|1@1+ (1,0) [0|1] "" Vector__XXX
 SG_ EPASTS_a214_velInterfaceErr m3 : 37|1@1+ (1,0) [0|1] "" Vector__XXX
 SG_ EPASTS_a215_vsgSafeViolErr m3 : 38|1@1+ (1,0) [0|1] "" Vector__XXX
 SG_ EPASTS_a216_isdgImproperShutdown m3 : 39|1@1+ (1,0) [0|1] "" Vector__XXX
 SG_ EPASTS_a217_msdMasterSilentErr m3 : 40|1@1+ (1,0) [0|1] "" Vector__XXX
 SG_ EPASTS_a218_aadApplicationStateE m3 : 41|1@1+ (1,0) [0|1] "" Vector__XXX
 SG_ EPASTS_a219_frhFastRestartFailed m3 : 42|1@1+ (1,0) [0|1] "" Vector__XXX
 SG_ EPASTS_a220_transceiverInputqueu m3 : 43|1@1+ (1,0) [0|1] "" Vector__XXX
 SG_ EPASTS_a221_apsCntError m3 : 44|1@1+ (1,0) [0|1] "" Vector__XXX
 SG_ EPASTS_a222_apsCsError m3 : 45|1@1+ (1,0) [0|1] "" Vector__XXX
 SG_ EPASTS_a223_apsMia m3 : 46|1@1+ (1,0) [0|1] "" Vector__XXX
 SG_ EPASTS_a224_dasCntError m3 : 47|1@1+ (1,0) [0|1] "" Vector__XXX
 SG_ EPASTS_a225_dasCsError m3 : 48|1@1+ (1,0) [0|1] "" Vector__XXX
 SG_ EPASTS_a226_dasMia m3 : 49|1@1+ (1,0) [0|1] "" Vector__XXX
 SG_ EPASTS_a227_dirTorqueCntError m3 : 50|1@1+ (1,0) [0|1] "" Vector__XXX
 SG_ EPASTS_a228_dirTorqueCsError m3 : 51|1@1+ (1,0) [0|1] "" Vector__XXX
 SG_ EPASTS_a229_dirTorqueMia m3 : 52|1@1+ (1,0) [0|1] "" Vector__XXX
 SG_ EPASTS_a230_diSpdCntError m3 : 53|1@1+ (1,0) [0|1] "" Vector__XXX
 SG_ EPASTS_a231_diSpdCsError m3 : 54|1@1+ (1,0) [0|1] "" Vector__XXX
 SG_ EPASTS_a232_diSpdMia m3 : 55|1@1+ (1,0) [0|1] "" Vector__XXX
 SG_ EPASTS_a233_ecu1StatCntError m3 : 56|1@1+ (1,0) [0|1] "" Vector__XXX
 SG_ EPASTS_a234_ecu1StatCsError m3 : 57|1@1+ (1,0) [0|1] "" Vector__XXX
 SG_ EPASTS_a235_ecu1StatMia m3 : 58|1@1+ (1,0) [0|1] "" Vector__XXX
 SG_ EPASTS_a236_espWrCntError m3 : 59|1@1+ (1,0) [0|1] "" Vector__XXX
 SG_ EPASTS_a237_espWrCsError m3 : 60|1@1+ (1,0) [0|1] "" Vector__XXX
 SG_ EPASTS_a238_espWrMia m3 : 61|1@1+ (1,0) [0|1] "" Vector__XXX
 SG_ EPASTS_a239_espWsCntError m3 : 62|1@1+ (1,0) [0|1] "" Vector__XXX
 SG_ EPASTS_a240_espWsCsError m3 : 63|1@1+ (1,0) [0|1] "" Vector__XXX
 SG_ EPASTS_a241_espWsMia m4 : 4|1@1+ (1,0) [0|1] "" Vector__XXX
 SG_ EPASTS_a242_gtwConfigMia m4 : 5|1@1+ (1,0) [0|1] "" Vector__XXX
 SG_ EPASTS_a243_rcmCntError m4 : 6|1@1+ (1,0) [0|1] "" Vector__XXX
 SG_ EPASTS_a244_rcmCsError m4 : 7|1@1+ (1,0) [0|1] "" Vector__XXX
 SG_ EPASTS_a245_rcmMia m4 : 8|1@1+ (1,0) [0|1] "" Vector__XXX
 SG_ EPASTS_a246_sccmCntError m4 : 9|1@1+ (1,0) [0|1] "" Vector__XXX
 SG_ EPASTS_a247_sccmCsError m4 : 10|1@1+ (1,0) [0|1] "" Vector__XXX
 SG_ EPASTS_a248_sccmMia m4 : 11|1@1+ (1,0) [0|1] "" Vector__XXX
 SG_ EPASTS_a249_uiTuneReqCntError m4 : 12|1@1+ (1,0) [0|1] "" Vector__XXX
 SG_ EPASTS_a250_uiTuneReqCsError m4 : 13|1@1+ (1,0) [0|1] "" Vector__XXX
 SG_ EPASTS_a251_uiTuneReqMia m4 : 14|1@1+ (1,0) [0|1] "" Vector__XXX
 SG_ EPASTS_a252_vcFrontCntError m4 : 15|1@1+ (1,0) [0|1] "" Vector__XXX
 SG_ EPASTS_a253_vcFrontCsError m4 : 16|1@1+ (1,0) [0|1] "" Vector__XXX
 SG_ EPASTS_a254_vcFrontMia m4 : 17|1@1+ (1,0) [0|1] "" Vector__XXX
 SG_ EPASTS_a255_pmState2Mia m4 : 18|1@1+ (1,0) [0|1] "" Vector__XXX
 SG_ EPASTS_a256_dcvmOverVolt m4 : 19|1@1+ (1,0) [0|1] "" Vector__XXX
 SG_ EPASTS_a257_dcvmUnderVolt m4 : 20|1@1+ (1,0) [0|1] "" Vector__XXX
 SG_ EPASTS_a258_pspInvalidProjectPar m4 : 21|1@1+ (1,0) [0|1] "" Vector__XXX
 SG_ EPASTS_a259_scoCanBusOff m4 : 22|1@1+ (1,0) [0|1] "" Vector__XXX
 SG_ EPASTS_a260_scoPrivateBusOff m4 : 23|1@1+ (1,0) [0|1] "" Vector__XXX
 SG_ EPASTS_a261_sccmStatusError m4 : 24|1@1+ (1,0) [0|1] "" Vector__XXX
 SG_ EPASTS_a262_yawRateStatus m4 : 25|1@1+ (1,0) [0|1] "" Vector__XXX
 SG_ EPASTS_a263_espWsStatus m4 : 26|1@1+ (1,0) [0|1] "" Vector__XXX
 SG_ EPASTS_a264_assistTorqueLimited m4 : 27|1@1+ (1,0) [0|1] "" Vector__XXX
 SG_ EPASTS_a265_overheatProtect m4 : 28|1@1+ (1,0) [0|1] "" Vector__XXX
 SG_ EPASTS_a266_overloadProtect m4 : 29|1@1+ (1,0) [0|1] "" Vector__XXX
 SG_ EPASTS_a267_safeSpeedAssist m4 : 30|1@1+ (1,0) [0|1] "" Vector__XXX
 SG_ EPASTS_a268_eacCancelled m4 : 31|1@1+ (1,0) [0|1] "" Vector__XXX
 SG_ EPASTS_a269_assistTorqueDisabled m4 : 32|1@1+ (1,0) [0|1] "" Vector__XXX
 SG_ EPASTS_a270_oscillationCompTrqLi m4 : 33|1@1+ (1,0) [0|1] "" Vector__XXX

BO_ 981 ESP_alertMatrix: 8 ESP
 SG_ ESP_matrixIndex M : 0|4@1+ (1,0) [0|15] "" Vector__XXX
 SG_ ESP_a001_ecuGenericFault m0 : 4|1@1+ (1,0) [0|1] "" Vector__XXX
 SG_ ESP_a002_valvesGenericFault m0 : 5|1@1+ (1,0) [0|1] "" Vector__XXX
 SG_ ESP_a003_outletValvesFault m0 : 6|1@1+ (1,0) [0|1] "" Vector__XXX
 SG_ ESP_a004_inletValvesFault m0 : 7|1@1+ (1,0) [0|1] "" Vector__XXX
 SG_ ESP_a005_HSVValvesFault m0 : 8|1@1+ (1,0) [0|1] "" Vector__XXX
 SG_ ESP_a006_USVValvesFault m0 : 9|1@1+ (1,0) [0|1] "" Vector__XXX
 SG_ ESP_a007_pumpMotorFault m0 : 10|1@1+ (1,0) [0|1] "" Vector__XXX
 SG_ ESP_a008_pumpMotor12VsupplyLow m0 : 11|1@1+ (1,0) [0|1] "" Vector__XXX
 SG_ ESP_a009_12VHardUndervoltage m0 : 12|1@1+ (1,0) [0|1] "" Vector__XXX
 SG_ ESP_a010_12VUndervoltage m0 : 13|1@1+ (1,0) [0|1] "" Vector__XXX
 SG_ ESP_a011_12VSystemUndervoltage m0 : 14|1@1+ (1,0) [0|1] "" Vector__XXX
 SG_ ESP_a012_netUndervoltage m0 : 15|1@1+ (1,0) [0|1] "" Vector__XXX
 SG_ ESP_a013_valveRelayUndervoltage m0 : 16|1@1+ (1,0) [0|1] "" Vector__XXX
 SG_ ESP_a014_WSSSupplyUndervoltage m0 : 17|1@1+ (1,0) [0|1] "" Vector__XXX
 SG_ ESP_a015_12VSupplyOvervoltage m0 : 18|1@1+ (1,0) [0|1] "" Vector__XXX
 SG_ ESP_a016_12VSystemOvervoltage m0 : 19|1@1+ (1,0) [0|1] "" Vector__XXX
 SG_ ESP_a017_netOvervoltage m0 : 20|1@1+ (1,0) [0|1] "" Vector__XXX
 SG_ ESP_a018_WSSSignFrontAxle m0 : 21|1@1+ (1,0) [0|1] "" Vector__XXX
 SG_ ESP_a019_WSSSignRearAxle m0 : 22|1@1+ (1,0) [0|1] "" Vector__XXX
 SG_ ESP_a020_WSSGenericTempFault m0 : 23|1@1+ (1,0) [0|1] "" Vector__XXX
 SG_ ESP_a021_WSSGeneralVDiffFault m0 : 24|1@1+ (1,0) [0|1] "" Vector__XXX
 SG_ ESP_a022_WSSDirectionFault m0 : 25|1@1+ (1,0) [0|1] "" Vector__XXX
 SG_ ESP_a023_WSSSeveralSuspected m0 : 26|1@1+ (1,0) [0|1] "" Vector__XXX
 SG_ ESP_a024_WSSReverseCurrent m0 : 27|1@1+ (1,0) [0|1] "" Vector__XXX
 SG_ ESP_a025_FrLWSSOpenOrShortToGnd m0 : 28|1@1+ (1,0) [0|1] "" Vector__XXX
 SG_ ESP_a026_FrLWSSShortTo12V m0 : 29|1@1+ (1,0) [0|1] "" Vector__XXX
 SG_ ESP_a027_FrLWSSLineInterruption m0 : 30|1@1+ (1,0) [0|1] "" Vector__XXX
 SG_ ESP_a028_FrLWSSMaxSpeedExceeded m0 : 31|1@1+ (1,0) [0|1] "" Vector__XXX
 SG_ ESP_a029_FrLWSSTooManyPulses m0 : 32|1@1+ (1,0) [0|1] "" Vector__XXX
 SG_ ESP_a030_FrLWSSLostSignal m0 : 33|1@1+ (1,0) [0|1] "" Vector__XXX
 SG_ ESP_a031_FrLWSSNoPulsesDetected m0 : 34|1@1+ (1,0) [0|1] "" Vector__XXX
 SG_ ESP_a032_FrLWSSWrongSensorType m0 : 35|1@1+ (1,0) [0|1] "" Vector__XXX
 SG_ ESP_a033_FrLWSSSignalNoise m0 : 36|1@1+ (1,0) [0|1] "" Vector__XXX
 SG_ ESP_a034_FrLWSSVDiffFault m0 : 37|1@1+ (1,0) [0|1] "" Vector__XXX
 SG_ ESP_a035_FrLWSSDirectionFault m0 : 38|1@1+ (1,0) [0|1] "" Vector__XXX
 SG_ ESP_a036_FrLWSSLargeAirGap m0 : 39|1@1+ (1,0) [0|1] "" Vector__XXX
 SG_ ESP_a037_FrLWSSSupplyShortToGnd m0 : 40|1@1+ (1,0) [0|1] "" Vector__XXX
 SG_ ESP_a038_FrLWSSGeneralFault m0 : 41|1@1+ (1,0) [0|1] "" Vector__XXX
 SG_ ESP_a039_FrRWSSOpenOrShortToGnd m0 : 42|1@1+ (1,0) [0|1] "" Vector__XXX
 SG_ ESP_a040_FrRWSSShortTo12V m0 : 43|1@1+ (1,0) [0|1] "" Vector__XXX
 SG_ ESP_a041_FrRWSSLineInterruption m0 : 44|1@1+ (1,0) [0|1] "" Vector__XXX
 SG_ ESP_a042_FrRWSSMaxSpeedExceeded m0 : 45|1@1+ (1,0) [0|1] "" Vector__XXX
 SG_ ESP_a043_FrRWSSTooManyPulses m0 : 46|1@1+ (1,0) [0|1] "" Vector__XXX
 SG_ ESP_a044_FrRWSSLostSignal m0 : 47|1@1+ (1,0) [0|1] "" Vector__XXX
 SG_ ESP_a045_FrRWSSNoPulsesDetected m0 : 48|1@1+ (1,0) [0|1] "" Vector__XXX
 SG_ ESP_a046_FrRWSSWrongSensorType m0 : 49|1@1+ (1,0) [0|1] "" Vector__XXX
 SG_ ESP_a047_FrRWSSSignalNoise m0 : 50|1@1+ (1,0) [0|1] "" Vector__XXX
 SG_ ESP_a048_FrRWSSVDiffFault m0 : 51|1@1+ (1,0) [0|1] "" Vector__XXX
 SG_ ESP_a049_FrRWSSDirectionFault m0 : 52|1@1+ (1,0) [0|1] "" Vector__XXX
 SG_ ESP_a050_FrRWSSLargeAirGap m0 : 53|1@1+ (1,0) [0|1] "" Vector__XXX
 SG_ ESP_a051_FrRWSSSupplyShortToGnd m0 : 54|1@1+ (1,0) [0|1] "" Vector__XXX
 SG_ ESP_a052_FrRWSSGeneralFault m0 : 55|1@1+ (1,0) [0|1] "" Vector__XXX
 SG_ ESP_a053_ReLWSSOpenOrShortToGnd m0 : 56|1@1+ (1,0) [0|1] "" Vector__XXX
 SG_ ESP_a054_ReLWSSShortTo12V m0 : 57|1@1+ (1,0) [0|1] "" Vector__XXX
 SG_ ESP_a055_ReLWSSLineInterruption m0 : 58|1@1+ (1,0) [0|1] "" Vector__XXX
 SG_ ESP_a056_ReLWSSMaxSpeedExceeded m0 : 59|1@1+ (1,0) [0|1] "" Vector__XXX
 SG_ ESP_a057_ReLWSSTooManyPulses m0 : 60|1@1+ (1,0) [0|1] "" Vector__XXX
 SG_ ESP_a058_ReLWSSLostSignal m0 : 61|1@1+ (1,0) [0|1] "" Vector__XXX
 SG_ ESP_a059_ReLWSSNoPulsesDetected m0 : 62|1@1+ (1,0) [0|1] "" Vector__XXX
 SG_ ESP_a060_ReLWSSWrongSensorType m0 : 63|1@1+ (1,0) [0|1] "" Vector__XXX
 SG_ ESP_a061_ReLWSSSignalNoise m1 : 4|1@1+ (1,0) [0|1] "" Vector__XXX
 SG_ ESP_a062_ReLWSSVDiffFault m1 : 5|1@1+ (1,0) [0|1] "" Vector__XXX
 SG_ ESP_a063_ReLWSSDirectionFault m1 : 6|1@1+ (1,0) [0|1] "" Vector__XXX
 SG_ ESP_a064_ReLWSSLargeAirGap m1 : 7|1@1+ (1,0) [0|1] "" Vector__XXX
 SG_ ESP_a065_ReLWSSSupplyShortToGnd m1 : 8|1@1+ (1,0) [0|1] "" Vector__XXX
 SG_ ESP_a066_ReLWSSGeneralFault m1 : 9|1@1+ (1,0) [0|1] "" Vector__XXX
 SG_ ESP_a067_ReRWSSOpenOrShortToGnd m1 : 10|1@1+ (1,0) [0|1] "" Vector__XXX
 SG_ ESP_a068_ReRWSSShortTo12V m1 : 11|1@1+ (1,0) [0|1] "" Vector__XXX
 SG_ ESP_a069_ReRWSSLineInterruption m1 : 12|1@1+ (1,0) [0|1] "" Vector__XXX
 SG_ ESP_a070_ReRWSSMaxSpeedExceeded m1 : 13|1@1+ (1,0) [0|1] "" Vector__XXX
 SG_ ESP_a071_ReRWSSTooManyPulses m1 : 14|1@1+ (1,0) [0|1] "" Vector__XXX
 SG_ ESP_a072_ReRWSSLostSignal m1 : 15|1@1+ (1,0) [0|1] "" Vector__XXX
 SG_ ESP_a073_ReRWSSNoPulsesDetected m1 : 16|1@1+ (1,0) [0|1] "" Vector__XXX
 SG_ ESP_a074_ReRWSSWrongSensorType m1 : 17|1@1+ (1,0) [0|1] "" Vector__XXX
 SG_ ESP_a075_ReRWSSSignalNoise m1 : 18|1@1+ (1,0) [0|1] "" Vector__XXX
 SG_ ESP_a076_ReRWSSVDiffFault m1 : 19|1@1+ (1,0) [0|1] "" Vector__XXX
 SG_ ESP_a077_ReRWSSDirectionFault m1 : 20|1@1+ (1,0) [0|1] "" Vector__XXX
 SG_ ESP_a078_ReRWSSLargeAirGap m1 : 21|1@1+ (1,0) [0|1] "" Vector__XXX
 SG_ ESP_a079_ReRWSSSupplyShortToGnd m1 : 22|1@1+ (1,0) [0|1] "" Vector__XXX
 SG_ ESP_a080_ReRWSSGeneralFault m1 : 23|1@1+ (1,0) [0|1] "" Vector__XXX
 SG_ ESP_a081_PressureSensorShort m1 : 24|1@1+ (1,0) [0|1] "" Vector__XXX
 SG_ ESP_a082_PMCSensorOffsetHigh m1 : 25|1@1+ (1,0) [0|1] "" Vector__XXX
 SG_ ESP_a083_PMCSensorFault m1 : 26|1@1+ (1,0) [0|1] "" Vector__XXX
 SG_ ESP_a084_BrakeFluidReservoirLow m1 : 27|1@1+ (1,0) [0|1] "" Vector__XXX
 SG_ ESP_a085_BrakeSwitchStuckHigh m1 : 28|1@1+ (1,0) [0|1] "" Vector__XXX
 SG_ ESP_a086_BrakeSwitchImplausible1 m1 : 29|1@1+ (1,0) [0|1] "" Vector__XXX
 SG_ ESP_a087_BrakeSwitchImplausible3 m1 : 30|1@1+ (1,0) [0|1] "" Vector__XXX
 SG_ ESP_a088_absContinuousControl m1 : 31|1@1+ (1,0) [0|1] "" Vector__XXX
 SG_ ESP_a089_absNoPressureIncrease m1 : 32|1@1+ (1,0) [0|1] "" Vector__XXX
 SG_ ESP_a090_vdcContinuousControl m1 : 33|1@1+ (1,0) [0|1] "" Vector__XXX
 SG_ ESP_a091_CANUndervoltage m1 : 34|1@1+ (1,0) [0|1] "" Vector__XXX
 SG_ ESP_a092_CANOvervoltage m1 : 35|1@1+ (1,0) [0|1] "" Vector__XXX
 SG_ ESP_a093_partyBusOff m1 : 36|1@1+ (1,0) [0|1] "" Vector__XXX
 SG_ ESP_a094_partyBusPassive m1 : 37|1@1+ (1,0) [0|1] "" Vector__XXX
 SG_ ESP_a095_chassisBusOff m1 : 38|1@1+ (1,0) [0|1] "" Vector__XXX
 SG_ ESP_a096_chassisBusPassive m1 : 39|1@1+ (1,0) [0|1] "" Vector__XXX
 SG_ ESP_a097_tcsRefSpeedNotInit m1 : 40|1@1+ (1,0) [0|1] "" Vector__XXX
 SG_ ESP_a098_vdcRefSpeedNotInit m1 : 41|1@1+ (1,0) [0|1] "" Vector__XXX
 SG_ ESP_a099_brakeTempModelOverheat m1 : 42|1@1+ (1,0) [0|1] "" Vector__XXX
 SG_ ESP_a100_brakeTempModelDisabled m1 : 43|1@1+ (1,0) [0|1] "" Vector__XXX
 SG_ ESP_a101_ebdFault m1 : 44|1@1+ (1,0) [0|1] "" Vector__XXX
 SG_ ESP_a102_absFault m1 : 45|1@1+ (1,0) [0|1] "" Vector__XXX
 SG_ ESP_a103_stabilityControlFault m1 : 46|1@1+ (1,0) [0|1] "" Vector__XXX
 SG_ ESP_a104_hbcEnabled m1 : 47|1@1+ (1,0) [0|1] "" Vector__XXX
 SG_ ESP_a105_ebrFault m1 : 48|1@1+ (1,0) [0|1] "" Vector__XXX
 SG_ ESP_a106_vdcActuatorFault m1 : 49|1@1+ (1,0) [0|1] "" Vector__XXX
 SG_ ESP_a107_reserved107 m1 : 50|1@1+ (1,0) [0|1] "" Vector__XXX
 SG_ ESP_a108_reserved108 m1 : 51|1@1+ (1,0) [0|1] "" Vector__XXX
 SG_ ESP_a109_reserved109 m1 : 52|1@1+ (1,0) [0|1] "" Vector__XXX
 SG_ ESP_a110_rollerBenchActive m1 : 53|1@1+ (1,0) [0|1] "" Vector__XXX
 SG_ ESP_a111_absActive m1 : 54|1@1+ (1,0) [0|1] "" Vector__XXX
 SG_ ESP_a112_espActive m1 : 55|1@1+ (1,0) [0|1] "" Vector__XXX
 SG_ ESP_a113_btcActive m1 : 56|1@1+ (1,0) [0|1] "" Vector__XXX
 SG_ ESP_a114_tvdcActive m1 : 57|1@1+ (1,0) [0|1] "" Vector__XXX
 SG_ ESP_a115_ebdActive m1 : 58|1@1+ (1,0) [0|1] "" Vector__XXX
 SG_ ESP_a116_tsmActive m1 : 59|1@1+ (1,0) [0|1] "" Vector__XXX
 SG_ ESP_a117_hbaActive m1 : 60|1@1+ (1,0) [0|1] "" Vector__XXX
 SG_ ESP_a118_hfcActive m1 : 61|1@1+ (1,0) [0|1] "" Vector__XXX
 SG_ ESP_a119_hbbActive m1 : 62|1@1+ (1,0) [0|1] "" Vector__XXX
 SG_ ESP_a120_rmiActive m1 : 63|1@1+ (1,0) [0|1] "" Vector__XXX
 SG_ ESP_a121_regenTcActive m2 : 4|1@1+ (1,0) [0|1] "" Vector__XXX
 SG_ ESP_a122_bdwActive m2 : 5|1@1+ (1,0) [0|1] "" Vector__XXX
 SG_ ESP_a123_ebrActive m2 : 6|1@1+ (1,0) [0|1] "" Vector__XXX
 SG_ ESP_a124_ebrSkidActive m2 : 7|1@1+ (1,0) [0|1] "" Vector__XXX
 SG_ ESP_a125_reserved125 m2 : 8|1@1+ (1,0) [0|1] "" Vector__XXX
 SG_ ESP_a126_reserved126 m2 : 9|1@1+ (1,0) [0|1] "" Vector__XXX
 SG_ ESP_a127_reserved127 m2 : 10|1@1+ (1,0) [0|1] "" Vector__XXX
 SG_ ESP_a128_reserved128 m2 : 11|1@1+ (1,0) [0|1] "" Vector__XXX
 SG_ ESP_a129_reserved129 m2 : 12|1@1+ (1,0) [0|1] "" Vector__XXX
 SG_ ESP_a130_EPAS3PsysStatusTimeout m2 : 13|1@1+ (1,0) [0|1] "" Vector__XXX
 SG_ ESP_a131_EPAS3PsysStatusDLC m2 : 14|1@1+ (1,0) [0|1] "" Vector__XXX
 SG_ ESP_a132_EPAS3PsysStatusChecksum m2 : 15|1@1+ (1,0) [0|1] "" Vector__XXX
 SG_ ESP_a133_EPAS3PsysStatusCounter m2 : 16|1@1+ (1,0) [0|1] "" Vector__XXX
 SG_ ESP_a134_steeringAngleInvalid m2 : 17|1@1+ (1,0) [0|1] "" Vector__XXX
 SG_ ESP_a135_steeringAngleNoCenter m2 : 18|1@1+ (1,0) [0|1] "" Vector__XXX
 SG_ ESP_a136_steeringAngleFrozen m2 : 19|1@1+ (1,0) [0|1] "" Vector__XXX
 SG_ ESP_a137_steeringOffsetTooLarge m2 : 20|1@1+ (1,0) [0|1] "" Vector__XXX
 SG_ ESP_a138_steeringAngleImplaus m2 : 21|1@1+ (1,0) [0|1] "" Vector__XXX
 SG_ ESP_a139_steeringAngleWrongSign m2 : 22|1@1+ (1,0) [0|1] "" Vector__XXX
 SG_ ESP_a140_RCMInertial1Timeout m2 : 23|1@1+ (1,0) [0|1] "" Vector__XXX
 SG_ ESP_a141_RCMInertial1DLC m2 : 24|1@1+ (1,0) [0|1] "" Vector__XXX
 SG_ ESP_a142_RCMInertial1Checksum m2 : 25|1@1+ (1,0) [0|1] "" Vector__XXX
 SG_ ESP_a143_RCMInertial1Counter m2 : 26|1@1+ (1,0) [0|1] "" Vector__XXX
 SG_ ESP_a144_yawMaxLatency m2 : 27|1@1+ (1,0) [0|1] "" Vector__XXX
 SG_ ESP_a145_yawInitFault m2 : 28|1@1+ (1,0) [0|1] "" Vector__XXX
 SG_ ESP_a146_yawInvalidValue m2 : 29|1@1+ (1,0) [0|1] "" Vector__XXX
 SG_ ESP_a147_yawSensorNotAvailable m2 : 30|1@1+ (1,0) [0|1] "" Vector__XXX
 SG_ ESP_a148_yawSignalFault m2 : 31|1@1+ (1,0) [0|1] "" Vector__XXX
 SG_ ESP_a149_yawInvalidSign m2 : 32|1@1+ (1,0) [0|1] "" Vector__XXX
 SG_ ESP_a150_yawImplausible m2 : 33|1@1+ (1,0) [0|1] "" Vector__XXX
 SG_ ESP_a151_RCMInertial2Timeout m2 : 34|1@1+ (1,0) [0|1] "" Vector__XXX
 SG_ ESP_a152_RCMInertial2DLC m2 : 35|1@1+ (1,0) [0|1] "" Vector__XXX
 SG_ ESP_a153_RCMInertial2Checksum m2 : 36|1@1+ (1,0) [0|1] "" Vector__XXX
 SG_ ESP_a154_RCMInertial2Counter m2 : 37|1@1+ (1,0) [0|1] "" Vector__XXX
 SG_ ESP_a155_ayMaxLatency m2 : 38|1@1+ (1,0) [0|1] "" Vector__XXX
 SG_ ESP_a156_ayInitFault m2 : 39|1@1+ (1,0) [0|1] "" Vector__XXX
 SG_ ESP_a157_ayInvalidValue m2 : 40|1@1+ (1,0) [0|1] "" Vector__XXX
 SG_ ESP_a158_aySensorNotAvailable m2 : 41|1@1+ (1,0) [0|1] "" Vector__XXX
 SG_ ESP_a159_aySignalFault m2 : 42|1@1+ (1,0) [0|1] "" Vector__XXX
 SG_ ESP_a160_ayRangeExceeded m2 : 43|1@1+ (1,0) [0|1] "" Vector__XXX
 SG_ ESP_a161_ayOffsetExceeded m2 : 44|1@1+ (1,0) [0|1] "" Vector__XXX
 SG_ ESP_a162_ayImplausible m2 : 45|1@1+ (1,0) [0|1] "" Vector__XXX
 SG_ ESP_a163_axMaxLatency m2 : 46|1@1+ (1,0) [0|1] "" Vector__XXX
 SG_ ESP_a164_axInitFault m2 : 47|1@1+ (1,0) [0|1] "" Vector__XXX
 SG_ ESP_a165_axInvalidValue m2 : 48|1@1+ (1,0) [0|1] "" Vector__XXX
 SG_ ESP_a166_axSensorNotAvailable m2 : 49|1@1+ (1,0) [0|1] "" Vector__XXX
 SG_ ESP_a167_axSignalFault m2 : 50|1@1+ (1,0) [0|1] "" Vector__XXX
 SG_ ESP_a168_axRangeExceeded m2 : 51|1@1+ (1,0) [0|1] "" Vector__XXX
 SG_ ESP_a169_axOffsetExceeded m2 : 52|1@1+ (1,0) [0|1] "" Vector__XXX
 SG_ ESP_a170_axSignalFrozen m2 : 53|1@1+ (1,0) [0|1] "" Vector__XXX
 SG_ ESP_a171_axImplausible m2 : 54|1@1+ (1,0) [0|1] "" Vector__XXX
 SG_ ESP_a172_IBSTparty1Timeout m2 : 55|1@1+ (1,0) [0|1] "" Vector__XXX
 SG_ ESP_a173_IBSTparty1DLC m2 : 56|1@1+ (1,0) [0|1] "" Vector__XXX
 SG_ ESP_a174_IBSTparty1Checksum m2 : 57|1@1+ (1,0) [0|1] "" Vector__XXX
 SG_ ESP_a175_IBSTparty1Counter m2 : 58|1@1+ (1,0) [0|1] "" Vector__XXX
 SG_ ESP_a176_IBSTEBRNotAvailable m2 : 59|1@1+ (1,0) [0|1] "" Vector__XXX
 SG_ ESP_a177_IBSTOutputRodDrvInvalid m2 : 60|1@1+ (1,0) [0|1] "" Vector__XXX
 SG_ ESP_a178_IBSTOutputRodActInvalid m2 : 61|1@1+ (1,0) [0|1] "" Vector__XXX
 SG_ ESP_a179_IBSTparty2Timeout m2 : 62|1@1+ (1,0) [0|1] "" Vector__XXX
 SG_ ESP_a180_IBSTparty2Checksum m2 : 63|1@1+ (1,0) [0|1] "" Vector__XXX
 SG_ ESP_a181_IBSTparty2DLC m3 : 4|1@1+ (1,0) [0|1] "" Vector__XXX
 SG_ ESP_a182_IBSTparty2Counter m3 : 5|1@1+ (1,0) [0|1] "" Vector__XXX
 SG_ ESP_a183_IBSTStatusOff m3 : 6|1@1+ (1,0) [0|1] "" Vector__XXX
 SG_ ESP_a184_IBSTpRunoutInvalid m3 : 7|1@1+ (1,0) [0|1] "" Vector__XXX
 SG_ ESP_a185_IBSTFeedforwardBackup m3 : 8|1@1+ (1,0) [0|1] "" Vector__XXX
 SG_ ESP_a186_IBSTBrakeAppliedInvalid m3 : 9|1@1+ (1,0) [0|1] "" Vector__XXX
 SG_ ESP_a187_DIbtcRequestTimeout m3 : 10|1@1+ (1,0) [0|1] "" Vector__XXX
 SG_ ESP_a188_DIbtcRequestDLC m3 : 11|1@1+ (1,0) [0|1] "" Vector__XXX
 SG_ ESP_a189_DIbtcRequestChecksum m3 : 12|1@1+ (1,0) [0|1] "" Vector__XXX
 SG_ ESP_a190_DIbtcRequestCounter m3 : 13|1@1+ (1,0) [0|1] "" Vector__XXX
 SG_ ESP_a191_DIchassisControlTimeout m3 : 14|1@1+ (1,0) [0|1] "" Vector__XXX
 SG_ ESP_a192_DIchassisControlDLC m3 : 15|1@1+ (1,0) [0|1] "" Vector__XXX
 SG_ ESP_a193_DIchassisControlChecksu m3 : 16|1@1+ (1,0) [0|1] "" Vector__XXX
 SG_ ESP_a194_DIchassisControlCounter m3 : 17|1@1+ (1,0) [0|1] "" Vector__XXX
 SG_ ESP_a195_ptcStateInvalid m3 : 18|1@1+ (1,0) [0|1] "" Vector__XXX
 SG_ ESP_a196_DIsystemStatusTimeout m3 : 19|1@1+ (1,0) [0|1] "" Vector__XXX
 SG_ ESP_a197_DIsystemStatusDLC m3 : 20|1@1+ (1,0) [0|1] "" Vector__XXX
 SG_ ESP_a198_DIsystemStatusChecksum m3 : 21|1@1+ (1,0) [0|1] "" Vector__XXX
 SG_ ESP_a199_DIsystemStatusCounter m3 : 22|1@1+ (1,0) [0|1] "" Vector__XXX
 SG_ ESP_a200_reverseGearStuckHigh m3 : 23|1@1+ (1,0) [0|1] "" Vector__XXX
 SG_ ESP_a201_reverseGearStuckLow m3 : 24|1@1+ (1,0) [0|1] "" Vector__XXX
 SG_ ESP_a202_accelPedalInvalid m3 : 25|1@1+ (1,0) [0|1] "" Vector__XXX
 SG_ ESP_a203_DItorqueTimeout m3 : 26|1@1+ (1,0) [0|1] "" Vector__XXX
 SG_ ESP_a204_DItorqueDLC m3 : 27|1@1+ (1,0) [0|1] "" Vector__XXX
 SG_ ESP_a205_DItorqueChecksum m3 : 28|1@1+ (1,0) [0|1] "" Vector__XXX
 SG_ ESP_a206_DItorqueCounter m3 : 29|1@1+ (1,0) [0|1] "" Vector__XXX
 SG_ ESP_a207_DITorqueCommandInvalid m3 : 30|1@1+ (1,0) [0|1] "" Vector__XXX
 SG_ ESP_a208_DIRPMInvalid m3 : 31|1@1+ (1,0) [0|1] "" Vector__XXX
 SG_ ESP_a209_DITorqueActualInvalid m3 : 32|1@1+ (1,0) [0|1] "" Vector__XXX
 SG_ ESP_a210_DIStorqueTimeout m3 : 33|1@1+ (1,0) [0|1] "" Vector__XXX
 SG_ ESP_a211_DIStorqueDLC m3 : 34|1@1+ (1,0) [0|1] "" Vector__XXX
 SG_ ESP_a212_DIStorqueChecksum m3 : 35|1@1+ (1,0) [0|1] "" Vector__XXX
 SG_ ESP_a213_DIStorqueCounter m3 : 36|1@1+ (1,0) [0|1] "" Vector__XXX
 SG_ ESP_a214_DISTorqueCommandInvalid m3 : 37|1@1+ (1,0) [0|1] "" Vector__XXX
 SG_ ESP_a215_DISRPMInvalid m3 : 38|1@1+ (1,0) [0|1] "" Vector__XXX
 SG_ ESP_a216_DISTorqueActualInvalid m3 : 39|1@1+ (1,0) [0|1] "" Vector__XXX
 SG_ ESP_a217_DIvdcLeftTimeout m3 : 40|1@1+ (1,0) [0|1] "" Vector__XXX
 SG_ ESP_a218_DIvdcLeftDLC m3 : 41|1@1+ (1,0) [0|1] "" Vector__XXX
 SG_ ESP_a219_DIvdcLeftChecksum m3 : 42|1@1+ (1,0) [0|1] "" Vector__XXX
 SG_ ESP_a220_DIvdcLeftCounter m3 : 43|1@1+ (1,0) [0|1] "" Vector__XXX
 SG_ ESP_a221_DIvdcRightTimeout m3 : 44|1@1+ (1,0) [0|1] "" Vector__XXX
 SG_ ESP_a222_DIvdcRightDLC m3 : 45|1@1+ (1,0) [0|1] "" Vector__XXX
 SG_ ESP_a223_DIvdcRightChecksum m3 : 46|1@1+ (1,0) [0|1] "" Vector__XXX
 SG_ ESP_a224_DIvdcRightCounter m3 : 47|1@1+ (1,0) [0|1] "" Vector__XXX
 SG_ ESP_a225_configMismatch m3 : 48|1@1+ (1,0) [0|1] "" Vector__XXX
 SG_ ESP_a226_bdwRequestInvalid m3 : 49|1@1+ (1,0) [0|1] "" Vector__XXX
 SG_ ESP_a227_bdwRequestActiveInvalid m3 : 50|1@1+ (1,0) [0|1] "" Vector__XXX
 SG_ ESP_a228_GTWvinTimeout m3 : 51|1@1+ (1,0) [0|1] "" Vector__XXX
 SG_ ESP_a229_GTWvinDLC m3 : 52|1@1+ (1,0) [0|1] "" Vector__XXX
 SG_ ESP_a230_vinNotLearned m3 : 53|1@1+ (1,0) [0|1] "" Vector__XXX
 SG_ ESP_a231_storedVINMismatch m3 : 54|1@1+ (1,0) [0|1] "" Vector__XXX
 SG_ ESP_a232_PMstate2Timeout m3 : 55|1@1+ (1,0) [0|1] "" Vector__XXX
 SG_ ESP_a233_PMstate2Checksum m3 : 56|1@1+ (1,0) [0|1] "" Vector__XXX
 SG_ ESP_a234_PMstate2DLC m3 : 57|1@1+ (1,0) [0|1] "" Vector__XXX
 SG_ ESP_a235_PMstate2Counter m3 : 58|1@1+ (1,0) [0|1] "" Vector__XXX
 SG_ ESP_a236_ebrCommandStateInvalid m3 : 59|1@1+ (1,0) [0|1] "" Vector__XXX
 SG_ ESP_a237_vdcCommandStateInvalid m3 : 60|1@1+ (1,0) [0|1] "" Vector__XXX
 SG_ ESP_a238_UIodoTimeout m3 : 61|1@1+ (1,0) [0|1] "" Vector__XXX
 SG_ ESP_a239_UIodoDLC m3 : 62|1@1+ (1,0) [0|1] "" Vector__XXX
 SG_ ESP_a240_LVPowerStateTimeout m3 : 63|1@1+ (1,0) [0|1] "" Vector__XXX
 SG_ ESP_a241_LVPowerStateChecksum m4 : 4|1@1+ (1,0) [0|1] "" Vector__XXX
 SG_ ESP_a242_LVPowerStateDLC m4 : 5|1@1+ (1,0) [0|1] "" Vector__XXX
 SG_ ESP_a243_LVPowerStateCounter m4 : 6|1@1+ (1,0) [0|1] "" Vector__XXX
 SG_ ESP_a244_LVOffStateInvalid m4 : 7|1@1+ (1,0) [0|1] "" Vector__XXX
 SG_ ESP_a245_LVGoingDownStateInvalid m4 : 8|1@1+ (1,0) [0|1] "" Vector__XXX
 SG_ ESP_a246_VCFRONTsensorTimeout m4 : 9|1@1+ (1,0) [0|1] "" Vector__XXX
 SG_ ESP_a247_VCFRONTsensorDLC m4 : 10|1@1+ (1,0) [0|1] "" Vector__XXX
 SG_ ESP_a248_vdcBrkeTrqTarFrLInvalid m4 : 11|1@1+ (1,0) [0|1] "" Vector__XXX
 SG_ ESP_a249_vdcBrkeTrqTarFrRInvalid m4 : 12|1@1+ (1,0) [0|1] "" Vector__XXX
 SG_ ESP_a250_vdcBrkeTrqTarReLInvalid m4 : 13|1@1+ (1,0) [0|1] "" Vector__XXX
 SG_ ESP_a251_vdcBrkeTrqTarReRInvalid m4 : 14|1@1+ (1,0) [0|1] "" Vector__XXX
 SG_ ESP_a252_vdcWhlSlipLimFrLInvalid m4 : 15|1@1+ (1,0) [0|1] "" Vector__XXX
 SG_ ESP_a253_vdcWhlSlipLimFrRInvalid m4 : 16|1@1+ (1,0) [0|1] "" Vector__XXX
 SG_ ESP_a254_vdcWhlSlipLimReLInvalid m4 : 17|1@1+ (1,0) [0|1] "" Vector__XXX
 SG_ ESP_a255_vdcWhlSlipLimReRInvalid m4 : 18|1@1+ (1,0) [0|1] "" Vector__XXX
 SG_ ESP_a256_epbmStatusTimeout m4 : 19|1@1+ (1,0) [0|1] "" Vector__XXX
 SG_ ESP_a257_epbmStatusChecksum m4 : 20|1@1+ (1,0) [0|1] "" Vector__XXX
 SG_ ESP_a258_epbmStatusDLC m4 : 21|1@1+ (1,0) [0|1] "" Vector__XXX
 SG_ ESP_a259_epbmStatusCounter m4 : 22|1@1+ (1,0) [0|1] "" Vector__XXX
 SG_ ESP_a260_epblStatusTimeout m4 : 23|1@1+ (1,0) [0|1] "" Vector__XXX
 SG_ ESP_a261_epblStatusChecksum m4 : 24|1@1+ (1,0) [0|1] "" Vector__XXX
 SG_ ESP_a262_epblStatusDLC m4 : 25|1@1+ (1,0) [0|1] "" Vector__XXX
 SG_ ESP_a263_epblStatusCounter m4 : 26|1@1+ (1,0) [0|1] "" Vector__XXX
 SG_ ESP_a264_pumpSpeedLimitInvalid m4 : 27|1@1+ (1,0) [0|1] "" Vector__XXX
 SG_ ESP_a265_DIRELtorqueTimeout m4 : 28|1@1+ (1,0) [0|1] "" Vector__XXX
 SG_ ESP_a266_DIRELtorqueDLC m4 : 29|1@1+ (1,0) [0|1] "" Vector__XXX
 SG_ ESP_a267_DIRELtorqueChecksum m4 : 30|1@1+ (1,0) [0|1] "" Vector__XXX
 SG_ ESP_a268_DIRELtorqueCounter m4 : 31|1@1+ (1,0) [0|1] "" Vector__XXX
 SG_ ESP_a269_DIRELTorqueCommandInval m4 : 32|1@1+ (1,0) [0|1] "" Vector__XXX
 SG_ ESP_a270_DIRELRPMInvalid m4 : 33|1@1+ (1,0) [0|1] "" Vector__XXX
 SG_ ESP_a271_DIRELTorqueActualInvali m4 : 34|1@1+ (1,0) [0|1] "" Vector__XXX
 SG_ ESP_a272_DIRERtorqueTimeout m4 : 35|1@1+ (1,0) [0|1] "" Vector__XXX
 SG_ ESP_a273_DIRERtorqueDLC m4 : 36|1@1+ (1,0) [0|1] "" Vector__XXX
 SG_ ESP_a274_DIRERtorqueChecksum m4 : 37|1@1+ (1,0) [0|1] "" Vector__XXX
 SG_ ESP_a275_DIRERtorqueCounter m4 : 38|1@1+ (1,0) [0|1] "" Vector__XXX
 SG_ ESP_a276_DIRERTorqueCommandInval m4 : 39|1@1+ (1,0) [0|1] "" Vector__XXX
 SG_ ESP_a277_DIRERRPMInvalid m4 : 40|1@1+ (1,0) [0|1] "" Vector__XXX
 SG_ ESP_a278_DIRERTorqueActualInvali m4 : 41|1@1+ (1,0) [0|1] "" Vector__XXX
 SG_ ESP_a279_lifetimeManagementOverr m4 : 42|1@1+ (1,0) [0|1] "" Vector__XXX
 SG_ ESP_a280_trackModeABSEnabled m4 : 43|1@1+ (1,0) [0|1] "" Vector__XXX
 SG_ ESP_a281_trackModeABSdisabled m4 : 44|1@1+ (1,0) [0|1] "" Vector__XXX
 SG_ ESP_a282_trackModeABSRequestInva m4 : 45|1@1+ (1,0) [0|1] "" Vector__XXX
 SG_ ESP_a283_secondaryCollisionMitig m4 : 46|1@1+ (1,0) [0|1] "" Vector__XXX
 SG_ ESP_a284_scmRequestInvalidChecks m4 : 47|1@1+ (1,0) [0|1] "" Vector__XXX
 SG_ ESP_a285_scmRequestDLC m4 : 48|1@1+ (1,0) [0|1] "" Vector__XXX
 SG_ ESP_a286_hydroplaneDetected m4 : 49|1@1+ (1,0) [0|1] "" Vector__XXX
 SG_ ESP_a287_failedBrakeCircuitDetec m4 : 50|1@1+ (1,0) [0|1] "" Vector__XXX
 SG_ ESP_a288_leftBusOff m4 : 51|1@1+ (1,0) [0|1] "" Vector__XXX
 SG_ ESP_a289_leftBusPassive m4 : 52|1@1+ (1,0) [0|1] "" Vector__XXX
 SG_ ESP_a290_brakeBusOff m4 : 53|1@1+ (1,0) [0|1] "" Vector__XXX
 SG_ ESP_a291_brakeBusPassive m4 : 54|1@1+ (1,0) [0|1] "" Vector__XXX
 SG_ ESP_a292_PEPSstatusTimeout m4 : 55|1@1+ (1,0) [0|1] "" Vector__XXX
 SG_ ESP_a293_PEPSstatusDLC m4 : 56|1@1+ (1,0) [0|1] "" Vector__XXX
 SG_ ESP_a294_PEPSstatusChecksum m4 : 57|1@1+ (1,0) [0|1] "" Vector__XXX
 SG_ ESP_a295_PEPSstatusCounter m4 : 58|1@1+ (1,0) [0|1] "" Vector__XXX
 SG_ ESP_a296_roadWheelAngleHealthDeg m4 : 59|1@1+ (1,0) [0|1] "" Vector__XXX
 SG_ ESP_a297_roadWheelAngleHealthFau m4 : 60|1@1+ (1,0) [0|1] "" Vector__XXX
 SG_ ESP_a298_RSArearSteerStatusTimeo m4 : 61|1@1+ (1,0) [0|1] "" Vector__XXX
 SG_ ESP_a299_RSArearSteerStatusDLC m4 : 62|1@1+ (1,0) [0|1] "" Vector__XXX
 SG_ ESP_a300_RSArearSteerStatusCheck m4 : 63|1@1+ (1,0) [0|1] "" Vector__XXX
 SG_ ESP_a301_PEPSstatusCounter m5 : 4|1@1+ (1,0) [0|1] "" Vector__XXX
 SG_ ESP_a302_rearRoadWheelAngleHealt m5 : 5|1@1+ (1,0) [0|1] "" Vector__XXX
 SG_ ESP_a303_rearRoadWheelAngleHealt m5 : 6|1@1+ (1,0) [0|1] "" Vector__XXX
 SG_ ESP_a304_rearVCLVPowerStateTimeo m5 : 7|1@1+ (1,0) [0|1] "" Vector__XXX
 SG_ ESP_a305_rearVCLVPowerStateDLC m5 : 8|1@1+ (1,0) [0|1] "" Vector__XXX
 SG_ ESP_a306_rearVCLVPowerStateCheck m5 : 9|1@1+ (1,0) [0|1] "" Vector__XXX
 SG_ ESP_a307_rearVCLVPowerStateCount m5 : 10|1@1+ (1,0) [0|1] "" Vector__XXX
 SG_ ESP_a308_evacFillNotComplete m5 : 11|1@1+ (1,0) [0|1] "" Vector__XXX
 SG_ ESP_a309_factoryModeActive m5 : 12|1@1+ (1,0) [0|1] "" Vector__XXX
 SG_ ESP_a310_brakeLatencyReductionAc m5 : 13|1@1+ (1,0) [0|1] "" Vector__XXX
 SG_ ESP_a311_aesActive m5 : 14|1@1+ (1,0) [0|1] "" Vector__XXX
 SG_ ESP_a312_undefinedAlertDetected m5 : 15|1@1+ (1,0) [0|1] "" Vector__XXX
 SG_ ESP_a313_cdpRequestStateInvalid m5 : 16|1@1+ (1,0) [0|1] "" Vector__XXX
 SG_ ESP_a314_aesFault m5 : 17|1@1+ (1,0) [0|1] "" Vector__XXX
 SG_ ESP_a315_EMCBackup11Timeout m5 : 18|1@1+ (1,0) [0|1] "" Vector__XXX
 SG_ ESP_a316_EMCBackup11DLC m5 : 19|1@1+ (1,0) [0|1] "" Vector__XXX
 SG_ ESP_a317_EMCBackup11Checksum m5 : 20|1@1+ (1,0) [0|1] "" Vector__XXX
 SG_ ESP_a318_EMCBackup11Counter m5 : 21|1@1+ (1,0) [0|1] "" Vector__XXX
 SG_ ESP_a319_AES_BackupActuatorActiv m5 : 22|1@1+ (1,0) [0|1] "" Vector__XXX
 SG_ ESP_a320_DPB_actuator1Counter m5 : 23|1@1+ (1,0) [0|1] "" Vector__XXX
 SG_ ESP_a321_DPB_actuator1Checksum m5 : 24|1@1+ (1,0) [0|1] "" Vector__XXX
 SG_ ESP_a322_DPB_actuator1DLC m5 : 25|1@1+ (1,0) [0|1] "" Vector__XXX
 SG_ ESP_a323_DPB_actuator1Timeout m5 : 26|1@1+ (1,0) [0|1] "" Vector__XXX
 SG_ ESP_a324_DPB_actuator2Counter m5 : 27|1@1+ (1,0) [0|1] "" Vector__XXX
 SG_ ESP_a325_DPB_actuator2Checksum m5 : 28|1@1+ (1,0) [0|1] "" Vector__XXX
 SG_ ESP_a326_DPB_actuator2DLC m5 : 29|1@1+ (1,0) [0|1] "" Vector__XXX
 SG_ ESP_a327_DPB_actuator2Timeout m5 : 30|1@1+ (1,0) [0|1] "" Vector__XXX
 SG_ ESP_a328_DPB_actuator3Counter m5 : 31|1@1+ (1,0) [0|1] "" Vector__XXX
 SG_ ESP_a329_DPB_actuator3Checksum m5 : 32|1@1+ (1,0) [0|1] "" Vector__XXX
 SG_ ESP_a330_DPB_actuator3DLC m5 : 33|1@1+ (1,0) [0|1] "" Vector__XXX
 SG_ ESP_a331_DPB_actuator3Timeout m5 : 34|1@1+ (1,0) [0|1] "" Vector__XXX
 SG_ ESP_a332_PressureSensorValHigh m5 : 35|1@1+ (1,0) [0|1] "" Vector__XXX
 SG_ ESP_a333_ActCircuitNoPressure m5 : 36|1@1+ (1,0) [0|1] "" Vector__XXX
 SG_ ESP_a334_BrakePedalAppliedInvali m5 : 37|1@1+ (1,0) [0|1] "" Vector__XXX
 SG_ ESP_a335_LdmFxTarBrakeActInvalid m5 : 38|1@1+ (1,0) [0|1] "" Vector__XXX
 SG_ ESP_a336_FxTargetDriverInvalid m5 : 39|1@1+ (1,0) [0|1] "" Vector__XXX
 SG_ ESP_a337_pReductionPotentialInva m5 : 40|1@1+ (1,0) [0|1] "" Vector__XXX
 SG_ ESP_a338_pRunoutInvalid m5 : 41|1@1+ (1,0) [0|1] "" Vector__XXX
 SG_ ESP_a339_sInputRodInvalid m5 : 42|1@1+ (1,0) [0|1] "" Vector__XXX
 SG_ ESP_a340_RollerBenchMisuse m5 : 43|1@1+ (1,0) [0|1] "" Vector__XXX
 SG_ ESP_a341_EnhancedPressureBuildAc m5 : 44|1@1+ (1,0) [0|1] "" Vector__XXX
 SG_ ESP_a342_EnhancedPressureBuildNo m5 : 45|1@1+ (1,0) [0|1] "" Vector__XXX
 SG_ ESP_a343_EnhancedPressureBuildLt m5 : 46|1@1+ (1,0) [0|1] "" Vector__XXX
 SG_ ESP_a344_DIbrakeCommandCounter m5 : 47|1@1+ (1,0) [0|1] "" Vector__XXX
 SG_ ESP_a345_DIbrakeCommandChecksum m5 : 48|1@1+ (1,0) [0|1] "" Vector__XXX
 SG_ ESP_a346_DIbrakeCommandDLC m5 : 49|1@1+ (1,0) [0|1] "" Vector__XXX
 SG_ ESP_a347_DIbrakeCommandTimeout m5 : 50|1@1+ (1,0) [0|1] "" Vector__XXX
 SG_ ESP_a348_brakeCmdStateInvalid m5 : 51|1@1+ (1,0) [0|1] "" Vector__XXX
 SG_ ESP_a349_ForceLampToRed m5 : 52|1@1+ (1,0) [0|1] "" Vector__XXX
 SG_ ESP_a350_ActuatorOff m5 : 53|1@1+ (1,0) [0|1] "" Vector__XXX
 SG_ ESP_a351_ActuatorYellowLampReque m5 : 54|1@1+ (1,0) [0|1] "" Vector__XXX
 SG_ ESP_a352_ActuatorLDMFailure m5 : 55|1@1+ (1,0) [0|1] "" Vector__XXX
 SG_ ESP_a353_PressureSensorImplausHi m5 : 56|1@1+ (1,0) [0|1] "" Vector__XXX
 SG_ ESP_a354_HBCRequestInvalid m5 : 57|1@1+ (1,0) [0|1] "" Vector__XXX
 SG_ ESP_a355_RecuStatusActInvalid m5 : 58|1@1+ (1,0) [0|1] "" Vector__XXX
 SG_ ESP_a356_DIFAxleTorqueInvalid m5 : 59|1@1+ (1,0) [0|1] "" Vector__XXX
 SG_ ESP_a357_DIRAxleTorqueInvalid m5 : 60|1@1+ (1,0) [0|1] "" Vector__XXX
 SG_ ESP_a358_externalActuatorFallbac m5 : 61|1@1+ (1,0) [0|1] "" Vector__XXX
 SG_ ESP_a359_externalActuatorNoExtRe m5 : 62|1@1+ (1,0) [0|1] "" Vector__XXX
 SG_ ESP_a360_BBbrakeActuationTimeout m5 : 63|1@1+ (1,0) [0|1] "" Vector__XXX
 SG_ ESP_a361_BBbrakeActuationDLC m6 : 4|1@1+ (1,0) [0|1] "" Vector__XXX
 SG_ ESP_a362_BBbrakeActuationChecksu m6 : 5|1@1+ (1,0) [0|1] "" Vector__XXX
 SG_ ESP_a363_BBbrakeActuationCounter m6 : 6|1@1+ (1,0) [0|1] "" Vector__XXX
 SG_ ESP_a364_DIgearInvalid m6 : 7|1@1+ (1,0) [0|1] "" Vector__XXX
 SG_ ESP_a365_TCSInputQualityTooLow m6 : 8|1@1+ (1,0) [0|1] "" Vector__XXX
 SG_ ESP_a366_ActuatorBlendingModeReq m6 : 9|1@1+ (1,0) [0|1] "" Vector__XXX
 SG_ ESP_a367_CBDS_fillBufferThreshol m6 : 10|1@1+ (1,0) [0|1] "" Vector__XXX
 SG_ ESP_a368_CBDS_fmeInternalEvent m6 : 11|1@1+ (1,0) [0|1] "" Vector__XXX
 SG_ ESP_a369_LargeLeakageDetectedByD m6 : 12|1@1+ (1,0) [0|1] "" Vector__XXX
 SG_ ESP_a370_DPB_actuator4Timeout m6 : 13|1@1+ (1,0) [0|1] "" Vector__XXX
 SG_ ESP_a371_DPB_actuator4DLC m6 : 14|1@1+ (1,0) [0|1] "" Vector__XXX
 SG_ ESP_a372_DPB_actuator4Checksum m6 : 15|1@1+ (1,0) [0|1] "" Vector__XXX
 SG_ ESP_a373_DPB_actuator4Counter m6 : 16|1@1+ (1,0) [0|1] "" Vector__XXX
 SG_ ESP_a374_StatInvalid_DI_FullSNA m6 : 17|1@1+ (1,0) [0|1] "" Vector__XXX
 SG_ ESP_a375_PM_locStateCounter m6 : 18|1@1+ (1,0) [0|1] "" Vector__XXX
 SG_ ESP_a376_PM_locStateChecksum m6 : 19|1@1+ (1,0) [0|1] "" Vector__XXX
 SG_ ESP_a377_PM_locStateDLC m6 : 20|1@1+ (1,0) [0|1] "" Vector__XXX
 SG_ ESP_a378_PM_locStateTimeout m6 : 21|1@1+ (1,0) [0|1] "" Vector__XXX
 SG_ ESP_a379_DASredundantBrakingCont m6 : 22|1@1+ (1,0) [0|1] "" Vector__XXX
 SG_ ESP_a380_DASredundantBrakingCont m6 : 23|1@1+ (1,0) [0|1] "" Vector__XXX
 SG_ ESP_a381_DASredundantBrakingCont m6 : 24|1@1+ (1,0) [0|1] "" Vector__XXX
 SG_ ESP_a382_DASredundantBrakingCont m6 : 25|1@1+ (1,0) [0|1] "" Vector__XXX
 SG_ ESP_a383_DASredundantBrakingCont m6 : 26|1@1+ (1,0) [0|1] "" Vector__XXX
 SG_ ESP_a384_DASredundantBrakingCont m6 : 27|1@1+ (1,0) [0|1] "" Vector__XXX
 SG_ ESP_a385_DASredundantBrakingCont m6 : 28|1@1+ (1,0) [0|1] "" Vector__XXX
 SG_ ESP_a386_DASredundantBrakingCont m6 : 29|1@1+ (1,0) [0|1] "" Vector__XXX
 SG_ ESP_a387_DIlocStatus2Checksum m6 : 30|1@1+ (1,0) [0|1] "" Vector__XXX
 SG_ ESP_a388_DIlocStatus2Counter m6 : 31|1@1+ (1,0) [0|1] "" Vector__XXX
 SG_ ESP_a389_DIlocStatus2DLC m6 : 32|1@1+ (1,0) [0|1] "" Vector__XXX
 SG_ ESP_a390_DIlocStatus2Timeout m6 : 33|1@1+ (1,0) [0|1] "" Vector__XXX
 SG_ ESP_a391_standaloneEBRActive m6 : 34|1@1+ (1,0) [0|1] "" Vector__XXX
 SG_ ESP_a392_driverlessArmingUnavail m6 : 35|1@1+ (1,0) [0|1] "" Vector__XXX
 SG_ ESP_a393_EMCBackup21Checksum m6 : 36|1@1+ (1,0) [0|1] "" Vector__XXX
 SG_ ESP_a394_EMCBackup21Counter m6 : 37|1@1+ (1,0) [0|1] "" Vector__XXX
 SG_ ESP_a395_EMCBackup21DLC m6 : 38|1@1+ (1,0) [0|1] "" Vector__XXX
 SG_ ESP_a396_EMCBackup21Timeout m6 : 39|1@1+ (1,0) [0|1] "" Vector__XXX
 SG_ ESP_a397_epbrStatusTimeout m6 : 40|1@1+ (1,0) [0|1] "" Vector__XXX
 SG_ ESP_a398_epbrStatusChecksum m6 : 41|1@1+ (1,0) [0|1] "" Vector__XXX
 SG_ ESP_a399_epbrStatusDLC m6 : 42|1@1+ (1,0) [0|1] "" Vector__XXX
 SG_ ESP_a400_epbrStatusCounter m6 : 43|1@1+ (1,0) [0|1] "" Vector__XXX
 SG_ ESP_a401_bsmCircuitFailure m6 : 44|1@1+ (1,0) [0|1] "" Vector__XXX
 SG_ ESP_a402_bsmPtsPlausToPsTooHigh m6 : 45|1@1+ (1,0) [0|1] "" Vector__XXX
 SG_ ESP_a403_batMotorVoltage m6 : 46|1@1+ (1,0) [0|1] "" Vector__XXX
 SG_ ESP_a404_batPressureCircuit1 m6 : 47|1@1+ (1,0) [0|1] "" Vector__XXX
 SG_ ESP_a405_batPressureCircuit2 m6 : 48|1@1+ (1,0) [0|1] "" Vector__XXX
 SG_ ESP_a406_DIespActuatorTestTimeou m6 : 49|1@1+ (1,0) [0|1] "" Vector__XXX
 SG_ ESP_a407_DIespActuatorTestChecks m6 : 50|1@1+ (1,0) [0|1] "" Vector__XXX
 SG_ ESP_a408_DIespActuatorTestDLC m6 : 51|1@1+ (1,0) [0|1] "" Vector__XXX
 SG_ ESP_a409_DIespActuatorTestCounte m6 : 52|1@1+ (1,0) [0|1] "" Vector__XXX

BO_ 805 ESP_info: 8 ESP
 SG_ ESP_infoIndex M : 0|8@1+ (1,0) [0|255] "" Vector__XXX
 SG_ ESP_infoBuildType m10 : 8|8@1+ (1,0) [0|255] "" Vector__XXX
 SG_ ESP_vehFlashMode m10 : 24|1@1+ (1,0) [0|1] "" Vector__XXX
 SG_ ESP_infoComponentID m10 : 48|16@1+ (1,0) [0|65535] "" Vector__XXX
 SG_ ESP_infoPcbaID m11 : 16|8@1+ (1,0) [0|255] "" Vector__XXX
 SG_ ESP_infoAssemblyID m11 : 24|8@1+ (1,0) [0|255] "" Vector__XXX
 SG_ ESP_infoUsageID m11 : 32|16@1+ (1,0) [0|65535] "" Vector__XXX
 SG_ ESP_infoSubUsageID m11 : 48|16@1+ (1,0) [0|65535] "" Vector__XXX
 SG_ ESP_infoApplicationCRC m13 : 39|32@0+ (1,0) [0|4294967295] "" Vector__XXX
 SG_ ESP_infoVehicleVariant m16 : 16|8@1+ (1,0) [0|255] "" Vector__XXX
 SG_ ESP_infoSubcomponent1 m16 : 32|32@1+ (1,0) [0|4294967295] "" Vector__XXX
 SG_ ESP_infoBootUdsProtoVersion m20 : 8|8@1+ (1,0) [0|255] "" Vector__XXX
 SG_ ESP_infoBootloaderCRC m20 : 32|32@1+ (1,0) [0|4294967295] "" Vector__XXX
 SG_ ESP_infoVariantCRC m22 : 39|32@0+ (1,0) [0|4294967295] "" Vector__XXX

BO_ 1621 ESP_udsResponse: 8 ESP
 SG_ ESP_udsResponseData : 7|64@0+ (1,0) [0|1.84467440737e+19] "" Vector__XXX

BO_ 861 IBST_alertMatrix: 8 IBST
 SG_ IBST_matrixIndex M : 0|4@1+ (1,0) [0|15] "" Vector__XXX
 SG_ IBST_a001_microSupplyError m0 : 4|1@1+ (1,0) [0|1] "" Vector__XXX
 SG_ IBST_a002_HWBISTError m0 : 5|1@1+ (1,0) [0|1] "" Vector__XXX
 SG_ IBST_a003_RAMFault m0 : 6|1@1+ (1,0) [0|1] "" Vector__XXX
 SG_ IBST_a004_flashFault m0 : 7|1@1+ (1,0) [0|1] "" Vector__XXX
 SG_ IBST_a005_microSafetyFault m0 : 8|1@1+ (1,0) [0|1] "" Vector__XXX
 SG_ IBST_a006_microSafetyLogicFault m0 : 9|1@1+ (1,0) [0|1] "" Vector__XXX
 SG_ IBST_a007_RBCPUException m0 : 10|1@1+ (1,0) [0|1] "" Vector__XXX
 SG_ IBST_a008_stackOverUnderFlow m0 : 11|1@1+ (1,0) [0|1] "" Vector__XXX
 SG_ IBST_a009_systemErrorHook m0 : 12|1@1+ (1,0) [0|1] "" Vector__XXX
 SG_ IBST_a010_OSErrorHook m0 : 13|1@1+ (1,0) [0|1] "" Vector__XXX
 SG_ IBST_a011_systemTaskOverRun m0 : 14|1@1+ (1,0) [0|1] "" Vector__XXX
 SG_ IBST_a012_OSTaskSchemeError m0 : 15|1@1+ (1,0) [0|1] "" Vector__XXX
 SG_ IBST_a013_systemTaskJitter m0 : 16|1@1+ (1,0) [0|1] "" Vector__XXX
 SG_ IBST_a014_DMATransferError m0 : 17|1@1+ (1,0) [0|1] "" Vector__XXX
 SG_ IBST_a015_asicOscillatorError m0 : 18|1@1+ (1,0) [0|1] "" Vector__XXX
 SG_ IBST_a016_RBBLMShaftShiftError m0 : 19|1@1+ (1,0) [0|1] "" Vector__XXX
 SG_ IBST_a017_assertionFault m0 : 20|1@1+ (1,0) [0|1] "" Vector__XXX
 SG_ IBST_a018_unsupportedHW m0 : 21|1@1+ (1,0) [0|1] "" Vector__XXX
 SG_ IBST_a019_supplyASICInitFault m0 : 22|1@1+ (1,0) [0|1] "" Vector__XXX
 SG_ IBST_a020_VPREU5VOutOfRange m0 : 23|1@1+ (1,0) [0|1] "" Vector__XXX
 SG_ IBST_a021_IREFOutOfRange m0 : 24|1@1+ (1,0) [0|1] "" Vector__XXX
 SG_ IBST_a022_U5VTestFault m0 : 25|1@1+ (1,0) [0|1] "" Vector__XXX
 SG_ IBST_a023_U5VOutOfRange m0 : 26|1@1+ (1,0) [0|1] "" Vector__XXX
 SG_ IBST_a024_chargePumpFault m0 : 27|1@1+ (1,0) [0|1] "" Vector__XXX
 SG_ IBST_a025_ecuClockTestFault m0 : 28|1@1+ (1,0) [0|1] "" Vector__XXX
 SG_ IBST_a026_ecuBistCmdTestFault m0 : 29|1@1+ (1,0) [0|1] "" Vector__XXX
 SG_ IBST_a027_ecuFastWdTestFault m0 : 30|1@1+ (1,0) [0|1] "" Vector__XXX
 SG_ IBST_a028_ecuBistFaultCtrFault m0 : 31|1@1+ (1,0) [0|1] "" Vector__XXX
 SG_ IBST_a029_ecuErrpinCounterFault m0 : 32|1@1+ (1,0) [0|1] "" Vector__XXX
 SG_ IBST_a030_ecuEnableElLowFault m0 : 33|1@1+ (1,0) [0|1] "" Vector__XXX
 SG_ IBST_a031_decoupleBitTestFault m0 : 34|1@1+ (1,0) [0|1] "" Vector__XXX
 SG_ IBST_a032_ecuEnableElHighFault m0 : 35|1@1+ (1,0) [0|1] "" Vector__XXX
 SG_ IBST_a033_ecuWdStartuptestFault m0 : 36|1@1+ (1,0) [0|1] "" Vector__XXX
 SG_ IBST_a034_ecuEnableHyHighFault m0 : 37|1@1+ (1,0) [0|1] "" Vector__XXX
 SG_ IBST_a035_ecuEnableHyLowFault m0 : 38|1@1+ (1,0) [0|1] "" Vector__XXX
 SG_ IBST_a036_MRGPathTestFault m0 : 39|1@1+ (1,0) [0|1] "" Vector__XXX
 SG_ IBST_a037_ecuWdSContinuousError m0 : 40|1@1+ (1,0) [0|1] "" Vector__XXX
 SG_ IBST_a038_ecuEnContinuousError m0 : 41|1@1+ (1,0) [0|1] "" Vector__XXX
 SG_ IBST_a039_GTMRefFrequencyError m0 : 42|1@1+ (1,0) [0|1] "" Vector__XXX
 SG_ IBST_a040_GTMTbuMonError m0 : 43|1@1+ (1,0) [0|1] "" Vector__XXX
 SG_ IBST_a041_micAsicClkInError m0 : 44|1@1+ (1,0) [0|1] "" Vector__XXX
 SG_ IBST_a042_micAsicInitTestError m0 : 45|1@1+ (1,0) [0|1] "" Vector__XXX
 SG_ IBST_a043_micSpiTransferError m0 : 46|1@1+ (1,0) [0|1] "" Vector__XXX
 SG_ IBST_a044_NvMEepromWIP m0 : 47|1@1+ (1,0) [0|1] "" Vector__XXX
 SG_ IBST_a045_WdhAsicWdErrorCntStuck m0 : 48|1@1+ (1,0) [0|1] "" Vector__XXX
 SG_ IBST_a046_WdhAsicWdErrorCntLimit m0 : 49|1@1+ (1,0) [0|1] "" Vector__XXX
 SG_ IBST_a047_WdhAsicWdCmdMissing m0 : 50|1@1+ (1,0) [0|1] "" Vector__XXX
 SG_ IBST_a048_WdhSwBistConCnt m0 : 51|1@1+ (1,0) [0|1] "" Vector__XXX
 SG_ IBST_a049_WdhTaskMonConCnt m0 : 52|1@1+ (1,0) [0|1] "" Vector__XXX
 SG_ IBST_a050_VPreExternalFeeding m0 : 53|1@1+ (1,0) [0|1] "" Vector__XXX
 SG_ IBST_a051_ecuBandgap m0 : 54|1@1+ (1,0) [0|1] "" Vector__XXX
 SG_ IBST_a052_AdcPinTest m0 : 55|1@1+ (1,0) [0|1] "" Vector__XXX
 SG_ IBST_a053_AdcSelftestC5P m0 : 56|1@1+ (1,0) [0|1] "" Vector__XXX
 SG_ IBST_a054_AdcPeripheralFault m0 : 57|1@1+ (1,0) [0|1] "" Vector__XXX
 SG_ IBST_a055_UB6SupplyPathFault m0 : 58|1@1+ (1,0) [0|1] "" Vector__XXX
 SG_ IBST_a056_UB6PlausiMonFault m0 : 59|1@1+ (1,0) [0|1] "" Vector__XXX
 SG_ IBST_a057_microRegisterFault m0 : 60|1@1+ (1,0) [0|1] "" Vector__XXX
 SG_ IBST_a058_NvMWriteCycleExceed m0 : 61|1@1+ (1,0) [0|1] "" Vector__XXX
 SG_ IBST_a059_NvMEepromSize m0 : 62|1@1+ (1,0) [0|1] "" Vector__XXX
 SG_ IBST_a060_NvMMigrationFault m0 : 63|1@1+ (1,0) [0|1] "" Vector__XXX
 SG_ IBST_a061_AswSystemTimeOut m1 : 4|1@1+ (1,0) [0|1] "" Vector__XXX
 SG_ IBST_a062_MICB6TransferError m1 : 5|1@1+ (1,0) [0|1] "" Vector__XXX
 SG_ IBST_a063_tempSens2ShortToSupply m1 : 6|1@1+ (1,0) [0|1] "" Vector__XXX
 SG_ IBST_a064_tempSens1ShortToGround m1 : 7|1@1+ (1,0) [0|1] "" Vector__XXX
 SG_ IBST_a065_tempSens2ShortToGround m1 : 8|1@1+ (1,0) [0|1] "" Vector__XXX
 SG_ IBST_a066_tempSens1ShortToSupply m1 : 9|1@1+ (1,0) [0|1] "" Vector__XXX
 SG_ IBST_a067_tempSensImplausVoltage m1 : 10|1@1+ (1,0) [0|1] "" Vector__XXX
 SG_ IBST_a068_chargePumpUndervoltage m1 : 11|1@1+ (1,0) [0|1] "" Vector__XXX
 SG_ IBST_a069_greasingRoutineFault m1 : 12|1@1+ (1,0) [0|1] "" Vector__XXX
 SG_ IBST_a070_notShutDownNvMWrite m1 : 13|1@1+ (1,0) [0|1] "" Vector__XXX
 SG_ IBST_a071_notShutDownNvMRead m1 : 14|1@1+ (1,0) [0|1] "" Vector__XXX
 SG_ IBST_a072_notShutDownRight m1 : 15|1@1+ (1,0) [0|1] "" Vector__XXX
 SG_ IBST_a073_jumpInAdjustNvMRead m1 : 16|1@1+ (1,0) [0|1] "" Vector__XXX
 SG_ IBST_a074_FindIdleDataNvMWrite m1 : 17|1@1+ (1,0) [0|1] "" Vector__XXX
 SG_ IBST_a075_FindIdleRoutineFault m1 : 18|1@1+ (1,0) [0|1] "" Vector__XXX
 SG_ IBST_a076_masterCylLengthRead m1 : 19|1@1+ (1,0) [0|1] "" Vector__XXX
 SG_ IBST_a077_runOutMotorSaturated m1 : 20|1@1+ (1,0) [0|1] "" Vector__XXX
 SG_ IBST_a078_wearOffsetCompNVMRead m1 : 21|1@1+ (1,0) [0|1] "" Vector__XXX
 SG_ IBST_a079_motorTempHighLevel1 m1 : 22|1@1+ (1,0) [0|1] "" Vector__XXX
 SG_ IBST_a080_motorTempHighLevel2 m1 : 23|1@1+ (1,0) [0|1] "" Vector__XXX
 SG_ IBST_a081_travelDeviation m1 : 24|1@1+ (1,0) [0|1] "" Vector__XXX
 SG_ IBST_a082_motorSpeedDeviation m1 : 25|1@1+ (1,0) [0|1] "" Vector__XXX
 SG_ IBST_a083_spindlePositionTooHigh m1 : 26|1@1+ (1,0) [0|1] "" Vector__XXX
 SG_ IBST_a084_CANTransceiverHWFault m1 : 27|1@1+ (1,0) [0|1] "" Vector__XXX
 SG_ IBST_a085_supplyUndervoltageLvl3 m1 : 28|1@1+ (1,0) [0|1] "" Vector__XXX
 SG_ IBST_a086_supplyOvervoltageLvl3 m1 : 29|1@1+ (1,0) [0|1] "" Vector__XXX
 SG_ IBST_a087_rotorSinOutOfRangeLow m1 : 30|1@1+ (1,0) [0|1] "" Vector__XXX
 SG_ IBST_a088_rotorCosOutOfRangeLow m1 : 31|1@1+ (1,0) [0|1] "" Vector__XXX
 SG_ IBST_a089_rotorSinOutOfRangeHigh m1 : 32|1@1+ (1,0) [0|1] "" Vector__XXX
 SG_ IBST_a090_rotorCosOutOfRangeHigh m1 : 33|1@1+ (1,0) [0|1] "" Vector__XXX
 SG_ IBST_a091_SMMOneRequestsInit m1 : 34|1@1+ (1,0) [0|1] "" Vector__XXX
 SG_ IBST_a092_systemStartTimeOut m1 : 35|1@1+ (1,0) [0|1] "" Vector__XXX
 SG_ IBST_a093_UEXSOvertemperature m1 : 36|1@1+ (1,0) [0|1] "" Vector__XXX
 SG_ IBST_a094_XPASSEchoTimeDeviation m1 : 37|1@1+ (1,0) [0|1] "" Vector__XXX
 SG_ IBST_a095_XPASSTimeOut m1 : 38|1@1+ (1,0) [0|1] "" Vector__XXX
 SG_ IBST_a096_bridgeDriverMonError m1 : 39|1@1+ (1,0) [0|1] "" Vector__XXX
 SG_ IBST_a097_bridgeDriverError m1 : 40|1@1+ (1,0) [0|1] "" Vector__XXX
 SG_ IBST_a098_bridgeShortedPhase m1 : 41|1@1+ (1,0) [0|1] "" Vector__XXX
 SG_ IBST_a099_bridgeSwitchInitError m1 : 42|1@1+ (1,0) [0|1] "" Vector__XXX
 SG_ IBST_a100_current2OffsetHigh m1 : 43|1@1+ (1,0) [0|1] "" Vector__XXX
 SG_ IBST_a101_current2OffsetLow m1 : 44|1@1+ (1,0) [0|1] "" Vector__XXX
 SG_ IBST_a102_current1OffsetHigh m1 : 45|1@1+ (1,0) [0|1] "" Vector__XXX
 SG_ IBST_a103_current1OffsetLow m1 : 46|1@1+ (1,0) [0|1] "" Vector__XXX
 SG_ IBST_a104_bridgeDriverShort m1 : 47|1@1+ (1,0) [0|1] "" Vector__XXX
 SG_ IBST_a105_LiPSUndervoltage m1 : 48|1@1+ (1,0) [0|1] "" Vector__XXX
 SG_ IBST_a106_LiPS5VSupply m1 : 49|1@1+ (1,0) [0|1] "" Vector__XXX
 SG_ IBST_a107_LiPS2PwmLineHigh m1 : 50|1@1+ (1,0) [0|1] "" Vector__XXX
 SG_ IBST_a108_LiPS2PwmLineLow m1 : 51|1@1+ (1,0) [0|1] "" Vector__XXX
 SG_ IBST_a109_LiPS2PwmTransmission m1 : 52|1@1+ (1,0) [0|1] "" Vector__XXX
 SG_ IBST_a110_LiPS1SentLineHigh m1 : 53|1@1+ (1,0) [0|1] "" Vector__XXX
 SG_ IBST_a111_LiPS1SentLineLow m1 : 54|1@1+ (1,0) [0|1] "" Vector__XXX
 SG_ IBST_a112_LiPS1SentTransmission m1 : 55|1@1+ (1,0) [0|1] "" Vector__XXX
 SG_ IBST_a113_LiPS1SentSensor m1 : 56|1@1+ (1,0) [0|1] "" Vector__XXX
 SG_ IBST_a114_partyBusOff m1 : 57|1@1+ (1,0) [0|1] "" Vector__XXX
 SG_ IBST_a115_chassisBusOff m1 : 58|1@1+ (1,0) [0|1] "" Vector__XXX
 SG_ IBST_a116_supplyUndervoltageLvl2 m1 : 59|1@1+ (1,0) [0|1] "" Vector__XXX
 SG_ IBST_a117_supplyOvervoltageLvl2 m1 : 60|1@1+ (1,0) [0|1] "" Vector__XXX
 SG_ IBST_a118_RPSNvMReadFault m1 : 61|1@1+ (1,0) [0|1] "" Vector__XXX
 SG_ IBST_a119_RPSWrongCalibData m1 : 62|1@1+ (1,0) [0|1] "" Vector__XXX
 SG_ IBST_a120_RPSVectorRangeHigh m1 : 63|1@1+ (1,0) [0|1] "" Vector__XXX
 SG_ IBST_a121_RPSVectorRangeLow m2 : 4|1@1+ (1,0) [0|1] "" Vector__XXX
 SG_ IBST_a122_RPSVectorOscillating m2 : 5|1@1+ (1,0) [0|1] "" Vector__XXX
 SG_ IBST_a123_bridgeDriverUnavail m2 : 6|1@1+ (1,0) [0|1] "" Vector__XXX
 SG_ IBST_a124_OBDCurrent1OORHigh m2 : 7|1@1+ (1,0) [0|1] "" Vector__XXX
 SG_ IBST_a125_OBDCurrent2OORHigh m2 : 8|1@1+ (1,0) [0|1] "" Vector__XXX
 SG_ IBST_a126_OBDCurrent1OORLow m2 : 9|1@1+ (1,0) [0|1] "" Vector__XXX
 SG_ IBST_a127_OBDCurrent2OORLow m2 : 10|1@1+ (1,0) [0|1] "" Vector__XXX
 SG_ IBST_a128_BLMMuxerTimeoutError m2 : 11|1@1+ (1,0) [0|1] "" Vector__XXX
 SG_ IBST_a129_loadDumpOnFSLTest m2 : 12|1@1+ (1,0) [0|1] "" Vector__XXX
 SG_ IBST_a130_DTSFunctionalRangeLow m2 : 13|1@1+ (1,0) [0|1] "" Vector__XXX
 SG_ IBST_a131_DTSFunctionalRangeHigh m2 : 14|1@1+ (1,0) [0|1] "" Vector__XXX
 SG_ IBST_a132_DTSPlausiCheck1vs2 m2 : 15|1@1+ (1,0) [0|1] "" Vector__XXX
 SG_ IBST_a133_DTSOffsetTooLow m2 : 16|1@1+ (1,0) [0|1] "" Vector__XXX
 SG_ IBST_a134_DTSOffsetTooHigh m2 : 17|1@1+ (1,0) [0|1] "" Vector__XXX
 SG_ IBST_a135_ESPparty1DLC m2 : 18|1@1+ (1,0) [0|1] "" Vector__XXX
 SG_ IBST_a136_ESPparty1Timeout m2 : 19|1@1+ (1,0) [0|1] "" Vector__XXX
 SG_ IBST_a137_ESPparty1Checksum m2 : 20|1@1+ (1,0) [0|1] "" Vector__XXX
 SG_ IBST_a138_ESPparty1Counter m2 : 21|1@1+ (1,0) [0|1] "" Vector__XXX
 SG_ IBST_a139_ESPparty2DLC m2 : 22|1@1+ (1,0) [0|1] "" Vector__XXX
 SG_ IBST_a140_ESPparty2Timeout m2 : 23|1@1+ (1,0) [0|1] "" Vector__XXX
 SG_ IBST_a141_ESPparty2Checksum m2 : 24|1@1+ (1,0) [0|1] "" Vector__XXX
 SG_ IBST_a142_ESPparty2Counter m2 : 25|1@1+ (1,0) [0|1] "" Vector__XXX
 SG_ IBST_a143_ESPparty3DLC m2 : 26|1@1+ (1,0) [0|1] "" Vector__XXX
 SG_ IBST_a144_ESPparty3Timeout m2 : 27|1@1+ (1,0) [0|1] "" Vector__XXX
 SG_ IBST_a145_ESPparty3Checksum m2 : 28|1@1+ (1,0) [0|1] "" Vector__XXX
 SG_ IBST_a146_ESPparty3Counter m2 : 29|1@1+ (1,0) [0|1] "" Vector__XXX
 SG_ IBST_a147_PSCMotorSizeReadFault m2 : 30|1@1+ (1,0) [0|1] "" Vector__XXX
 SG_ IBST_a148_MLIGainMechReadFault m2 : 31|1@1+ (1,0) [0|1] "" Vector__XXX
 SG_ IBST_a149_MLITMCAreaReadFault m2 : 32|1@1+ (1,0) [0|1] "" Vector__XXX
 SG_ IBST_a150_motorTestFault m2 : 33|1@1+ (1,0) [0|1] "" Vector__XXX
 SG_ IBST_a151_PSCGearRatioReadFault m2 : 34|1@1+ (1,0) [0|1] "" Vector__XXX
 SG_ IBST_a152_PSCVoltageImplausible m2 : 35|1@1+ (1,0) [0|1] "" Vector__XXX
 SG_ IBST_a153_unused m2 : 36|1@1+ (1,0) [0|1] "" Vector__XXX
 SG_ IBST_a154_unused m2 : 37|1@1+ (1,0) [0|1] "" Vector__XXX
 SG_ IBST_a155_supplyUndervoltageLvl1 m2 : 38|1@1+ (1,0) [0|1] "" Vector__XXX
 SG_ IBST_a156_supplyOvervoltageLvl1 m2 : 39|1@1+ (1,0) [0|1] "" Vector__XXX
 SG_ IBST_a157_masterCylPressInvalid m2 : 40|1@1+ (1,0) [0|1] "" Vector__XXX
 SG_ IBST_a158_DTSOffsHighSuspicious m2 : 41|1@1+ (1,0) [0|1] "" Vector__XXX
 SG_ IBST_a159_FindIdleNvMReadError m2 : 42|1@1+ (1,0) [0|1] "" Vector__XXX
 SG_ IBST_a160_DTSIDTimeOut m2 : 43|1@1+ (1,0) [0|1] "" Vector__XXX
 SG_ IBST_a161_powerPackMismatch m2 : 44|1@1+ (1,0) [0|1] "" Vector__XXX
 SG_ IBST_a162_idlePosNotDetected m2 : 45|1@1+ (1,0) [0|1] "" Vector__XXX
 SG_ IBST_a163_ESPpEstMaxInvalid m2 : 46|1@1+ (1,0) [0|1] "" Vector__XXX
 SG_ IBST_a164_ESPVehicleSpeedInvalid m2 : 47|1@1+ (1,0) [0|1] "" Vector__XXX
 SG_ IBST_a165_ESPpForceBlendInvalid m2 : 48|1@1+ (1,0) [0|1] "" Vector__XXX
 SG_ IBST_a166_ESPpMcVirtualInvalid m2 : 49|1@1+ (1,0) [0|1] "" Vector__XXX
 SG_ IBST_a167_ESPqTargetExterInvalid m2 : 50|1@1+ (1,0) [0|1] "" Vector__XXX
 SG_ IBST_a168_CANOvervoltage m2 : 51|1@1+ (1,0) [0|1] "" Vector__XXX
 SG_ IBST_a169_CANUndervoltage m2 : 52|1@1+ (1,0) [0|1] "" Vector__XXX
 SG_ IBST_a170_LVPowerStateTimeout m2 : 53|1@1+ (1,0) [0|1] "" Vector__XXX
 SG_ IBST_a171_LVPowerStateChecksum m2 : 54|1@1+ (1,0) [0|1] "" Vector__XXX
 SG_ IBST_a172_LVPowerStateDLC m2 : 55|1@1+ (1,0) [0|1] "" Vector__XXX
 SG_ IBST_a173_LVPowerStateCounter m2 : 56|1@1+ (1,0) [0|1] "" Vector__XXX
 SG_ IBST_a174_LVOffStateInvalid m2 : 57|1@1+ (1,0) [0|1] "" Vector__XXX
 SG_ IBST_a175_LVGoingDownInvalid m2 : 58|1@1+ (1,0) [0|1] "" Vector__XXX
 SG_ IBST_a176_blockedPedalDetected m2 : 59|1@1+ (1,0) [0|1] "" Vector__XXX
 SG_ IBST_a177_EPBLsystemStatusMIA m2 : 60|1@1+ (1,0) [0|1] "" Vector__XXX
 SG_ IBST_a178_EPBRsystemStatusMIA m2 : 61|1@1+ (1,0) [0|1] "" Vector__XXX
 SG_ IBST_a179_VCLEFTepbmStatusMIA m2 : 62|1@1+ (1,0) [0|1] "" Vector__XXX
 SG_ IBST_a180_VCRIGHTepbmStatusMIA m2 : 63|1@1+ (1,0) [0|1] "" Vector__XXX
 SG_ IBST_a181_DIchassisControlDLC m3 : 4|1@1+ (1,0) [0|1] "" Vector__XXX
 SG_ IBST_a182_DIchassisControlTimeou m3 : 5|1@1+ (1,0) [0|1] "" Vector__XXX
 SG_ IBST_a183_DIchassisControlChecks m3 : 6|1@1+ (1,0) [0|1] "" Vector__XXX
 SG_ IBST_a184_DIchassisControlCounte m3 : 7|1@1+ (1,0) [0|1] "" Vector__XXX
 SG_ IBST_a185_rightBusOff m3 : 8|1@1+ (1,0) [0|1] "" Vector__XXX
 SG_ IBST_a186_rightBusPassive m3 : 9|1@1+ (1,0) [0|1] "" Vector__XXX
 SG_ IBST_a187_brakeBusOff m3 : 10|1@1+ (1,0) [0|1] "" Vector__XXX
 SG_ IBST_a188_brakeBusPassive m3 : 11|1@1+ (1,0) [0|1] "" Vector__XXX
 SG_ IBST_a189_rightVCLVPowerStateTim m3 : 12|1@1+ (1,0) [0|1] "" Vector__XXX
 SG_ IBST_a190_rightVCLVPowerStateDLC m3 : 13|1@1+ (1,0) [0|1] "" Vector__XXX
 SG_ IBST_a191_rightVCLVPowerStateChe m3 : 14|1@1+ (1,0) [0|1] "" Vector__XXX
 SG_ IBST_a192_rightVCLVPowerStateCou m3 : 15|1@1+ (1,0) [0|1] "" Vector__XXX
 SG_ IBST_a193_leftVCLVPowerStateTime m3 : 16|1@1+ (1,0) [0|1] "" Vector__XXX
 SG_ IBST_a194_leftVCLVPowerStateChec m3 : 17|1@1+ (1,0) [0|1] "" Vector__XXX
 SG_ IBST_a195_leftVCLVPowerStateDLC m3 : 18|1@1+ (1,0) [0|1] "" Vector__XXX
 SG_ IBST_a196_leftVCLVPowerStateCoun m3 : 19|1@1+ (1,0) [0|1] "" Vector__XXX
 SG_ IBST_a197_brakeLatencyReductionA m3 : 20|1@1+ (1,0) [0|1] "" Vector__XXX
 SG_ IBST_a198_aesActive m3 : 21|1@1+ (1,0) [0|1] "" Vector__XXX
 SG_ IBST_a199_undefinedAlertDetected m3 : 22|1@1+ (1,0) [0|1] "" Vector__XXX
 SG_ IBST_a200_aesFault m3 : 23|1@1+ (1,0) [0|1] "" Vector__XXX
 SG_ IBST_a201_EGGREAR1wheelSpeedsRea m3 : 24|1@1+ (1,0) [0|1] "" Vector__XXX
 SG_ IBST_a202_EGGREAR1wheelSpeedsRea m3 : 25|1@1+ (1,0) [0|1] "" Vector__XXX
 SG_ IBST_a203_EGGREAR1wheelSpeedsRea m3 : 26|1@1+ (1,0) [0|1] "" Vector__XXX
 SG_ IBST_a204_EGGREAR1wheelSpeedsRea m3 : 27|1@1+ (1,0) [0|1] "" Vector__XXX
 SG_ IBST_a205_EGGRIGHT1wheelSpeedsFr m3 : 28|1@1+ (1,0) [0|1] "" Vector__XXX
 SG_ IBST_a206_EGGRIGHT1wheelSpeedsFr m3 : 29|1@1+ (1,0) [0|1] "" Vector__XXX
 SG_ IBST_a207_EGGRIGHT1wheelSpeedsFr m3 : 30|1@1+ (1,0) [0|1] "" Vector__XXX
 SG_ IBST_a208_EGGRIGHT1wheelSpeedsFr m3 : 31|1@1+ (1,0) [0|1] "" Vector__XXX
 SG_ IBST_a209_reducedBrakePowerActiv m3 : 32|1@1+ (1,0) [0|1] "" Vector__XXX
 SG_ IBST_a210_reducedBrakePowerNotAv m3 : 33|1@1+ (1,0) [0|1] "" Vector__XXX
 SG_ IBST_a211_DETReportError m3 : 34|1@1+ (1,0) [0|1] "" Vector__XXX
 SG_ IBST_a212_infoFailureWrongCUBASH m3 : 35|1@1+ (1,0) [0|1] "" Vector__XXX
 SG_ IBST_a213_PDURouterinitializatio m3 : 36|1@1+ (1,0) [0|1] "" Vector__XXX
 SG_ IBST_a214_LossOfPDUInstanceDetec m3 : 37|1@1+ (1,0) [0|1] "" Vector__XXX
 SG_ IBST_a215_UnsupportedSeriesHWDet m3 : 38|1@1+ (1,0) [0|1] "" Vector__XXX
 SG_ IBST_a216_AsicMalfunctionDetecte m3 : 39|1@1+ (1,0) [0|1] "" Vector__XXX
 SG_ IBST_a217_AsicTrimmingNotComplet m3 : 40|1@1+ (1,0) [0|1] "" Vector__XXX
 SG_ IBST_a218_uCSafetyNotificationGR m3 : 41|1@1+ (1,0) [0|1] "" Vector__XXX
 SG_ IBST_a219_uCSafetyNotification m3 : 42|1@1+ (1,0) [0|1] "" Vector__XXX
 SG_ IBST_a220_ASICOvercurrentOnGPIO2 m3 : 43|1@1+ (1,0) [0|1] "" Vector__XXX
 SG_ IBST_a221_ASICOvercurrentOnGPIO2 m3 : 44|1@1+ (1,0) [0|1] "" Vector__XXX
 SG_ IBST_a222_ASICOvercurrentOnGPIO5 m3 : 45|1@1+ (1,0) [0|1] "" Vector__XXX
 SG_ IBST_a223_ASICOvercurrentOnGPIO5 m3 : 46|1@1+ (1,0) [0|1] "" Vector__XXX
 SG_ IBST_a224_ASICOvercurrentOnGPIO5 m3 : 47|1@1+ (1,0) [0|1] "" Vector__XXX
 SG_ IBST_a225_ASICOvercurrentOnGPIO5 m3 : 48|1@1+ (1,0) [0|1] "" Vector__XXX
 SG_ IBST_a226_ASICOvercurrentOnWRHS m3 : 49|1@1+ (1,0) [0|1] "" Vector__XXX
 SG_ IBST_a227_wakeRequestMismatchDet m3 : 50|1@1+ (1,0) [0|1] "" Vector__XXX
 SG_ IBST_a228_BlockedPedalDetectedDu m3 : 51|1@1+ (1,0) [0|1] "" Vector__XXX
 SG_ IBST_a229_BlockedPedalDetected m3 : 52|1@1+ (1,0) [0|1] "" Vector__XXX
 SG_ IBST_a230_DTS2FunctionalRangeLow m3 : 53|1@1+ (1,0) [0|1] "" Vector__XXX
 SG_ IBST_a231_DTS2FunctionalRangeLow m3 : 54|1@1+ (1,0) [0|1] "" Vector__XXX
 SG_ IBST_a232_PostAssemblyRoutineFai m3 : 55|1@1+ (1,0) [0|1] "" Vector__XXX
 SG_ IBST_a233_ReferenceRunAbortByECU m3 : 56|1@1+ (1,0) [0|1] "" Vector__XXX
 SG_ IBST_a234_LiPSOutOfRangeHigh m3 : 57|1@1+ (1,0) [0|1] "" Vector__XXX
 SG_ IBST_a235_LiPSOutOfRangeLow m3 : 58|1@1+ (1,0) [0|1] "" Vector__XXX
 SG_ IBST_a246_DASredundantBrakingCon m4 : 9|1@1+ (1,0) [0|1] "" Vector__XXX
 SG_ IBST_a247_DASredundantBrakingCon m4 : 10|1@1+ (1,0) [0|1] "" Vector__XXX
 SG_ IBST_a248_DASredundantBrakingCon m4 : 11|1@1+ (1,0) [0|1] "" Vector__XXX
 SG_ IBST_a249_DASredundantBrakingCon m4 : 12|1@1+ (1,0) [0|1] "" Vector__XXX
 SG_ IBST_a250_DASredundantBrakingCon m4 : 13|1@1+ (1,0) [0|1] "" Vector__XXX
 SG_ IBST_a251_DASredundantBrakingCon m4 : 14|1@1+ (1,0) [0|1] "" Vector__XXX
 SG_ IBST_a252_DASredundantBrakingCon m4 : 15|1@1+ (1,0) [0|1] "" Vector__XXX
 SG_ IBST_a253_DASredundantBrakingCon m4 : 16|1@1+ (1,0) [0|1] "" Vector__XXX
 SG_ IBST_a254_DIlocStatus2Checksum m4 : 17|1@1+ (1,0) [0|1] "" Vector__XXX
 SG_ IBST_a255_DIlocStatus2Counter m4 : 18|1@1+ (1,0) [0|1] "" Vector__XXX
 SG_ IBST_a256_DIlocStatus2DLC m4 : 19|1@1+ (1,0) [0|1] "" Vector__XXX
 SG_ IBST_a257_DIlocStatus2Timeout m4 : 20|1@1+ (1,0) [0|1] "" Vector__XXX
 SG_ IBST_a258_standaloneEBRActive m4 : 21|1@1+ (1,0) [0|1] "" Vector__XXX
 SG_ IBST_a259_EMCMain11Checksum m4 : 22|1@1+ (1,0) [0|1] "" Vector__XXX
 SG_ IBST_a260_EMCMain11Counter m4 : 23|1@1+ (1,0) [0|1] "" Vector__XXX
 SG_ IBST_a261_EMCMain11DLC m4 : 24|1@1+ (1,0) [0|1] "" Vector__XXX
 SG_ IBST_a262_EMCMain11Timeout m4 : 25|1@1+ (1,0) [0|1] "" Vector__XXX
 SG_ IBST_a263_EMCMain21Checksum m4 : 26|1@1+ (1,0) [0|1] "" Vector__XXX
 SG_ IBST_a264_EMCMain21Counter m4 : 27|1@1+ (1,0) [0|1] "" Vector__XXX
 SG_ IBST_a265_EMCMain21DLC m4 : 28|1@1+ (1,0) [0|1] "" Vector__XXX
 SG_ IBST_a266_EMCMain21Timeout m4 : 29|1@1+ (1,0) [0|1] "" Vector__XXX

BO_ 813 IBST_info: 8 IBST
 SG_ IBST_infoIndex M : 0|8@1+ (1,0) [0|255] "" Vector__XXX
 SG_ IBST_infoBuildType m10 : 8|8@1+ (1,0) [0|255] "" Vector__XXX
 SG_ IBST_infoComponentID m10 : 55|16@0+ (1,0) [0|65535] "" Vector__XXX
 SG_ IBST_infoPcbaID m11 : 16|8@1+ (1,0) [0|255] "" Vector__XXX
 SG_ IBST_infoAssemblyID m11 : 24|8@1+ (1,0) [0|255] "" Vector__XXX
 SG_ IBST_infoUsageID m11 : 32|16@1+ (1,0) [0|65535] "" Vector__XXX
 SG_ IBST_infoSubUsageID m11 : 48|16@1+ (1,0) [0|65535] "" Vector__XXX
 SG_ IBST_infoApplicationCRC m13 : 32|32@1+ (1,0) [0|4294967295] "" Vector__XXX
 SG_ IBST_infoBootUdsProtoVersion m20 : 8|8@1+ (1,0) [0|255] "" Vector__XXX
 SG_ IBST_infoBootloaderCRC m20 : 32|32@1+ (1,0) [0|4294967295] "" Vector__XXX
 SG_ IBST_infoVariantCRC m22 : 32|32@1+ (1,0) [0|4294967295] "" Vector__XXX

BO_ 1629 IBST_udsResponse: 8 IBST
 SG_ IBST_udsResponseData : 7|64@0+ (1,0) [0|1.84467440737e+19] "" Vector__XXX

BO_TX_BU_ 920 : EPASTS;
BO_TX_BU_ 981 : ESP;
BO_TX_BU_ 805 : ESP;
BO_TX_BU_ 1621 : ESP;
BO_TX_BU_ 861 : IBST;
BO_TX_BU_ 813 : IBST;
BO_TX_BU_ 1629 : IBST;
CM_ BO_ 920 "EPASTS ECU message: alert matrix; frame length from the layout, not yet observed on a vehicle bus";
CM_ SG_ 920 EPASTS_matrixIndex "EPASTS ECU: matrix index";
CM_ SG_ 920 EPASTS_a001_adcCalibrationOrInit "EPASTS ECU: a001 adc calibration or init fail";
CM_ SG_ 920 EPASTS_a002_adcMuxErr "EPASTS ECU: a002 adc mux err";
CM_ SG_ 920 EPASTS_a003_pspInvalidParamset "EPASTS ECU: a003 psp invalid paramset";
CM_ SG_ 920 EPASTS_a004_scpInputMia "EPASTS ECU: a004 scp input mia";
CM_ SG_ 920 EPASTS_a005_scpUnknownResetSourc "EPASTS ECU: a005 scp unknown reset source";
CM_ SG_ 920 EPASTS_a006_swrhResetByInvalidEr "EPASTS ECU: a006 swrh reset by invalid errid";
CM_ SG_ 920 EPASTS_a007_tsmcCoreTempDiff "EPASTS ECU: a007 tsmc core temp diff";
CM_ SG_ 920 EPASTS_a008_psdcPlatformShutdown "EPASTS ECU: a008 psdc platform shutdown";
CM_ SG_ 920 EPASTS_a009_mcusscLbistPermanent "EPASTS ECU: a009 mcussc lbist permanent fail";
CM_ SG_ 920 EPASTS_a010_svcIncompatibleSwVer "EPASTS ECU: a010 svc incompatible sw versions";
CM_ SG_ 920 EPASTS_a011_mcusscMonbistErr "EPASTS ECU: a011 mcussc monbist err";
CM_ SG_ 920 EPASTS_a012_mcusscMbistEccErr "EPASTS ECU: a012 mcussc mbist ecc err";
CM_ SG_ 920 EPASTS_a013_mcusscSffMonitoringF "EPASTS ECU: a013 mcussc sff monitoring failed";
CM_ SG_ 920 EPASTS_a014_mcusscSffMonitoringM "EPASTS ECU: a014 mcussc sff monitoring mia";
CM_ SG_ 920 EPASTS_a015_mcusscCsErrorCheckFa "EPASTS ECU: a015 mcussc cs error check fail";
CM_ SG_ 920 EPASTS_a016_mcufcCsErrorCheckFai "EPASTS ECU: a016 mcufc cs error check fail";
CM_ SG_ 920 EPASTS_a017_stmdStmPlausibilityC "EPASTS ECU: a017 stmd stm plausibility check err";
CM_ SG_ 920 EPASTS_a018_exchCsErrorCheck "EPASTS ECU: a018 exch cs error check";
CM_ SG_ 920 EPASTS_a019_rsthHwResetInfoCorru "EPASTS ECU: a019 rsth hw reset info corruption check";
CM_ SG_ 920 EPASTS_a020_mcusscEolEcuIdIntegr "EPASTS ECU: a020 mcussc eol ecu id integritiy fail";
CM_ SG_ 920 EPASTS_a021_osehCsErrorCheck "EPASTS ECU: a021 oseh cs error check";
CM_ SG_ 920 EPASTS_a022_swrhSwResetInfoCorru "EPASTS ECU: a022 swrh sw reset info corruption check";
CM_ SG_ 920 EPASTS_a023_btarcCorruptionCheck "EPASTS ECU: a023 btarc corruption check";
CM_ SG_ 920 EPASTS_a024_srhCsErrorCheckFail "EPASTS ECU: a024 srh cs error check fail";
CM_ SG_ 920 EPASTS_a025_btarcCorruptionCheck "EPASTS ECU: a025 btarc corruption check";
CM_ SG_ 920 EPASTS_a026_mrccCsErrorCheckFail "EPASTS ECU: a026 mrcc cs error check fail";
CM_ SG_ 920 EPASTS_a027_mcusscDmuHfErr "EPASTS ECU: a027 mcussc dmu hf err";
CM_ SG_ 920 EPASTS_a028_smuhNonInitDataCorru "EPASTS ECU: a028 smuh non init data corruption";
CM_ SG_ 920 EPASTS_a029_smuhSmuCoreCntErrorT "EPASTS ECU: a029 smuh smu core cnt error test fail";
CM_ SG_ 920 EPASTS_a030_rsthClockReset "EPASTS ECU: a030 rsth clock reset";
CM_ SG_ 920 EPASTS_a031_pmsProductionModeFai "EPASTS ECU: a031 pms production mode failed";
CM_ SG_ 920 EPASTS_a032_eolpEolCheckFailed "EPASTS ECU: a032 eolp eol check failed";
CM_ SG_ 920 EPASTS_a033_icsvcPswVersionMisma "EPASTS ECU: a033 icsvc psw version mismatch";
CM_ SG_ 920 EPASTS_a034_sbchReadbackRegFail "EPASTS ECU: a034 sbch readback reg fail";
CM_ SG_ 920 EPASTS_a035_sbchChipIdFail "EPASTS ECU: a035 sbch chip id fail";
CM_ SG_ 920 EPASTS_a036_sbcmSbcBistFailed "EPASTS ECU: a036 sbcm sbc bist failed";
CM_ SG_ 920 EPASTS_a037_epmV5P2Fail "EPASTS ECU: a037 epm V5 P2 fail";
CM_ SG_ 920 EPASTS_a038_csohCh1CsErrorErrAtR "EPASTS ECU: a038 csoh ch1 cs error err at reset";
CM_ SG_ 920 EPASTS_a039_csohCh2CsErrorErrAtR "EPASTS ECU: a039 csoh ch2 cs error err at reset";
CM_ SG_ 920 EPASTS_a040_swrhLimitedResetRetr "EPASTS ECU: a040 swrh limited reset retries expired";
CM_ SG_ 920 EPASTS_a041_imcmCoreConfiguratio "EPASTS ECU: a041 imcm core configuration mismatch";
CM_ SG_ 920 EPASTS_a042_wdhWdTestFail "EPASTS ECU: a042 wdh wd test fail";
CM_ SG_ 920 EPASTS_a043_sbcmWdStateDisabled "EPASTS ECU: a043 sbcm wd state disabled";
CM_ SG_ 920 EPASTS_a044_sbcmSbcEepromFail "EPASTS ECU: a044 sbcm sbc eeprom fail";
CM_ SG_ 920 EPASTS_a045_psumSbcBandgapVoltEr "EPASTS ECU: a045 psum sbc bandgap volt err";
CM_ SG_ 920 EPASTS_a046_mcusscOscillatorNotR "EPASTS ECU: a046 mcussc oscillator not reliable";
CM_ SG_ 920 EPASTS_a047_epmVregVoltFail "EPASTS ECU: a047 epm vreg volt fail";
CM_ SG_ 920 EPASTS_a048_epmVcpVoltFail "EPASTS ECU: a048 epm vcp volt fail";
CM_ SG_ 920 EPASTS_a049_epmLgFail "EPASTS ECU: a049 epm lg fail";
CM_ SG_ 920 EPASTS_a050_erlErr "EPASTS ECU: a050 erl err";
CM_ SG_ 920 EPASTS_a051_ermMessageErr "EPASTS ECU: a051 erm message err";
CM_ SG_ 920 EPASTS_a052_ermSdcInputBufferOve "EPASTS ECU: a052 erm sdc input buffer overflow";
CM_ SG_ 920 EPASTS_a053_adcUnexpectedNumOfDa "EPASTS ECU: a053 adc unexpected num of data";
CM_ SG_ 920 EPASTS_a054_adcUnexpectedData "EPASTS ECU: a054 adc unexpected data";
CM_ SG_ 920 EPASTS_a055_amExtendedGduTest "EPASTS ECU: a055 am extended gdu test";
CM_ SG_ 920 EPASTS_a056_amGduConfigCsErrorCh "EPASTS ECU: a056 am gdu config cs error check";
CM_ SG_ 920 EPASTS_a057_amGduVds "EPASTS ECU: a057 am gdu vds";
CM_ SG_ 920 EPASTS_a058_amIntVgsUndervtgErr "EPASTS ECU: a058 am int vgs undervtg err";
CM_ SG_ 920 EPASTS_a059_amStartupTestFailed "EPASTS ECU: a059 am startup test failed";
CM_ SG_ 920 EPASTS_a060_amGduFail "EPASTS ECU: a060 am gdu fail";
CM_ SG_ 920 EPASTS_a061_amIntSerialErr "EPASTS ECU: a061 am int serial err";
CM_ SG_ 920 EPASTS_a062_amPhaseBridgeCheck "EPASTS ECU: a062 am phase bridge check";
CM_ SG_ 920 EPASTS_a063_amIntRegulatorErr "EPASTS ECU: a063 am int regulator err";
CM_ SG_ 920 EPASTS_a064_amBridgeShort "EPASTS ECU: a064 am bridge short";
CM_ SG_ 920 EPASTS_a065_amGduJuncTemp "EPASTS ECU: a065 am gdu junc temp";
CM_ SG_ 920 EPASTS_a066_amVoltQfErr "EPASTS ECU: a066 am volt qf err";
CM_ SG_ 920 EPASTS_a067_tspmPowermoduleTempI "EPASTS ECU: a067 tspm powermodule temp implausible";
CM_ SG_ 920 EPASTS_a068_rsthCoreRedundancyEr "EPASTS ECU: a068 rsth core redundancy err";
CM_ SG_ 920 EPASTS_a069_rsthCoreTempOutOfRan "EPASTS ECU: a069 rsth core temp out of range hw check";
CM_ SG_ 920 EPASTS_a070_rsthInternalLowVolt "EPASTS ECU: a070 rsth internal low volt";
CM_ SG_ 920 EPASTS_a071_rsthInternalHighVolt "EPASTS ECU: a071 rsth internal high volt";
CM_ SG_ 920 EPASTS_a072_rsthFlashUncorrEccOr "EPASTS ECU: a072 rsth flash uncorr ecc or ovfl";
CM_ SG_ 920 EPASTS_a073_rsthOtherEdcEcc "EPASTS ECU: a073 rsth other edc ecc";
CM_ SG_ 920 EPASTS_a074_rsthUnexpectedAlarm "EPASTS ECU: a074 rsth unexpected alarm";
CM_ SG_ 920 EPASTS_a075_rsthUnusedOtherModul "EPASTS ECU: a075 rsth unused other module alarm";
CM_ SG_ 920 EPASTS_a076_exchGeneralException "EPASTS ECU: a076 exch general exception";
CM_ SG_ 920 EPASTS_a077_dmDeadlineViolation "EPASTS ECU: a077 dm deadline violation";
CM_ SG_ 920 EPASTS_a078_dmDeadlineViolation "EPASTS ECU: a078 dm deadline violation";
CM_ SG_ 920 EPASTS_a079_gduhComErr "EPASTS ECU: a079 gduh com err";
CM_ SG_ 920 EPASTS_a080_pwmTimerSyncCheck "EPASTS ECU: a080 pwm timer sync check";
CM_ SG_ 920 EPASTS_a081_exchFloatingPointExc "EPASTS ECU: a081 exch floating point exception";
CM_ SG_ 920 EPASTS_a082_adcTriggerTimeChk "EPASTS ECU: a082 adc trigger time chk";
CM_ SG_ 920 EPASTS_a083_tdaDclinkcapacitorTe "EPASTS ECU: a083 tda dclinkcapacitor temp checker";
CM_ SG_ 920 EPASTS_a084_adcTriggerCheck "EPASTS ECU: a084 adc trigger check";
CM_ SG_ 920 EPASTS_a085_amGduSwitchOffTestBy "EPASTS ECU: a085 am gdu switch off test by mcu";
CM_ SG_ 920 EPASTS_a086_rsthRamUncorrEcc "EPASTS ECU: a086 rsth ram uncorr ecc";
CM_ SG_ 920 EPASTS_a087_rsthFlashConfigErr "EPASTS ECU: a087 rsth flash config err";
CM_ SG_ 920 EPASTS_a088_tedMainboardTempChec "EPASTS ECU: a088 ted mainboard temp checker";
CM_ SG_ 920 EPASTS_a089_tedRevercebattfetjun "EPASTS ECU: a089 ted revercebattfetjunction temp checker";
CM_ SG_ 920 EPASTS_a090_etsmWarning "EPASTS ECU: a090 etsm warning";
CM_ SG_ 920 EPASTS_a091_bvpBattVoltCrossChkF "EPASTS ECU: a091 bvp batt volt cross chk failed";
CM_ SG_ 920 EPASTS_a092_amGduSwitchOffTestBy "EPASTS ECU: a092 am gdu switch off test by sbc";
CM_ SG_ 920 EPASTS_a093_sctpTsuSingleStaticF "EPASTS ECU: a093 sctp tsu single static fail";
CM_ SG_ 920 EPASTS_a094_sctpTsuMultipleStati "EPASTS ECU: a094 sctp tsu multiple static fail";
CM_ SG_ 920 EPASTS_a095_mdModelBasedMotorInt "EPASTS ECU: a095 md model based motor integrity check";
CM_ SG_ 920 EPASTS_a096_rppRpsSingleStaticFa "EPASTS ECU: a096 rpp rps single static fail";
CM_ SG_ 920 EPASTS_a097_rppRpsMultipleStatic "EPASTS ECU: a097 rpp rps multiple static fail";
CM_ SG_ 920 EPASTS_a098_invErr "EPASTS ECU: a098 inv err";
CM_ SG_ 920 EPASTS_a099_mcdTorqueMismatchFau "EPASTS ECU: a099 mcd torque mismatch fault";
CM_ SG_ 920 EPASTS_a100_amVbrgLssFault "EPASTS ECU: a100 am vbrg lss fault";
CM_ SG_ 920 EPASTS_a101_sdrvSpcIdMismatch "EPASTS ECU: a101 sdrv spc id mismatch";
CM_ SG_ 920 EPASTS_a102_amPhasecurrentQosErr "EPASTS ECU: a102 am phasecurrent qos err";
CM_ SG_ 920 EPASTS_a103_exhaUnusedInterruptC "EPASTS ECU: a103 exha unused interrupt call exception";
CM_ SG_ 920 EPASTS_a104_exhaBusMpuException "EPASTS ECU: a104 exha bus mpu exception";
CM_ SG_ 920 EPASTS_a105_exhaSriBusErrExcepti "EPASTS ECU: a105 exha sri bus err exception";
CM_ SG_ 920 EPASTS_a106_exhaSpbBusErrExcepti "EPASTS ECU: a106 exha spb bus err exception";
CM_ SG_ 920 EPASTS_a107_exhaOtherNmiExceptio "EPASTS ECU: a107 exha other nmi exception";
CM_ SG_ 920 EPASTS_a108_exhaInternalProtecti "EPASTS ECU: a108 exha internal protection exception";
CM_ SG_ 920 EPASTS_a109_exhaSysBusOrPeriphEr "EPASTS ECU: a109 exha sys bus or periph err exception";
CM_ SG_ 920 EPASTS_a110_amPhaseRelaySwitchOf "EPASTS ECU: a110 am phase relay switch off test";
CM_ SG_ 920 EPASTS_a111_amCurrentSensingDisc "EPASTS ECU: a111 am current sensing disconnection";
CM_ SG_ 920 EPASTS_a112_rsthSafetyFlipflopEr "EPASTS ECU: a112 rsth safety flipflop err";
CM_ SG_ 920 EPASTS_a113_rsthUncorrectableEnd "EPASTS ECU: a113 rsth uncorrectable end to end bus err";
CM_ SG_ 920 EPASTS_a114_osehOsErr "EPASTS ECU: a114 oseh os err";
CM_ SG_ 920 EPASTS_a115_mcusscLbistSingleFai "EPASTS ECU: a115 mcussc lbist single fail";
CM_ SG_ 920 EPASTS_a116_mrccStartupRegCsErro "EPASTS ECU: a116 mrcc startup reg cs error static err";
CM_ SG_ 920 EPASTS_a117_mrccStartupRegCsErro "EPASTS ECU: a117 mrcc startup reg cs error transient err";
CM_ SG_ 920 EPASTS_a118_mcusscFlashCsErrorEr "EPASTS ECU: a118 mcussc flash cs error err";
CM_ SG_ 920 EPASTS_a119_mcusscFlashEccCritic "EPASTS ECU: a119 mcussc flash ecc critical err";
CM_ SG_ 920 EPASTS_a120_mcusscFlashEccLatent "EPASTS ECU: a120 mcussc flash ecc latent err";
CM_ SG_ 920 EPASTS_a121_mcusscMbistEccErr "EPASTS ECU: a121 mcussc mbist ecc err";
CM_ SG_ 920 EPASTS_a122_pcpBridgeFetShort "EPASTS ECU: a122 pcp bridge fet short";
CM_ SG_ 920 EPASTS_a123_imcmCommErr "EPASTS ECU: a123 imcm comm err";
CM_ SG_ 920 EPASTS_a124_mcusscMbistEccTransi "EPASTS ECU: a124 mcussc mbist ecc transient err";
CM_ SG_ 920 EPASTS_a125_mcusscMbistMiaErr "EPASTS ECU: a125 mcussc mbist mia err";
CM_ SG_ 920 EPASTS_a126_mcusscMonbistMiaErr "EPASTS ECU: a126 mcussc monbist mia err";
CM_ SG_ 920 EPASTS_a127_exchAdditionalExcept "EPASTS ECU: a127 exch additional exception after rst";
CM_ SG_ 920 EPASTS_a128_exchExceptionStopRes "EPASTS ECU: a128 exch exception stop restart";
CM_ SG_ 920 EPASTS_a129_exchAdditionalExcept "EPASTS ECU: a129 exch additional exception stop restart";
CM_ SG_ 920 EPASTS_a130_mrccConfigCsErrorErr "EPASTS ECU: a130 mrcc config cs error err";
CM_ SG_ 920 EPASTS_a131_exchGuardedResetAfte "EPASTS ECU: a131 exch guarded reset after partition stop";
CM_ SG_ 920 EPASTS_a132_mcusscNotSupportedMc "EPASTS ECU: a132 mcussc not supported mcu";
CM_ SG_ 920 EPASTS_a133_mcusscLbistEcuIdIsNo "EPASTS ECU: a133 mcussc lbist ecu id is not supported";
CM_ SG_ 920 EPASTS_a134_osehGuardedResetAfte "EPASTS ECU: a134 oseh guarded reset after err without reset";
CM_ SG_ 920 EPASTS_a135_tmpsfetjCalculationO "EPASTS ECU: a135 tmpsfetj calculation overflow err";
CM_ SG_ 920 EPASTS_a136_ftElectricalAngleQf "EPASTS ECU: a136 ft electrical angle qf";
CM_ SG_ 920 EPASTS_a137_osehErrWithoutImmedi "EPASTS ECU: a137 oseh err without immediate reset";
CM_ SG_ 920 EPASTS_a138_osehAdditionalErrWit "EPASTS ECU: a138 oseh additional err without imm reset";
CM_ SG_ 920 EPASTS_a139_osehAdditionalOsErr "EPASTS ECU: a139 oseh additional os err";
CM_ SG_ 920 EPASTS_a140_imcmConfigurationErr "EPASTS ECU: a140 imcm configuration err";
CM_ SG_ 920 EPASTS_a141_amFetShortTest "EPASTS ECU: a141 am fet short test";
CM_ SG_ 920 EPASTS_a142_tedEmifilterDmcTempC "EPASTS ECU: a142 ted emifilter dmc temp checker";
CM_ SG_ 920 EPASTS_a143_tedEmifilterCmcTempC "EPASTS ECU: a143 ted emifilter cmc temp checker";
CM_ SG_ 920 EPASTS_a144_mriCoreRaminitFailed "EPASTS ECU: a144 mri core raminit failed";
CM_ SG_ 920 EPASTS_a145_mriPeripheralRaminit "EPASTS ECU: a145 mri peripheral raminit failed";
CM_ SG_ 920 EPASTS_a146_btarcRcCircuitCheck "EPASTS ECU: a146 btarc rc circuit check";
CM_ SG_ 920 EPASTS_a147_amDcLinkShortedFail "EPASTS ECU: a147 am dc link shorted fail";
CM_ SG_ 920 EPASTS_a148_mrccExitFromStandbyD "EPASTS ECU: a148 mrcc exit from standby detected";
CM_ SG_ 920 EPASTS_a149_amReversibleEmergenc "EPASTS ECU: a149 am reversible emergency off requested";
CM_ SG_ 920 EPASTS_a150_amExternalEmergencyO "EPASTS ECU: a150 am external emergency off requested";
CM_ SG_ 920 EPASTS_a151_amPermanentEmergency "EPASTS ECU: a151 am permanent emergency off requested";
CM_ SG_ 920 EPASTS_a152_exchFlashEccExceptio "EPASTS ECU: a152 exch flash ecc exception";
CM_ SG_ 920 EPASTS_a153_sdsmBlockSelectorInv "EPASTS ECU: a153 sdsm block selector invalid";
CM_ SG_ 920 EPASTS_a154_sdsmCsErrorInvalidPr "EPASTS ECU: a154 sdsm cs error invalid primary";
CM_ SG_ 920 EPASTS_a155_sdsmDataInvalidAll "EPASTS ECU: a155 sdsm data invalid all";
CM_ SG_ 920 EPASTS_a156_amIntSerialErrSafety "EPASTS ECU: a156 am int serial err safety reset";
CM_ SG_ 920 EPASTS_a157_mcudcpInvalidEcuId "EPASTS ECU: a157 mcudcp invalid ecu id";
CM_ SG_ 920 EPASTS_a158_amGduFailDuringRecov "EPASTS ECU: a158 am gdu fail during recovery";
CM_ SG_ 920 EPASTS_a159_exchFlashWordlineTra "EPASTS ECU: a159 exch flash wordline transient err";
CM_ SG_ 920 EPASTS_a160_rsthCpu1UnexpectedAl "EPASTS ECU: a160 rsth cpu1 unexpected alarm";
CM_ SG_ 920 EPASTS_a161_tdaRelayfetjunctionT "EPASTS ECU: a161 tda relayfetjunction temp checker";
CM_ SG_ 920 EPASTS_a162_tdaBridgefetjunction "EPASTS ECU: a162 tda bridgefetjunction temp checker";
CM_ SG_ 920 EPASTS_a163_tdaPowermoduleTempCh "EPASTS ECU: a163 tda powermodule temp checker";
CM_ SG_ 920 EPASTS_a164_tdaBattfetjunctionTe "EPASTS ECU: a164 tda battfetjunction temp checker";
CM_ SG_ 920 EPASTS_a165_tdaDcbusshuntTempChe "EPASTS ECU: a165 tda dcbusshunt temp checker";
CM_ SG_ 920 EPASTS_a166_tdaPhasecurrentshunt "EPASTS ECU: a166 tda phasecurrentshunt temp checker";
CM_ SG_ 920 EPASTS_a167_iccd1ErrQueueOverflo "EPASTS ECU: a167 iccd1 err queue overflow";
CM_ SG_ 920 EPASTS_a168_c1csInvalidC1App "EPASTS ECU: a168 c1cs invalid C1 app";
CM_ SG_ 920 EPASTS_a169_scpSafetyReset "EPASTS ECU: a169 scp safety reset";
CM_ SG_ 920 EPASTS_a170_pmpDcvoltAge "EPASTS ECU: a170 pmp dcvolt age";
CM_ SG_ 920 EPASTS_a171_pmpKgvalueAge "EPASTS ECU: a171 pmp kgvalue age";
CM_ SG_ 920 EPASTS_a172_pmpElangMotorcurrent "EPASTS ECU: a172 pmp elang motorcurrent age";
CM_ SG_ 920 EPASTS_a173_pmpRotorspeedAge "EPASTS ECU: a173 pmp rotorspeed age";
CM_ SG_ 920 EPASTS_a174_pmpPhasecurrentAge "EPASTS ECU: a174 pmp phasecurrent age";
CM_ SG_ 920 EPASTS_a175_exchFlashStoredConfi "EPASTS ECU: a175 exch flash stored config err";
CM_ SG_ 920 EPASTS_a176_exchCpu1ExceptionRes "EPASTS ECU: a176 exch cpu1 exception reset";
CM_ SG_ 920 EPASTS_a177_etsrInvalidated "EPASTS ECU: a177 etsr invalidated";
CM_ SG_ 920 EPASTS_a178_exchWdtException "EPASTS ECU: a178 exch wdt exception";
CM_ SG_ 920 EPASTS_a179_tedMotorcoilTempChec "EPASTS ECU: a179 ted motorcoil temp checker";
CM_ SG_ 920 EPASTS_a180_dmDeadlineViolationC "EPASTS ECU: a180 dm deadline violation C1";
CM_ SG_ 920 EPASTS_a181_dmDeadlineViolationC "EPASTS ECU: a181 dm deadline violation C1";
CM_ SG_ 920 EPASTS_a182_mcdInputMia "EPASTS ECU: a182 mcd input mia";
CM_ SG_ 920 EPASTS_a183_sbchCommErrSbcToMcu "EPASTS ECU: a183 sbch comm err sbc to mcu";
CM_ SG_ 920 EPASTS_a184_sbcmCommBufferOverfl "EPASTS ECU: a184 sbcm comm buffer overflow";
CM_ SG_ 920 EPASTS_a185_sbcscpQAWatchdogRese "EPASTS ECU: a185 sbcscp QA watchdog reset";
CM_ SG_ 920 EPASTS_a186_wdhCommBufferOverflo "EPASTS ECU: a186 wdh comm buffer overflow";
CM_ SG_ 920 EPASTS_a187_epmVoltFail "EPASTS ECU: a187 epm volt fail";
CM_ SG_ 920 EPASTS_a188_epmCommBufferOverflo "EPASTS ECU: a188 epm comm buffer overflow";
CM_ SG_ 920 EPASTS_a189_sbchCommErrMcuToSbc "EPASTS ECU: a189 sbch comm err mcu to sbc";
CM_ SG_ 920 EPASTS_a190_sbchCommBufferOverfl "EPASTS ECU: a190 sbch comm buffer overflow";
CM_ SG_ 920 EPASTS_a191_sbcscpVcp2VucVoltFai "EPASTS ECU: a191 sbcscp vcp2 vuc volt fail";
CM_ SG_ 920 EPASTS_a192_osumC0CsaNearFull "EPASTS ECU: a192 osum C0 csa near full";
CM_ SG_ 920 EPASTS_a193_osumC0StackNearFull "EPASTS ECU: a193 osum C0 stack near full";
CM_ SG_ 920 EPASTS_a194_amNvdataLoss "EPASTS ECU: a194 am nvdata loss";
CM_ SG_ 920 EPASTS_a195_imcmCommErrC1 "EPASTS ECU: a195 imcm comm err C1";
CM_ SG_ 920 EPASTS_a196_topEolTasOffsetInval "EPASTS ECU: a196 top eol tas offset invalid";
CM_ SG_ 920 EPASTS_a197_difpDifactorInvalid "EPASTS ECU: a197 difp difactor invalid";
CM_ SG_ 920 EPASTS_a198_osumC1CsaNearFull "EPASTS ECU: a198 osum C1 csa near full";
CM_ SG_ 920 EPASTS_a199_osumC1StackNearFull "EPASTS ECU: a199 osum C1 stack near full";
CM_ SG_ 920 EPASTS_a200_ammInputBufferOverfl "EPASTS ECU: a200 amm input buffer overflow";
CM_ SG_ 920 EPASTS_a201_ammOutputBufferOverf "EPASTS ECU: a201 amm output buffer overflow";
CM_ SG_ 920 EPASTS_a202_ohnvmpStoredOffsetLo "EPASTS ECU: a202 ohnvmp stored offset lost";
CM_ SG_ 920 EPASTS_a203_ctcInterfaceErr "EPASTS ECU: a203 ctc interface err";
CM_ SG_ 920 EPASTS_a204_fdpPrevTrqErr "EPASTS ECU: a204 fdp prev trq err";
CM_ SG_ 920 EPASTS_a205_fdrOclFail "EPASTS ECU: a205 fdr ocl fail";
CM_ SG_ 920 EPASTS_a206_fdrOclPartialBlockin "EPASTS ECU: a206 fdr ocl partial blocking";
CM_ SG_ 920 EPASTS_a207_fdrOclFreezing "EPASTS ECU: a207 fdr ocl freezing";
CM_ SG_ 920 EPASTS_a208_fdrLowSeverityBlocki "EPASTS ECU: a208 fdr low severity blocking";
CM_ SG_ 920 EPASTS_a209_fdrLowSeverityFreezi "EPASTS ECU: a209 fdr low severity freezing";
CM_ SG_ 920 EPASTS_a210_fdrTotalBlocking "EPASTS ECU: a210 fdr total blocking";
CM_ SG_ 920 EPASTS_a211_frmInternalErr "EPASTS ECU: a211 frm internal err";
CM_ SG_ 920 EPASTS_a212_frmDataLost "EPASTS ECU: a212 frm data lost";
CM_ SG_ 920 EPASTS_a213_frmHighFrictionDetec "EPASTS ECU: a213 frm high friction detected";
CM_ SG_ 920 EPASTS_a214_velInterfaceErr "EPASTS ECU: a214 vel interface err";
CM_ SG_ 920 EPASTS_a215_vsgSafeViolErr "EPASTS ECU: a215 vsg safe viol err";
CM_ SG_ 920 EPASTS_a216_isdgImproperShutdown "EPASTS ECU: a216 isdg improper shutdown";
CM_ SG_ 920 EPASTS_a217_msdMasterSilentErr "EPASTS ECU: a217 msd master silent err";
CM_ SG_ 920 EPASTS_a218_aadApplicationStateE "EPASTS ECU: a218 aad application state err";
CM_ SG_ 920 EPASTS_a219_frhFastRestartFailed "EPASTS ECU: a219 frh fast restart failed";
CM_ SG_ 920 EPASTS_a220_transceiverInputqueu "EPASTS ECU: a220 transceiver inputqueue overflow";
CM_ SG_ 920 EPASTS_a221_apsCntError "EPASTS ECU: a221 aps cnt error";
CM_ SG_ 920 EPASTS_a222_apsCsError "EPASTS ECU: a222 aps cs error";
CM_ SG_ 920 EPASTS_a223_apsMia "EPASTS ECU: a223 aps mia";
CM_ SG_ 920 EPASTS_a224_dasCntError "EPASTS ECU: a224 das cnt error";
CM_ SG_ 920 EPASTS_a225_dasCsError "EPASTS ECU: a225 das cs error";
CM_ SG_ 920 EPASTS_a226_dasMia "EPASTS ECU: a226 das mia";
CM_ SG_ 920 EPASTS_a227_dirTorqueCntError "EPASTS ECU: a227 dir torque cnt error";
CM_ SG_ 920 EPASTS_a228_dirTorqueCsError "EPASTS ECU: a228 dir torque cs error";
CM_ SG_ 920 EPASTS_a229_dirTorqueMia "EPASTS ECU: a229 dir torque mia";
CM_ SG_ 920 EPASTS_a230_diSpdCntError "EPASTS ECU: a230 di spd cnt error";
CM_ SG_ 920 EPASTS_a231_diSpdCsError "EPASTS ECU: a231 di spd cs error";
CM_ SG_ 920 EPASTS_a232_diSpdMia "EPASTS ECU: a232 di spd mia";
CM_ SG_ 920 EPASTS_a233_ecu1StatCntError "EPASTS ECU: a233 ecu1 stat cnt error";
CM_ SG_ 920 EPASTS_a234_ecu1StatCsError "EPASTS ECU: a234 ecu1 stat cs error";
CM_ SG_ 920 EPASTS_a235_ecu1StatMia "EPASTS ECU: a235 ecu1 stat mia";
CM_ SG_ 920 EPASTS_a236_espWrCntError "EPASTS ECU: a236 esp wr cnt error";
CM_ SG_ 920 EPASTS_a237_espWrCsError "EPASTS ECU: a237 esp wr cs error";
CM_ SG_ 920 EPASTS_a238_espWrMia "EPASTS ECU: a238 esp wr mia";
CM_ SG_ 920 EPASTS_a239_espWsCntError "EPASTS ECU: a239 esp ws cnt error";
CM_ SG_ 920 EPASTS_a240_espWsCsError "EPASTS ECU: a240 esp ws cs error";
CM_ SG_ 920 EPASTS_a241_espWsMia "EPASTS ECU: a241 esp ws mia";
CM_ SG_ 920 EPASTS_a242_gtwConfigMia "EPASTS ECU: a242 gtw config mia";
CM_ SG_ 920 EPASTS_a243_rcmCntError "EPASTS ECU: a243 rcm cnt error";
CM_ SG_ 920 EPASTS_a244_rcmCsError "EPASTS ECU: a244 rcm cs error";
CM_ SG_ 920 EPASTS_a245_rcmMia "EPASTS ECU: a245 rcm mia";
CM_ SG_ 920 EPASTS_a246_sccmCntError "EPASTS ECU: a246 sccm cnt error";
CM_ SG_ 920 EPASTS_a247_sccmCsError "EPASTS ECU: a247 sccm cs error";
CM_ SG_ 920 EPASTS_a248_sccmMia "EPASTS ECU: a248 sccm mia";
CM_ SG_ 920 EPASTS_a249_uiTuneReqCntError "EPASTS ECU: a249 ui tune req cnt error";
CM_ SG_ 920 EPASTS_a250_uiTuneReqCsError "EPASTS ECU: a250 ui tune req cs error";
CM_ SG_ 920 EPASTS_a251_uiTuneReqMia "EPASTS ECU: a251 ui tune req mia";
CM_ SG_ 920 EPASTS_a252_vcFrontCntError "EPASTS ECU: a252 vc front cnt error";
CM_ SG_ 920 EPASTS_a253_vcFrontCsError "EPASTS ECU: a253 vc front cs error";
CM_ SG_ 920 EPASTS_a254_vcFrontMia "EPASTS ECU: a254 vc front mia";
CM_ SG_ 920 EPASTS_a255_pmState2Mia "EPASTS ECU: a255 pm state2 mia";
CM_ SG_ 920 EPASTS_a256_dcvmOverVolt "EPASTS ECU: a256 dcvm over volt";
CM_ SG_ 920 EPASTS_a257_dcvmUnderVolt "EPASTS ECU: a257 dcvm under volt";
CM_ SG_ 920 EPASTS_a258_pspInvalidProjectPar "EPASTS ECU: a258 psp invalid project paramset";
CM_ SG_ 920 EPASTS_a259_scoCanBusOff "EPASTS ECU: a259 sco can bus off";
CM_ SG_ 920 EPASTS_a260_scoPrivateBusOff "EPASTS ECU: a260 sco private bus off";
CM_ SG_ 920 EPASTS_a261_sccmStatusError "EPASTS ECU: a261 sccm status error";
CM_ SG_ 920 EPASTS_a262_yawRateStatus "EPASTS ECU: a262 yaw rate status";
CM_ SG_ 920 EPASTS_a263_espWsStatus "EPASTS ECU: a263 esp ws status";
CM_ SG_ 920 EPASTS_a264_assistTorqueLimited "EPASTS ECU: a264 assist torque limited";
CM_ SG_ 920 EPASTS_a265_overheatProtect "EPASTS ECU: a265 overheat protect";
CM_ SG_ 920 EPASTS_a266_overloadProtect "EPASTS ECU: a266 overload protect";
CM_ SG_ 920 EPASTS_a267_safeSpeedAssist "EPASTS ECU: a267 safe speed assist";
CM_ SG_ 920 EPASTS_a268_eacCancelled "EPASTS ECU: a268 eac cancelled";
CM_ SG_ 920 EPASTS_a269_assistTorqueDisabled "EPASTS ECU: a269 assist torque disabled";
CM_ SG_ 920 EPASTS_a270_oscillationCompTrqLi "EPASTS ECU: a270 oscillation comp trq lim reached";
CM_ BO_ 981 "Electronic stability control message: alert matrix; frame length from the layout, not yet observed on a vehicle bus";
CM_ SG_ 981 ESP_matrixIndex "Electronic stability control: matrix index";
CM_ SG_ 981 ESP_a001_ecuGenericFault "Electronic stability control: a001 ecu generic fault";
CM_ SG_ 981 ESP_a002_valvesGenericFault "Electronic stability control: a002 valves generic fault";
CM_ SG_ 981 ESP_a003_outletValvesFault "Electronic stability control: a003 outlet valves fault";
CM_ SG_ 981 ESP_a004_inletValvesFault "Electronic stability control: a004 inlet valves fault";
CM_ SG_ 981 ESP_a005_HSVValvesFault "Electronic stability control: a005 HSV valves fault";
CM_ SG_ 981 ESP_a006_USVValvesFault "Electronic stability control: a006 USV valves fault";
CM_ SG_ 981 ESP_a007_pumpMotorFault "Electronic stability control: a007 pump motor fault";
CM_ SG_ 981 ESP_a008_pumpMotor12VsupplyLow "Electronic stability control: a008 pump motor12 vsupply low";
CM_ SG_ 981 ESP_a009_12VHardUndervoltage "Electronic stability control: a009 12 v hard undervoltage";
CM_ SG_ 981 ESP_a010_12VUndervoltage "Electronic stability control: a010 12 v undervoltage";
CM_ SG_ 981 ESP_a011_12VSystemUndervoltage "Electronic stability control: a011 12 v system undervoltage";
CM_ SG_ 981 ESP_a012_netUndervoltage "Electronic stability control: a012 net undervoltage";
CM_ SG_ 981 ESP_a013_valveRelayUndervoltage "Electronic stability control: a013 valve relay undervoltage";
CM_ SG_ 981 ESP_a014_WSSSupplyUndervoltage "Electronic stability control: a014 WSS supply undervoltage";
CM_ SG_ 981 ESP_a015_12VSupplyOvervoltage "Electronic stability control: a015 12 v supply overvoltage";
CM_ SG_ 981 ESP_a016_12VSystemOvervoltage "Electronic stability control: a016 12 v system overvoltage";
CM_ SG_ 981 ESP_a017_netOvervoltage "Electronic stability control: a017 net overvoltage";
CM_ SG_ 981 ESP_a018_WSSSignFrontAxle "Electronic stability control: a018 WSS sign front axle";
CM_ SG_ 981 ESP_a019_WSSSignRearAxle "Electronic stability control: a019 WSS sign rear axle";
CM_ SG_ 981 ESP_a020_WSSGenericTempFault "Electronic stability control: a020 WSS generic temp fault";
CM_ SG_ 981 ESP_a021_WSSGeneralVDiffFault "Electronic stability control: a021 WSS general v diff fault";
CM_ SG_ 981 ESP_a022_WSSDirectionFault "Electronic stability control: a022 WSS direction fault";
CM_ SG_ 981 ESP_a023_WSSSeveralSuspected "Electronic stability control: a023 WSS several suspected";
CM_ SG_ 981 ESP_a024_WSSReverseCurrent "Electronic stability control: a024 WSS reverse current";
CM_ SG_ 981 ESP_a025_FrLWSSOpenOrShortToGnd "Electronic stability control: a025 fr LWSS open or short to gnd";
CM_ SG_ 981 ESP_a026_FrLWSSShortTo12V "Electronic stability control: a026 fr LWSS short to12 v";
CM_ SG_ 981 ESP_a027_FrLWSSLineInterruption "Electronic stability control: a027 fr LWSS line interruption";
CM_ SG_ 981 ESP_a028_FrLWSSMaxSpeedExceeded "Electronic stability control: a028 fr LWSS max speed exceeded";
CM_ SG_ 981 ESP_a029_FrLWSSTooManyPulses "Electronic stability control: a029 fr LWSS too many pulses";
CM_ SG_ 981 ESP_a030_FrLWSSLostSignal "Electronic stability control: a030 fr LWSS lost signal";
CM_ SG_ 981 ESP_a031_FrLWSSNoPulsesDetected "Electronic stability control: a031 fr LWSS no pulses detected";
CM_ SG_ 981 ESP_a032_FrLWSSWrongSensorType "Electronic stability control: a032 fr LWSS wrong sensor type";
CM_ SG_ 981 ESP_a033_FrLWSSSignalNoise "Electronic stability control: a033 fr LWSS signal noise";
CM_ SG_ 981 ESP_a034_FrLWSSVDiffFault "Electronic stability control: a034 fr LWSSV diff fault";
CM_ SG_ 981 ESP_a035_FrLWSSDirectionFault "Electronic stability control: a035 fr LWSS direction fault";
CM_ SG_ 981 ESP_a036_FrLWSSLargeAirGap "Electronic stability control: a036 fr LWSS large air gap";
CM_ SG_ 981 ESP_a037_FrLWSSSupplyShortToGnd "Electronic stability control: a037 fr LWSS supply short to gnd";
CM_ SG_ 981 ESP_a038_FrLWSSGeneralFault "Electronic stability control: a038 fr LWSS general fault";
CM_ SG_ 981 ESP_a039_FrRWSSOpenOrShortToGnd "Electronic stability control: a039 fr RWSS open or short to gnd";
CM_ SG_ 981 ESP_a040_FrRWSSShortTo12V "Electronic stability control: a040 fr RWSS short to12 v";
CM_ SG_ 981 ESP_a041_FrRWSSLineInterruption "Electronic stability control: a041 fr RWSS line interruption";
CM_ SG_ 981 ESP_a042_FrRWSSMaxSpeedExceeded "Electronic stability control: a042 fr RWSS max speed exceeded";
CM_ SG_ 981 ESP_a043_FrRWSSTooManyPulses "Electronic stability control: a043 fr RWSS too many pulses";
CM_ SG_ 981 ESP_a044_FrRWSSLostSignal "Electronic stability control: a044 fr RWSS lost signal";
CM_ SG_ 981 ESP_a045_FrRWSSNoPulsesDetected "Electronic stability control: a045 fr RWSS no pulses detected";
CM_ SG_ 981 ESP_a046_FrRWSSWrongSensorType "Electronic stability control: a046 fr RWSS wrong sensor type";
CM_ SG_ 981 ESP_a047_FrRWSSSignalNoise "Electronic stability control: a047 fr RWSS signal noise";
CM_ SG_ 981 ESP_a048_FrRWSSVDiffFault "Electronic stability control: a048 fr RWSSV diff fault";
CM_ SG_ 981 ESP_a049_FrRWSSDirectionFault "Electronic stability control: a049 fr RWSS direction fault";
CM_ SG_ 981 ESP_a050_FrRWSSLargeAirGap "Electronic stability control: a050 fr RWSS large air gap";
CM_ SG_ 981 ESP_a051_FrRWSSSupplyShortToGnd "Electronic stability control: a051 fr RWSS supply short to gnd";
CM_ SG_ 981 ESP_a052_FrRWSSGeneralFault "Electronic stability control: a052 fr RWSS general fault";
CM_ SG_ 981 ESP_a053_ReLWSSOpenOrShortToGnd "Electronic stability control: a053 re LWSS open or short to gnd";
CM_ SG_ 981 ESP_a054_ReLWSSShortTo12V "Electronic stability control: a054 re LWSS short to12 v";
CM_ SG_ 981 ESP_a055_ReLWSSLineInterruption "Electronic stability control: a055 re LWSS line interruption";
CM_ SG_ 981 ESP_a056_ReLWSSMaxSpeedExceeded "Electronic stability control: a056 re LWSS max speed exceeded";
CM_ SG_ 981 ESP_a057_ReLWSSTooManyPulses "Electronic stability control: a057 re LWSS too many pulses";
CM_ SG_ 981 ESP_a058_ReLWSSLostSignal "Electronic stability control: a058 re LWSS lost signal";
CM_ SG_ 981 ESP_a059_ReLWSSNoPulsesDetected "Electronic stability control: a059 re LWSS no pulses detected";
CM_ SG_ 981 ESP_a060_ReLWSSWrongSensorType "Electronic stability control: a060 re LWSS wrong sensor type";
CM_ SG_ 981 ESP_a061_ReLWSSSignalNoise "Electronic stability control: a061 re LWSS signal noise";
CM_ SG_ 981 ESP_a062_ReLWSSVDiffFault "Electronic stability control: a062 re LWSSV diff fault";
CM_ SG_ 981 ESP_a063_ReLWSSDirectionFault "Electronic stability control: a063 re LWSS direction fault";
CM_ SG_ 981 ESP_a064_ReLWSSLargeAirGap "Electronic stability control: a064 re LWSS large air gap";
CM_ SG_ 981 ESP_a065_ReLWSSSupplyShortToGnd "Electronic stability control: a065 re LWSS supply short to gnd";
CM_ SG_ 981 ESP_a066_ReLWSSGeneralFault "Electronic stability control: a066 re LWSS general fault";
CM_ SG_ 981 ESP_a067_ReRWSSOpenOrShortToGnd "Electronic stability control: a067 re RWSS open or short to gnd";
CM_ SG_ 981 ESP_a068_ReRWSSShortTo12V "Electronic stability control: a068 re RWSS short to12 v";
CM_ SG_ 981 ESP_a069_ReRWSSLineInterruption "Electronic stability control: a069 re RWSS line interruption";
CM_ SG_ 981 ESP_a070_ReRWSSMaxSpeedExceeded "Electronic stability control: a070 re RWSS max speed exceeded";
CM_ SG_ 981 ESP_a071_ReRWSSTooManyPulses "Electronic stability control: a071 re RWSS too many pulses";
CM_ SG_ 981 ESP_a072_ReRWSSLostSignal "Electronic stability control: a072 re RWSS lost signal";
CM_ SG_ 981 ESP_a073_ReRWSSNoPulsesDetected "Electronic stability control: a073 re RWSS no pulses detected";
CM_ SG_ 981 ESP_a074_ReRWSSWrongSensorType "Electronic stability control: a074 re RWSS wrong sensor type";
CM_ SG_ 981 ESP_a075_ReRWSSSignalNoise "Electronic stability control: a075 re RWSS signal noise";
CM_ SG_ 981 ESP_a076_ReRWSSVDiffFault "Electronic stability control: a076 re RWSSV diff fault";
CM_ SG_ 981 ESP_a077_ReRWSSDirectionFault "Electronic stability control: a077 re RWSS direction fault";
CM_ SG_ 981 ESP_a078_ReRWSSLargeAirGap "Electronic stability control: a078 re RWSS large air gap";
CM_ SG_ 981 ESP_a079_ReRWSSSupplyShortToGnd "Electronic stability control: a079 re RWSS supply short to gnd";
CM_ SG_ 981 ESP_a080_ReRWSSGeneralFault "Electronic stability control: a080 re RWSS general fault";
CM_ SG_ 981 ESP_a081_PressureSensorShort "Electronic stability control: a081 pressure sensor short";
CM_ SG_ 981 ESP_a082_PMCSensorOffsetHigh "Electronic stability control: a082 PMC sensor offset high";
CM_ SG_ 981 ESP_a083_PMCSensorFault "Electronic stability control: a083 PMC sensor fault";
CM_ SG_ 981 ESP_a084_BrakeFluidReservoirLow "Electronic stability control: a084 brake fluid reservoir low";
CM_ SG_ 981 ESP_a085_BrakeSwitchStuckHigh "Electronic stability control: a085 brake switch stuck high";
CM_ SG_ 981 ESP_a086_BrakeSwitchImplausible1 "Electronic stability control: a086 brake switch implausible1";
CM_ SG_ 981 ESP_a087_BrakeSwitchImplausible3 "Electronic stability control: a087 brake switch implausible3";
CM_ SG_ 981 ESP_a088_absContinuousControl "Electronic stability control: a088 abs continuous control";
CM_ SG_ 981 ESP_a089_absNoPressureIncrease "Electronic stability control: a089 abs no pressure increase";
CM_ SG_ 981 ESP_a090_vdcContinuousControl "Electronic stability control: a090 vdc continuous control";
CM_ SG_ 981 ESP_a091_CANUndervoltage "Electronic stability control: a091 CAN undervoltage";
CM_ SG_ 981 ESP_a092_CANOvervoltage "Electronic stability control: a092 CAN overvoltage";
CM_ SG_ 981 ESP_a093_partyBusOff "Electronic stability control: a093 party bus off";
CM_ SG_ 981 ESP_a094_partyBusPassive "Electronic stability control: a094 party bus passive";
CM_ SG_ 981 ESP_a095_chassisBusOff "Electronic stability control: a095 chassis bus off";
CM_ SG_ 981 ESP_a096_chassisBusPassive "Electronic stability control: a096 chassis bus passive";
CM_ SG_ 981 ESP_a097_tcsRefSpeedNotInit "Electronic stability control: a097 tcs ref speed not init";
CM_ SG_ 981 ESP_a098_vdcRefSpeedNotInit "Electronic stability control: a098 vdc ref speed not init";
CM_ SG_ 981 ESP_a099_brakeTempModelOverheat "Electronic stability control: a099 brake temp model overheat";
CM_ SG_ 981 ESP_a100_brakeTempModelDisabled "Electronic stability control: a100 brake temp model disabled";
CM_ SG_ 981 ESP_a101_ebdFault "Electronic stability control: a101 ebd fault";
CM_ SG_ 981 ESP_a102_absFault "Electronic stability control: a102 abs fault";
CM_ SG_ 981 ESP_a103_stabilityControlFault "Electronic stability control: a103 stability control fault";
CM_ SG_ 981 ESP_a104_hbcEnabled "Electronic stability control: a104 hbc enabled";
CM_ SG_ 981 ESP_a105_ebrFault "Electronic stability control: a105 ebr fault";
CM_ SG_ 981 ESP_a106_vdcActuatorFault "Electronic stability control: a106 vdc actuator fault";
CM_ SG_ 981 ESP_a107_reserved107 "Electronic stability control: a107 reserved107";
CM_ SG_ 981 ESP_a108_reserved108 "Electronic stability control: a108 reserved108";
CM_ SG_ 981 ESP_a109_reserved109 "Electronic stability control: a109 reserved109";
CM_ SG_ 981 ESP_a110_rollerBenchActive "Electronic stability control: a110 roller bench active";
CM_ SG_ 981 ESP_a111_absActive "Electronic stability control: a111 abs active";
CM_ SG_ 981 ESP_a112_espActive "Electronic stability control: a112 esp active";
CM_ SG_ 981 ESP_a113_btcActive "Electronic stability control: a113 btc active";
CM_ SG_ 981 ESP_a114_tvdcActive "Electronic stability control: a114 tvdc active";
CM_ SG_ 981 ESP_a115_ebdActive "Electronic stability control: a115 ebd active";
CM_ SG_ 981 ESP_a116_tsmActive "Electronic stability control: a116 tsm active";
CM_ SG_ 981 ESP_a117_hbaActive "Electronic stability control: a117 hba active";
CM_ SG_ 981 ESP_a118_hfcActive "Electronic stability control: a118 hfc active";
CM_ SG_ 981 ESP_a119_hbbActive "Electronic stability control: a119 hbb active";
CM_ SG_ 981 ESP_a120_rmiActive "Electronic stability control: a120 rmi active";
CM_ SG_ 981 ESP_a121_regenTcActive "Electronic stability control: a121 regen tc active";
CM_ SG_ 981 ESP_a122_bdwActive "Electronic stability control: a122 bdw active";
CM_ SG_ 981 ESP_a123_ebrActive "Electronic stability control: a123 ebr active";
CM_ SG_ 981 ESP_a124_ebrSkidActive "Electronic stability control: a124 ebr skid active";
CM_ SG_ 981 ESP_a125_reserved125 "Electronic stability control: a125 reserved125";
CM_ SG_ 981 ESP_a126_reserved126 "Electronic stability control: a126 reserved126";
CM_ SG_ 981 ESP_a127_reserved127 "Electronic stability control: a127 reserved127";
CM_ SG_ 981 ESP_a128_reserved128 "Electronic stability control: a128 reserved128";
CM_ SG_ 981 ESP_a129_reserved129 "Electronic stability control: a129 reserved129";
CM_ SG_ 981 ESP_a130_EPAS3PsysStatusTimeout "Electronic stability control: a130 EPAS3 psys status timeout";
CM_ SG_ 981 ESP_a131_EPAS3PsysStatusDLC "Electronic stability control: a131 EPAS3 psys status DLC";
CM_ SG_ 981 ESP_a132_EPAS3PsysStatusChecksum "Electronic stability control: a132 EPAS3 psys status checksum";
CM_ SG_ 981 ESP_a133_EPAS3PsysStatusCounter "Electronic stability control: a133 EPAS3 psys status counter";
CM_ SG_ 981 ESP_a134_steeringAngleInvalid "Electronic stability control: a134 steering angle invalid";
CM_ SG_ 981 ESP_a135_steeringAngleNoCenter "Electronic stability control: a135 steering angle no center";
CM_ SG_ 981 ESP_a136_steeringAngleFrozen "Electronic stability control: a136 steering angle frozen";
CM_ SG_ 981 ESP_a137_steeringOffsetTooLarge "Electronic stability control: a137 steering offset too large";
CM_ SG_ 981 ESP_a138_steeringAngleImplaus "Electronic stability control: a138 steering angle implaus";
CM_ SG_ 981 ESP_a139_steeringAngleWrongSign "Electronic stability control: a139 steering angle wrong sign";
CM_ SG_ 981 ESP_a140_RCMInertial1Timeout "Electronic stability control: a140 RCM inertial1 timeout";
CM_ SG_ 981 ESP_a141_RCMInertial1DLC "Electronic stability control: a141 RCM inertial1 DLC";
CM_ SG_ 981 ESP_a142_RCMInertial1Checksum "Electronic stability control: a142 RCM inertial1 checksum";
CM_ SG_ 981 ESP_a143_RCMInertial1Counter "Electronic stability control: a143 RCM inertial1 counter";
CM_ SG_ 981 ESP_a144_yawMaxLatency "Electronic stability control: a144 yaw max latency";
CM_ SG_ 981 ESP_a145_yawInitFault "Electronic stability control: a145 yaw init fault";
CM_ SG_ 981 ESP_a146_yawInvalidValue "Electronic stability control: a146 yaw invalid value";
CM_ SG_ 981 ESP_a147_yawSensorNotAvailable "Electronic stability control: a147 yaw sensor not available";
CM_ SG_ 981 ESP_a148_yawSignalFault "Electronic stability control: a148 yaw signal fault";
CM_ SG_ 981 ESP_a149_yawInvalidSign "Electronic stability control: a149 yaw invalid sign";
CM_ SG_ 981 ESP_a150_yawImplausible "Electronic stability control: a150 yaw implausible";
CM_ SG_ 981 ESP_a151_RCMInertial2Timeout "Electronic stability control: a151 RCM inertial2 timeout";
CM_ SG_ 981 ESP_a152_RCMInertial2DLC "Electronic stability control: a152 RCM inertial2 DLC";
CM_ SG_ 981 ESP_a153_RCMInertial2Checksum "Electronic stability control: a153 RCM inertial2 checksum";
CM_ SG_ 981 ESP_a154_RCMInertial2Counter "Electronic stability control: a154 RCM inertial2 counter";
CM_ SG_ 981 ESP_a155_ayMaxLatency "Electronic stability control: a155 ay max latency";
CM_ SG_ 981 ESP_a156_ayInitFault "Electronic stability control: a156 ay init fault";
CM_ SG_ 981 ESP_a157_ayInvalidValue "Electronic stability control: a157 ay invalid value";
CM_ SG_ 981 ESP_a158_aySensorNotAvailable "Electronic stability control: a158 ay sensor not available";
CM_ SG_ 981 ESP_a159_aySignalFault "Electronic stability control: a159 ay signal fault";
CM_ SG_ 981 ESP_a160_ayRangeExceeded "Electronic stability control: a160 ay range exceeded";
CM_ SG_ 981 ESP_a161_ayOffsetExceeded "Electronic stability control: a161 ay offset exceeded";
CM_ SG_ 981 ESP_a162_ayImplausible "Electronic stability control: a162 ay implausible";
CM_ SG_ 981 ESP_a163_axMaxLatency "Electronic stability control: a163 ax max latency";
CM_ SG_ 981 ESP_a164_axInitFault "Electronic stability control: a164 ax init fault";
CM_ SG_ 981 ESP_a165_axInvalidValue "Electronic stability control: a165 ax invalid value";
CM_ SG_ 981 ESP_a166_axSensorNotAvailable "Electronic stability control: a166 ax sensor not available";
CM_ SG_ 981 ESP_a167_axSignalFault "Electronic stability control: a167 ax signal fault";
CM_ SG_ 981 ESP_a168_axRangeExceeded "Electronic stability control: a168 ax range exceeded";
CM_ SG_ 981 ESP_a169_axOffsetExceeded "Electronic stability control: a169 ax offset exceeded";
CM_ SG_ 981 ESP_a170_axSignalFrozen "Electronic stability control: a170 ax signal frozen";
CM_ SG_ 981 ESP_a171_axImplausible "Electronic stability control: a171 ax implausible";
CM_ SG_ 981 ESP_a172_IBSTparty1Timeout "Electronic stability control: a172 IBS tparty1 timeout";
CM_ SG_ 981 ESP_a173_IBSTparty1DLC "Electronic stability control: a173 IBS tparty1 DLC";
CM_ SG_ 981 ESP_a174_IBSTparty1Checksum "Electronic stability control: a174 IBS tparty1 checksum";
CM_ SG_ 981 ESP_a175_IBSTparty1Counter "Electronic stability control: a175 IBS tparty1 counter";
CM_ SG_ 981 ESP_a176_IBSTEBRNotAvailable "Electronic stability control: a176 IBSTEBR not available";
CM_ SG_ 981 ESP_a177_IBSTOutputRodDrvInvalid "Electronic stability control: a177 IBST output rod drv invalid";
CM_ SG_ 981 ESP_a178_IBSTOutputRodActInvalid "Electronic stability control: a178 IBST output rod act invalid";
CM_ SG_ 981 ESP_a179_IBSTparty2Timeout "Electronic stability control: a179 IBS tparty2 timeout";
CM_ SG_ 981 ESP_a180_IBSTparty2Checksum "Electronic stability control: a180 IBS tparty2 checksum";
CM_ SG_ 981 ESP_a181_IBSTparty2DLC "Electronic stability control: a181 IBS tparty2 DLC";
CM_ SG_ 981 ESP_a182_IBSTparty2Counter "Electronic stability control: a182 IBS tparty2 counter";
CM_ SG_ 981 ESP_a183_IBSTStatusOff "Electronic stability control: a183 IBST status off";
CM_ SG_ 981 ESP_a184_IBSTpRunoutInvalid "Electronic stability control: a184 IBS tp runout invalid";
CM_ SG_ 981 ESP_a185_IBSTFeedforwardBackup "Electronic stability control: a185 IBST feedforward backup";
CM_ SG_ 981 ESP_a186_IBSTBrakeAppliedInvalid "Electronic stability control: a186 IBST brake applied invalid";
CM_ SG_ 981 ESP_a187_DIbtcRequestTimeout "Electronic stability control: a187 d ibtc request timeout";
CM_ SG_ 981 ESP_a188_DIbtcRequestDLC "Electronic stability control: a188 d ibtc request DLC";
CM_ SG_ 981 ESP_a189_DIbtcRequestChecksum "Electronic stability control: a189 d ibtc request checksum";
CM_ SG_ 981 ESP_a190_DIbtcRequestCounter "Electronic stability control: a190 d ibtc request counter";
CM_ SG_ 981 ESP_a191_DIchassisControlTimeout "Electronic stability control: a191 d ichassis control timeout";
CM_ SG_ 981 ESP_a192_DIchassisControlDLC "Electronic stability control: a192 d ichassis control DLC";
CM_ SG_ 981 ESP_a193_DIchassisControlChecksu "Electronic stability control: a193 d ichassis control checksum";
CM_ SG_ 981 ESP_a194_DIchassisControlCounter "Electronic stability control: a194 d ichassis control counter";
CM_ SG_ 981 ESP_a195_ptcStateInvalid "Electronic stability control: a195 ptc state invalid";
CM_ SG_ 981 ESP_a196_DIsystemStatusTimeout "Electronic stability control: a196 d isystem status timeout";
CM_ SG_ 981 ESP_a197_DIsystemStatusDLC "Electronic stability control: a197 d isystem status DLC";
CM_ SG_ 981 ESP_a198_DIsystemStatusChecksum "Electronic stability control: a198 d isystem status checksum";
CM_ SG_ 981 ESP_a199_DIsystemStatusCounter "Electronic stability control: a199 d isystem status counter";
CM_ SG_ 981 ESP_a200_reverseGearStuckHigh "Electronic stability control: a200 reverse gear stuck high";
CM_ SG_ 981 ESP_a201_reverseGearStuckLow "Electronic stability control: a201 reverse gear stuck low";
CM_ SG_ 981 ESP_a202_accelPedalInvalid "Electronic stability control: a202 accel pedal invalid";
CM_ SG_ 981 ESP_a203_DItorqueTimeout "Electronic stability control: a203 d itorque timeout";
CM_ SG_ 981 ESP_a204_DItorqueDLC "Electronic stability control: a204 d itorque DLC";
CM_ SG_ 981 ESP_a205_DItorqueChecksum "Electronic stability control: a205 d itorque checksum";
CM_ SG_ 981 ESP_a206_DItorqueCounter "Electronic stability control: a206 d itorque counter";
CM_ SG_ 981 ESP_a207_DITorqueCommandInvalid "Electronic stability control: a207 DI torque command invalid";
CM_ SG_ 981 ESP_a208_DIRPMInvalid "Electronic stability control: a208 DIRPM invalid";
CM_ SG_ 981 ESP_a209_DITorqueActualInvalid "Electronic stability control: a209 DI torque actual invalid";
CM_ SG_ 981 ESP_a210_DIStorqueTimeout "Electronic stability control: a210 DI storque timeout";
CM_ SG_ 981 ESP_a211_DIStorqueDLC "Electronic stability control: a211 DI storque DLC";
CM_ SG_ 981 ESP_a212_DIStorqueChecksum "Electronic stability control: a212 DI storque checksum";
CM_ SG_ 981 ESP_a213_DIStorqueCounter "Electronic stability control: a213 DI storque counter";
CM_ SG_ 981 ESP_a214_DISTorqueCommandInvalid "Electronic stability control: a214 DIS torque command invalid";
CM_ SG_ 981 ESP_a215_DISRPMInvalid "Electronic stability control: a215 DISRPM invalid";
CM_ SG_ 981 ESP_a216_DISTorqueActualInvalid "Electronic stability control: a216 DIS torque actual invalid";
CM_ SG_ 981 ESP_a217_DIvdcLeftTimeout "Electronic stability control: a217 d ivdc left timeout";
CM_ SG_ 981 ESP_a218_DIvdcLeftDLC "Electronic stability control: a218 d ivdc left DLC";
CM_ SG_ 981 ESP_a219_DIvdcLeftChecksum "Electronic stability control: a219 d ivdc left checksum";
CM_ SG_ 981 ESP_a220_DIvdcLeftCounter "Electronic stability control: a220 d ivdc left counter";
CM_ SG_ 981 ESP_a221_DIvdcRightTimeout "Electronic stability control: a221 d ivdc right timeout";
CM_ SG_ 981 ESP_a222_DIvdcRightDLC "Electronic stability control: a222 d ivdc right DLC";
CM_ SG_ 981 ESP_a223_DIvdcRightChecksum "Electronic stability control: a223 d ivdc right checksum";
CM_ SG_ 981 ESP_a224_DIvdcRightCounter "Electronic stability control: a224 d ivdc right counter";
CM_ SG_ 981 ESP_a225_configMismatch "Electronic stability control: a225 config mismatch";
CM_ SG_ 981 ESP_a226_bdwRequestInvalid "Electronic stability control: a226 bdw request invalid";
CM_ SG_ 981 ESP_a227_bdwRequestActiveInvalid "Electronic stability control: a227 bdw request active invalid";
CM_ SG_ 981 ESP_a228_GTWvinTimeout "Electronic stability control: a228 GT wvin timeout";
CM_ SG_ 981 ESP_a229_GTWvinDLC "Electronic stability control: a229 GT wvin DLC";
CM_ SG_ 981 ESP_a230_vinNotLearned "Electronic stability control: a230 vin not learned";
CM_ SG_ 981 ESP_a231_storedVINMismatch "Electronic stability control: a231 stored VIN mismatch";
CM_ SG_ 981 ESP_a232_PMstate2Timeout "Electronic stability control: a232 p mstate2 timeout";
CM_ SG_ 981 ESP_a233_PMstate2Checksum "Electronic stability control: a233 p mstate2 checksum";
CM_ SG_ 981 ESP_a234_PMstate2DLC "Electronic stability control: a234 p mstate2 DLC";
CM_ SG_ 981 ESP_a235_PMstate2Counter "Electronic stability control: a235 p mstate2 counter";
CM_ SG_ 981 ESP_a236_ebrCommandStateInvalid "Electronic stability control: a236 ebr command state invalid";
CM_ SG_ 981 ESP_a237_vdcCommandStateInvalid "Electronic stability control: a237 vdc command state invalid";
CM_ SG_ 981 ESP_a238_UIodoTimeout "Electronic stability control: a238 u iodo timeout";
CM_ SG_ 981 ESP_a239_UIodoDLC "Electronic stability control: a239 u iodo DLC";
CM_ SG_ 981 ESP_a240_LVPowerStateTimeout "Electronic stability control: a240 LV power state timeout";
CM_ SG_ 981 ESP_a241_LVPowerStateChecksum "Electronic stability control: a241 LV power state checksum";
CM_ SG_ 981 ESP_a242_LVPowerStateDLC "Electronic stability control: a242 LV power state DLC";
CM_ SG_ 981 ESP_a243_LVPowerStateCounter "Electronic stability control: a243 LV power state counter";
CM_ SG_ 981 ESP_a244_LVOffStateInvalid "Electronic stability control: a244 LV off state invalid";
CM_ SG_ 981 ESP_a245_LVGoingDownStateInvalid "Electronic stability control: a245 LV going down state invalid";
CM_ SG_ 981 ESP_a246_VCFRONTsensorTimeout "Electronic stability control: a246 VCFRON tsensor timeout";
CM_ SG_ 981 ESP_a247_VCFRONTsensorDLC "Electronic stability control: a247 VCFRON tsensor DLC";
CM_ SG_ 981 ESP_a248_vdcBrkeTrqTarFrLInvalid "Electronic stability control: a248 vdc brke trq tar fr l invalid";
CM_ SG_ 981 ESP_a249_vdcBrkeTrqTarFrRInvalid "Electronic stability control: a249 vdc brke trq tar fr r invalid";
CM_ SG_ 981 ESP_a250_vdcBrkeTrqTarReLInvalid "Electronic stability control: a250 vdc brke trq tar re l invalid";
CM_ SG_ 981 ESP_a251_vdcBrkeTrqTarReRInvalid "Electronic stability control: a251 vdc brke trq tar re r invalid";
CM_ SG_ 981 ESP_a252_vdcWhlSlipLimFrLInvalid "Electronic stability control: a252 vdc whl slip lim fr l invalid";
CM_ SG_ 981 ESP_a253_vdcWhlSlipLimFrRInvalid "Electronic stability control: a253 vdc whl slip lim fr r invalid";
CM_ SG_ 981 ESP_a254_vdcWhlSlipLimReLInvalid "Electronic stability control: a254 vdc whl slip lim re l invalid";
CM_ SG_ 981 ESP_a255_vdcWhlSlipLimReRInvalid "Electronic stability control: a255 vdc whl slip lim re r invalid";
CM_ SG_ 981 ESP_a256_epbmStatusTimeout "Electronic stability control: a256 epbm status timeout";
CM_ SG_ 981 ESP_a257_epbmStatusChecksum "Electronic stability control: a257 epbm status checksum";
CM_ SG_ 981 ESP_a258_epbmStatusDLC "Electronic stability control: a258 epbm status DLC";
CM_ SG_ 981 ESP_a259_epbmStatusCounter "Electronic stability control: a259 epbm status counter";
CM_ SG_ 981 ESP_a260_epblStatusTimeout "Electronic stability control: a260 epbl status timeout";
CM_ SG_ 981 ESP_a261_epblStatusChecksum "Electronic stability control: a261 epbl status checksum";
CM_ SG_ 981 ESP_a262_epblStatusDLC "Electronic stability control: a262 epbl status DLC";
CM_ SG_ 981 ESP_a263_epblStatusCounter "Electronic stability control: a263 epbl status counter";
CM_ SG_ 981 ESP_a264_pumpSpeedLimitInvalid "Electronic stability control: a264 pump speed limit invalid";
CM_ SG_ 981 ESP_a265_DIRELtorqueTimeout "Electronic stability control: a265 DIRE ltorque timeout";
CM_ SG_ 981 ESP_a266_DIRELtorqueDLC "Electronic stability control: a266 DIRE ltorque DLC";
CM_ SG_ 981 ESP_a267_DIRELtorqueChecksum "Electronic stability control: a267 DIRE ltorque checksum";
CM_ SG_ 981 ESP_a268_DIRELtorqueCounter "Electronic stability control: a268 DIRE ltorque counter";
CM_ SG_ 981 ESP_a269_DIRELTorqueCommandInval "Electronic stability control: a269 DIREL torque command invalid";
CM_ SG_ 981 ESP_a270_DIRELRPMInvalid "Electronic stability control: a270 DIRELRPM invalid";
CM_ SG_ 981 ESP_a271_DIRELTorqueActualInvali "Electronic stability control: a271 DIREL torque actual invalid";
CM_ SG_ 981 ESP_a272_DIRERtorqueTimeout "Electronic stability control: a272 DIRE rtorque timeout";
CM_ SG_ 981 ESP_a273_DIRERtorqueDLC "Electronic stability control: a273 DIRE rtorque DLC";
CM_ SG_ 981 ESP_a274_DIRERtorqueChecksum "Electronic stability control: a274 DIRE rtorque checksum";
CM_ SG_ 981 ESP_a275_DIRERtorqueCounter "Electronic stability control: a275 DIRE rtorque counter";
CM_ SG_ 981 ESP_a276_DIRERTorqueCommandInval "Electronic stability control: a276 DIRER torque command invalid";
CM_ SG_ 981 ESP_a277_DIRERRPMInvalid "Electronic stability control: a277 DIRERRPM invalid";
CM_ SG_ 981 ESP_a278_DIRERTorqueActualInvali "Electronic stability control: a278 DIRER torque actual invalid";
CM_ SG_ 981 ESP_a279_lifetimeManagementOverr "Electronic stability control: a279 lifetime management overrun";
CM_ SG_ 981 ESP_a280_trackModeABSEnabled "Electronic stability control: a280 track mode ABS enabled";
CM_ SG_ 981 ESP_a281_trackModeABSdisabled "Electronic stability control: a281 track mode AB sdisabled";
CM_ SG_ 981 ESP_a282_trackModeABSRequestInva "Electronic stability control: a282 track mode ABS request invalid";
CM_ SG_ 981 ESP_a283_secondaryCollisionMitig "Electronic stability control: a283 secondary collision mitigation active";
CM_ SG_ 981 ESP_a284_scmRequestInvalidChecks "Electronic stability control: a284 scm request invalid checksum";
CM_ SG_ 981 ESP_a285_scmRequestDLC "Electronic stability control: a285 scm request DLC";
CM_ SG_ 981 ESP_a286_hydroplaneDetected "Electronic stability control: a286 hydroplane detected";
CM_ SG_ 981 ESP_a287_failedBrakeCircuitDetec "Electronic stability control: a287 failed brake circuit detected";
CM_ SG_ 981 ESP_a288_leftBusOff "Electronic stability control: a288 left bus off";
CM_ SG_ 981 ESP_a289_leftBusPassive "Electronic stability control: a289 left bus passive";
CM_ SG_ 981 ESP_a290_brakeBusOff "Electronic stability control: a290 brake bus off";
CM_ SG_ 981 ESP_a291_brakeBusPassive "Electronic stability control: a291 brake bus passive";
CM_ SG_ 981 ESP_a292_PEPSstatusTimeout "Electronic stability control: a292 PEP sstatus timeout";
CM_ SG_ 981 ESP_a293_PEPSstatusDLC "Electronic stability control: a293 PEP sstatus DLC";
CM_ SG_ 981 ESP_a294_PEPSstatusChecksum "Electronic stability control: a294 PEP sstatus checksum";
CM_ SG_ 981 ESP_a295_PEPSstatusCounter "Electronic stability control: a295 PEP sstatus counter";
CM_ SG_ 981 ESP_a296_roadWheelAngleHealthDeg "Electronic stability control: a296 road wheel angle health degraded";
CM_ SG_ 981 ESP_a297_roadWheelAngleHealthFau "Electronic stability control: a297 road wheel angle health faulted";
CM_ SG_ 981 ESP_a298_RSArearSteerStatusTimeo "Electronic stability control: a298 RS arear steer status timeout";
CM_ SG_ 981 ESP_a299_RSArearSteerStatusDLC "Electronic stability control: a299 RS arear steer status DLC";
CM_ SG_ 981 ESP_a300_RSArearSteerStatusCheck "Electronic stability control: a300 RS arear steer status checksum";
CM_ SG_ 981 ESP_a301_PEPSstatusCounter "Electronic stability control: a301 PEP sstatus counter";
CM_ SG_ 981 ESP_a302_rearRoadWheelAngleHealt "Electronic stability control: a302 rear road wheel angle health degraded";
CM_ SG_ 981 ESP_a303_rearRoadWheelAngleHealt "Electronic stability control: a303 rear road wheel angle health faulted";
CM_ SG_ 981 ESP_a304_rearVCLVPowerStateTimeo "Electronic stability control: a304 rear VCLV power state timeout";
CM_ SG_ 981 ESP_a305_rearVCLVPowerStateDLC "Electronic stability control: a305 rear VCLV power state DLC";
CM_ SG_ 981 ESP_a306_rearVCLVPowerStateCheck "Electronic stability control: a306 rear VCLV power state checksum";
CM_ SG_ 981 ESP_a307_rearVCLVPowerStateCount "Electronic stability control: a307 rear VCLV power state counter";
CM_ SG_ 981 ESP_a308_evacFillNotComplete "Electronic stability control: a308 evac fill not complete";
CM_ SG_ 981 ESP_a309_factoryModeActive "Electronic stability control: a309 factory mode active";
CM_ SG_ 981 ESP_a310_brakeLatencyReductionAc "Electronic stability control: a310 brake latency reduction active";
CM_ SG_ 981 ESP_a311_aesActive "Electronic stability control: a311 aes active";
CM_ SG_ 981 ESP_a312_undefinedAlertDetected "Electronic stability control: a312 undefined alert detected";
CM_ SG_ 981 ESP_a313_cdpRequestStateInvalid "Electronic stability control: a313 cdp request state invalid";
CM_ SG_ 981 ESP_a314_aesFault "Electronic stability control: a314 aes fault";
CM_ SG_ 981 ESP_a315_EMCBackup11Timeout "Electronic stability control: a315 EMC backup11 timeout";
CM_ SG_ 981 ESP_a316_EMCBackup11DLC "Electronic stability control: a316 EMC backup11 DLC";
CM_ SG_ 981 ESP_a317_EMCBackup11Checksum "Electronic stability control: a317 EMC backup11 checksum";
CM_ SG_ 981 ESP_a318_EMCBackup11Counter "Electronic stability control: a318 EMC backup11 counter";
CM_ SG_ 981 ESP_a319_AES_BackupActuatorActiv "Electronic stability control: a319 AES backup actuator active";
CM_ SG_ 981 ESP_a320_DPB_actuator1Counter "Electronic stability control: a320 DPB actuator1 counter";
CM_ SG_ 981 ESP_a321_DPB_actuator1Checksum "Electronic stability control: a321 DPB actuator1 checksum";
CM_ SG_ 981 ESP_a322_DPB_actuator1DLC "Electronic stability control: a322 DPB actuator1 DLC";
CM_ SG_ 981 ESP_a323_DPB_actuator1Timeout "Electronic stability control: a323 DPB actuator1 timeout";
CM_ SG_ 981 ESP_a324_DPB_actuator2Counter "Electronic stability control: a324 DPB actuator2 counter";
CM_ SG_ 981 ESP_a325_DPB_actuator2Checksum "Electronic stability control: a325 DPB actuator2 checksum";
CM_ SG_ 981 ESP_a326_DPB_actuator2DLC "Electronic stability control: a326 DPB actuator2 DLC";
CM_ SG_ 981 ESP_a327_DPB_actuator2Timeout "Electronic stability control: a327 DPB actuator2 timeout";
CM_ SG_ 981 ESP_a328_DPB_actuator3Counter "Electronic stability control: a328 DPB actuator3 counter";
CM_ SG_ 981 ESP_a329_DPB_actuator3Checksum "Electronic stability control: a329 DPB actuator3 checksum";
CM_ SG_ 981 ESP_a330_DPB_actuator3DLC "Electronic stability control: a330 DPB actuator3 DLC";
CM_ SG_ 981 ESP_a331_DPB_actuator3Timeout "Electronic stability control: a331 DPB actuator3 timeout";
CM_ SG_ 981 ESP_a332_PressureSensorValHigh "Electronic stability control: a332 pressure sensor val high";
CM_ SG_ 981 ESP_a333_ActCircuitNoPressure "Electronic stability control: a333 act circuit no pressure";
CM_ SG_ 981 ESP_a334_BrakePedalAppliedInvali "Electronic stability control: a334 brake pedal applied invalid";
CM_ SG_ 981 ESP_a335_LdmFxTarBrakeActInvalid "Electronic stability control: a335 ldm fx tar brake act invalid";
CM_ SG_ 981 ESP_a336_FxTargetDriverInvalid "Electronic stability control: a336 fx target driver invalid";
CM_ SG_ 981 ESP_a337_pReductionPotentialInva "Electronic stability control: a337 p reduction potential invalid";
CM_ SG_ 981 ESP_a338_pRunoutInvalid "Electronic stability control: a338 p runout invalid";
CM_ SG_ 981 ESP_a339_sInputRodInvalid "Electronic stability control: a339 s input rod invalid";
CM_ SG_ 981 ESP_a340_RollerBenchMisuse "Electronic stability control: a340 roller bench misuse";
CM_ SG_ 981 ESP_a341_EnhancedPressureBuildAc "Electronic stability control: a341 enhanced pressure build active";
CM_ SG_ 981 ESP_a342_EnhancedPressureBuildNo "Electronic stability control: a342 enhanced pressure build not available";
CM_ SG_ 981 ESP_a343_EnhancedPressureBuildLt "Electronic stability control: a343 enhanced pressure build ltm reached";
CM_ SG_ 981 ESP_a344_DIbrakeCommandCounter "Electronic stability control: a344 d ibrake command counter";
CM_ SG_ 981 ESP_a345_DIbrakeCommandChecksum "Electronic stability control: a345 d ibrake command checksum";
CM_ SG_ 981 ESP_a346_DIbrakeCommandDLC "Electronic stability control: a346 d ibrake command DLC";
CM_ SG_ 981 ESP_a347_DIbrakeCommandTimeout "Electronic stability control: a347 d ibrake command timeout";
CM_ SG_ 981 ESP_a348_brakeCmdStateInvalid "Electronic stability control: a348 brake cmd state invalid";
CM_ SG_ 981 ESP_a349_ForceLampToRed "Electronic stability control: a349 force lamp to red";
CM_ SG_ 981 ESP_a350_ActuatorOff "Electronic stability control: a350 actuator off";
CM_ SG_ 981 ESP_a351_ActuatorYellowLampReque "Electronic stability control: a351 actuator yellow lamp requested";
CM_ SG_ 981 ESP_a352_ActuatorLDMFailure "Electronic stability control: a352 actuator LDM failure";
CM_ SG_ 981 ESP_a353_PressureSensorImplausHi "Electronic stability control: a353 pressure sensor implaus high";
CM_ SG_ 981 ESP_a354_HBCRequestInvalid "Electronic stability control: a354 HBC request invalid";
CM_ SG_ 981 ESP_a355_RecuStatusActInvalid "Electronic stability control: a355 recu status act invalid";
CM_ SG_ 981 ESP_a356_DIFAxleTorqueInvalid "Electronic stability control: a356 DIF axle torque invalid";
CM_ SG_ 981 ESP_a357_DIRAxleTorqueInvalid "Electronic stability control: a357 DIR axle torque invalid";
CM_ SG_ 981 ESP_a358_externalActuatorFallbac "Electronic stability control: a358 external actuator fallback";
CM_ SG_ 981 ESP_a359_externalActuatorNoExtRe "Electronic stability control: a359 external actuator no ext req";
CM_ SG_ 981 ESP_a360_BBbrakeActuationTimeout "Electronic stability control: a360 b bbrake actuation timeout";
CM_ SG_ 981 ESP_a361_BBbrakeActuationDLC "Electronic stability control: a361 b bbrake actuation DLC";
CM_ SG_ 981 ESP_a362_BBbrakeActuationChecksu "Electronic stability control: a362 b bbrake actuation checksum";
CM_ SG_ 981 ESP_a363_BBbrakeActuationCounter "Electronic stability control: a363 b bbrake actuation counter";
CM_ SG_ 981 ESP_a364_DIgearInvalid "Electronic stability control: a364 d igear invalid";
CM_ SG_ 981 ESP_a365_TCSInputQualityTooLow "Electronic stability control: a365 TCS input quality too low";
CM_ SG_ 981 ESP_a366_ActuatorBlendingModeReq "Electronic stability control: a366 actuator blending mode req not available";
CM_ SG_ 981 ESP_a367_CBDS_fillBufferThreshol "Electronic stability control: a367 CBDS fill buffer threshold";
CM_ SG_ 981 ESP_a368_CBDS_fmeInternalEvent "Electronic stability control: a368 CBDS fme internal event";
CM_ SG_ 981 ESP_a369_LargeLeakageDetectedByD "Electronic stability control: a369 large leakage detected by DPB";
CM_ SG_ 981 ESP_a370_DPB_actuator4Timeout "Electronic stability control: a370 DPB actuator4 timeout";
CM_ SG_ 981 ESP_a371_DPB_actuator4DLC "Electronic stability control: a371 DPB actuator4 DLC";
CM_ SG_ 981 ESP_a372_DPB_actuator4Checksum "Electronic stability control: a372 DPB actuator4 checksum";
CM_ SG_ 981 ESP_a373_DPB_actuator4Counter "Electronic stability control: a373 DPB actuator4 counter";
CM_ SG_ 981 ESP_a374_StatInvalid_DI_FullSNA "Electronic stability control: a374 stat invalid DI full SNA";
CM_ SG_ 981 ESP_a375_PM_locStateCounter "Electronic stability control: a375 PM loc state counter";
CM_ SG_ 981 ESP_a376_PM_locStateChecksum "Electronic stability control: a376 PM loc state checksum";
CM_ SG_ 981 ESP_a377_PM_locStateDLC "Electronic stability control: a377 PM loc state DLC";
CM_ SG_ 981 ESP_a378_PM_locStateTimeout "Electronic stability control: a378 PM loc state timeout";
CM_ SG_ 981 ESP_a379_DASredundantBrakingCont "Electronic stability control: a379 DA sredundant braking control party checksum";
CM_ SG_ 981 ESP_a380_DASredundantBrakingCont "Electronic stability control: a380 DA sredundant braking control party counter";
CM_ SG_ 981 ESP_a381_DASredundantBrakingCont "Electronic stability control: a381 DA sredundant braking control party DLC";
CM_ SG_ 981 ESP_a382_DASredundantBrakingCont "Electronic stability control: a382 DA sredundant braking control party timeout";
CM_ SG_ 981 ESP_a383_DASredundantBrakingCont "Electronic stability control: a383 DA sredundant braking control chassis checksum";
CM_ SG_ 981 ESP_a384_DASredundantBrakingCont "Electronic stability control: a384 DA sredundant braking control chassis counter";
CM_ SG_ 981 ESP_a385_DASredundantBrakingCont "Electronic stability control: a385 DA sredundant braking control chassis DLC";
CM_ SG_ 981 ESP_a386_DASredundantBrakingCont "Electronic stability control: a386 DA sredundant braking control chassis timeout";
CM_ SG_ 981 ESP_a387_DIlocStatus2Checksum "Electronic stability control: a387 d iloc status2 checksum";
CM_ SG_ 981 ESP_a388_DIlocStatus2Counter "Electronic stability control: a388 d iloc status2 counter";
CM_ SG_ 981 ESP_a389_DIlocStatus2DLC "Electronic stability control: a389 d iloc status2 DLC";
CM_ SG_ 981 ESP_a390_DIlocStatus2Timeout "Electronic stability control: a390 d iloc status2 timeout";
CM_ SG_ 981 ESP_a391_standaloneEBRActive "Electronic stability control: a391 standalone EBR active";
CM_ SG_ 981 ESP_a392_driverlessArmingUnavail "Electronic stability control: a392 driverless arming unavailable";
CM_ SG_ 981 ESP_a393_EMCBackup21Checksum "Electronic stability control: a393 EMC backup21 checksum";
CM_ SG_ 981 ESP_a394_EMCBackup21Counter "Electronic stability control: a394 EMC backup21 counter";
CM_ SG_ 981 ESP_a395_EMCBackup21DLC "Electronic stability control: a395 EMC backup21 DLC";
CM_ SG_ 981 ESP_a396_EMCBackup21Timeout "Electronic stability control: a396 EMC backup21 timeout";
CM_ SG_ 981 ESP_a397_epbrStatusTimeout "Electronic stability control: a397 epbr status timeout";
CM_ SG_ 981 ESP_a398_epbrStatusChecksum "Electronic stability control: a398 epbr status checksum";
CM_ SG_ 981 ESP_a399_epbrStatusDLC "Electronic stability control: a399 epbr status DLC";
CM_ SG_ 981 ESP_a400_epbrStatusCounter "Electronic stability control: a400 epbr status counter";
CM_ SG_ 981 ESP_a401_bsmCircuitFailure "Electronic stability control: a401 bsm circuit failure";
CM_ SG_ 981 ESP_a402_bsmPtsPlausToPsTooHigh "Electronic stability control: a402 bsm pts plaus to ps too high";
CM_ SG_ 981 ESP_a403_batMotorVoltage "Electronic stability control: a403 bat motor voltage";
CM_ SG_ 981 ESP_a404_batPressureCircuit1 "Electronic stability control: a404 bat pressure circuit1";
CM_ SG_ 981 ESP_a405_batPressureCircuit2 "Electronic stability control: a405 bat pressure circuit2";
CM_ SG_ 981 ESP_a406_DIespActuatorTestTimeou "Electronic stability control: a406 d iesp actuator test timeout";
CM_ SG_ 981 ESP_a407_DIespActuatorTestChecks "Electronic stability control: a407 d iesp actuator test checksum";
CM_ SG_ 981 ESP_a408_DIespActuatorTestDLC "Electronic stability control: a408 d iesp actuator test DLC";
CM_ SG_ 981 ESP_a409_DIespActuatorTestCounte "Electronic stability control: a409 d iesp actuator test counter";
CM_ BO_ 805 "Electronic stability control message: info; frame length from the layout, not yet observed on a vehicle bus";
CM_ SG_ 805 ESP_infoIndex "Electronic stability control: info index";
CM_ SG_ 805 ESP_infoBuildType "Electronic stability control: info build type";
CM_ SG_ 805 ESP_vehFlashMode "Electronic stability control: veh flash mode";
CM_ SG_ 805 ESP_infoComponentID "Electronic stability control: info component ID";
CM_ SG_ 805 ESP_infoPcbaID "Electronic stability control: info pcba ID";
CM_ SG_ 805 ESP_infoAssemblyID "Electronic stability control: info assembly ID";
CM_ SG_ 805 ESP_infoUsageID "Electronic stability control: info usage ID";
CM_ SG_ 805 ESP_infoSubUsageID "Electronic stability control: info sub usage ID";
CM_ SG_ 805 ESP_infoApplicationCRC "Indicating the Application CRC value of firmware running in system.";
CM_ SG_ 805 ESP_infoVehicleVariant "Electronic stability control: info vehicle variant";
CM_ SG_ 805 ESP_infoSubcomponent1 "Electronic stability control: info subcomponent1";
CM_ SG_ 805 ESP_infoBootUdsProtoVersion "Electronic stability control: info boot uds proto version";
CM_ SG_ 805 ESP_infoBootloaderCRC "Electronic stability control: info bootloader CRC";
CM_ SG_ 805 ESP_infoVariantCRC "Indicating the Calibration CRC value of firmware running in system.";
CM_ BO_ 1621 "Electronic stability control message: uds response; frame length from the layout, not yet observed on a vehicle bus";
CM_ SG_ 1621 ESP_udsResponseData "Electronic stability control: uds response data";
CM_ BO_ 861 "Electric brake booster message: alert matrix; frame length from the layout, not yet observed on a vehicle bus";
CM_ SG_ 861 IBST_matrixIndex "Electric brake booster: matrix index";
CM_ SG_ 861 IBST_a001_microSupplyError "Electric brake booster: a001 micro supply error";
CM_ SG_ 861 IBST_a002_HWBISTError "Electric brake booster: a002 HWBIST error";
CM_ SG_ 861 IBST_a003_RAMFault "Electric brake booster: a003 RAM fault";
CM_ SG_ 861 IBST_a004_flashFault "Electric brake booster: a004 flash fault";
CM_ SG_ 861 IBST_a005_microSafetyFault "Electric brake booster: a005 micro safety fault";
CM_ SG_ 861 IBST_a006_microSafetyLogicFault "Electric brake booster: a006 micro safety logic fault";
CM_ SG_ 861 IBST_a007_RBCPUException "Electric brake booster: a007 RBCPU exception";
CM_ SG_ 861 IBST_a008_stackOverUnderFlow "Electric brake booster: a008 stack over under flow";
CM_ SG_ 861 IBST_a009_systemErrorHook "Electric brake booster: a009 system error hook";
CM_ SG_ 861 IBST_a010_OSErrorHook "Electric brake booster: a010 OS error hook";
CM_ SG_ 861 IBST_a011_systemTaskOverRun "Electric brake booster: a011 system task over run";
CM_ SG_ 861 IBST_a012_OSTaskSchemeError "Electric brake booster: a012 OS task scheme error";
CM_ SG_ 861 IBST_a013_systemTaskJitter "Electric brake booster: a013 system task jitter";
CM_ SG_ 861 IBST_a014_DMATransferError "Electric brake booster: a014 DMA transfer error";
CM_ SG_ 861 IBST_a015_asicOscillatorError "Electric brake booster: a015 asic oscillator error";
CM_ SG_ 861 IBST_a016_RBBLMShaftShiftError "Electric brake booster: a016 RBBLM shaft shift error";
CM_ SG_ 861 IBST_a017_assertionFault "Electric brake booster: a017 assertion fault";
CM_ SG_ 861 IBST_a018_unsupportedHW "Electric brake booster: a018 unsupported HW";
CM_ SG_ 861 IBST_a019_supplyASICInitFault "Electric brake booster: a019 supply ASIC init fault";
CM_ SG_ 861 IBST_a020_VPREU5VOutOfRange "Electric brake booster: a020 VPREU5 v out of range";
CM_ SG_ 861 IBST_a021_IREFOutOfRange "Electric brake booster: a021 IREF out of range";
CM_ SG_ 861 IBST_a022_U5VTestFault "Electric brake booster: a022 U5 v test fault";
CM_ SG_ 861 IBST_a023_U5VOutOfRange "Electric brake booster: a023 U5 v out of range";
CM_ SG_ 861 IBST_a024_chargePumpFault "Electric brake booster: a024 charge pump fault";
CM_ SG_ 861 IBST_a025_ecuClockTestFault "Electric brake booster: a025 ecu clock test fault";
CM_ SG_ 861 IBST_a026_ecuBistCmdTestFault "Electric brake booster: a026 ecu bist cmd test fault";
CM_ SG_ 861 IBST_a027_ecuFastWdTestFault "Electric brake booster: a027 ecu fast wd test fault";
CM_ SG_ 861 IBST_a028_ecuBistFaultCtrFault "Electric brake booster: a028 ecu bist fault ctr fault";
CM_ SG_ 861 IBST_a029_ecuErrpinCounterFault "Electric brake booster: a029 ecu errpin counter fault";
CM_ SG_ 861 IBST_a030_ecuEnableElLowFault "Electric brake booster: a030 ecu enable el low fault";
CM_ SG_ 861 IBST_a031_decoupleBitTestFault "Electric brake booster: a031 decouple bit test fault";
CM_ SG_ 861 IBST_a032_ecuEnableElHighFault "Electric brake booster: a032 ecu enable el high fault";
CM_ SG_ 861 IBST_a033_ecuWdStartuptestFault "Electric brake booster: a033 ecu wd startuptest fault";
CM_ SG_ 861 IBST_a034_ecuEnableHyHighFault "Electric brake booster: a034 ecu enable hy high fault";
CM_ SG_ 861 IBST_a035_ecuEnableHyLowFault "Electric brake booster: a035 ecu enable hy low fault";
CM_ SG_ 861 IBST_a036_MRGPathTestFault "Electric brake booster: a036 MRG path test fault";
CM_ SG_ 861 IBST_a037_ecuWdSContinuousError "Electric brake booster: a037 ecu wd s continuous error";
CM_ SG_ 861 IBST_a038_ecuEnContinuousError "Electric brake booster: a038 ecu en continuous error";
CM_ SG_ 861 IBST_a039_GTMRefFrequencyError "Electric brake booster: a039 GTM ref frequency error";
CM_ SG_ 861 IBST_a040_GTMTbuMonError "Electric brake booster: a040 GTM tbu mon error";
CM_ SG_ 861 IBST_a041_micAsicClkInError "Electric brake booster: a041 mic asic clk in error";
CM_ SG_ 861 IBST_a042_micAsicInitTestError "Electric brake booster: a042 mic asic init test error";
CM_ SG_ 861 IBST_a043_micSpiTransferError "Electric brake booster: a043 mic spi transfer error";
CM_ SG_ 861 IBST_a044_NvMEepromWIP "Electric brake booster: a044 nv m eeprom WIP";
CM_ SG_ 861 IBST_a045_WdhAsicWdErrorCntStuck "Electric brake booster: a045 wdh asic wd error cnt stuck";
CM_ SG_ 861 IBST_a046_WdhAsicWdErrorCntLimit "Electric brake booster: a046 wdh asic wd error cnt limit";
CM_ SG_ 861 IBST_a047_WdhAsicWdCmdMissing "Electric brake booster: a047 wdh asic wd cmd missing";
CM_ SG_ 861 IBST_a048_WdhSwBistConCnt "Electric brake booster: a048 wdh sw bist con cnt";
CM_ SG_ 861 IBST_a049_WdhTaskMonConCnt "Electric brake booster: a049 wdh task mon con cnt";
CM_ SG_ 861 IBST_a050_VPreExternalFeeding "Electric brake booster: a050 v pre external feeding";
CM_ SG_ 861 IBST_a051_ecuBandgap "Electric brake booster: a051 ecu bandgap";
CM_ SG_ 861 IBST_a052_AdcPinTest "Electric brake booster: a052 adc pin test";
CM_ SG_ 861 IBST_a053_AdcSelftestC5P "Electric brake booster: a053 adc selftest C5 p";
CM_ SG_ 861 IBST_a054_AdcPeripheralFault "Electric brake booster: a054 adc peripheral fault";
CM_ SG_ 861 IBST_a055_UB6SupplyPathFault "Electric brake booster: a055 UB6 supply path fault";
CM_ SG_ 861 IBST_a056_UB6PlausiMonFault "Electric brake booster: a056 UB6 plausi mon fault";
CM_ SG_ 861 IBST_a057_microRegisterFault "Electric brake booster: a057 micro register fault";
CM_ SG_ 861 IBST_a058_NvMWriteCycleExceed "Electric brake booster: a058 nv m write cycle exceed";
CM_ SG_ 861 IBST_a059_NvMEepromSize "Electric brake booster: a059 nv m eeprom size";
CM_ SG_ 861 IBST_a060_NvMMigrationFault "Electric brake booster: a060 nv m migration fault";
CM_ SG_ 861 IBST_a061_AswSystemTimeOut "Electric brake booster: a061 asw system time out";
CM_ SG_ 861 IBST_a062_MICB6TransferError "Electric brake booster: a062 MICB6 transfer error";
CM_ SG_ 861 IBST_a063_tempSens2ShortToSupply "Electric brake booster: a063 temp sens2 short to supply";
CM_ SG_ 861 IBST_a064_tempSens1ShortToGround "Electric brake booster: a064 temp sens1 short to ground";
CM_ SG_ 861 IBST_a065_tempSens2ShortToGround "Electric brake booster: a065 temp sens2 short to ground";
CM_ SG_ 861 IBST_a066_tempSens1ShortToSupply "Electric brake booster: a066 temp sens1 short to supply";
CM_ SG_ 861 IBST_a067_tempSensImplausVoltage "Electric brake booster: a067 temp sens implaus voltage";
CM_ SG_ 861 IBST_a068_chargePumpUndervoltage "Electric brake booster: a068 charge pump undervoltage";
CM_ SG_ 861 IBST_a069_greasingRoutineFault "Electric brake booster: a069 greasing routine fault";
CM_ SG_ 861 IBST_a070_notShutDownNvMWrite "Electric brake booster: a070 not shut down nv m write";
CM_ SG_ 861 IBST_a071_notShutDownNvMRead "Electric brake booster: a071 not shut down nv m read";
CM_ SG_ 861 IBST_a072_notShutDownRight "Electric brake booster: a072 not shut down right";
CM_ SG_ 861 IBST_a073_jumpInAdjustNvMRead "Electric brake booster: a073 jump in adjust nv m read";
CM_ SG_ 861 IBST_a074_FindIdleDataNvMWrite "Electric brake booster: a074 find idle data nv m write";
CM_ SG_ 861 IBST_a075_FindIdleRoutineFault "Electric brake booster: a075 find idle routine fault";
CM_ SG_ 861 IBST_a076_masterCylLengthRead "Electric brake booster: a076 master cyl length read";
CM_ SG_ 861 IBST_a077_runOutMotorSaturated "Electric brake booster: a077 run out motor saturated";
CM_ SG_ 861 IBST_a078_wearOffsetCompNVMRead "Electric brake booster: a078 wear offset comp NVM read";
CM_ SG_ 861 IBST_a079_motorTempHighLevel1 "Electric brake booster: a079 motor temp high level1";
CM_ SG_ 861 IBST_a080_motorTempHighLevel2 "Electric brake booster: a080 motor temp high level2";
CM_ SG_ 861 IBST_a081_travelDeviation "Electric brake booster: a081 travel deviation";
CM_ SG_ 861 IBST_a082_motorSpeedDeviation "Electric brake booster: a082 motor speed deviation";
CM_ SG_ 861 IBST_a083_spindlePositionTooHigh "Electric brake booster: a083 spindle position too high";
CM_ SG_ 861 IBST_a084_CANTransceiverHWFault "Electric brake booster: a084 CAN transceiver HW fault";
CM_ SG_ 861 IBST_a085_supplyUndervoltageLvl3 "Electric brake booster: a085 supply undervoltage lvl3";
CM_ SG_ 861 IBST_a086_supplyOvervoltageLvl3 "Electric brake booster: a086 supply overvoltage lvl3";
CM_ SG_ 861 IBST_a087_rotorSinOutOfRangeLow "Electric brake booster: a087 rotor sin out of range low";
CM_ SG_ 861 IBST_a088_rotorCosOutOfRangeLow "Electric brake booster: a088 rotor cos out of range low";
CM_ SG_ 861 IBST_a089_rotorSinOutOfRangeHigh "Electric brake booster: a089 rotor sin out of range high";
CM_ SG_ 861 IBST_a090_rotorCosOutOfRangeHigh "Electric brake booster: a090 rotor cos out of range high";
CM_ SG_ 861 IBST_a091_SMMOneRequestsInit "Electric brake booster: a091 SMM one requests init";
CM_ SG_ 861 IBST_a092_systemStartTimeOut "Electric brake booster: a092 system start time out";
CM_ SG_ 861 IBST_a093_UEXSOvertemperature "Electric brake booster: a093 UEXS overtemperature";
CM_ SG_ 861 IBST_a094_XPASSEchoTimeDeviation "Electric brake booster: a094 XPASS echo time deviation";
CM_ SG_ 861 IBST_a095_XPASSTimeOut "Electric brake booster: a095 XPASS time out";
CM_ SG_ 861 IBST_a096_bridgeDriverMonError "Electric brake booster: a096 bridge driver mon error";
CM_ SG_ 861 IBST_a097_bridgeDriverError "Electric brake booster: a097 bridge driver error";
CM_ SG_ 861 IBST_a098_bridgeShortedPhase "Electric brake booster: a098 bridge shorted phase";
CM_ SG_ 861 IBST_a099_bridgeSwitchInitError "Electric brake booster: a099 bridge switch init error";
CM_ SG_ 861 IBST_a100_current2OffsetHigh "Electric brake booster: a100 current2 offset high";
CM_ SG_ 861 IBST_a101_current2OffsetLow "Electric brake booster: a101 current2 offset low";
CM_ SG_ 861 IBST_a102_current1OffsetHigh "Electric brake booster: a102 current1 offset high";
CM_ SG_ 861 IBST_a103_current1OffsetLow "Electric brake booster: a103 current1 offset low";
CM_ SG_ 861 IBST_a104_bridgeDriverShort "Electric brake booster: a104 bridge driver short";
CM_ SG_ 861 IBST_a105_LiPSUndervoltage "Electric brake booster: a105 li PS undervoltage";
CM_ SG_ 861 IBST_a106_LiPS5VSupply "Electric brake booster: a106 li PS5 v supply";
CM_ SG_ 861 IBST_a107_LiPS2PwmLineHigh "Electric brake booster: a107 li PS2 pwm line high";
CM_ SG_ 861 IBST_a108_LiPS2PwmLineLow "Electric brake booster: a108 li PS2 pwm line low";
CM_ SG_ 861 IBST_a109_LiPS2PwmTransmission "Electric brake booster: a109 li PS2 pwm transmission";
CM_ SG_ 861 IBST_a110_LiPS1SentLineHigh "Electric brake booster: a110 li PS1 sent line high";
CM_ SG_ 861 IBST_a111_LiPS1SentLineLow "Electric brake booster: a111 li PS1 sent line low";
CM_ SG_ 861 IBST_a112_LiPS1SentTransmission "Electric brake booster: a112 li PS1 sent transmission";
CM_ SG_ 861 IBST_a113_LiPS1SentSensor "Electric brake booster: a113 li PS1 sent sensor";
CM_ SG_ 861 IBST_a114_partyBusOff "Electric brake booster: a114 party bus off";
CM_ SG_ 861 IBST_a115_chassisBusOff "Electric brake booster: a115 chassis bus off";
CM_ SG_ 861 IBST_a116_supplyUndervoltageLvl2 "Electric brake booster: a116 supply undervoltage lvl2";
CM_ SG_ 861 IBST_a117_supplyOvervoltageLvl2 "Electric brake booster: a117 supply overvoltage lvl2";
CM_ SG_ 861 IBST_a118_RPSNvMReadFault "Electric brake booster: a118 RPS nv m read fault";
CM_ SG_ 861 IBST_a119_RPSWrongCalibData "Electric brake booster: a119 RPS wrong calib data";
CM_ SG_ 861 IBST_a120_RPSVectorRangeHigh "Electric brake booster: a120 RPS vector range high";
CM_ SG_ 861 IBST_a121_RPSVectorRangeLow "Electric brake booster: a121 RPS vector range low";
CM_ SG_ 861 IBST_a122_RPSVectorOscillating "Electric brake booster: a122 RPS vector oscillating";
CM_ SG_ 861 IBST_a123_bridgeDriverUnavail "Electric brake booster: a123 bridge driver unavail";
CM_ SG_ 861 IBST_a124_OBDCurrent1OORHigh "Electric brake booster: a124 OBD current1 OOR high";
CM_ SG_ 861 IBST_a125_OBDCurrent2OORHigh "Electric brake booster: a125 OBD current2 OOR high";
CM_ SG_ 861 IBST_a126_OBDCurrent1OORLow "Electric brake booster: a126 OBD current1 OOR low";
CM_ SG_ 861 IBST_a127_OBDCurrent2OORLow "Electric brake booster: a127 OBD current2 OOR low";
CM_ SG_ 861 IBST_a128_BLMMuxerTimeoutError "Electric brake booster: a128 BLM muxer timeout error";
CM_ SG_ 861 IBST_a129_loadDumpOnFSLTest "Electric brake booster: a129 load dump on FSL test";
CM_ SG_ 861 IBST_a130_DTSFunctionalRangeLow "Electric brake booster: a130 DTS functional range low";
CM_ SG_ 861 IBST_a131_DTSFunctionalRangeHigh "Electric brake booster: a131 DTS functional range high";
CM_ SG_ 861 IBST_a132_DTSPlausiCheck1vs2 "Electric brake booster: a132 DTS plausi check1vs2";
CM_ SG_ 861 IBST_a133_DTSOffsetTooLow "Electric brake booster: a133 DTS offset too low";
CM_ SG_ 861 IBST_a134_DTSOffsetTooHigh "Electric brake booster: a134 DTS offset too high";
CM_ SG_ 861 IBST_a135_ESPparty1DLC "Electric brake booster: a135 ES pparty1 DLC";
CM_ SG_ 861 IBST_a136_ESPparty1Timeout "Electric brake booster: a136 ES pparty1 timeout";
CM_ SG_ 861 IBST_a137_ESPparty1Checksum "Electric brake booster: a137 ES pparty1 checksum";
CM_ SG_ 861 IBST_a138_ESPparty1Counter "Electric brake booster: a138 ES pparty1 counter";
CM_ SG_ 861 IBST_a139_ESPparty2DLC "Electric brake booster: a139 ES pparty2 DLC";
CM_ SG_ 861 IBST_a140_ESPparty2Timeout "Electric brake booster: a140 ES pparty2 timeout";
CM_ SG_ 861 IBST_a141_ESPparty2Checksum "Electric brake booster: a141 ES pparty2 checksum";
CM_ SG_ 861 IBST_a142_ESPparty2Counter "Electric brake booster: a142 ES pparty2 counter";
CM_ SG_ 861 IBST_a143_ESPparty3DLC "Electric brake booster: a143 ES pparty3 DLC";
CM_ SG_ 861 IBST_a144_ESPparty3Timeout "Electric brake booster: a144 ES pparty3 timeout";
CM_ SG_ 861 IBST_a145_ESPparty3Checksum "Electric brake booster: a145 ES pparty3 checksum";
CM_ SG_ 861 IBST_a146_ESPparty3Counter "Electric brake booster: a146 ES pparty3 counter";
CM_ SG_ 861 IBST_a147_PSCMotorSizeReadFault "Electric brake booster: a147 PSC motor size read fault";
CM_ SG_ 861 IBST_a148_MLIGainMechReadFault "Electric brake booster: a148 MLI gain mech read fault";
CM_ SG_ 861 IBST_a149_MLITMCAreaReadFault "Electric brake booster: a149 MLITMC area read fault";
CM_ SG_ 861 IBST_a150_motorTestFault "Electric brake booster: a150 motor test fault";
CM_ SG_ 861 IBST_a151_PSCGearRatioReadFault "Electric brake booster: a151 PSC gear ratio read fault";
CM_ SG_ 861 IBST_a152_PSCVoltageImplausible "Electric brake booster: a152 PSC voltage implausible";
CM_ SG_ 861 IBST_a153_unused "Electric brake booster: a153 unused";
CM_ SG_ 861 IBST_a154_unused "Electric brake booster: a154 unused";
CM_ SG_ 861 IBST_a155_supplyUndervoltageLvl1 "Electric brake booster: a155 supply undervoltage lvl1";
CM_ SG_ 861 IBST_a156_supplyOvervoltageLvl1 "Electric brake booster: a156 supply overvoltage lvl1";
CM_ SG_ 861 IBST_a157_masterCylPressInvalid "Electric brake booster: a157 master cyl press invalid";
CM_ SG_ 861 IBST_a158_DTSOffsHighSuspicious "Electric brake booster: a158 DTS offs high suspicious";
CM_ SG_ 861 IBST_a159_FindIdleNvMReadError "Electric brake booster: a159 find idle nv m read error";
CM_ SG_ 861 IBST_a160_DTSIDTimeOut "Electric brake booster: a160 DTSID time out";
CM_ SG_ 861 IBST_a161_powerPackMismatch "Electric brake booster: a161 power pack mismatch";
CM_ SG_ 861 IBST_a162_idlePosNotDetected "Electric brake booster: a162 idle pos not detected";
CM_ SG_ 861 IBST_a163_ESPpEstMaxInvalid "Electric brake booster: a163 ES pp est max invalid";
CM_ SG_ 861 IBST_a164_ESPVehicleSpeedInvalid "Electric brake booster: a164 ESP vehicle speed invalid";
CM_ SG_ 861 IBST_a165_ESPpForceBlendInvalid "Electric brake booster: a165 ES pp force blend invalid";
CM_ SG_ 861 IBST_a166_ESPpMcVirtualInvalid "Electric brake booster: a166 ES pp mc virtual invalid";
CM_ SG_ 861 IBST_a167_ESPqTargetExterInvalid "Electric brake booster: a167 ES pq target exter invalid";
CM_ SG_ 861 IBST_a168_CANOvervoltage "Electric brake booster: a168 CAN overvoltage";
CM_ SG_ 861 IBST_a169_CANUndervoltage "Electric brake booster: a169 CAN undervoltage";
CM_ SG_ 861 IBST_a170_LVPowerStateTimeout "Electric brake booster: a170 LV power state timeout";
CM_ SG_ 861 IBST_a171_LVPowerStateChecksum "Electric brake booster: a171 LV power state checksum";
CM_ SG_ 861 IBST_a172_LVPowerStateDLC "Electric brake booster: a172 LV power state DLC";
CM_ SG_ 861 IBST_a173_LVPowerStateCounter "Electric brake booster: a173 LV power state counter";
CM_ SG_ 861 IBST_a174_LVOffStateInvalid "Electric brake booster: a174 LV off state invalid";
CM_ SG_ 861 IBST_a175_LVGoingDownInvalid "Electric brake booster: a175 LV going down invalid";
CM_ SG_ 861 IBST_a176_blockedPedalDetected "Electric brake booster: a176 blocked pedal detected";
CM_ SG_ 861 IBST_a177_EPBLsystemStatusMIA "Electric brake booster: a177 EPB lsystem status MIA";
CM_ SG_ 861 IBST_a178_EPBRsystemStatusMIA "Electric brake booster: a178 EPB rsystem status MIA";
CM_ SG_ 861 IBST_a179_VCLEFTepbmStatusMIA "Electric brake booster: a179 VCLEF tepbm status MIA";
CM_ SG_ 861 IBST_a180_VCRIGHTepbmStatusMIA "Electric brake booster: a180 VCRIGH tepbm status MIA";
CM_ SG_ 861 IBST_a181_DIchassisControlDLC "Electric brake booster: a181 d ichassis control DLC";
CM_ SG_ 861 IBST_a182_DIchassisControlTimeou "Electric brake booster: a182 d ichassis control timeout";
CM_ SG_ 861 IBST_a183_DIchassisControlChecks "Electric brake booster: a183 d ichassis control checksum";
CM_ SG_ 861 IBST_a184_DIchassisControlCounte "Electric brake booster: a184 d ichassis control counter";
CM_ SG_ 861 IBST_a185_rightBusOff "Electric brake booster: a185 right bus off";
CM_ SG_ 861 IBST_a186_rightBusPassive "Electric brake booster: a186 right bus passive";
CM_ SG_ 861 IBST_a187_brakeBusOff "Electric brake booster: a187 brake bus off";
CM_ SG_ 861 IBST_a188_brakeBusPassive "Electric brake booster: a188 brake bus passive";
CM_ SG_ 861 IBST_a189_rightVCLVPowerStateTim "Electric brake booster: a189 right VCLV power state timeout";
CM_ SG_ 861 IBST_a190_rightVCLVPowerStateDLC "Electric brake booster: a190 right VCLV power state DLC";
CM_ SG_ 861 IBST_a191_rightVCLVPowerStateChe "Electric brake booster: a191 right VCLV power state checksum";
CM_ SG_ 861 IBST_a192_rightVCLVPowerStateCou "Electric brake booster: a192 right VCLV power state counter";
CM_ SG_ 861 IBST_a193_leftVCLVPowerStateTime "Electric brake booster: a193 left VCLV power state timeout";
CM_ SG_ 861 IBST_a194_leftVCLVPowerStateChec "Electric brake booster: a194 left VCLV power state checksum";
CM_ SG_ 861 IBST_a195_leftVCLVPowerStateDLC "Electric brake booster: a195 left VCLV power state DLC";
CM_ SG_ 861 IBST_a196_leftVCLVPowerStateCoun "Electric brake booster: a196 left VCLV power state counter";
CM_ SG_ 861 IBST_a197_brakeLatencyReductionA "Electric brake booster: a197 brake latency reduction active";
CM_ SG_ 861 IBST_a198_aesActive "Electric brake booster: a198 aes active";
CM_ SG_ 861 IBST_a199_undefinedAlertDetected "Electric brake booster: a199 undefined alert detected";
CM_ SG_ 861 IBST_a200_aesFault "Electric brake booster: a200 aes fault";
CM_ SG_ 861 IBST_a201_EGGREAR1wheelSpeedsRea "Electric brake booster: a201 eggrear1wheel speeds rear time out";
CM_ SG_ 861 IBST_a202_EGGREAR1wheelSpeedsRea "Electric brake booster: a202 eggrear1wheel speeds rear checksum";
CM_ SG_ 861 IBST_a203_EGGREAR1wheelSpeedsRea "Electric brake booster: a203 eggrear1wheel speeds rear DLC";
CM_ SG_ 861 IBST_a204_EGGREAR1wheelSpeedsRea "Electric brake booster: a204 eggrear1wheel speeds rear counter";
CM_ SG_ 861 IBST_a205_EGGRIGHT1wheelSpeedsFr "Electric brake booster: a205 eggright1wheel speeds front time out";
CM_ SG_ 861 IBST_a206_EGGRIGHT1wheelSpeedsFr "Electric brake booster: a206 eggright1wheel speeds front checksum";
CM_ SG_ 861 IBST_a207_EGGRIGHT1wheelSpeedsFr "Electric brake booster: a207 eggright1wheel speeds front DLC";
CM_ SG_ 861 IBST_a208_EGGRIGHT1wheelSpeedsFr "Electric brake booster: a208 eggright1wheel speeds front counter";
CM_ SG_ 861 IBST_a209_reducedBrakePowerActiv "Electric brake booster: a209 reduced brake power active";
CM_ SG_ 861 IBST_a210_reducedBrakePowerNotAv "Electric brake booster: a210 reduced brake power not available";
CM_ SG_ 861 IBST_a211_DETReportError "Electric brake booster: a211 DET report error";
CM_ SG_ 861 IBST_a212_infoFailureWrongCUBASH "Electric brake booster: a212 info failure wrong CUBAS handling detected";
CM_ SG_ 861 IBST_a213_PDURouterinitializatio "Electric brake booster: a213 PDU routerinitialization failed";
CM_ SG_ 861 IBST_a214_LossOfPDUInstanceDetec "Electric brake booster: a214 loss of PDU instance detected";
CM_ SG_ 861 IBST_a215_UnsupportedSeriesHWDet "Electric brake booster: a215 unsupported series HW detected";
CM_ SG_ 861 IBST_a216_AsicMalfunctionDetecte "Electric brake booster: a216 asic malfunction detected";
CM_ SG_ 861 IBST_a217_AsicTrimmingNotComplet "Electric brake booster: a217 asic trimming not completed";
CM_ SG_ 861 IBST_a218_uCSafetyNotificationGR "Electric brake booster: a218 u c safety notification GRAM";
CM_ SG_ 861 IBST_a219_uCSafetyNotification "Electric brake booster: a219 u c safety notification";
CM_ SG_ 861 IBST_a220_ASICOvercurrentOnGPIO2 "Electric brake booster: a220 ASIC overcurrent on GPIO250 2";
CM_ SG_ 861 IBST_a221_ASICOvercurrentOnGPIO2 "Electric brake booster: a221 ASIC overcurrent on GPIO250 1";
CM_ SG_ 861 IBST_a222_ASICOvercurrentOnGPIO5 "Electric brake booster: a222 ASIC overcurrent on GPIO50 4";
CM_ SG_ 861 IBST_a223_ASICOvercurrentOnGPIO5 "Electric brake booster: a223 ASIC overcurrent on GPIO50 3";
CM_ SG_ 861 IBST_a224_ASICOvercurrentOnGPIO5 "Electric brake booster: a224 ASIC overcurrent on GPIO50 2";
CM_ SG_ 861 IBST_a225_ASICOvercurrentOnGPIO5 "Electric brake booster: a225 ASIC overcurrent on GPIO50 1";
CM_ SG_ 861 IBST_a226_ASICOvercurrentOnWRHS "Electric brake booster: a226 ASIC overcurrent on WRHS";
CM_ SG_ 861 IBST_a227_wakeRequestMismatchDet "Electric brake booster: a227 wake request mismatch detected";
CM_ SG_ 861 IBST_a228_BlockedPedalDetectedDu "Electric brake booster: a228 blocked pedal detected during HAD";
CM_ SG_ 861 IBST_a229_BlockedPedalDetected "Electric brake booster: a229 blocked pedal detected";
CM_ SG_ 861 IBST_a230_DTS2FunctionalRangeLow "Electric brake booster: a230 DTS2 functional range low";
CM_ SG_ 861 IBST_a231_DTS2FunctionalRangeLow "Electric brake booster: a231 DTS2 functional range low";
CM_ SG_ 861 IBST_a232_PostAssemblyRoutineFai "Electric brake booster: a232 post assembly routine failed";
CM_ SG_ 861 IBST_a233_ReferenceRunAbortByECU "Electric brake booster: a233 reference run abort by ECU reset";
CM_ SG_ 861 IBST_a234_LiPSOutOfRangeHigh "Electric brake booster: a234 li PS out of range high";
CM_ SG_ 861 IBST_a235_LiPSOutOfRangeLow "Electric brake booster: a235 li PS out of range low";
CM_ SG_ 861 IBST_a246_DASredundantBrakingCon "Electric brake booster: a246 DA sredundant braking control party checksum";
CM_ SG_ 861 IBST_a247_DASredundantBrakingCon "Electric brake booster: a247 DA sredundant braking control party counter";
CM_ SG_ 861 IBST_a248_DASredundantBrakingCon "Electric brake booster: a248 DA sredundant braking control party DLC";
CM_ SG_ 861 IBST_a249_DASredundantBrakingCon "Electric brake booster: a249 DA sredundant braking control party timeout";
CM_ SG_ 861 IBST_a250_DASredundantBrakingCon "Electric brake booster: a250 DA sredundant braking control chassis checksum";
CM_ SG_ 861 IBST_a251_DASredundantBrakingCon "Electric brake booster: a251 DA sredundant braking control chassis counter";
CM_ SG_ 861 IBST_a252_DASredundantBrakingCon "Electric brake booster: a252 DA sredundant braking control chassis DLC";
CM_ SG_ 861 IBST_a253_DASredundantBrakingCon "Electric brake booster: a253 DA sredundant braking control chassis timeout";
CM_ SG_ 861 IBST_a254_DIlocStatus2Checksum "Electric brake booster: a254 d iloc status2 checksum";
CM_ SG_ 861 IBST_a255_DIlocStatus2Counter "Electric brake booster: a255 d iloc status2 counter";
CM_ SG_ 861 IBST_a256_DIlocStatus2DLC "Electric brake booster: a256 d iloc status2 DLC";
CM_ SG_ 861 IBST_a257_DIlocStatus2Timeout "Electric brake booster: a257 d iloc status2 timeout";
CM_ SG_ 861 IBST_a258_standaloneEBRActive "Electric brake booster: a258 standalone EBR active";
CM_ SG_ 861 IBST_a259_EMCMain11Checksum "Electric brake booster: a259 EMC main11 checksum";
CM_ SG_ 861 IBST_a260_EMCMain11Counter "Electric brake booster: a260 EMC main11 counter";
CM_ SG_ 861 IBST_a261_EMCMain11DLC "Electric brake booster: a261 EMC main11 DLC";
CM_ SG_ 861 IBST_a262_EMCMain11Timeout "Electric brake booster: a262 EMC main11 timeout";
CM_ SG_ 861 IBST_a263_EMCMain21Checksum "Electric brake booster: a263 EMC main21 checksum";
CM_ SG_ 861 IBST_a264_EMCMain21Counter "Electric brake booster: a264 EMC main21 counter";
CM_ SG_ 861 IBST_a265_EMCMain21DLC "Electric brake booster: a265 EMC main21 DLC";
CM_ SG_ 861 IBST_a266_EMCMain21Timeout "Electric brake booster: a266 EMC main21 timeout";
CM_ BO_ 813 "Electric brake booster message: info; frame length from the layout, not yet observed on a vehicle bus";
CM_ SG_ 813 IBST_infoIndex "Electric brake booster: info index";
CM_ SG_ 813 IBST_infoBuildType "Electric brake booster: info build type";
CM_ SG_ 813 IBST_infoComponentID "Electric brake booster: info component ID";
CM_ SG_ 813 IBST_infoPcbaID "Electric brake booster: info pcba ID";
CM_ SG_ 813 IBST_infoAssemblyID "Electric brake booster: info assembly ID";
CM_ SG_ 813 IBST_infoUsageID "Electric brake booster: info usage ID";
CM_ SG_ 813 IBST_infoSubUsageID "Electric brake booster: info sub usage ID";
CM_ SG_ 813 IBST_infoApplicationCRC "Indicating the Application CRC value of firmware running in system.";
CM_ SG_ 813 IBST_infoBootUdsProtoVersion "Electric brake booster: info boot uds proto version";
CM_ SG_ 813 IBST_infoBootloaderCRC "Electric brake booster: info bootloader CRC";
CM_ SG_ 813 IBST_infoVariantCRC "Indicating the Calibration CRC value of firmware running in system.";
CM_ BO_ 1629 "Electric brake booster message: uds response; frame length from the layout, not yet observed on a vehicle bus";
CM_ SG_ 1629 IBST_udsResponseData "Electric brake booster: uds response data";
BA_DEF_ BO_ "GenMsgCycleTime" INT 0 3600000;
BA_DEF_ BO_ "GenMsgSendType" ENUM "Cyclic","NotUsed","NotUsed","NotUsed","NotUsed","NotUsed","NotUsed","IfActive","NoMsgSendType","NotUsed";
BA_DEF_ BO_ "VFrameFormat" ENUM "StandardCAN","ExtendedCAN","reserved","J1939PG","reserved","reserved","reserved","reserved","reserved","reserved","reserved","reserved","reserved","reserved","StandardCAN_FD","ExtendedCAN_FD";
BA_DEF_ BO_ "CANFD_BRS" ENUM "0","1";
BA_DEF_ SG_ "GenSigSNA" STRING;
BA_DEF_ SG_ "SystemSignalLongSymbol" STRING;
BA_DEF_ SG_ "Confidence" ENUM "validated","plausible","layout-only","contradicted";
BA_DEF_DEF_ "GenMsgCycleTime" 0;
BA_DEF_DEF_ "GenMsgSendType" "NoMsgSendType";
BA_DEF_DEF_ "VFrameFormat" "StandardCAN";
BA_DEF_DEF_ "CANFD_BRS" "1";
BA_DEF_DEF_ "GenSigSNA" "";
BA_DEF_DEF_ "SystemSignalLongSymbol" "";
BA_DEF_DEF_ "Confidence" "layout-only";
BA_ "GenMsgCycleTime" BO_ 920 1000;
BA_ "GenMsgSendType" BO_ 920 0;
BA_ "GenMsgCycleTime" BO_ 981 1000;
BA_ "GenMsgSendType" BO_ 981 0;
BA_ "GenMsgCycleTime" BO_ 805 10000;
BA_ "GenMsgSendType" BO_ 805 0;
BA_ "GenMsgCycleTime" BO_ 1621 100;
BA_ "GenMsgSendType" BO_ 1621 0;
BA_ "GenMsgCycleTime" BO_ 861 1000;
BA_ "GenMsgSendType" BO_ 861 0;
BA_ "GenMsgCycleTime" BO_ 813 10000;
BA_ "GenMsgSendType" BO_ 813 0;
BA_ "Confidence" SG_ 920 EPASTS_matrixIndex 1;
BA_ "SystemSignalLongSymbol" SG_ 920 EPASTS_a001_adcCalibrationOrInit "EPASTS_a001_adcCalibrationOrInitFail";
BA_ "SystemSignalLongSymbol" SG_ 920 EPASTS_a005_scpUnknownResetSourc "EPASTS_a005_scpUnknownResetSource";
BA_ "SystemSignalLongSymbol" SG_ 920 EPASTS_a006_swrhResetByInvalidEr "EPASTS_a006_swrhResetByInvalidErrid";
BA_ "SystemSignalLongSymbol" SG_ 920 EPASTS_a009_mcusscLbistPermanent "EPASTS_a009_mcusscLbistPermanentFail";
BA_ "SystemSignalLongSymbol" SG_ 920 EPASTS_a010_svcIncompatibleSwVer "EPASTS_a010_svcIncompatibleSwVersions";
BA_ "SystemSignalLongSymbol" SG_ 920 EPASTS_a013_mcusscSffMonitoringF "EPASTS_a013_mcusscSffMonitoringFailed";
BA_ "SystemSignalLongSymbol" SG_ 920 EPASTS_a014_mcusscSffMonitoringM "EPASTS_a014_mcusscSffMonitoringMia";
BA_ "SystemSignalLongSymbol" SG_ 920 EPASTS_a015_mcusscCsErrorCheckFa "EPASTS_a015_mcusscCsErrorCheckFail";
BA_ "SystemSignalLongSymbol" SG_ 920 EPASTS_a016_mcufcCsErrorCheckFai "EPASTS_a016_mcufcCsErrorCheckFail";
BA_ "SystemSignalLongSymbol" SG_ 920 EPASTS_a017_stmdStmPlausibilityC "EPASTS_a017_stmdStmPlausibilityCheckErr";
BA_ "SystemSignalLongSymbol" SG_ 920 EPASTS_a019_rsthHwResetInfoCorru "EPASTS_a019_rsthHwResetInfoCorruptionCheck";
BA_ "SystemSignalLongSymbol" SG_ 920 EPASTS_a020_mcusscEolEcuIdIntegr "EPASTS_a020_mcusscEolEcuIdIntegritiyFail";
BA_ "SystemSignalLongSymbol" SG_ 920 EPASTS_a022_swrhSwResetInfoCorru "EPASTS_a022_swrhSwResetInfoCorruptionCheck";
BA_ "SystemSignalLongSymbol" SG_ 920 EPASTS_a028_smuhNonInitDataCorru "EPASTS_a028_smuhNonInitDataCorruption";
BA_ "SystemSignalLongSymbol" SG_ 920 EPASTS_a029_smuhSmuCoreCntErrorT "EPASTS_a029_smuhSmuCoreCntErrorTestFail";
BA_ "SystemSignalLongSymbol" SG_ 920 EPASTS_a031_pmsProductionModeFai "EPASTS_a031_pmsProductionModeFailed";
BA_ "SystemSignalLongSymbol" SG_ 920 EPASTS_a033_icsvcPswVersionMisma "EPASTS_a033_icsvcPswVersionMismatch";
BA_ "SystemSignalLongSymbol" SG_ 920 EPASTS_a038_csohCh1CsErrorErrAtR "EPASTS_a038_csohCh1CsErrorErrAtReset";
BA_ "SystemSignalLongSymbol" SG_ 920 EPASTS_a039_csohCh2CsErrorErrAtR "EPASTS_a039_csohCh2CsErrorErrAtReset";
BA_ "SystemSignalLongSymbol" SG_ 920 EPASTS_a040_swrhLimitedResetRetr "EPASTS_a040_swrhLimitedResetRetriesExpired";
BA_ "SystemSignalLongSymbol" SG_ 920 EPASTS_a041_imcmCoreConfiguratio "EPASTS_a041_imcmCoreConfigurationMismatch";
BA_ "SystemSignalLongSymbol" SG_ 920 EPASTS_a045_psumSbcBandgapVoltEr "EPASTS_a045_psumSbcBandgapVoltErr";
BA_ "SystemSignalLongSymbol" SG_ 920 EPASTS_a046_mcusscOscillatorNotR "EPASTS_a046_mcusscOscillatorNotReliable";
BA_ "SystemSignalLongSymbol" SG_ 920 EPASTS_a052_ermSdcInputBufferOve "EPASTS_a052_ermSdcInputBufferOverflow";
BA_ "SystemSignalLongSymbol" SG_ 920 EPASTS_a053_adcUnexpectedNumOfDa "EPASTS_a053_adcUnexpectedNumOfData";
BA_ "SystemSignalLongSymbol" SG_ 920 EPASTS_a056_amGduConfigCsErrorCh "EPASTS_a056_amGduConfigCsErrorCheck";
BA_ "SystemSignalLongSymbol" SG_ 920 EPASTS_a067_tspmPowermoduleTempI "EPASTS_a067_tspmPowermoduleTempImplausible";
BA_ "SystemSignalLongSymbol" SG_ 920 EPASTS_a068_rsthCoreRedundancyEr "EPASTS_a068_rsthCoreRedundancyErr";
BA_ "SystemSignalLongSymbol" SG_ 920 EPASTS_a069_rsthCoreTempOutOfRan "EPASTS_a069_rsthCoreTempOutOfRangeHwCheck";
BA_ "SystemSignalLongSymbol" SG_ 920 EPASTS_a072_rsthFlashUncorrEccOr "EPASTS_a072_rsthFlashUncorrEccOrOvfl";
BA_ "SystemSignalLongSymbol" SG_ 920 EPASTS_a075_rsthUnusedOtherModul "EPASTS_a075_rsthUnusedOtherModuleAlarm";
BA_ "SystemSignalLongSymbol" SG_ 920 EPASTS_a081_exchFloatingPointExc "EPASTS_a081_exchFloatingPointException";
BA_ "SystemSignalLongSymbol" SG_ 920 EPASTS_a083_tdaDclinkcapacitorTe "EPASTS_a083_tdaDclinkcapacitorTempChecker";
BA_ "SystemSignalLongSymbol" SG_ 920 EPASTS_a085_amGduSwitchOffTestBy "EPASTS_a085_amGduSwitchOffTestByMcu";
BA_ "SystemSignalLongSymbol" SG_ 920 EPASTS_a088_tedMainboardTempChec "EPASTS_a088_tedMainboardTempChecker";
BA_ "SystemSignalLongSymbol" SG_ 920 EPASTS_a089_tedRevercebattfetjun "EPASTS_a089_tedRevercebattfetjunctionTempChecker";
BA_ "SystemSignalLongSymbol" SG_ 920 EPASTS_a091_bvpBattVoltCrossChkF "EPASTS_a091_bvpBattVoltCrossChkFailed";
BA_ "SystemSignalLongSymbol" SG_ 920 EPASTS_a092_amGduSwitchOffTestBy "EPASTS_a092_amGduSwitchOffTestBySbc";
BA_ "SystemSignalLongSymbol" SG_ 920 EPASTS_a093_sctpTsuSingleStaticF "EPASTS_a093_sctpTsuSingleStaticFail";
BA_ "SystemSignalLongSymbol" SG_ 920 EPASTS_a094_sctpTsuMultipleStati "EPASTS_a094_sctpTsuMultipleStaticFail";
BA_ "SystemSignalLongSymbol" SG_ 920 EPASTS_a095_mdModelBasedMotorInt "EPASTS_a095_mdModelBasedMotorIntegrityCheck";
BA_ "SystemSignalLongSymbol" SG_ 920 EPASTS_a096_rppRpsSingleStaticFa "EPASTS_a096_rppRpsSingleStaticFail";
BA_ "SystemSignalLongSymbol" SG_ 920 EPASTS_a097_rppRpsMultipleStatic "EPASTS_a097_rppRpsMultipleStaticFail";
BA_ "SystemSignalLongSymbol" SG_ 920 EPASTS_a099_mcdTorqueMismatchFau "EPASTS_a099_mcdTorqueMismatchFault";
BA_ "SystemSignalLongSymbol" SG_ 920 EPASTS_a103_exhaUnusedInterruptC "EPASTS_a103_exhaUnusedInterruptCallException";
BA_ "SystemSignalLongSymbol" SG_ 920 EPASTS_a105_exhaSriBusErrExcepti "EPASTS_a105_exhaSriBusErrException";
BA_ "SystemSignalLongSymbol" SG_ 920 EPASTS_a106_exhaSpbBusErrExcepti "EPASTS_a106_exhaSpbBusErrException";
BA_ "SystemSignalLongSymbol" SG_ 920 EPASTS_a107_exhaOtherNmiExceptio "EPASTS_a107_exhaOtherNmiException";
BA_ "SystemSignalLongSymbol" SG_ 920 EPASTS_a108_exhaInternalProtecti "EPASTS_a108_exhaInternalProtectionException";
BA_ "SystemSignalLongSymbol" SG_ 920 EPASTS_a109_exhaSysBusOrPeriphEr "EPASTS_a109_exhaSysBusOrPeriphErrException";
BA_ "SystemSignalLongSymbol" SG_ 920 EPASTS_a110_amPhaseRelaySwitchOf "EPASTS_a110_amPhaseRelaySwitchOffTest";
BA_ "SystemSignalLongSymbol" SG_ 920 EPASTS_a111_amCurrentSensingDisc "EPASTS_a111_amCurrentSensingDisconnection";
BA_ "SystemSignalLongSymbol" SG_ 920 EPASTS_a112_rsthSafetyFlipflopEr "EPASTS_a112_rsthSafetyFlipflopErr";
BA_ "SystemSignalLongSymbol" SG_ 920 EPASTS_a113_rsthUncorrectableEnd "EPASTS_a113_rsthUncorrectableEndToEndBusErr";
BA_ "SystemSignalLongSymbol" SG_ 920 EPASTS_a115_mcusscLbistSingleFai "EPASTS_a115_mcusscLbistSingleFail";
BA_ "SystemSignalLongSymbol" SG_ 920 EPASTS_a116_mrccStartupRegCsErro "EPASTS_a116_mrccStartupRegCsErrorStaticErr";
BA_ "SystemSignalLongSymbol" SG_ 920 EPASTS_a117_mrccStartupRegCsErro "EPASTS_a117_mrccStartupRegCsErrorTransientErr";
BA_ "SystemSignalLongSymbol" SG_ 920 EPASTS_a118_mcusscFlashCsErrorEr "EPASTS_a118_mcusscFlashCsErrorErr";
BA_ "SystemSignalLongSymbol" SG_ 920 EPASTS_a119_mcusscFlashEccCritic "EPASTS_a119_mcusscFlashEccCriticalErr";
BA_ "SystemSignalLongSymbol" SG_ 920 EPASTS_a120_mcusscFlashEccLatent "EPASTS_a120_mcusscFlashEccLatentErr";
BA_ "SystemSignalLongSymbol" SG_ 920 EPASTS_a124_mcusscMbistEccTransi "EPASTS_a124_mcusscMbistEccTransientErr";
BA_ "SystemSignalLongSymbol" SG_ 920 EPASTS_a127_exchAdditionalExcept "EPASTS_a127_exchAdditionalExceptionAfterRst";
BA_ "SystemSignalLongSymbol" SG_ 920 EPASTS_a128_exchExceptionStopRes "EPASTS_a128_exchExceptionStopRestart";
BA_ "SystemSignalLongSymbol" SG_ 920 EPASTS_a129_exchAdditionalExcept "EPASTS_a129_exchAdditionalExceptionStopRestart";
BA_ "SystemSignalLongSymbol" SG_ 920 EPASTS_a131_exchGuardedResetAfte "EPASTS_a131_exchGuardedResetAfterPartitionStop";
BA_ "SystemSignalLongSymbol" SG_ 920 EPASTS_a132_mcusscNotSupportedMc "EPASTS_a132_mcusscNotSupportedMcu";
BA_ "SystemSignalLongSymbol" SG_ 920 EPASTS_a133_mcusscLbistEcuIdIsNo "EPASTS_a133_mcusscLbistEcuIdIsNotSupported";
BA_ "SystemSignalLongSymbol" SG_ 920 EPASTS_a134_osehGuardedResetAfte "EPASTS_a134_osehGuardedResetAfterErrWithoutReset";
BA_ "SystemSignalLongSymbol" SG_ 920 EPASTS_a135_tmpsfetjCalculationO "EPASTS_a135_tmpsfetjCalculationOverflowErr";
BA_ "SystemSignalLongSymbol" SG_ 920 EPASTS_a137_osehErrWithoutImmedi "EPASTS_a137_osehErrWithoutImmediateReset";
BA_ "SystemSignalLongSymbol" SG_ 920 EPASTS_a138_osehAdditionalErrWit "EPASTS_a138_osehAdditionalErrWithoutImmReset";
BA_ "SystemSignalLongSymbol" SG_ 920 EPASTS_a142_tedEmifilterDmcTempC "EPASTS_a142_tedEmifilterDmcTempChecker";
BA_ "SystemSignalLongSymbol" SG_ 920 EPASTS_a143_tedEmifilterCmcTempC "EPASTS_a143_tedEmifilterCmcTempChecker";
BA_ "SystemSignalLongSymbol" SG_ 920 EPASTS_a145_mriPeripheralRaminit "EPASTS_a145_mriPeripheralRaminitFailed";
BA_ "SystemSignalLongSymbol" SG_ 920 EPASTS_a148_mrccExitFromStandbyD "EPASTS_a148_mrccExitFromStandbyDetected";
BA_ "SystemSignalLongSymbol" SG_ 920 EPASTS_a149_amReversibleEmergenc "EPASTS_a149_amReversibleEmergencyOffRequested";
BA_ "SystemSignalLongSymbol" SG_ 920 EPASTS_a150_amExternalEmergencyO "EPASTS_a150_amExternalEmergencyOffRequested";
BA_ "SystemSignalLongSymbol" SG_ 920 EPASTS_a151_amPermanentEmergency "EPASTS_a151_amPermanentEmergencyOffRequested";
BA_ "SystemSignalLongSymbol" SG_ 920 EPASTS_a152_exchFlashEccExceptio "EPASTS_a152_exchFlashEccException";
BA_ "SystemSignalLongSymbol" SG_ 920 EPASTS_a153_sdsmBlockSelectorInv "EPASTS_a153_sdsmBlockSelectorInvalid";
BA_ "SystemSignalLongSymbol" SG_ 920 EPASTS_a154_sdsmCsErrorInvalidPr "EPASTS_a154_sdsmCsErrorInvalidPrimary";
BA_ "SystemSignalLongSymbol" SG_ 920 EPASTS_a156_amIntSerialErrSafety "EPASTS_a156_amIntSerialErrSafetyReset";
BA_ "SystemSignalLongSymbol" SG_ 920 EPASTS_a158_amGduFailDuringRecov "EPASTS_a158_amGduFailDuringRecovery";
BA_ "SystemSignalLongSymbol" SG_ 920 EPASTS_a159_exchFlashWordlineTra "EPASTS_a159_exchFlashWordlineTransientErr";
BA_ "SystemSignalLongSymbol" SG_ 920 EPASTS_a160_rsthCpu1UnexpectedAl "EPASTS_a160_rsthCpu1UnexpectedAlarm";
BA_ "SystemSignalLongSymbol" SG_ 920 EPASTS_a161_tdaRelayfetjunctionT "EPASTS_a161_tdaRelayfetjunctionTempChecker";
BA_ "SystemSignalLongSymbol" SG_ 920 EPASTS_a162_tdaBridgefetjunction "EPASTS_a162_tdaBridgefetjunctionTempChecker";
BA_ "SystemSignalLongSymbol" SG_ 920 EPASTS_a163_tdaPowermoduleTempCh "EPASTS_a163_tdaPowermoduleTempChecker";
BA_ "SystemSignalLongSymbol" SG_ 920 EPASTS_a164_tdaBattfetjunctionTe "EPASTS_a164_tdaBattfetjunctionTempChecker";
BA_ "SystemSignalLongSymbol" SG_ 920 EPASTS_a165_tdaDcbusshuntTempChe "EPASTS_a165_tdaDcbusshuntTempChecker";
BA_ "SystemSignalLongSymbol" SG_ 920 EPASTS_a166_tdaPhasecurrentshunt "EPASTS_a166_tdaPhasecurrentshuntTempChecker";
BA_ "SystemSignalLongSymbol" SG_ 920 EPASTS_a167_iccd1ErrQueueOverflo "EPASTS_a167_iccd1ErrQueueOverflow";
BA_ "SystemSignalLongSymbol" SG_ 920 EPASTS_a172_pmpElangMotorcurrent "EPASTS_a172_pmpElangMotorcurrentAge";
BA_ "SystemSignalLongSymbol" SG_ 920 EPASTS_a175_exchFlashStoredConfi "EPASTS_a175_exchFlashStoredConfigErr";
BA_ "SystemSignalLongSymbol" SG_ 920 EPASTS_a176_exchCpu1ExceptionRes "EPASTS_a176_exchCpu1ExceptionReset";
BA_ "SystemSignalLongSymbol" SG_ 920 EPASTS_a179_tedMotorcoilTempChec "EPASTS_a179_tedMotorcoilTempChecker";
BA_ "SystemSignalLongSymbol" SG_ 920 EPASTS_a180_dmDeadlineViolationC "EPASTS_a180_dmDeadlineViolationC1";
BA_ "SystemSignalLongSymbol" SG_ 920 EPASTS_a181_dmDeadlineViolationC "EPASTS_a181_dmDeadlineViolationC1";
BA_ "SystemSignalLongSymbol" SG_ 920 EPASTS_a184_sbcmCommBufferOverfl "EPASTS_a184_sbcmCommBufferOverflow";
BA_ "SystemSignalLongSymbol" SG_ 920 EPASTS_a185_sbcscpQAWatchdogRese "EPASTS_a185_sbcscpQAWatchdogReset";
BA_ "SystemSignalLongSymbol" SG_ 920 EPASTS_a186_wdhCommBufferOverflo "EPASTS_a186_wdhCommBufferOverflow";
BA_ "SystemSignalLongSymbol" SG_ 920 EPASTS_a188_epmCommBufferOverflo "EPASTS_a188_epmCommBufferOverflow";
BA_ "SystemSignalLongSymbol" SG_ 920 EPASTS_a190_sbchCommBufferOverfl "EPASTS_a190_sbchCommBufferOverflow";
BA_ "SystemSignalLongSymbol" SG_ 920 EPASTS_a191_sbcscpVcp2VucVoltFai "EPASTS_a191_sbcscpVcp2VucVoltFail";
BA_ "SystemSignalLongSymbol" SG_ 920 EPASTS_a196_topEolTasOffsetInval "EPASTS_a196_topEolTasOffsetInvalid";
BA_ "SystemSignalLongSymbol" SG_ 920 EPASTS_a200_ammInputBufferOverfl "EPASTS_a200_ammInputBufferOverflow";
BA_ "SystemSignalLongSymbol" SG_ 920 EPASTS_a201_ammOutputBufferOverf "EPASTS_a201_ammOutputBufferOverflow";
BA_ "SystemSignalLongSymbol" SG_ 920 EPASTS_a202_ohnvmpStoredOffsetLo "EPASTS_a202_ohnvmpStoredOffsetLost";
BA_ "SystemSignalLongSymbol" SG_ 920 EPASTS_a206_fdrOclPartialBlockin "EPASTS_a206_fdrOclPartialBlocking";
BA_ "SystemSignalLongSymbol" SG_ 920 EPASTS_a208_fdrLowSeverityBlocki "EPASTS_a208_fdrLowSeverityBlocking";
BA_ "SystemSignalLongSymbol" SG_ 920 EPASTS_a209_fdrLowSeverityFreezi "EPASTS_a209_fdrLowSeverityFreezing";
BA_ "SystemSignalLongSymbol" SG_ 920 EPASTS_a213_frmHighFrictionDetec "EPASTS_a213_frmHighFrictionDetected";
BA_ "SystemSignalLongSymbol" SG_ 920 EPASTS_a218_aadApplicationStateE "EPASTS_a218_aadApplicationStateErr";
BA_ "SystemSignalLongSymbol" SG_ 920 EPASTS_a220_transceiverInputqueu "EPASTS_a220_transceiverInputqueueOverflow";
BA_ "SystemSignalLongSymbol" SG_ 920 EPASTS_a258_pspInvalidProjectPar "EPASTS_a258_pspInvalidProjectParamset";
BA_ "SystemSignalLongSymbol" SG_ 920 EPASTS_a270_oscillationCompTrqLi "EPASTS_a270_oscillationCompTrqLimReached";
BA_ "Confidence" SG_ 981 ESP_matrixIndex 1;
BA_ "SystemSignalLongSymbol" SG_ 981 ESP_a193_DIchassisControlChecksu "ESP_a193_DIchassisControlChecksum";
BA_ "SystemSignalLongSymbol" SG_ 981 ESP_a269_DIRELTorqueCommandInval "ESP_a269_DIRELTorqueCommandInvalid";
BA_ "SystemSignalLongSymbol" SG_ 981 ESP_a271_DIRELTorqueActualInvali "ESP_a271_DIRELTorqueActualInvalid";
BA_ "SystemSignalLongSymbol" SG_ 981 ESP_a276_DIRERTorqueCommandInval "ESP_a276_DIRERTorqueCommandInvalid";
BA_ "SystemSignalLongSymbol" SG_ 981 ESP_a278_DIRERTorqueActualInvali "ESP_a278_DIRERTorqueActualInvalid";
BA_ "SystemSignalLongSymbol" SG_ 981 ESP_a279_lifetimeManagementOverr "ESP_a279_lifetimeManagementOverrun";
BA_ "SystemSignalLongSymbol" SG_ 981 ESP_a282_trackModeABSRequestInva "ESP_a282_trackModeABSRequestInvalid";
BA_ "SystemSignalLongSymbol" SG_ 981 ESP_a283_secondaryCollisionMitig "ESP_a283_secondaryCollisionMitigationActive";
BA_ "SystemSignalLongSymbol" SG_ 981 ESP_a284_scmRequestInvalidChecks "ESP_a284_scmRequestInvalidChecksum";
BA_ "SystemSignalLongSymbol" SG_ 981 ESP_a287_failedBrakeCircuitDetec "ESP_a287_failedBrakeCircuitDetected";
BA_ "SystemSignalLongSymbol" SG_ 981 ESP_a296_roadWheelAngleHealthDeg "ESP_a296_roadWheelAngleHealthDegraded";
BA_ "SystemSignalLongSymbol" SG_ 981 ESP_a297_roadWheelAngleHealthFau "ESP_a297_roadWheelAngleHealthFaulted";
BA_ "SystemSignalLongSymbol" SG_ 981 ESP_a298_RSArearSteerStatusTimeo "ESP_a298_RSArearSteerStatusTimeout";
BA_ "SystemSignalLongSymbol" SG_ 981 ESP_a300_RSArearSteerStatusCheck "ESP_a300_RSArearSteerStatusChecksum";
BA_ "SystemSignalLongSymbol" SG_ 981 ESP_a302_rearRoadWheelAngleHealt "ESP_a302_rearRoadWheelAngleHealthDegraded";
BA_ "SystemSignalLongSymbol" SG_ 981 ESP_a303_rearRoadWheelAngleHealt "ESP_a303_rearRoadWheelAngleHealthFaulted";
BA_ "SystemSignalLongSymbol" SG_ 981 ESP_a304_rearVCLVPowerStateTimeo "ESP_a304_rearVCLVPowerStateTimeout";
BA_ "SystemSignalLongSymbol" SG_ 981 ESP_a306_rearVCLVPowerStateCheck "ESP_a306_rearVCLVPowerStateChecksum";
BA_ "SystemSignalLongSymbol" SG_ 981 ESP_a307_rearVCLVPowerStateCount "ESP_a307_rearVCLVPowerStateCounter";
BA_ "SystemSignalLongSymbol" SG_ 981 ESP_a310_brakeLatencyReductionAc "ESP_a310_brakeLatencyReductionActive";
BA_ "SystemSignalLongSymbol" SG_ 981 ESP_a319_AES_BackupActuatorActiv "ESP_a319_AES_BackupActuatorActive";
BA_ "SystemSignalLongSymbol" SG_ 981 ESP_a334_BrakePedalAppliedInvali "ESP_a334_BrakePedalAppliedInvalid";
BA_ "SystemSignalLongSymbol" SG_ 981 ESP_a337_pReductionPotentialInva "ESP_a337_pReductionPotentialInvalid";
BA_ "SystemSignalLongSymbol" SG_ 981 ESP_a341_EnhancedPressureBuildAc "ESP_a341_EnhancedPressureBuildActive";
BA_ "SystemSignalLongSymbol" SG_ 981 ESP_a342_EnhancedPressureBuildNo "ESP_a342_EnhancedPressureBuildNotAvailable";
BA_ "SystemSignalLongSymbol" SG_ 981 ESP_a343_EnhancedPressureBuildLt "ESP_a343_EnhancedPressureBuildLtmReached";
BA_ "SystemSignalLongSymbol" SG_ 981 ESP_a351_ActuatorYellowLampReque "ESP_a351_ActuatorYellowLampRequested";
BA_ "SystemSignalLongSymbol" SG_ 981 ESP_a353_PressureSensorImplausHi "ESP_a353_PressureSensorImplausHigh";
BA_ "SystemSignalLongSymbol" SG_ 981 ESP_a358_externalActuatorFallbac "ESP_a358_externalActuatorFallback";
BA_ "SystemSignalLongSymbol" SG_ 981 ESP_a359_externalActuatorNoExtRe "ESP_a359_externalActuatorNoExtReq";
BA_ "SystemSignalLongSymbol" SG_ 981 ESP_a362_BBbrakeActuationChecksu "ESP_a362_BBbrakeActuationChecksum";
BA_ "SystemSignalLongSymbol" SG_ 981 ESP_a366_ActuatorBlendingModeReq "ESP_a366_ActuatorBlendingModeReqNotAvailable";
BA_ "SystemSignalLongSymbol" SG_ 981 ESP_a367_CBDS_fillBufferThreshol "ESP_a367_CBDS_fillBufferThreshold";
BA_ "SystemSignalLongSymbol" SG_ 981 ESP_a369_LargeLeakageDetectedByD "ESP_a369_LargeLeakageDetectedByDPB";
BA_ "SystemSignalLongSymbol" SG_ 981 ESP_a379_DASredundantBrakingCont "ESP_a379_DASredundantBrakingControlPartyChecksum";
BA_ "SystemSignalLongSymbol" SG_ 981 ESP_a380_DASredundantBrakingCont "ESP_a380_DASredundantBrakingControlPartyCounter";
BA_ "SystemSignalLongSymbol" SG_ 981 ESP_a381_DASredundantBrakingCont "ESP_a381_DASredundantBrakingControlPartyDLC";
BA_ "SystemSignalLongSymbol" SG_ 981 ESP_a382_DASredundantBrakingCont "ESP_a382_DASredundantBrakingControlPartyTimeout";
BA_ "SystemSignalLongSymbol" SG_ 981 ESP_a383_DASredundantBrakingCont "ESP_a383_DASredundantBrakingControlChassisChecksum";
BA_ "SystemSignalLongSymbol" SG_ 981 ESP_a384_DASredundantBrakingCont "ESP_a384_DASredundantBrakingControlChassisCounter";
BA_ "SystemSignalLongSymbol" SG_ 981 ESP_a385_DASredundantBrakingCont "ESP_a385_DASredundantBrakingControlChassisDLC";
BA_ "SystemSignalLongSymbol" SG_ 981 ESP_a386_DASredundantBrakingCont "ESP_a386_DASredundantBrakingControlChassisTimeout";
BA_ "SystemSignalLongSymbol" SG_ 981 ESP_a392_driverlessArmingUnavail "ESP_a392_driverlessArmingUnavailable";
BA_ "SystemSignalLongSymbol" SG_ 981 ESP_a406_DIespActuatorTestTimeou "ESP_a406_DIespActuatorTestTimeout";
BA_ "SystemSignalLongSymbol" SG_ 981 ESP_a407_DIespActuatorTestChecks "ESP_a407_DIespActuatorTestChecksum";
BA_ "SystemSignalLongSymbol" SG_ 981 ESP_a409_DIespActuatorTestCounte "ESP_a409_DIespActuatorTestCounter";
BA_ "Confidence" SG_ 805 ESP_infoIndex 1;
BA_ "Confidence" SG_ 805 ESP_infoBuildType 0;
BA_ "Confidence" SG_ 805 ESP_vehFlashMode 0;
BA_ "Confidence" SG_ 805 ESP_infoComponentID 0;
BA_ "Confidence" SG_ 805 ESP_infoPcbaID 0;
BA_ "Confidence" SG_ 805 ESP_infoAssemblyID 0;
BA_ "Confidence" SG_ 805 ESP_infoUsageID 0;
BA_ "Confidence" SG_ 805 ESP_infoSubUsageID 0;
BA_ "Confidence" SG_ 805 ESP_infoApplicationCRC 1;
BA_ "Confidence" SG_ 805 ESP_infoVehicleVariant 0;
BA_ "Confidence" SG_ 805 ESP_infoSubcomponent1 0;
BA_ "Confidence" SG_ 805 ESP_infoBootUdsProtoVersion 0;
BA_ "Confidence" SG_ 805 ESP_infoBootloaderCRC 0;
BA_ "Confidence" SG_ 805 ESP_infoVariantCRC 1;
BA_ "Confidence" SG_ 1621 ESP_udsResponseData 1;
BA_ "Confidence" SG_ 861 IBST_matrixIndex 1;
BA_ "SystemSignalLongSymbol" SG_ 861 IBST_a182_DIchassisControlTimeou "IBST_a182_DIchassisControlTimeout";
BA_ "SystemSignalLongSymbol" SG_ 861 IBST_a183_DIchassisControlChecks "IBST_a183_DIchassisControlChecksum";
BA_ "SystemSignalLongSymbol" SG_ 861 IBST_a184_DIchassisControlCounte "IBST_a184_DIchassisControlCounter";
BA_ "SystemSignalLongSymbol" SG_ 861 IBST_a189_rightVCLVPowerStateTim "IBST_a189_rightVCLVPowerStateTimeout";
BA_ "SystemSignalLongSymbol" SG_ 861 IBST_a191_rightVCLVPowerStateChe "IBST_a191_rightVCLVPowerStateChecksum";
BA_ "SystemSignalLongSymbol" SG_ 861 IBST_a192_rightVCLVPowerStateCou "IBST_a192_rightVCLVPowerStateCounter";
BA_ "SystemSignalLongSymbol" SG_ 861 IBST_a193_leftVCLVPowerStateTime "IBST_a193_leftVCLVPowerStateTimeout";
BA_ "SystemSignalLongSymbol" SG_ 861 IBST_a194_leftVCLVPowerStateChec "IBST_a194_leftVCLVPowerStateChecksum";
BA_ "SystemSignalLongSymbol" SG_ 861 IBST_a196_leftVCLVPowerStateCoun "IBST_a196_leftVCLVPowerStateCounter";
BA_ "SystemSignalLongSymbol" SG_ 861 IBST_a197_brakeLatencyReductionA "IBST_a197_brakeLatencyReductionActive";
BA_ "SystemSignalLongSymbol" SG_ 861 IBST_a201_EGGREAR1wheelSpeedsRea "IBST_a201_EGGREAR1wheelSpeedsRearTimeOut";
BA_ "SystemSignalLongSymbol" SG_ 861 IBST_a202_EGGREAR1wheelSpeedsRea "IBST_a202_EGGREAR1wheelSpeedsRearChecksum";
BA_ "SystemSignalLongSymbol" SG_ 861 IBST_a203_EGGREAR1wheelSpeedsRea "IBST_a203_EGGREAR1wheelSpeedsRearDLC";
BA_ "SystemSignalLongSymbol" SG_ 861 IBST_a204_EGGREAR1wheelSpeedsRea "IBST_a204_EGGREAR1wheelSpeedsRearCounter";
BA_ "SystemSignalLongSymbol" SG_ 861 IBST_a205_EGGRIGHT1wheelSpeedsFr "IBST_a205_EGGRIGHT1wheelSpeedsFrontTimeOut";
BA_ "SystemSignalLongSymbol" SG_ 861 IBST_a206_EGGRIGHT1wheelSpeedsFr "IBST_a206_EGGRIGHT1wheelSpeedsFrontChecksum";
BA_ "SystemSignalLongSymbol" SG_ 861 IBST_a207_EGGRIGHT1wheelSpeedsFr "IBST_a207_EGGRIGHT1wheelSpeedsFrontDLC";
BA_ "SystemSignalLongSymbol" SG_ 861 IBST_a208_EGGRIGHT1wheelSpeedsFr "IBST_a208_EGGRIGHT1wheelSpeedsFrontCounter";
BA_ "SystemSignalLongSymbol" SG_ 861 IBST_a209_reducedBrakePowerActiv "IBST_a209_reducedBrakePowerActive";
BA_ "SystemSignalLongSymbol" SG_ 861 IBST_a210_reducedBrakePowerNotAv "IBST_a210_reducedBrakePowerNotAvailable";
BA_ "SystemSignalLongSymbol" SG_ 861 IBST_a212_infoFailureWrongCUBASH "IBST_a212_infoFailureWrongCUBASHandlingDetected";
BA_ "SystemSignalLongSymbol" SG_ 861 IBST_a213_PDURouterinitializatio "IBST_a213_PDURouterinitializationFailed";
BA_ "SystemSignalLongSymbol" SG_ 861 IBST_a214_LossOfPDUInstanceDetec "IBST_a214_LossOfPDUInstanceDetected";
BA_ "SystemSignalLongSymbol" SG_ 861 IBST_a215_UnsupportedSeriesHWDet "IBST_a215_UnsupportedSeriesHWDetected";
BA_ "SystemSignalLongSymbol" SG_ 861 IBST_a216_AsicMalfunctionDetecte "IBST_a216_AsicMalfunctionDetected";
BA_ "SystemSignalLongSymbol" SG_ 861 IBST_a217_AsicTrimmingNotComplet "IBST_a217_AsicTrimmingNotCompleted";
BA_ "SystemSignalLongSymbol" SG_ 861 IBST_a218_uCSafetyNotificationGR "IBST_a218_uCSafetyNotificationGRAM";
BA_ "SystemSignalLongSymbol" SG_ 861 IBST_a220_ASICOvercurrentOnGPIO2 "IBST_a220_ASICOvercurrentOnGPIO250_2";
BA_ "SystemSignalLongSymbol" SG_ 861 IBST_a221_ASICOvercurrentOnGPIO2 "IBST_a221_ASICOvercurrentOnGPIO250_1";
BA_ "SystemSignalLongSymbol" SG_ 861 IBST_a222_ASICOvercurrentOnGPIO5 "IBST_a222_ASICOvercurrentOnGPIO50_4";
BA_ "SystemSignalLongSymbol" SG_ 861 IBST_a223_ASICOvercurrentOnGPIO5 "IBST_a223_ASICOvercurrentOnGPIO50_3";
BA_ "SystemSignalLongSymbol" SG_ 861 IBST_a224_ASICOvercurrentOnGPIO5 "IBST_a224_ASICOvercurrentOnGPIO50_2";
BA_ "SystemSignalLongSymbol" SG_ 861 IBST_a225_ASICOvercurrentOnGPIO5 "IBST_a225_ASICOvercurrentOnGPIO50_1";
BA_ "SystemSignalLongSymbol" SG_ 861 IBST_a227_wakeRequestMismatchDet "IBST_a227_wakeRequestMismatchDetected";
BA_ "SystemSignalLongSymbol" SG_ 861 IBST_a228_BlockedPedalDetectedDu "IBST_a228_BlockedPedalDetectedDuringHAD";
BA_ "SystemSignalLongSymbol" SG_ 861 IBST_a232_PostAssemblyRoutineFai "IBST_a232_PostAssemblyRoutineFailed";
BA_ "SystemSignalLongSymbol" SG_ 861 IBST_a233_ReferenceRunAbortByECU "IBST_a233_ReferenceRunAbortByECUReset";
BA_ "SystemSignalLongSymbol" SG_ 861 IBST_a246_DASredundantBrakingCon "IBST_a246_DASredundantBrakingControlPartyChecksum";
BA_ "SystemSignalLongSymbol" SG_ 861 IBST_a247_DASredundantBrakingCon "IBST_a247_DASredundantBrakingControlPartyCounter";
BA_ "SystemSignalLongSymbol" SG_ 861 IBST_a248_DASredundantBrakingCon "IBST_a248_DASredundantBrakingControlPartyDLC";
BA_ "SystemSignalLongSymbol" SG_ 861 IBST_a249_DASredundantBrakingCon "IBST_a249_DASredundantBrakingControlPartyTimeout";
BA_ "SystemSignalLongSymbol" SG_ 861 IBST_a250_DASredundantBrakingCon "IBST_a250_DASredundantBrakingControlChassisChecksum";
BA_ "SystemSignalLongSymbol" SG_ 861 IBST_a251_DASredundantBrakingCon "IBST_a251_DASredundantBrakingControlChassisCounter";
BA_ "SystemSignalLongSymbol" SG_ 861 IBST_a252_DASredundantBrakingCon "IBST_a252_DASredundantBrakingControlChassisDLC";
BA_ "SystemSignalLongSymbol" SG_ 861 IBST_a253_DASredundantBrakingCon "IBST_a253_DASredundantBrakingControlChassisTimeout";
BA_ "Confidence" SG_ 813 IBST_infoIndex 1;
BA_ "Confidence" SG_ 813 IBST_infoBuildType 0;
BA_ "Confidence" SG_ 813 IBST_infoPcbaID 0;
BA_ "Confidence" SG_ 813 IBST_infoAssemblyID 0;
BA_ "Confidence" SG_ 813 IBST_infoUsageID 0;
BA_ "Confidence" SG_ 813 IBST_infoSubUsageID 0;
BA_ "Confidence" SG_ 813 IBST_infoApplicationCRC 0;
BA_ "Confidence" SG_ 813 IBST_infoBootUdsProtoVersion 0;
BA_ "Confidence" SG_ 813 IBST_infoBootloaderCRC 0;
BA_ "Confidence" SG_ 813 IBST_infoVariantCRC 0;
BA_ "Confidence" SG_ 1629 IBST_udsResponseData 1;
VAL_ 920 EPASTS_matrixIndex 4 "AlertMatrix4" 3 "AlertMatrix3" 2 "AlertMatrix2" 1 "AlertMatrix1" 0 "AlertMatrix0" ;
VAL_ 981 ESP_matrixIndex 6 "AlertMatrix6" 5 "AlertMatrix5" 4 "AlertMatrix4" 3 "AlertMatrix3" 2 "AlertMatrix2" 1 "AlertMatrix1" 0 "AlertMatrix0" ;
VAL_ 805 ESP_infoIndex 255 "END" 31 "SUBCOMPONENT_GITHASH" 30 "PACKAGE_SN_8_14" 29 "PACKAGE_SN_1_7" 27 "PACKAGE_PN_15_20" 26 "PACKAGE_PN_8_14" 25 "PACKAGE_PN_1_7" 23 "SUBCOMPONENT2" 22 "VARIANTCRC" 20 "UDS_PROTOCOL_BOOTCRC" 19 "VERSION_DEPRECATED" 18 "BOOTLOADER_GITHASH" 17 "APP_GITHASH" 16 "SUBCOMPONENT" 15 "BOOTLOADER_CRC" 14 "BOOTLOADER_SVN" 13 "APP_CRC" 11 "PCBAID_ASSYID_USAGEID" 10 "BUILD_HWID_COMPONENTID" 9 "DEPRECATED_9" 8 "DEPRECATED_8" 7 "DEPRECATED_7" 6 "DEPRECATED_6" 5 "DEPRECATED_5" 4 "DEPRECATED_4" 3 "DEPRECATED_3" 2 "DEPRECATED_2" 1 "DEPRECATED_1" 0 "DEPRECATED_0" ;
VAL_ 805 ESP_infoBuildType 4 "INFO_MFG_BUILD" 3 "INFO_TRACEABLE_CI_BUILD" 2 "INFO_LOCAL_BUILD" 1 "INFO_PLATFORM_BUILD" 0 "INFO_UNKNOWN_BUILD" ;
VAL_ 805 ESP_vehFlashMode 1 "Development_Mode" 0 "Production_Mode" ;
VAL_ 805 ESP_infoSubUsageID 16 "XCP_Dfive_ESP_CP_CB" 8 "nonXCP_Dfour_ESP_CP_CB" 4 "XCP_Gladiator_ESP" 2 "nonXCP_Rev_C_ESP_Cappella" 0 "nonXCP_Rev_B_ESP_Cappella" ;
VAL_ 805 ESP_infoVehicleVariant 9 "MODEL_3_VARIANT_09" 8 "MODEL_3_VARIANT_08" 7 "MODEL_3_VARIANT_07" 6 "MODEL_3_VARIANT_06" 5 "MODEL_3_VARIANT_05" 4 "MODEL_3_VARIANT_04" 3 "MODEL_3_VARIANT_03" 2 "MODEL_3_VARIANT_02" 1 "MODEL_3_VARIANT_01" ;
VAL_ 861 IBST_matrixIndex 4 "AlertMatrix4" 3 "AlertMatrix3" 2 "AlertMatrix2" 1 "AlertMatrix1" 0 "AlertMatrix0" ;
VAL_ 813 IBST_infoIndex 255 "END" 31 "SUBCOMPONENT_GITHASH" 30 "PACKAGE_SN_8_14" 29 "PACKAGE_SN_1_7" 27 "PACKAGE_PN_15_20" 26 "PACKAGE_PN_8_14" 25 "PACKAGE_PN_1_7" 23 "SUBCOMPONENT2" 22 "VARIANTCRC" 20 "UDS_PROTOCOL_BOOTCRC" 19 "VERSION_DEPRECATED" 18 "BOOTLOADER_GITHASH" 17 "APP_GITHASH" 16 "SUBCOMPONENT" 15 "BOOTLOADER_CRC" 14 "BOOTLOADER_SVN" 13 "APP_CRC" 11 "PCBAID_ASSYID_USAGEID" 10 "BUILD_HWID_COMPONENTID" 9 "DEPRECATED_9" 8 "DEPRECATED_8" 7 "DEPRECATED_7" 6 "DEPRECATED_6" 5 "DEPRECATED_5" 4 "DEPRECATED_4" 3 "DEPRECATED_3" 2 "DEPRECATED_2" 1 "DEPRECATED_1" 0 "DEPRECATED_0" ;
VAL_ 813 IBST_infoBuildType 4 "INFO_MFG_BUILD" 3 "INFO_TRACEABLE_CI_BUILD" 2 "INFO_LOCAL_BUILD" 1 "INFO_PLATFORM_BUILD" 0 "INFO_UNKNOWN_BUILD" ;
