VERSION "dbc-export 1 2026.26.6.5"

NS_ :

BS_:

BU_: APP APS BMS CC CMP CMPD CP DAS DI DIF DIR EPBL EPBR EVSE FC GTW HCML HCMR HVP ICR PCS PCS2 PLG PM PMF PMR PTC SCCM SCM SCS SDCR TAS UMC V2G VC VCBATT VCBATT0 VCBATT1 VCBATT2 VCFRONT VCFRONT1 VCFRONT2 VCLEFT VCRIGHT VCSEAT2L VCSEAT2R VCSEC

BO_ 737 VCFRONT_status: 8 VCFRONT
 SG_ VCFRONT_statusIndex M : 0|3@1+ (1,0) [0|7] "" Vector__XXX
 SG_ VCFRONT_frunkLatchStatus m0 : 3|4@1+ (1,0) [1|15] "" Vector__XXX
 SG_ VCFRONT_wiperSpeed m0 : 8|4@1+ (1,0) [1|15] "" Vector__XXX
 SG_ VCFRONT_wiperPosition m0 : 12|3@1+ (1,0) [1|7] "" Vector__XXX
 SG_ VCFRONT_wiperBlocked m0 : 15|1@1+ (1,0) [0|1] "" Vector__XXX
 SG_ VCFRONT_wiperState m0 : 16|4@1+ (1,0) [1|15] "" Vector__XXX
 SG_ VCFRONT_crashDetectedType m0 : 20|2@1+ (1,0) [0|3] "" Vector__XXX
 SG_ VCFRONT_crashState m0 : 22|2@1+ (1,0) [0|3] "" Vector__XXX
 SG_ VCFRONT_crashUnlockOverrideSet m0 : 24|1@1+ (1,0) [0|1] "" Vector__XXX
 SG_ VCFRONT_washPumpState m0 : 25|2@1+ (1,0) [0|3] "" Vector__XXX
 SG_ VCFRONT_turnIndicatorControlType m0 : 27|2@1+ (1,0) [0|3] "" Vector__XXX
 SG_ VCFRONT_wiperHealth m0 : 32|3@1+ (1,0) [0|7] "" Vector__XXX
 SG_ VCFRONT_wiperLINHealth m0 : 35|3@1+ (1,0) [0|7] "" Vector__XXX
 SG_ VCFRONT_frunkLatchCurrent m0 : 40|8@1- (0.157480314374,0) [-10|10] "A" Vector__XXX
 SG_ VCFRONT_frunkInteriorRelSwitch m0 : 48|1@1+ (1,0) [0|1] "" Vector__XXX
 SG_ VCFRONT_anyClosureOpen m0 : 49|1@1+ (1,0) [0|1] "" Vector__XXX
 SG_ VCFRONT_anyDoorOpen m0 : 50|1@1+ (1,0) [0|1] "" Vector__XXX
 SG_ VCFRONT_hornOn m0 : 51|1@1+ (1,0) [0|1] "" Vector__XXX
 SG_ VCFRONT_radarHeaterState m0 : 52|3@1+ (1,0) [1|7] "" Vector__XXX
 SG_ VCFRONT_trunkExteriorWakeSwitch m0 : 55|1@1+ (1,0) [0|1] "" Vector__XXX
 SG_ VCFRONT_passengerBuckleStatus m0 : 57|1@1+ (1,0) [0|1] "" Vector__XXX
 SG_ VCFRONT_frunkLatchType m0 : 58|2@1+ (1,0) [0|3] "" Vector__XXX
 SG_ VCFRONT_headlampLeftFanStatus m0 : 60|1@1+ (1,0) [0|1] "" Vector__XXX
 SG_ VCFRONT_headlampRightFanStatus m0 : 61|1@1+ (1,0) [0|1] "" Vector__XXX
 SG_ VCFRONT_frunkAccessPost m0 : 62|1@1+ (1,0) [0|1] "" Vector__XXX
 SG_ VCFRONT_isActiveHeatingBattery m0 : 63|1@1+ (1,0) [0|1] "" Vector__XXX
 SG_ VCFRONT_iBoosterWakeLine m1 : 3|1@1+ (1,0) [0|1] "" Vector__XXX
 SG_ VCFRONT_epasWakeLine m1 : 4|1@1+ (1,0) [0|1] "" Vector__XXX
 SG_ VCFRONT_iBoosterStateDBG m1 : 5|3@1+ (1,0) [0|7] "" Vector__XXX
 SG_ VCFRONT_vehicleStatusDBG m1 : 8|5@1+ (1,0) [0|31] "" Vector__XXX
 SG_ VCFRONT_timeSpentSleeping m1 : 13|10@1+ (1,0) [0|1023] "s" Vector__XXX
 SG_ VCFRONT_sleepCurrent m1 : 24|12@1+ (0.125,-511.875) [-511.875|-0.125] "mA" Vector__XXX
 SG_ VCFRONT_hibernationState m1 : 36|3@1+ (1,0) [0|7] "" Vector__XXX
 SG_ VCFRONT_wiperECUType m1 : 40|2@1+ (1,0) [0|3] "" Vector__XXX
 SG_ VCFRONT_wiperHeaterState m1 : 42|3@1+ (1,0) [1|7] "" Vector__XXX
 SG_ VCFRONT_occupantCount m1 : 45|3@1+ (1,0) [0|7] "" Vector__XXX
 SG_ VCFRONT_closureEasterEggState m1 : 48|3@1+ (1,0) [0|7] "" Vector__XXX
 SG_ VCFRONT_espWakeLine m1 : 51|1@1+ (1,0) [0|1] "" Vector__XXX
 SG_ VCFRONT_allowEvapInLowAmbient m1 : 52|1@1+ (1,0) [0|1] "" Vector__XXX
 SG_ VCFRONT_potentialRadiatorSteam m1 : 53|1@1+ (1,0) [0|1] "" Vector__XXX
 SG_ VCFRONT_potentialRadiatorSteamUI m1 : 54|1@1+ (1,0) [0|1] "" Vector__XXX
 SG_ VCFRONT_hvacReqOffForFasterCharg m1 : 55|1@1+ (1,0) [0|1] "" Vector__XXX
 SG_ VCFRONT_limitedSplitTempDeltaEnf m1 : 56|1@1+ (1,0) [0|1] "" Vector__XXX
 SG_ VCFRONT_batteryDischArbState m1 : 57|3@1+ (1,0) [0|7] "" Vector__XXX
 SG_ VCFRONT_maxEvapHeatRejection m2 : 8|8@1+ (65,0) [0|16575] "W" Vector__XXX
 SG_ VCFRONT_minEvapHeatRejection m2 : 16|8@1+ (15,0) [0|3800] "W" Vector__XXX
 SG_ VCFRONT_freezeEvapITerm m2 : 24|1@1+ (1,0) [0|1] "" Vector__XXX
 SG_ VCFRONT_isEvapOperationAllowed m2 : 25|1@1+ (1,0) [0|1] "" Vector__XXX
 SG_ VCFRONT_chillerDemandActive m2 : 26|1@1+ (1,0) [0|1] "" Vector__XXX
 SG_ VCFRONT_compPerfRecoveryLimited m2 : 27|1@1+ (1,0) [0|1] "" Vector__XXX
 SG_ VCFRONT_hvacModeNotAttainable m2 : 28|1@1+ (1,0) [0|1] "" Vector__XXX
 SG_ VCFRONT_hasLowRefrigerant m2 : 29|1@1+ (1,0) [0|1] "" Vector__XXX
 SG_ VCFRONT_isColdStartRunning m2 : 30|1@1+ (1,0) [0|1] "" Vector__XXX
 SG_ VCFRONT_isHeatPumpOilPurgeActive m2 : 31|1@1+ (1,0) [0|1] "" Vector__XXX
 SG_ VCFRONT_pressureRefrigSuction m2 : 32|7@1+ (0.125,0) [0|11.5] "bar" Vector__XXX
 SG_ VCFRONT_pressureRefrigDischarge m2 : 40|9@1+ (0.08,0) [0|37.25] "bar" Vector__XXX
 SG_ VCFRONT_hvacPerfTestCommand m2 : 49|3@1+ (1,0) [0|7] "" Vector__XXX
 SG_ VCFRONT_coolantFillRoutineStatus m2 : 52|2@1+ (1,0) [0|3] "" Vector__XXX
 SG_ VCFRONT_refrigFillRoutineStatus m2 : 54|2@1+ (1,0) [0|3] "" Vector__XXX
 SG_ VCFRONT_isCOP1Running m2 : 56|1@1+ (1,0) [0|1] "" Vector__XXX
 SG_ VCFRONT_closeValvesRoutineStatus m2 : 57|2@1+ (1,0) [0|3] "" Vector__XXX
 SG_ VCFRONT_thermalPerfTestRunning m2 : 59|1@1+ (1,0) [0|1] "" Vector__XXX
 SG_ VCFRONT_extendedHvacPerfTestComm m2 : 60|4@1+ (1,0) [0|15] "" Vector__XXX
 SG_ VCFRONT_5VARailStable m3 : 3|1@1+ (1,0) [0|1] "" Vector__XXX
 SG_ VCFRONT_5VBRailStable m3 : 4|1@1+ (1,0) [0|1] "" Vector__XXX
 SG_ VCFRONT_12VARailStable m3 : 5|1@1+ (1,0) [0|1] "" Vector__XXX
 SG_ VCFRONT_12VBRailStable m3 : 6|1@1+ (1,0) [0|1] "" Vector__XXX
 SG_ VCFRONT_railAState m3 : 7|1@1+ (1,0) [0|1] "" Vector__XXX
 SG_ VCFRONT_railBState m3 : 8|1@1+ (1,0) [0|1] "" Vector__XXX
 SG_ VCFRONT_ChargePumpVoltageStable m3 : 9|1@1+ (1,0) [0|1] "" Vector__XXX
 SG_ VCFRONT_PEResetLineState m3 : 10|1@1+ (1,0) [0|1] "" Vector__XXX
 SG_ VCFRONT_HSDInitCompleteU13 m3 : 11|1@1+ (1,0) [0|1] "" Vector__XXX
 SG_ VCFRONT_HSDInitCompleteU16 m3 : 12|1@1+ (1,0) [0|1] "" Vector__XXX
 SG_ VCFRONT_vbatMonitorVoltage m3 : 16|12@1+ (0.005443676,0) [0|22.286409544] "V" Vector__XXX
 SG_ VCFRONT_AS8510Voltage m3 : 28|12@1+ (0.005443676,0) [0|22.286409544] "V" Vector__XXX
 SG_ VCFRONT_vbatProt m3 : 40|12@1+ (0.005443676,0) [0|22.29185322] "V" Vector__XXX
 SG_ VCFRONT_logVerbosity m3 : 52|3@1+ (1,0) [0|7] "" Vector__XXX
 SG_ VCFRONT_IBSFault m4 : 3|1@1+ (1,0) [0|1] "" Vector__XXX
 SG_ VCFRONT_12VOverchargeCounter m4 : 4|4@1+ (1,0) [0|15] "" Vector__XXX
 SG_ VCFRONT_compPowerSupportingHvac m4 : 8|11@1+ (10,0) [0|20470] "W" Vector__XXX
 SG_ VCFRONT_compPowerSupportingPT m4 : 19|11@1+ (10,0) [0|20470] "W" Vector__XXX
 SG_ VCFRONT_maxHeatingPowerLeftCC m4 : 30|7@1+ (100,0) [0|12000] "W" Vector__XXX
 SG_ VCFRONT_maxHeatingPowerRightCC m4 : 37|7@1+ (100,0) [0|12000] "W" Vector__XXX
 SG_ VCFRONT_activeLouverOpenPos m4 : 44|7@1+ (1,0) [0|100] "%" Vector__XXX
 SG_ VCFRONT_activeLouverState m4 : 51|5@1+ (1,0) [0|31] "" Vector__XXX
 SG_ VCFRONT_windshieldCameraHeaterPo m4 : 56|6@1+ (2.5,0) [0|155] "W" Vector__XXX

BO_ 1349 VCFRONT_systemStatus: 8 VCFRONT
 SG_ VCFRONT_systemStatusMuxIndex M : 0|2@1+ (1,0) [0|3] "" Vector__XXX
 SG_ VCFRONT_systemStatusCounter : 52|4@1+ (1,0) [0|15] "" Vector__XXX
 SG_ VCFRONT_systemStatusChecksum : 56|8@1+ (1,0) [0|255] "" Vector__XXX
 SG_ VCFRONT_loadShedReason m1 : 3|9@1+ (1,0) [0|511] "" Vector__XXX
 SG_ VCFRONT_VCRightEFuseLoadShedStag m1 : 12|5@1+ (1,0) [0|31] "" Vector__XXX
 SG_ VCFRONT_VCLeftEFuseLoadShedStage m1 : 20|5@1+ (1,0) [0|31] "" Vector__XXX
 SG_ VCFRONT_DCDCSaturationLoadShedSt m1 : 28|5@1+ (1,0) [0|31] "" Vector__XXX
 SG_ VCFRONT_vehicleLoadShedStage m1 : 36|2@1+ (1,0) [0|3] "" Vector__XXX
 SG_ VCFRONT_HVFaultVehicleLoadShedRe m1 : 38|1@1+ (1,0) [0|1] "" Vector__XXX
 SG_ VCFRONT_postCrashVehicleLoadShed m1 : 39|1@1+ (1,0) [0|1] "" Vector__XXX
 SG_ VCFRONT_HVFaultVehicleLoadShedAc m1 : 40|1@1+ (1,0) [0|1] "" Vector__XXX
 SG_ VCFRONT_factoryVehicleLoadShedAc m1 : 41|1@1+ (1,0) [0|1] "" Vector__XXX
 SG_ VCFRONT_anyVehicleLoadShedActive m1 : 42|1@1+ (1,0) [0|1] "" Vector__XXX
 SG_ VCFRONT_DIVehLoadShedActive m1 : 43|1@1+ (1,0) [0|1] "" Vector__XXX
 SG_ VCFRONT_HVFaultLoadShedStateDBG m1 : 44|2@1+ (1,0) [0|3] "" Vector__XXX
 SG_ VCFRONT_LVUnhealthyVehicleLoadSh m1 : 46|1@1+ (1,0) [0|1] "" Vector__XXX
 SG_ VCFRONT_loadShedStsCondenserFan m2 : 3|1@1+ (1,0) [0|1] "" Vector__XXX
 SG_ VCFRONT_loadShedStsPTPump m2 : 6|1@1+ (1,0) [0|1] "" Vector__XXX
 SG_ VCFRONT_loadShedMCUAudio m2 : 10|1@1+ (1,0) [0|1] "" Vector__XXX
 SG_ VCFRONT_loadShedHVDownTriggerDBG m2 : 11|1@1+ (1,0) [0|1] "" Vector__XXX
 SG_ VCFRONT_loadShedPCSSatTriggerDBG m2 : 12|1@1+ (1,0) [0|1] "" Vector__XXX
 SG_ VCFRONT_loadShedStsBatteryPump m2 : 13|1@1+ (1,0) [0|1] "" Vector__XXX
 SG_ VCFRONT_loadShedStsAPGlassHeater m2 : 14|1@1+ (1,0) [0|1] "" Vector__XXX
 SG_ VCFRONT_loadShedStsMCUGraphics m2 : 15|1@1+ (1,0) [0|1] "" Vector__XXX
 SG_ VCFRONT_IBSCurrentRMS_loadShed m2 : 16|7@1+ (0.05,0) [0|6.35] "A" Vector__XXX
 SG_ VCFRONT_loadShedAhLeakyBktCntDBG m2 : 23|9@1+ (0.001,0) [0|0.511] "Ah" Vector__XXX
 SG_ VCFRONT_loadShedPcs m2 : 33|1@1+ (1,0) [0|1] "" Vector__XXX
 SG_ VCFRONT_loadShedGTWDownstrmRails m2 : 35|1@1+ (1,0) [0|1] "" Vector__XXX
 SG_ VCFRONT_loadShedPCSMIATriggerDBG m2 : 36|1@1+ (1,0) [0|1] "" Vector__XXX
 SG_ VCFRONT_loadShedTAS m2 : 37|1@1+ (1,0) [0|1] "" Vector__XXX
 SG_ VCFRONT_loadShedBackStopBktCntDB m2 : 38|5@1+ (0.05,0) [0|1.55] "Ah" Vector__XXX
 SG_ VCFRONT_loadShedPCSLeakyBktCtDBG m2 : 44|6@1+ (100,0) [0|6300] "mV" Vector__XXX
 SG_ VCFRONT_loadShedUI m2 : 50|1@1+ (1,0) [0|1] "" Vector__XXX
 SG_ VCFRONT_loadShedAutoPilot m2 : 51|1@1+ (1,0) [0|1] "" Vector__XXX

BO_ 1537 VCFRONT_udsResponse: 8 VCFRONT
 SG_ VCFRONT_udsResponseData : 7|64@0+ (1,0) [0|1.84467440737e+19] "" Vector__XXX

BO_ 929 VCFRONT_vehicleStatus: 8 VCFRONT
 SG_ VCFRONT_vehicleStatusMuxIndex M : 0|1@1+ (1,0) [0|1] "" Vector__XXX
 SG_ VCFRONT_vehicleStatusCounter : 52|4@1+ (1,0) [0|15] "" Vector__XXX
 SG_ VCFRONT_vehicleStatusChecksum : 56|8@1+ (1,0) [0|255] "" Vector__XXX
 SG_ VCFRONT_preconditionRequest m0 : 1|1@1+ (1,0) [0|1] "" Vector__XXX
 SG_ VCFRONT_APGlassHeaterState m0 : 2|3@1+ (1,0) [1|7] "" Vector__XXX
 SG_ VCFRONT_thermalSystemType m0 : 5|1@1+ (1,0) [0|1] "" Vector__XXX
 SG_ VCFRONT_standbySupplySupported m0 : 6|1@1+ (1,0) [0|1] "" Vector__XXX
 SG_ VCFRONT_driverPresent m0 : 7|1@1+ (1,0) [0|1] "" Vector__XXX
 SG_ VCFRONT_passengerPresent m0 : 8|1@1+ (1,0) [0|1] "" Vector__XXX
 SG_ VCFRONT_accPlusAvailable m0 : 9|1@1+ (1,0) [0|1] "" Vector__XXX
 SG_ VCFRONT_diPowerOnState m0 : 10|3@1+ (1,0) [0|7] "" Vector__XXX
 SG_ VCFRONT_12vStatusForDrive m0 : 14|2@1+ (1,0) [0|3] "" Vector__XXX
 SG_ VCFRONT_dcr12VMilliOhms m0 : 16|8@1+ (1,0) [0|255] "mOhm" Vector__XXX
 SG_ VC_userPresenceState m0 : 24|2@1+ (1,0) [0|3] "" Vector__XXX
 SG_ VCFRONT_factoryLimitsOverrideOk m0 : 27|1@1+ (1,0) [0|1] "" Vector__XXX
 SG_ VCFRONT_ota12VSupportRequest m0 : 29|1@1+ (1,0) [0|1] "" Vector__XXX
 SG_ VCFRONT_driverBuckleStatus m0 : 30|1@1+ (1,0) [0|1] "" Vector__XXX
 SG_ VCFRONT_driverDoorStatus m0 : 31|1@1+ (1,0) [0|1] "" Vector__XXX
 SG_ VCFRONT_driverUnbuckled m0 : 32|2@1+ (1,0) [0|3] "" Vector__XXX
 SG_ VCFRONT_passengerUnbuckled m0 : 34|2@1+ (1,0) [0|3] "" Vector__XXX
 SG_ VCFRONT_2RowLeftUnbuckled m0 : 36|2@1+ (1,0) [0|3] "" Vector__XXX
 SG_ VCFRONT_2RowCenterUnbuckled m0 : 38|2@1+ (1,0) [0|3] "" Vector__XXX
 SG_ VCFRONT_2RowRightUnbuckled m0 : 40|2@1+ (1,0) [0|3] "" Vector__XXX
 SG_ VCFRONT_pcsEFuseVoltage m0 : 42|10@1+ (0.1,0) [0|102.2] "V" Vector__XXX
 SG_ VCFRONT_bmsHvChargeEnable m1 : 1|1@1+ (1,0) [0|1] "" Vector__XXX
 SG_ VCFRONT_3RowLeftUnbuckled m1 : 2|2@1+ (1,0) [0|3] "" Vector__XXX
 SG_ VCFRONT_3RowRightUnbuckled m1 : 4|2@1+ (1,0) [0|3] "" Vector__XXX
 SG_ VCFRONT_maxBattHeatRejection m1 : 6|10@1+ (30,0) [0|30690] "W" Vector__XXX
 SG_ VCFRONT_hvacReqBattCoolOutTemp m1 : 16|9@1+ (0.1,40) [40|91.1] "degC" Vector__XXX
 SG_ VCFRONT_PCSCurrent m1 : 25|13@1- (0.1,0) [-409.6|409.5] "A" Vector__XXX
 SG_ VCFRONT_refSystemNominal m1 : 38|1@1+ (1,0) [0|1] "" Vector__XXX
 SG_ VCFRONT_driverEnteredCabinEstima m1 : 39|1@1+ (1,0) [0|1] "" Vector__XXX
 SG_ VCFRONT_anySWEFuseActive m1 : 40|1@1+ (1,0) [0|1] "" Vector__XXX
 SG_ VCFRONT_hpBattHeatingPowerTrgt m1 : 41|7@1+ (100,0) [0|10000] "W" Vector__XXX
 SG_ VCFRONT_LVStatusForDriveVEH m1 : 48|3@1+ (1,0) [0|7] "" Vector__XXX

BO_ 507 VCLEFT_TLCStatus: 8 VCLEFT
 SG_ VCLEFT_TLCStatusIndex M : 0|2@1+ (1,0) [0|3] "" Vector__XXX
 SG_ VCLEFT_TLCTemperature m1 : 2|8@1- (1,68) [-59|195] "degC" Vector__XXX
 SG_ VCLEFT_TLCLeftTurnVoltage m1 : 10|8@1+ (0.1,0) [0|25.4] "V" Vector__XXX
 SG_ VCLEFT_TLCRightTurnVoltage m1 : 18|8@1+ (0.1,0) [0|25.4] "V" Vector__XXX
 SG_ VCLEFT_TLCState_LeftTurn m1 : 26|3@1+ (1,0) [0|7] "" Vector__XXX
 SG_ VCLEFT_TLCState_RightTurn m1 : 29|3@1+ (1,0) [0|7] "" Vector__XXX
 SG_ VCLEFT_TLCState_Tail m1 : 32|3@1+ (1,0) [0|7] "" Vector__XXX
 SG_ VCLEFT_TLCState_Stop m1 : 35|3@1+ (1,0) [0|7] "" Vector__XXX
 SG_ VCLEFT_TLCState_Fog m1 : 38|3@1+ (1,0) [0|7] "" Vector__XXX
 SG_ VCLEFT_TLCState_Reverse m1 : 41|3@1+ (1,0) [0|7] "" Vector__XXX

BO_ 1373 VCLEFT_alertLog: 8 VCLEFT
 SG_ VCLEFT_alertID M : 0|10@1+ (1,0) [0|1023] "" Vector__XXX
 SG_ VCLEFT_alertState : 15|1@1+ (1,0) [0|1] "" Vector__XXX
 SG_ VCLEFT_a001_InternalWatchdog m1 : 16|1@1+ (1,0) [0|1] "" Vector__XXX
 SG_ VCLEFT_a010_UnderVoltageDetected m10 : 16|1@1+ (1,0) [0|1] "" Vector__XXX
 SG_ VCLEFT_a010_UnderVoltageTimeout m10 : 17|1@1+ (1,0) [0|1] "" Vector__XXX
 SG_ VCLEFT_a015_NVMMMemOverflow m15 : 16|1@1+ (1,0) [0|1] "" Vector__XXX
 SG_ VCLEFT_a015_NVMMFilesystemError m15 : 17|1@1+ (1,0) [0|1] "" Vector__XXX
 SG_ VCLEFT_a015_NVMMRecordIDError m15 : 18|1@1+ (1,0) [0|1] "" Vector__XXX
 SG_ VCLEFT_a057_VEH_cpControl m57 : 16|1@1+ (1,0) [0|1] "" Vector__XXX
 SG_ VCLEFT_a059_voltageDrop m59 : 16|12@1+ (0.005443676,0) [0|22.29185322] "V" Vector__XXX
 SG_ VCLEFT_a059_resistanceEstimate m59 : 28|12@1+ (0.00244,0) [0|9.9918] "Ohms" Vector__XXX
 SG_ VCLEFT_a059_current m59 : 40|12@1+ (0.05,0) [0|204.75] "A" Vector__XXX
 SG_ VCLEFT_a063_switchChannel m63 : 16|8@1+ (1,0) [0|255] "" Vector__XXX
 SG_ VCLEFT_a063_switchType m63 : 24|8@1+ (1,0) [0|255] "" Vector__XXX
 SG_ VCLEFT_a063_ADCVoltage m63 : 32|8@1+ (0.025,0) [0|6.375] "V" Vector__XXX
 SG_ VCLEFT_a063_disconnected m63 : 40|1@1+ (1,0) [0|1] "" Vector__XXX
 SG_ VCLEFT_a063_indeterminate m63 : 41|1@1+ (1,0) [0|1] "" Vector__XXX
 SG_ VCLEFT_a063_stuckActive m63 : 42|1@1+ (1,0) [0|1] "" Vector__XXX
 SG_ VCLEFT_a063_faulted m63 : 43|1@1+ (1,0) [0|1] "" Vector__XXX
 SG_ VCLEFT_a082_RIPC_epbPrivateState m82 : 16|1@1+ (1,0) [0|1] "" Vector__XXX
 SG_ VCLEFT_a082_RIPC_remoteHSD m82 : 17|1@1+ (1,0) [0|1] "" Vector__XXX
 SG_ VCLEFT_a082_RIPC_railStatus m82 : 18|1@1+ (1,0) [0|1] "" Vector__XXX
 SG_ VCLEFT_a082_RIPC_remoteMux m82 : 19|1@1+ (1,0) [0|1] "" Vector__XXX
 SG_ VCLEFT_a083_LIPC_epbPrivateState m83 : 16|1@1+ (1,0) [0|1] "" Vector__XXX
 SG_ VCLEFT_a083_LIPC_remoteHSD m83 : 17|1@1+ (1,0) [0|1] "" Vector__XXX
 SG_ VCLEFT_a083_LIPC_railStatus m83 : 18|1@1+ (1,0) [0|1] "" Vector__XXX
 SG_ VCLEFT_a083_LIPC_HSDFaults m83 : 19|1@1+ (1,0) [0|1] "" Vector__XXX
 SG_ VCLEFT_a084_CH_StatusC m84 : 16|1@1+ (1,0) [0|1] "" Vector__XXX
 SG_ VCLEFT_a085_PARTY_buttonStatus m85 : 16|1@1+ (1,0) [0|1] "" Vector__XXX
 SG_ VCLEFT_a086_VEH_LVBMS_statusHigh m86 : 16|1@1+ (1,0) [0|1] "" Vector__XXX
 SG_ VCLEFT_a086_VEH_LVBMS_statusLow m86 : 17|1@1+ (1,0) [0|1] "" Vector__XXX
 SG_ VCLEFT_a086_VEH_status m86 : 18|1@1+ (1,0) [0|1] "" Vector__XXX
 SG_ VCLEFT_a086_VEH_12VBatteryStatus m86 : 19|1@1+ (1,0) [0|1] "" Vector__XXX
 SG_ VCLEFT_a086_VEH_LVPowerState m86 : 20|1@1+ (1,0) [0|1] "" Vector__XXX
 SG_ VCLEFT_a086_VEH_lightStatus m86 : 21|1@1+ (1,0) [0|1] "" Vector__XXX
 SG_ VCLEFT_a086_VEH_systemStatus m86 : 22|1@1+ (1,0) [0|1] "" Vector__XXX
 SG_ VCLEFT_a086_VEH_thermalStatus m86 : 23|1@1+ (1,0) [0|1] "" Vector__XXX
 SG_ VCLEFT_a086_VEH_vehNm m86 : 24|1@1+ (1,0) [0|1] "" Vector__XXX
 SG_ VCLEFT_a086_BDY_LVSelfTests m86 : 60|1@1+ (1,0) [0|1] "" Vector__XXX
 SG_ VCLEFT_a086_VEH_LVSelfTests m86 : 61|1@1+ (1,0) [0|1] "" Vector__XXX
 SG_ VCLEFT_a086_VEH_LVHealth m86 : 62|1@1+ (1,0) [0|1] "" Vector__XXX
 SG_ VCLEFT_a086_BDY_12VBatteryStatus m86 : 63|1@1+ (1,0) [0|1] "" Vector__XXX
 SG_ VCLEFT_a087_VEH_temperature m87 : 16|1@1+ (1,0) [0|1] "" Vector__XXX
 SG_ VCLEFT_a087_VEH_thermalControl m87 : 17|1@1+ (1,0) [0|1] "" Vector__XXX
 SG_ VCLEFT_a087_VEH_torque m87 : 18|1@1+ (1,0) [0|1] "" Vector__XXX
 SG_ VCLEFT_a087_VEH_status m87 : 19|1@1+ (1,0) [0|1] "" Vector__XXX
 SG_ VCLEFT_a087_PARTY_torque m87 : 20|1@1+ (1,0) [0|1] "" Vector__XXX
 SG_ VCLEFT_a087_PARTY_status m87 : 21|1@1+ (1,0) [0|1] "" Vector__XXX
 SG_ VCLEFT_a087_PARTY_temperature m87 : 22|1@1+ (1,0) [0|1] "" Vector__XXX
 SG_ VCLEFT_a087_PARTY_thermalControl m87 : 23|1@1+ (1,0) [0|1] "" Vector__XXX
 SG_ VCLEFT_a087_VEH_motorStatus m87 : 24|1@1+ (1,0) [0|1] "" Vector__XXX
 SG_ VCLEFT_a088_VEH_temperature m88 : 16|1@1+ (1,0) [0|1] "" Vector__XXX
 SG_ VCLEFT_a088_VEH_thermalControl m88 : 17|1@1+ (1,0) [0|1] "" Vector__XXX
 SG_ VCLEFT_a088_VEH_torque m88 : 18|1@1+ (1,0) [0|1] "" Vector__XXX
 SG_ VCLEFT_a088_VEH_status m88 : 19|1@1+ (1,0) [0|1] "" Vector__XXX
 SG_ VCLEFT_a088_PARTY_torque m88 : 20|1@1+ (1,0) [0|1] "" Vector__XXX
 SG_ VCLEFT_a088_PARTY_status m88 : 21|1@1+ (1,0) [0|1] "" Vector__XXX
 SG_ VCLEFT_a088_PARTY_temperature m88 : 22|1@1+ (1,0) [0|1] "" Vector__XXX
 SG_ VCLEFT_a088_PARTY_thermalControl m88 : 23|1@1+ (1,0) [0|1] "" Vector__XXX
 SG_ VCLEFT_a088_VEH_motorStatus m88 : 24|1@1+ (1,0) [0|1] "" Vector__XXX
 SG_ VCLEFT_a089_PARTY_party1 m89 : 16|1@1+ (1,0) [0|1] "" Vector__XXX
 SG_ VCLEFT_a089_PARTY_status m89 : 17|1@1+ (1,0) [0|1] "" Vector__XXX
 SG_ VCLEFT_a089_VEH_status m89 : 18|1@1+ (1,0) [0|1] "" Vector__XXX
 SG_ VCLEFT_a089_BDY_party1 m89 : 19|1@1+ (1,0) [0|1] "" Vector__XXX
 SG_ VCLEFT_a089_BDY_status m89 : 20|1@1+ (1,0) [0|1] "" Vector__XXX
 SG_ VCLEFT_a089_CH_status m89 : 21|1@1+ (1,0) [0|1] "" Vector__XXX
 SG_ VCLEFT_a089_CH_party1 m89 : 22|1@1+ (1,0) [0|1] "" Vector__XXX
 SG_ VCLEFT_a089_CH_party3 m89 : 23|1@1+ (1,0) [0|1] "" Vector__XXX
 SG_ VCLEFT_a089_VEH_party1 m89 : 24|1@1+ (1,0) [0|1] "" Vector__XXX
 SG_ VCLEFT_a089_VEH_party3 m89 : 25|1@1+ (1,0) [0|1] "" Vector__XXX
 SG_ VCLEFT_a091_VEH_faultsAndExtras m91 : 16|1@1+ (1,0) [0|1] "" Vector__XXX
 SG_ VCLEFT_a091_VEH_info m91 : 17|1@1+ (1,0) [0|1] "" Vector__XXX
 SG_ VCLEFT_a091_VEH_state m91 : 18|1@1+ (1,0) [0|1] "" Vector__XXX
 SG_ VCLEFT_a092_VEH_restraintStatus m92 : 16|1@1+ (1,0) [0|1] "" Vector__XXX
 SG_ VCLEFT_a092_VEH_switchStatus m92 : 17|1@1+ (1,0) [0|1] "" Vector__XXX
 SG_ VCLEFT_a092_VEH_seatStatus2 m92 : 18|1@1+ (1,0) [0|1] "" Vector__XXX
 SG_ VCLEFT_a092_VEH_vehNm m92 : 19|1@1+ (1,0) [0|1] "" Vector__XXX
 SG_ VCLEFT_a093_VEH_restraintStatus m93 : 16|1@1+ (1,0) [0|1] "" Vector__XXX
 SG_ VCLEFT_a093_VEH_switchStatus m93 : 17|1@1+ (1,0) [0|1] "" Vector__XXX
 SG_ VCLEFT_a093_VEH_seatStatus2 m93 : 18|1@1+ (1,0) [0|1] "" Vector__XXX
 SG_ VCLEFT_a093_VEH_vehNm m93 : 19|1@1+ (1,0) [0|1] "" Vector__XXX
 SG_ VCLEFT_a094_VEH_sysStatus m94 : 16|1@1+ (1,0) [0|1] "" Vector__XXX
 SG_ VCLEFT_a094_PARTY_sysStatus m94 : 17|1@1+ (1,0) [0|1] "" Vector__XXX
 SG_ VCLEFT_a094_CH_sysStatus m94 : 18|1@1+ (1,0) [0|1] "" Vector__XXX
 SG_ VCLEFT_a095_PT_ptNm m95 : 16|1@1+ (1,0) [0|1] "" Vector__XXX
 SG_ VCLEFT_a095_PT_status m95 : 17|1@1+ (1,0) [0|1] "" Vector__XXX
 SG_ VCLEFT_a096_VEH_status m96 : 16|1@1+ (1,0) [0|1] "" Vector__XXX
 SG_ VCLEFT_a096_CH_status m96 : 17|1@1+ (1,0) [0|1] "" Vector__XXX
 SG_ VCLEFT_a097_VEH_HVStatus m97 : 16|1@1+ (1,0) [0|1] "" Vector__XXX
 SG_ VCLEFT_a097_VEH_state m97 : 17|1@1+ (1,0) [0|1] "" Vector__XXX
 SG_ VCLEFT_a098_CH_torque m98 : 16|1@1+ (1,0) [0|1] "" Vector__XXX
 SG_ VCLEFT_a098_VEH_hvStatus m98 : 17|1@1+ (1,0) [0|1] "" Vector__XXX
 SG_ VCLEFT_a098_VEH_status m98 : 18|1@1+ (1,0) [0|1] "" Vector__XXX
 SG_ VCLEFT_a098_VEH_thermalControl m98 : 19|1@1+ (1,0) [0|1] "" Vector__XXX
 SG_ VCLEFT_a098_VEH_temperature m98 : 20|1@1+ (1,0) [0|1] "" Vector__XXX
 SG_ VCLEFT_a098_VEH_torque m98 : 21|1@1+ (1,0) [0|1] "" Vector__XXX
 SG_ VCLEFT_a098_PARTY_status m98 : 22|1@1+ (1,0) [0|1] "" Vector__XXX
 SG_ VCLEFT_a098_PARTY_temperature m98 : 23|1@1+ (1,0) [0|1] "" Vector__XXX
 SG_ VCLEFT_a098_PARTY_thermalControl m98 : 24|1@1+ (1,0) [0|1] "" Vector__XXX
 SG_ VCLEFT_a098_PARTY_torque m98 : 25|1@1+ (1,0) [0|1] "" Vector__XXX
 SG_ VCLEFT_a098_PT_thermalControl m98 : 26|1@1+ (1,0) [0|1] "" Vector__XXX
 SG_ VCLEFT_a098_PT_temperature m98 : 27|1@1+ (1,0) [0|1] "" Vector__XXX
 SG_ VCLEFT_a098_PARTY_motorStatus m98 : 28|1@1+ (1,0) [0|1] "" Vector__XXX
 SG_ VCLEFT_a098_VEH_motorStatus m98 : 29|1@1+ (1,0) [0|1] "" Vector__XXX
 SG_ VCLEFT_a099_VEH_oocStatus m99 : 16|1@1+ (1,0) [0|1] "" Vector__XXX
 SG_ VCLEFT_a100_VEH m100 : 16|1@1+ (1,0) [0|1] "" Vector__XXX
 SG_ VCLEFT_a100_PARTY m100 : 17|1@1+ (1,0) [0|1] "" Vector__XXX
 SG_ VCLEFT_a100_PT m100 : 18|1@1+ (1,0) [0|1] "" Vector__XXX
 SG_ VCLEFT_a100_CH m100 : 19|1@1+ (1,0) [0|1] "" Vector__XXX
 SG_ VCLEFT_a100_OBD m100 : 20|1@1+ (1,0) [0|1] "" Vector__XXX
 SG_ VCLEFT_a101_VEH_state m101 : 16|1@1+ (1,0) [0|1] "" Vector__XXX
 SG_ VCLEFT_a101_PARTY_locState m101 : 17|1@1+ (1,0) [0|1] "" Vector__XXX
 SG_ VCLEFT_a101_LIPC_externalWatchdo m101 : 18|1@1+ (1,0) [0|1] "" Vector__XXX
 SG_ VCLEFT_a101_VEH_locState m101 : 19|1@1+ (1,0) [0|1] "" Vector__XXX
 SG_ VCLEFT_a101_BDY_locState m101 : 20|1@1+ (1,0) [0|1] "" Vector__XXX
 SG_ VCLEFT_a102_VEH_faultsAndExtras m102 : 16|1@1+ (1,0) [0|1] "" Vector__XXX
 SG_ VCLEFT_a102_VEH_feedbackStatus m102 : 17|1@1+ (1,0) [0|1] "" Vector__XXX
 SG_ VCLEFT_a102_VEH_sensorStatus m102 : 18|1@1+ (1,0) [0|1] "" Vector__XXX
 SG_ VCLEFT_a102_VEH_rods m102 : 19|1@1+ (1,0) [0|1] "" Vector__XXX
 SG_ VCLEFT_a103_VEH_hvsNm m103 : 16|1@1+ (1,0) [0|1] "" Vector__XXX
 SG_ VCLEFT_a103_VEH_vehNm m103 : 17|1@1+ (1,0) [0|1] "" Vector__XXX
 SG_ VCLEFT_a103_VEH_status m103 : 18|1@1+ (1,0) [0|1] "" Vector__XXX
 SG_ VCLEFT_a103_PT_ptNm m103 : 19|1@1+ (1,0) [0|1] "" Vector__XXX
 SG_ VCLEFT_a103_PT_status m103 : 20|1@1+ (1,0) [0|1] "" Vector__XXX
 SG_ VCLEFT_a103_VEH_evseStatus m103 : 21|1@1+ (1,0) [0|1] "" Vector__XXX
 SG_ VCLEFT_a105_VEH_states m105 : 16|1@1+ (1,0) [0|1] "" Vector__XXX
 SG_ VCLEFT_a105_VEH_chNm m105 : 17|1@1+ (1,0) [0|1] "" Vector__XXX
 SG_ VCLEFT_a105_VEH_dampingStates m105 : 18|1@1+ (1,0) [0|1] "" Vector__XXX
 SG_ VCLEFT_a106_VEH_dcdcStatus m106 : 16|1@1+ (1,0) [0|1] "" Vector__XXX
 SG_ VCLEFT_a106_VEH_thermalControl m106 : 17|1@1+ (1,0) [0|1] "" Vector__XXX
 SG_ VCLEFT_a106_VEH_dcdcRailStatus m106 : 18|1@1+ (1,0) [0|1] "" Vector__XXX
 SG_ VCLEFT_a106_CH_dcdcRailStatus m106 : 19|1@1+ (1,0) [0|1] "" Vector__XXX
 SG_ VCLEFT_a106_CH_alertMatrix m106 : 20|1@1+ (1,0) [0|1] "" Vector__XXX
 SG_ VCLEFT_a107_VEH_hvsNm m107 : 16|1@1+ (1,0) [0|1] "" Vector__XXX
 SG_ VCLEFT_a107_VEH_vehNm m107 : 17|1@1+ (1,0) [0|1] "" Vector__XXX
 SG_ VCLEFT_a107_VEH_status m107 : 18|1@1+ (1,0) [0|1] "" Vector__XXX
 SG_ VCLEFT_a107_VEH_thermalStatus m107 : 19|1@1+ (1,0) [0|1] "" Vector__XXX
 SG_ VCLEFT_a107_VEH_bmbMinMax m107 : 20|1@1+ (1,0) [0|1] "" Vector__XXX
 SG_ VCLEFT_a107_VEH_powerAvailable m107 : 21|1@1+ (1,0) [0|1] "" Vector__XXX
 SG_ VCLEFT_a107_PT_ptNm m107 : 22|1@1+ (1,0) [0|1] "" Vector__XXX
 SG_ VCLEFT_a107_PT_status m107 : 23|1@1+ (1,0) [0|1] "" Vector__XXX
 SG_ VCLEFT_a107_PT_thermalStatus m107 : 24|1@1+ (1,0) [0|1] "" Vector__XXX
 SG_ VCLEFT_a107_PT_socStatus m107 : 25|1@1+ (1,0) [0|1] "" Vector__XXX
 SG_ VCLEFT_a107_VEH_socStatus m107 : 26|1@1+ (1,0) [0|1] "" Vector__XXX
 SG_ VCLEFT_a107_VEH_packConfig m107 : 27|1@1+ (1,0) [0|1] "" Vector__XXX
 SG_ VCLEFT_a107_VEH_energyStatus m107 : 28|1@1+ (1,0) [0|1] "" Vector__XXX
 SG_ VCLEFT_a107_VEH_chargeInfo m107 : 29|1@1+ (1,0) [0|1] "" Vector__XXX
 SG_ VCLEFT_a108_VEH_hvStatus m108 : 16|1@1+ (1,0) [0|1] "" Vector__XXX
 SG_ VCLEFT_a108_VEH_temperature m108 : 17|1@1+ (1,0) [0|1] "" Vector__XXX
 SG_ VCLEFT_a108_VEH_thermalControl m108 : 18|1@1+ (1,0) [0|1] "" Vector__XXX
 SG_ VCLEFT_a108_VEH_torque m108 : 19|1@1+ (1,0) [0|1] "" Vector__XXX
 SG_ VCLEFT_a108_VEH_status m108 : 20|1@1+ (1,0) [0|1] "" Vector__XXX
 SG_ VCLEFT_a108_PARTY_torque m108 : 21|1@1+ (1,0) [0|1] "" Vector__XXX
 SG_ VCLEFT_a108_PARTY_status m108 : 22|1@1+ (1,0) [0|1] "" Vector__XXX
 SG_ VCLEFT_a108_PARTY_temperature m108 : 23|1@1+ (1,0) [0|1] "" Vector__XXX
 SG_ VCLEFT_a108_PARTY_thermalControl m108 : 24|1@1+ (1,0) [0|1] "" Vector__XXX
 SG_ VCLEFT_a108_PT_temperature m108 : 25|1@1+ (1,0) [0|1] "" Vector__XXX
 SG_ VCLEFT_a108_PT_thermalControl m108 : 26|1@1+ (1,0) [0|1] "" Vector__XXX
 SG_ VCLEFT_a108_PARTY_motorStatus m108 : 27|1@1+ (1,0) [0|1] "" Vector__XXX
 SG_ VCLEFT_a108_VEH_motorStatus m108 : 28|1@1+ (1,0) [0|1] "" Vector__XXX
 SG_ VCLEFT_a108_CH_torque m108 : 29|1@1+ (1,0) [0|1] "" Vector__XXX
 SG_ VCLEFT_a110_VEH_carState m110 : 16|1@1+ (1,0) [0|1] "" Vector__XXX
 SG_ VCLEFT_a110_VEH_carConfig m110 : 17|1@1+ (1,0) [0|1] "" Vector__XXX
 SG_ VCLEFT_a110_VEH_time m110 : 18|1@1+ (1,0) [0|1] "" Vector__XXX
 SG_ VCLEFT_a110_VEH_updateStatus m110 : 19|1@1+ (1,0) [0|1] "" Vector__XXX
 SG_ VCLEFT_a110_VEH_vehNm m110 : 20|1@1+ (1,0) [0|1] "" Vector__XXX
 SG_ VCLEFT_a110_VEH_mismatchFault m110 : 21|1@1+ (1,0) [0|1] "" Vector__XXX
 SG_ VCLEFT_a110_VEH_vin m110 : 22|1@1+ (1,0) [0|1] "" Vector__XXX
 SG_ VCLEFT_a110_VEH_bmpDebug m110 : 23|1@1+ (1,0) [0|1] "" Vector__XXX
 SG_ VCLEFT_a110_VEH_gearControl m110 : 24|1@1+ (1,0) [0|1] "" Vector__XXX
 SG_ VCLEFT_a110_VEH_canLogAvailabili m110 : 25|1@1+ (1,0) [0|1] "" Vector__XXX
 SG_ VCLEFT_a110_CH_airbagCutoffStatu m110 : 26|1@1+ (1,0) [0|1] "" Vector__XXX
 SG_ VCLEFT_a110_CH_carConfig m110 : 27|1@1+ (1,0) [0|1] "" Vector__XXX
 SG_ VCLEFT_a110_CH_carState m110 : 28|1@1+ (1,0) [0|1] "" Vector__XXX
 SG_ VCLEFT_a110_CH_vin m110 : 29|1@1+ (1,0) [0|1] "" Vector__XXX
 SG_ VCLEFT_a110_CH_chNm m110 : 30|1@1+ (1,0) [0|1] "" Vector__XXX
 SG_ VCLEFT_a110_CH_epochTimeGtw m110 : 31|1@1+ (1,0) [0|1] "" Vector__XXX
 SG_ VCLEFT_a110_PARTY_carConfig m110 : 32|1@1+ (1,0) [0|1] "" Vector__XXX
 SG_ VCLEFT_a111_VEH_internalStatus m111 : 16|1@1+ (1,0) [0|1] "" Vector__XXX
 SG_ VCLEFT_a111_VEH_status m111 : 17|1@1+ (1,0) [0|1] "" Vector__XXX
 SG_ VCLEFT_a111_VEH_vehNm m111 : 18|1@1+ (1,0) [0|1] "" Vector__XXX
 SG_ VCLEFT_a111_RIPC_LVPowerState m111 : 19|1@1+ (1,0) [0|1] "" Vector__XXX
 SG_ VCLEFT_a111_RIPC_epbPrivateState m111 : 20|1@1+ (1,0) [0|1] "" Vector__XXX
 SG_ VCLEFT_a111_RIPC_railStatus m111 : 21|1@1+ (1,0) [0|1] "" Vector__XXX
 SG_ VCLEFT_a111_RIPC_remoteADC m111 : 22|1@1+ (1,0) [0|1] "" Vector__XXX
 SG_ VCLEFT_a111_RIPC_switchStatus m111 : 23|1@1+ (1,0) [0|1] "" Vector__XXX
 SG_ VCLEFT_a111_VEH_LVPowerState m111 : 24|1@1+ (1,0) [0|1] "" Vector__XXX
 SG_ VCLEFT_a111_VEH_seatStatus m111 : 25|1@1+ (1,0) [0|1] "" Vector__XXX
 SG_ VCLEFT_a111_PARTY_status m111 : 26|1@1+ (1,0) [0|1] "" Vector__XXX
 SG_ VCLEFT_a111_CH_status m111 : 27|1@1+ (1,0) [0|1] "" Vector__XXX
 SG_ VCLEFT_a112_VEH_internalStatus m112 : 16|1@1+ (1,0) [0|1] "" Vector__XXX
 SG_ VCLEFT_a112_VEH_status m112 : 17|1@1+ (1,0) [0|1] "" Vector__XXX
 SG_ VCLEFT_a112_VEH_vehNm m112 : 18|1@1+ (1,0) [0|1] "" Vector__XXX
 SG_ VCLEFT_a112_LIPC_LVPowerState m112 : 19|1@1+ (1,0) [0|1] "" Vector__XXX
 SG_ VCLEFT_a112_LIPC_epbPrivateState m112 : 20|1@1+ (1,0) [0|1] "" Vector__XXX
 SG_ VCLEFT_a112_LIPC_railStatus m112 : 21|1@1+ (1,0) [0|1] "" Vector__XXX
 SG_ VCLEFT_a112_LIPC_remoteADC m112 : 22|1@1+ (1,0) [0|1] "" Vector__XXX
 SG_ VCLEFT_a112_LIPC_switchStatus m112 : 23|1@1+ (1,0) [0|1] "" Vector__XXX
 SG_ VCLEFT_a112_VEH_LVPowerState m112 : 24|1@1+ (1,0) [0|1] "" Vector__XXX
 SG_ VCLEFT_a112_PARTY_status m112 : 25|1@1+ (1,0) [0|1] "" Vector__XXX
 SG_ VCLEFT_a112_CH_status m112 : 26|1@1+ (1,0) [0|1] "" Vector__XXX
 SG_ VCLEFT_a114_PARTY_status m114 : 16|1@1+ (1,0) [0|1] "" Vector__XXX
 SG_ VCLEFT_a114_PARTY_wheelSpeeds m114 : 17|1@1+ (1,0) [0|1] "" Vector__XXX
 SG_ VCLEFT_a114_VEH_wheelSpeeds m114 : 18|1@1+ (1,0) [0|1] "" Vector__XXX
 SG_ VCLEFT_a114_CH_wheelSpeeds m114 : 19|1@1+ (1,0) [0|1] "" Vector__XXX
 SG_ VCLEFT_a114_PARTY_party3 m114 : 20|1@1+ (1,0) [0|1] "" Vector__XXX
 SG_ VCLEFT_a114_VEH_party3 m114 : 21|1@1+ (1,0) [0|1] "" Vector__XXX
 SG_ VCLEFT_a114_VEH_status m114 : 22|1@1+ (1,0) [0|1] "" Vector__XXX
 SG_ VCLEFT_a114_PARTY_wheelRotation m114 : 23|1@1+ (1,0) [0|1] "" Vector__XXX
 SG_ VCLEFT_a114_CH_wheelRotation m114 : 24|1@1+ (1,0) [0|1] "" Vector__XXX
 SG_ VCLEFT_a114_VEH_wheelRotation m114 : 25|1@1+ (1,0) [0|1] "" Vector__XXX
 SG_ VCLEFT_a114_PARTY_brakeTorque m114 : 26|1@1+ (1,0) [0|1] "" Vector__XXX
 SG_ VCLEFT_a114_PARTY_offsets m114 : 27|1@1+ (1,0) [0|1] "" Vector__XXX
 SG_ VCLEFT_a114_BDY_offsets m114 : 28|1@1+ (1,0) [0|1] "" Vector__XXX
 SG_ VCLEFT_a114_BDY_party3 m114 : 29|1@1+ (1,0) [0|1] "" Vector__XXX
 SG_ VCLEFT_a114_BDY_status m114 : 30|1@1+ (1,0) [0|1] "" Vector__XXX
 SG_ VCLEFT_a114_BDY_wheelRotation m114 : 31|1@1+ (1,0) [0|1] "" Vector__XXX
 SG_ VCLEFT_a114_BDY_wheelSpeeds m114 : 32|1@1+ (1,0) [0|1] "" Vector__XXX
 SG_ VCLEFT_a114_CH_party1 m114 : 33|1@1+ (1,0) [0|1] "" Vector__XXX
 SG_ VCLEFT_a114_CH_party3 m114 : 34|1@1+ (1,0) [0|1] "" Vector__XXX
 SG_ VCLEFT_a114_CH_status m114 : 35|1@1+ (1,0) [0|1] "" Vector__XXX
 SG_ VCLEFT_a115_VEH_RSSI m115 : 16|1@1+ (1,0) [0|1] "" Vector__XXX
 SG_ VCLEFT_a115_VEH_authenticationWi m115 : 17|1@1+ (1,0) [0|1] "" Vector__XXX
 SG_ VCLEFT_a115_VEH_endpointTemp m115 : 18|1@1+ (1,0) [0|1] "" Vector__XXX
 SG_ VCLEFT_a115_VEH_ChildSeatStatus m115 : 19|1@1+ (1,0) [0|1] "" Vector__XXX
 SG_ VCLEFT_a115_BDY_ChildSeatStatus m115 : 20|1@1+ (1,0) [0|1] "" Vector__XXX
 SG_ VCLEFT_a115_VEH_vehNm m115 : 21|1@1+ (1,0) [0|1] "" Vector__XXX
 SG_ VCLEFT_a115_VEH_authentication m115 : 22|1@1+ (1,0) [0|1] "" Vector__XXX
 SG_ VCLEFT_a115_VEH_BLEResetRequest m115 : 23|1@1+ (1,0) [0|1] "" Vector__XXX
 SG_ VCLEFT_a115_VEH_requests m115 : 24|1@1+ (1,0) [0|1] "" Vector__XXX
 SG_ VCLEFT_a115_VEH_requests2 m115 : 25|1@1+ (1,0) [0|1] "" Vector__XXX
 SG_ VCLEFT_a115_REM_authentication m115 : 26|1@1+ (1,0) [0|1] "" Vector__XXX
 SG_ VCLEFT_a115_UI_corianderVehicleC m115 : 27|1@1+ (1,0) [0|1] "" Vector__XXX
 SG_ VCLEFT_a115_CH_TPMSDisplay m115 : 28|1@1+ (1,0) [0|1] "" Vector__XXX
 SG_ VCLEFT_a115_BDY_BLEResetRequest m115 : 48|1@1+ (1,0) [0|1] "" Vector__XXX
 SG_ VCLEFT_a115_BDY_RSSI m115 : 49|1@1+ (1,0) [0|1] "" Vector__XXX
 SG_ VCLEFT_a115_BDY_authentication m115 : 50|1@1+ (1,0) [0|1] "" Vector__XXX
 SG_ VCLEFT_a115_BDY_requests m115 : 51|1@1+ (1,0) [0|1] "" Vector__XXX
 SG_ VCLEFT_a115_BDY_requests2 m115 : 52|1@1+ (1,0) [0|1] "" Vector__XXX
 SG_ VCLEFT_a115_BDY_vehNm m115 : 53|1@1+ (1,0) [0|1] "" Vector__XXX
 SG_ VCLEFT_a115_BDY_authenticationWi m115 : 54|1@1+ (1,0) [0|1] "" Vector__XXX
 SG_ VCLEFT_a116_PARTY_epbmStatus m116 : 16|1@1+ (1,0) [0|1] "" Vector__XXX
 SG_ VCLEFT_a116_VEH_vehNm m116 : 17|1@1+ (1,0) [0|1] "" Vector__XXX
 SG_ VCLEFT_a116_VEH_hvacRequest m116 : 18|1@1+ (1,0) [0|1] "" Vector__XXX
 SG_ VCLEFT_a116_VEH_hvacStatus m116 : 19|1@1+ (1,0) [0|1] "" Vector__XXX
 SG_ VCLEFT_a116_VEH_LVPowerState m116 : 20|1@1+ (1,0) [0|1] "" Vector__XXX
 SG_ VCLEFT_a116_VEH_lightStatus m116 : 21|1@1+ (1,0) [0|1] "" Vector__XXX
 SG_ VCLEFT_a116_VEH_seatStatus m116 : 22|1@1+ (1,0) [0|1] "" Vector__XXX
 SG_ VCLEFT_a116_VEH_thsStatus m116 : 23|1@1+ (1,0) [0|1] "" Vector__XXX
 SG_ VCLEFT_a116_VEH_doorStatus m116 : 24|1@1+ (1,0) [0|1] "" Vector__XXX
 SG_ VCLEFT_a116_VEH_seatHeatStatus m116 : 25|1@1+ (1,0) [0|1] "" Vector__XXX
 SG_ VCLEFT_a116_VEH_restraintStatus m116 : 26|1@1+ (1,0) [0|1] "" Vector__XXX
 SG_ VCLEFT_a116_VEH_switchStatus m116 : 27|1@1+ (1,0) [0|1] "" Vector__XXX
 SG_ VCLEFT_a116_VEH_logging1Hz m116 : 28|1@1+ (1,0) [0|1] "" Vector__XXX
 SG_ VCLEFT_a116_VEH_seatStatus2 m116 : 29|1@1+ (1,0) [0|1] "" Vector__XXX
 SG_ VCLEFT_a116_VEH_status m116 : 30|1@1+ (1,0) [0|1] "" Vector__XXX
 SG_ VCLEFT_a116_VEH_thermalCommand m116 : 31|1@1+ (1,0) [0|1] "" Vector__XXX
 SG_ VCLEFT_a116_VEH_windowStatus m116 : 32|1@1+ (1,0) [0|1] "" Vector__XXX
 SG_ VCLEFT_a116_PARTY_restraintStatu m116 : 33|1@1+ (1,0) [0|1] "" Vector__XXX
 SG_ VCLEFT_a116_PARTY_doorStatus m116 : 34|1@1+ (1,0) [0|1] "" Vector__XXX
 SG_ VCLEFT_a116_BDY_epbmStatus m116 : 35|1@1+ (1,0) [0|1] "" Vector__XXX
 SG_ VCLEFT_a116_BDY_restraintStatus m116 : 36|1@1+ (1,0) [0|1] "" Vector__XXX
 SG_ VCLEFT_a116_BDY_switchStatus m116 : 37|1@1+ (1,0) [0|1] "" Vector__XXX
 SG_ VCLEFT_a116_BDY_status m116 : 57|1@1+ (1,0) [0|1] "" Vector__XXX
 SG_ VCLEFT_a116_BDY_logging1Hz m116 : 58|1@1+ (1,0) [0|1] "" Vector__XXX
 SG_ VCLEFT_a116_BDY_hvacStatus m116 : 59|1@1+ (1,0) [0|1] "" Vector__XXX
 SG_ VCLEFT_a116_BDY_hvacRequest m116 : 60|1@1+ (1,0) [0|1] "" Vector__XXX
 SG_ VCLEFT_a116_VEH_liftgateFollower m116 : 61|1@1+ (1,0) [0|1] "" Vector__XXX
 SG_ VCLEFT_a116_VEH_liftgateFol_0001 m116 : 62|1@1+ (1,0) [0|1] "" Vector__XXX
 SG_ VCLEFT_a116_VEH_hvacStatus2 m116 : 63|1@1+ (1,0) [0|1] "" Vector__XXX
 SG_ VCLEFT_a117_BDY_epbmStatus m117 : 16|1@1+ (1,0) [0|1] "" Vector__XXX
 SG_ VCLEFT_a117_BDY_restraintStatus m117 : 17|1@1+ (1,0) [0|1] "" Vector__XXX
 SG_ VCLEFT_a117_VEH_prndStatus m117 : 18|1@1+ (1,0) [0|1] "" Vector__XXX
 SG_ VCLEFT_a117_PARTY_epbmStatus m117 : 19|1@1+ (1,0) [0|1] "" Vector__XXX
 SG_ VCLEFT_a117_VEH_vehNm m117 : 20|1@1+ (1,0) [0|1] "" Vector__XXX
 SG_ VCLEFT_a117_VEH_hvacBlowerFdb m117 : 21|1@1+ (1,0) [0|1] "" Vector__XXX
 SG_ VCLEFT_a117_VEH_LVPowerState m117 : 22|1@1+ (1,0) [0|1] "" Vector__XXX
 SG_ VCLEFT_a117_VEH_restraintStatus m117 : 23|1@1+ (1,0) [0|1] "" Vector__XXX
 SG_ VCLEFT_a117_VEH_lightStatus m117 : 24|1@1+ (1,0) [0|1] "" Vector__XXX
 SG_ VCLEFT_a117_VEH_seatStatus m117 : 25|1@1+ (1,0) [0|1] "" Vector__XXX
 SG_ VCLEFT_a117_BDY_falconSwitchStat m117 : 26|1@1+ (1,0) [0|1] "" Vector__XXX
 SG_ VCLEFT_a117_VEH_doorStatus m117 : 27|1@1+ (1,0) [0|1] "" Vector__XXX
 SG_ VCLEFT_a117_VEH_doorStatus2 m117 : 28|1@1+ (1,0) [0|1] "" Vector__XXX
 SG_ VCLEFT_a117_VEH_windowStatus m117 : 29|1@1+ (1,0) [0|1] "" Vector__XXX
 SG_ VCLEFT_a117_VEH_switchStatus m117 : 30|1@1+ (1,0) [0|1] "" Vector__XXX
 SG_ VCLEFT_a117_VEH_intrusionSensorS m117 : 31|1@1+ (1,0) [0|1] "" Vector__XXX
 SG_ VCLEFT_a117_VEH_liftgateStatus m117 : 32|1@1+ (1,0) [0|1] "" Vector__XXX
 SG_ VCLEFT_a117_VEH_seatStatus2 m117 : 33|1@1+ (1,0) [0|1] "" Vector__XXX
 SG_ VCLEFT_a117_PARTY_restraintStatu m117 : 34|1@1+ (1,0) [0|1] "" Vector__XXX
 SG_ VCLEFT_a117_VEH_thermalStatus m117 : 35|1@1+ (1,0) [0|1] "" Vector__XXX
 SG_ VCLEFT_a117_PARTY_doorStatus m117 : 36|1@1+ (1,0) [0|1] "" Vector__XXX
 SG_ VCLEFT_a117_VEH_status m117 : 37|1@1+ (1,0) [0|1] "" Vector__XXX
 SG_ VCLEFT_a117_PARTY_prndStatus m117 : 38|1@1+ (1,0) [0|1] "" Vector__XXX
 SG_ VCLEFT_a117_PARTY_lightingSecond m117 : 39|1@1+ (1,0) [0|1] "" Vector__XXX
 SG_ VCLEFT_a118_VEH_vehNm m118 : 16|1@1+ (1,0) [0|1] "" Vector__XXX
 SG_ VCLEFT_a118_VEH_lighting m118 : 17|1@1+ (1,0) [0|1] "" Vector__XXX
 SG_ VCLEFT_a118_VEH_sensors m118 : 18|1@1+ (1,0) [0|1] "" Vector__XXX
 SG_ VCLEFT_a118_VEH_status m118 : 19|1@1+ (1,0) [0|1] "" Vector__XXX
 SG_ VCLEFT_a118_VEH_okToUseHighPwr m118 : 20|1@1+ (1,0) [0|1] "" Vector__XXX
 SG_ VCLEFT_a118_VEH_LVPowerState m118 : 21|1@1+ (1,0) [0|1] "" Vector__XXX
 SG_ VCLEFT_a118_VEH_coolant m118 : 22|1@1+ (1,0) [0|1] "" Vector__XXX
 SG_ VCLEFT_a118_VEH_vehicleStatus m118 : 23|1@1+ (1,0) [0|1] "" Vector__XXX
 SG_ VCLEFT_a118_VEH_12VBatteryStatus m118 : 24|1@1+ (1,0) [0|1] "" Vector__XXX
 SG_ VCLEFT_a118_VEH_systemStatus m118 : 25|1@1+ (1,0) [0|1] "" Vector__XXX
 SG_ VCLEFT_a118_PARTY_LVPowerState m118 : 26|1@1+ (1,0) [0|1] "" Vector__XXX
 SG_ VCLEFT_a118_PARTY_outputPowerSta m118 : 27|1@1+ (1,0) [0|1] "" Vector__XXX
 SG_ VCLEFT_a118_PARTY_vehicleTime m118 : 28|1@1+ (1,0) [0|1] "" Vector__XXX
 SG_ VCLEFT_a118_VEH_thermalCommand m118 : 29|1@1+ (1,0) [0|1] "" Vector__XXX
 SG_ VCLEFT_a118_CH_LVPowerState m118 : 30|1@1+ (1,0) [0|1] "" Vector__XXX
 SG_ VCLEFT_a118_PARTY_sensors m118 : 31|1@1+ (1,0) [0|1] "" Vector__XXX
 SG_ VCLEFT_a118_CH_sensors m118 : 32|1@1+ (1,0) [0|1] "" Vector__XXX
 SG_ VCLEFT_a118_VEH_interNodeResista m118 : 33|1@1+ (1,0) [0|1] "" Vector__XXX
 SG_ VCLEFT_a118_CH_lighting m118 : 34|1@1+ (1,0) [0|1] "" Vector__XXX
 SG_ VCLEFT_a118_VEH_lightStatus m118 : 35|1@1+ (1,0) [0|1] "" Vector__XXX
 SG_ VCLEFT_a118_PARTY_vehNm m118 : 36|1@1+ (1,0) [0|1] "" Vector__XXX
 SG_ VCLEFT_a118_CH_12VBatteryStatus m118 : 37|1@1+ (1,0) [0|1] "" Vector__XXX
 SG_ VCLEFT_a118_CH_LVBMS_statusHigh m118 : 38|1@1+ (1,0) [0|1] "" Vector__XXX
 SG_ VCLEFT_a118_CH_alertMatrix m118 : 39|1@1+ (1,0) [0|1] "" Vector__XXX
 SG_ VCLEFT_a118_BDY_outputPowerStatu m118 : 40|1@1+ (1,0) [0|1] "" Vector__XXX
 SG_ VCLEFT_a118_BDY_vehicleTime m118 : 41|1@1+ (1,0) [0|1] "" Vector__XXX
 SG_ VCLEFT_a118_PARTY_AP_vehicleStat m118 : 42|1@1+ (1,0) [0|1] "" Vector__XXX
 SG_ VCLEFT_a118_BDY_AP_vehicleState1 m118 : 43|1@1+ (1,0) [0|1] "" Vector__XXX
 SG_ VCLEFT_a118_PARTY_VCFRONT_camera m118 : 44|1@1+ (1,0) [0|1] "" Vector__XXX
 SG_ VCLEFT_a118_BDY_LVHealth m118 : 63|1@1+ (1,0) [0|1] "" Vector__XXX
 SG_ VCLEFT_a119_VEH_steerAngle m119 : 16|1@1+ (1,0) [0|1] "" Vector__XXX
 SG_ VCLEFT_a119_VEH_leftStalk m119 : 17|1@1+ (1,0) [0|1] "" Vector__XXX
 SG_ VCLEFT_a119_VEH_rightStalk m119 : 18|1@1+ (1,0) [0|1] "" Vector__XXX
 SG_ VCLEFT_a119_PARTY_rightStalk m119 : 19|1@1+ (1,0) [0|1] "" Vector__XXX
 SG_ VCLEFT_a119_CH_steerAngle m119 : 20|1@1+ (1,0) [0|1] "" Vector__XXX
 SG_ VCLEFT_a119_PARTY_steerAngle m119 : 21|1@1+ (1,0) [0|1] "" Vector__XXX
 SG_ VCLEFT_a120_PARTY_chassisCntl m120 : 16|1@1+ (1,0) [0|1] "" Vector__XXX
 SG_ VCLEFT_a120_VEH_systemStatus m120 : 17|1@1+ (1,0) [0|1] "" Vector__XXX
 SG_ VCLEFT_a120_CH_chassisCntl m120 : 18|1@1+ (1,0) [0|1] "" Vector__XXX
 SG_ VCLEFT_a120_PARTY_systemStatus m120 : 19|1@1+ (1,0) [0|1] "" Vector__XXX
 SG_ VCLEFT_a120_PARTY_torque m120 : 20|1@1+ (1,0) [0|1] "" Vector__XXX
 SG_ VCLEFT_a120_VEH_torque m120 : 21|1@1+ (1,0) [0|1] "" Vector__XXX
 SG_ VCLEFT_a120_PARTY_locStatus m120 : 22|1@1+ (1,0) [0|1] "" Vector__XXX
 SG_ VCLEFT_a120_PARTY_speed m120 : 23|1@1+ (1,0) [0|1] "" Vector__XXX
 SG_ VCLEFT_a120_VEH_speed m120 : 24|1@1+ (1,0) [0|1] "" Vector__XXX
 SG_ VCLEFT_a120_PARTY_status m120 : 25|1@1+ (1,0) [0|1] "" Vector__XXX
 SG_ VCLEFT_a120_PT_speed m120 : 26|1@1+ (1,0) [0|1] "" Vector__XXX
 SG_ VCLEFT_a120_PT_systemStatus m120 : 27|1@1+ (1,0) [0|1] "" Vector__XXX
 SG_ VCLEFT_a120_PARTY_vehicleEstimat m120 : 28|1@1+ (1,0) [0|1] "" Vector__XXX
 SG_ VCLEFT_a120_VEH_aggregatedAxleSp m120 : 29|1@1+ (1,0) [0|1] "" Vector__XXX
 SG_ VCLEFT_a120_PARTY_aggregatedAxle m120 : 30|1@1+ (1,0) [0|1] "" Vector__XXX
 SG_ VCLEFT_a120_VEH_systemPower m120 : 31|1@1+ (1,0) [0|1] "" Vector__XXX
 SG_ VCLEFT_a120_PARTY_autonomyHealth m120 : 32|1@1+ (1,0) [0|1] "" Vector__XXX
 SG_ VCLEFT_a120_VEH_autonomyHealth m120 : 33|1@1+ (1,0) [0|1] "" Vector__XXX
 SG_ VCLEFT_a120_PT_systemPower m120 : 34|1@1+ (1,0) [0|1] "" Vector__XXX
 SG_ VCLEFT_a120_PARTY_stalklessInter m120 : 35|1@1+ (1,0) [0|1] "" Vector__XXX
 SG_ VCLEFT_a120_CH_speed m120 : 36|1@1+ (1,0) [0|1] "" Vector__XXX
 SG_ VCLEFT_a120_VEH_estimatedBrakeTe m120 : 37|1@1+ (1,0) [0|1] "" Vector__XXX
 SG_ VCLEFT_a120_PARTY_prndControl m120 : 38|1@1+ (1,0) [0|1] "" Vector__XXX
 SG_ VCLEFT_a120_PARTY_locStatus2 m120 : 39|1@1+ (1,0) [0|1] "" Vector__XXX
 SG_ VCLEFT_a120_VEH_chassisCntl m120 : 40|1@1+ (1,0) [0|1] "" Vector__XXX
 SG_ VCLEFT_a120_CH_locStatus2 m120 : 41|1@1+ (1,0) [0|1] "" Vector__XXX
 SG_ VCLEFT_a120_VEH_locStatus m120 : 42|1@1+ (1,0) [0|1] "" Vector__XXX
 SG_ VCLEFT_a120_VEH_locStatus2 m120 : 43|1@1+ (1,0) [0|1] "" Vector__XXX
 SG_ VCLEFT_a120_VEH_prndControl m120 : 44|1@1+ (1,0) [0|1] "" Vector__XXX
 SG_ VCLEFT_a120_VEH_vehicleEstimates m120 : 45|1@1+ (1,0) [0|1] "" Vector__XXX
 SG_ VCLEFT_a120_PARTY_motorStatus m120 : 46|1@1+ (1,0) [0|1] "" Vector__XXX
 SG_ VCLEFT_a120_VEH_motorStatus m120 : 47|1@1+ (1,0) [0|1] "" Vector__XXX
 SG_ VCLEFT_a120_BDY_speed m120 : 48|1@1+ (1,0) [0|1] "" Vector__XXX
 SG_ VCLEFT_a121_OBD_status m121 : 16|1@1+ (1,0) [0|1] "" Vector__XXX
 SG_ VCLEFT_a123_OBD_alcoholInterlock m123 : 16|1@1+ (1,0) [0|1] "" Vector__XXX
 SG_ VCLEFT_a124_PARTY_status m124 : 16|1@1+ (1,0) [0|1] "" Vector__XXX
 SG_ VCLEFT_a124_BDY_status m124 : 17|1@1+ (1,0) [0|1] "" Vector__XXX
 SG_ VCLEFT_a124_VEH_status m124 : 18|1@1+ (1,0) [0|1] "" Vector__XXX
 SG_ VCLEFT_a125_PARTY_actuation m125 : 16|1@1+ (1,0) [0|1] "" Vector__XXX
 SG_ VCLEFT_a125_BDY_actuation m125 : 17|1@1+ (1,0) [0|1] "" Vector__XXX
 SG_ VCLEFT_a125_PARTY_status m125 : 18|1@1+ (1,0) [0|1] "" Vector__XXX
 SG_ VCLEFT_a125_BDY_status m125 : 19|1@1+ (1,0) [0|1] "" Vector__XXX
 SG_ VCLEFT_a129_overCurrentError m129 : 16|1@1+ (1,0) [0|1] "" Vector__XXX
 SG_ VCLEFT_a129_fetShortCircuit m129 : 17|1@1+ (1,0) [0|1] "" Vector__XXX
 SG_ VCLEFT_a129_lockedRotor m129 : 18|1@1+ (1,0) [0|1] "" Vector__XXX
 SG_ VCLEFT_a129_VDS_HA m129 : 19|1@1+ (1,0) [0|1] "" Vector__XXX
 SG_ VCLEFT_a129_VDS_LA m129 : 20|1@1+ (1,0) [0|1] "" Vector__XXX
 SG_ VCLEFT_a129_VDS_HB m129 : 21|1@1+ (1,0) [0|1] "" Vector__XXX
 SG_ VCLEFT_a129_VDS_LB m129 : 22|1@1+ (1,0) [0|1] "" Vector__XXX
 SG_ VCLEFT_a129_VDS_HC m129 : 23|1@1+ (1,0) [0|1] "" Vector__XXX
 SG_ VCLEFT_a129_VDS_LC m129 : 24|1@1+ (1,0) [0|1] "" Vector__XXX
 SG_ VCLEFT_a129_SNS_C_OCP m129 : 25|1@1+ (1,0) [0|1] "" Vector__XXX
 SG_ VCLEFT_a129_SNS_B_OCP m129 : 26|1@1+ (1,0) [0|1] "" Vector__XXX
 SG_ VCLEFT_a129_SNS_A_OCP m129 : 27|1@1+ (1,0) [0|1] "" Vector__XXX
 SG_ VCLEFT_a129_PVDD_UVLO2 m129 : 28|1@1+ (1,0) [0|1] "" Vector__XXX
 SG_ VCLEFT_a129_WD_FAULT m129 : 29|1@1+ (1,0) [0|1] "" Vector__XXX
 SG_ VCLEFT_a129_OTSD m129 : 30|1@1+ (1,0) [0|1] "" Vector__XXX
 SG_ VCLEFT_a129_VREG_UV m129 : 31|1@1+ (1,0) [0|1] "" Vector__XXX
 SG_ VCLEFT_a129_AVDD_UVLO m129 : 32|1@1+ (1,0) [0|1] "" Vector__XXX
 SG_ VCLEFT_a129_VCP_LSD_UVLO2 m129 : 33|1@1+ (1,0) [0|1] "" Vector__XXX
 SG_ VCLEFT_a129_VCPH_UVLO2 m129 : 34|1@1+ (1,0) [0|1] "" Vector__XXX
 SG_ VCLEFT_a129_VCPH_UVLO m129 : 35|1@1+ (1,0) [0|1] "" Vector__XXX
 SG_ VCLEFT_a129_VCPH_OVLO_ABS m129 : 36|1@1+ (1,0) [0|1] "" Vector__XXX
 SG_ VCLEFT_a129_VGS_HA m129 : 37|1@1+ (1,0) [0|1] "" Vector__XXX
 SG_ VCLEFT_a129_VGS_LA m129 : 38|1@1+ (1,0) [0|1] "" Vector__XXX
 SG_ VCLEFT_a129_VGS_HB m129 : 39|1@1+ (1,0) [0|1] "" Vector__XXX
 SG_ VCLEFT_a129_VGS_LB m129 : 40|1@1+ (1,0) [0|1] "" Vector__XXX
 SG_ VCLEFT_a129_VGS_HC m129 : 41|1@1+ (1,0) [0|1] "" Vector__XXX
 SG_ VCLEFT_a129_VGS_LC m129 : 42|1@1+ (1,0) [0|1] "" Vector__XXX
 SG_ VCLEFT_a130_junctionTempWarning m130 : 16|1@1+ (1,0) [0|1] "" Vector__XXX
 SG_ VCLEFT_a130_junctionOverTemp m130 : 17|1@1+ (1,0) [0|1] "" Vector__XXX
 SG_ VCLEFT_a130_startUpOperation m130 : 18|1@1+ (1,0) [0|1] "" Vector__XXX
 SG_ VCLEFT_a130_lossOfSpeedLock m130 : 19|1@1+ (1,0) [0|1] "" Vector__XXX
 SG_ VCLEFT_a130_vccUnderVoltage m130 : 20|1@1+ (1,0) [0|1] "" Vector__XXX
 SG_ VCLEFT_a130_TEMP_FLAG4 m130 : 21|1@1+ (1,0) [0|1] "" Vector__XXX
 SG_ VCLEFT_a130_PVDD_UVFL m130 : 22|1@1+ (1,0) [0|1] "" Vector__XXX
 SG_ VCLEFT_a130_PVDD_OVFL m130 : 23|1@1+ (1,0) [0|1] "" Vector__XXX
 SG_ VCLEFT_a130_VDS_STATUS m130 : 24|1@1+ (1,0) [0|1] "" Vector__XXX
 SG_ VCLEFT_a130_VCPH_UVFL m130 : 25|1@1+ (1,0) [0|1] "" Vector__XXX
 SG_ VCLEFT_a130_TEMP_FLAG1 m130 : 26|1@1+ (1,0) [0|1] "" Vector__XXX
 SG_ VCLEFT_a130_TEMP_FLAG2 m130 : 27|1@1+ (1,0) [0|1] "" Vector__XXX
 SG_ VCLEFT_a130_TEMP_FLAG3 m130 : 28|1@1+ (1,0) [0|1] "" Vector__XXX
 SG_ VCLEFT_a130_OTW m130 : 29|1@1+ (1,0) [0|1] "" Vector__XXX
 SG_ VCLEFT_a131_vsUnderVoltage m131 : 16|1@1+ (1,0) [0|1] "" Vector__XXX
 SG_ VCLEFT_a131_vsOverVoltage m131 : 17|1@1+ (1,0) [0|1] "" Vector__XXX
 SG_ VCLEFT_a131_chpUnderVoltage m131 : 18|1@1+ (1,0) [0|1] "" Vector__XXX
 SG_ VCLEFT_a131_vglUnderVoltage m131 : 19|1@1+ (1,0) [0|1] "" Vector__XXX
 SG_ VCLEFT_a131_thOverTemperature m131 : 20|1@1+ (1,0) [0|1] "" Vector__XXX
 SG_ VCLEFT_a132_RPMActual m132 : 16|10@1+ (10,0) [0|10230] "RPM" Vector__XXX
 SG_ VCLEFT_a132_RPMTarget m132 : 26|10@1+ (10,0) [0|10230] "RPM" Vector__XXX
 SG_ VCLEFT_a133_RPMActual m133 : 16|10@1+ (10,0) [0|10230] "RPM" Vector__XXX
 SG_ VCLEFT_a133_RPMTarget m133 : 26|10@1+ (10,0) [0|10230] "RPM" Vector__XXX
 SG_ VCLEFT_a141_outputCurrent m141 : 16|16@1+ (0.1,0) [0|6553.5] "A" Vector__XXX
 SG_ VCLEFT_a145_brakeSwitch m145 : 16|2@1+ (1,0) [1|3] "" Vector__XXX
 SG_ VCLEFT_a145_ibstRodPosition m145 : 18|12@1+ (0.015625,-5) [-5|58.984375] "mm" Vector__XXX
 SG_ VCLEFT_a145_ibstRodPositionQF m145 : 30|2@1+ (1,0) [0|3] "" Vector__XXX
 SG_ VCLEFT_a150_windowPosition m150 : 16|9@1- (1.43137252331,197.529418945) [-168.901947022|562.529412389] "mm" Vector__XXX
 SG_ VCLEFT_a150_movementTimeMs m150 : 25|7@1+ (50,0) [0|6350] "ms" Vector__XXX
 SG_ VCLEFT_a150_windowPinchReason m150 : 32|3@1+ (1,0) [0|7] "" Vector__XXX
 SG_ VCLEFT_a150_lookbackIndex m150 : 35|6@1+ (1,0) [0|63] "" Vector__XXX
 SG_ VCLEFT_a150_absAccelExceedance m150 : 41|8@1+ (0.09803922,0) [0|25.0000011] "%" Vector__XXX
 SG_ VCLEFT_a150_relAccelExceedance m150 : 49|8@1+ (0.09803922,0) [0|25.0000011] "%" Vector__XXX
 SG_ VCLEFT_a150_speedExpScore m150 : 57|6@1- (0.0006451613,-0.009677419) [-0.0303225806|0.0103225813] "-" Vector__XXX
 SG_ VCLEFT_a150_treatedInGear m150 : 63|1@1+ (1,0) [0|1] "" Vector__XXX
 SG_ VCLEFT_a151_windowPosition m151 : 16|9@1- (1.43137252331,197.529418945) [-168.901947022|562.529412389] "mm" Vector__XXX
 SG_ VCLEFT_a151_movementTimeMs m151 : 25|7@1+ (50,0) [0|6350] "ms" Vector__XXX
 SG_ VCLEFT_a151_windowPinchReason m151 : 32|3@1+ (1,0) [0|7] "" Vector__XXX
 SG_ VCLEFT_a151_lookbackIndex m151 : 35|6@1+ (1,0) [0|63] "" Vector__XXX
 SG_ VCLEFT_a151_absAccelExceedance m151 : 41|8@1+ (0.09803922,0) [0|25.0000011] "%" Vector__XXX
 SG_ VCLEFT_a151_relAccelExceedance m151 : 49|8@1+ (0.09803922,0) [0|25.0000011] "%" Vector__XXX
 SG_ VCLEFT_a151_speedExpScore m151 : 57|6@1- (0.0006451613,-0.009677419) [-0.0303225806|0.0103225813] "-" Vector__XXX
 SG_ VCLEFT_a151_treatedInGear m151 : 63|1@1+ (1,0) [0|1] "" Vector__XXX
 SG_ VCLEFT_a152_zeroed m152 : 16|1@1+ (1,0) [0|1] "" Vector__XXX
 SG_ VCLEFT_a152_endStopTrusted m152 : 17|1@1+ (1,0) [0|1] "" Vector__XXX
 SG_ VCLEFT_a152_speedTableStatus m152 : 18|2@1+ (1,0) [1|3] "" Vector__XXX
 SG_ VCLEFT_a152_causedByBackoffs m152 : 20|1@1+ (1,0) [0|1] "" Vector__XXX
 SG_ VCLEFT_a153_zeroed m153 : 16|1@1+ (1,0) [0|1] "" Vector__XXX
 SG_ VCLEFT_a153_endStopTrusted m153 : 17|1@1+ (1,0) [0|1] "" Vector__XXX
 SG_ VCLEFT_a153_speedTableStatus m153 : 18|2@1+ (1,0) [1|3] "" Vector__XXX
 SG_ VCLEFT_a153_causedByBackoffs m153 : 20|1@1+ (1,0) [0|1] "" Vector__XXX
 SG_ VCLEFT_a154_windowThermalMode m154 : 16|2@1+ (1,0) [1|3] "" Vector__XXX
 SG_ VCLEFT_a154_lightShowActive m154 : 18|1@1+ (1,0) [0|1] "" Vector__XXX
 SG_ VCLEFT_a155_windowThermalMode m155 : 16|2@1+ (1,0) [1|3] "" Vector__XXX
 SG_ VCLEFT_a155_lightShowActive m155 : 18|1@1+ (1,0) [0|1] "" Vector__XXX
 SG_ VCLEFT_a180_intButtonPressed m180 : 16|1@1+ (1,0) [0|1] "" Vector__XXX
 SG_ VCLEFT_a180_extHandlePWM m180 : 24|8@1+ (1,0) [0|255] "%" Vector__XXX
 SG_ VCLEFT_a180_extHandlePulled m180 : 32|1@1+ (1,0) [0|1] "" Vector__XXX
 SG_ VCLEFT_a180_releasePWM m180 : 40|8@1+ (1,0) [0|255] "%" Vector__XXX
 SG_ VCLEFT_a180_latchStatus m180 : 48|4@1+ (1,0) [1|15] "" Vector__XXX
 SG_ VCLEFT_a180_latchClawStatus m180 : 52|1@1+ (1,0) [0|1] "" Vector__XXX
 SG_ VCLEFT_a181_intButtonPressed m181 : 16|1@1+ (1,0) [0|1] "" Vector__XXX
 SG_ VCLEFT_a181_extHandlePWM m181 : 24|8@1+ (1,0) [0|255] "%" Vector__XXX
 SG_ VCLEFT_a181_extHandlePulled m181 : 32|1@1+ (1,0) [0|1] "" Vector__XXX
 SG_ VCLEFT_a181_releasePWM m181 : 40|8@1+ (1,0) [0|255] "%" Vector__XXX
 SG_ VCLEFT_a181_latchStatus m181 : 48|4@1+ (1,0) [1|15] "" Vector__XXX
 SG_ VCLEFT_a181_latchClawStatus m181 : 52|1@1+ (1,0) [0|1] "" Vector__XXX
 SG_ VCLEFT_a186_voltage m186 : 16|7@1+ (0.15,0) [0|19.05] "V" Vector__XXX
 SG_ VCLEFT_a186_temperature m186 : 24|8@1+ (0.5,-40) [-40|87.5] "degC" Vector__XXX
 SG_ VCLEFT_a187_voltage m187 : 16|7@1+ (0.15,0) [0|19.05] "V" Vector__XXX
 SG_ VCLEFT_a187_temperature m187 : 24|8@1+ (0.5,-40) [-40|87.5] "degC" Vector__XXX
 SG_ VCLEFT_a188_voltage m188 : 16|7@1+ (0.15,0) [0|19.05] "V" Vector__XXX
 SG_ VCLEFT_a188_temperature m188 : 24|8@1+ (0.5,-40) [-40|87.5] "degC" Vector__XXX
 SG_ VCLEFT_a189_voltage m189 : 16|7@1+ (0.15,0) [0|19.05] "V" Vector__XXX
 SG_ VCLEFT_a189_temperature m189 : 24|8@1+ (0.5,-40) [-40|87.5] "degC" Vector__XXX
 SG_ VCLEFT_a190_eFuseTripCount m190 : 16|8@1+ (1,0) [0|255] "" Vector__XXX
 SG_ VCLEFT_a192_motorFaulted m192 : 16|1@1+ (1,0) [0|1] "" Vector__XXX
 SG_ VCLEFT_a192_motorLocked m192 : 17|1@1+ (1,0) [0|1] "" Vector__XXX
 SG_ VCLEFT_a192_ecuReset m192 : 18|1@1+ (1,0) [0|1] "" Vector__XXX
 SG_ VCLEFT_a192_fetTempIrrational m192 : 19|1@1+ (1,0) [0|1] "" Vector__XXX
 SG_ VCLEFT_a192_motorControlError m192 : 20|1@1+ (1,0) [0|1] "" Vector__XXX
 SG_ VCLEFT_a192_underVoltage m192 : 21|1@1+ (1,0) [0|1] "" Vector__XXX
 SG_ VCLEFT_a192_overVoltage m192 : 22|1@1+ (1,0) [0|1] "" Vector__XXX
 SG_ VCLEFT_a192_hardwareOvercurrent m192 : 23|1@1+ (1,0) [0|1] "" Vector__XXX
 SG_ VCLEFT_a192_motorOpenPhase m192 : 24|1@1+ (1,0) [0|1] "" Vector__XXX
 SG_ VCLEFT_a192_motorSoftOpenPhase m192 : 25|1@1+ (1,0) [0|1] "" Vector__XXX
 SG_ VCLEFT_a192_motorOvertemp m192 : 26|1@1+ (1,0) [0|1] "" Vector__XXX
 SG_ VCLEFT_a192_dcOvercurrent m192 : 27|1@1+ (1,0) [0|1] "" Vector__XXX
 SG_ VCLEFT_a192_motorStalled m192 : 28|1@1+ (1,0) [0|1] "" Vector__XXX
 SG_ VCLEFT_a192_selfTestFailed m192 : 29|1@1+ (1,0) [0|1] "" Vector__XXX
 SG_ VCLEFT_a192_selfTestResult m192 : 32|3@1+ (1,0) [0|7] "" Vector__XXX
 SG_ VCLEFT_a192_linChecksumError m192 : 35|1@1+ (1,0) [0|1] "" Vector__XXX
 SG_ VCLEFT_a192_linFramingError m192 : 36|1@1+ (1,0) [0|1] "" Vector__XXX
 SG_ VCLEFT_a192_phaseShorted m192 : 37|1@1+ (1,0) [0|1] "" Vector__XXX
 SG_ VCLEFT_a192_busVoltageIrrational m192 : 38|1@1+ (1,0) [0|1] "" Vector__XXX
 SG_ VCLEFT_a192_dcCurrentIrrational m192 : 39|1@1+ (1,0) [0|1] "" Vector__XXX
 SG_ VCLEFT_a192_motorSpeedIrrational m192 : 40|1@1+ (1,0) [0|1] "" Vector__XXX
 SG_ VCLEFT_a192_supplyVoltageIrratio m192 : 41|1@1+ (1,0) [0|1] "" Vector__XXX
 SG_ VCLEFT_a192_motorPhaseCurrentIrr m192 : 42|1@1+ (1,0) [0|1] "" Vector__XXX
 SG_ VCLEFT_a192_chipOvertemp m192 : 43|1@1+ (1,0) [0|1] "" Vector__XXX
 SG_ VCLEFT_a192_motorSpeedTooHigh m192 : 44|1@1+ (1,0) [0|1] "" Vector__XXX
 SG_ VCLEFT_a192_phaseOvercurrent m192 : 45|1@1+ (1,0) [0|1] "" Vector__XXX
 SG_ VCLEFT_a192_vddaOvercurrent m192 : 46|1@1+ (1,0) [0|1] "" Vector__XXX
 SG_ VCLEFT_a192_busVoltageUnhealthy m192 : 47|1@1+ (1,0) [0|1] "" Vector__XXX
 SG_ VCLEFT_a192_hsVdsOvervoltage m192 : 48|1@1+ (1,0) [0|1] "" Vector__XXX
 SG_ VCLEFT_a192_hsVdsOvervoltageMask m192 : 49|3@1+ (1,0) [0|7] "" Vector__XXX
 SG_ VCLEFT_a192_lsVdsOvervoltage m192 : 52|1@1+ (1,0) [0|1] "" Vector__XXX
 SG_ VCLEFT_a192_lsVdsOvervoltageMask m192 : 53|3@1+ (1,0) [0|7] "" Vector__XXX
 SG_ VCLEFT_a192_payloadBitsNotSet m192 : 56|1@1+ (1,0) [0|1] "" Vector__XXX
 SG_ VCLEFT_a192_motorNotIdentified m192 : 57|1@1+ (1,0) [0|1] "" Vector__XXX
 SG_ VCLEFT_a192_motorType m192 : 58|2@1+ (1,0) [0|3] "" Vector__XXX
 SG_ VCLEFT_a194_motorTypeUnknown m194 : 16|1@1+ (1,0) [0|1] "" Vector__XXX
 SG_ VCLEFT_a194_configurationMismatc m194 : 17|1@1+ (1,0) [0|1] "" Vector__XXX
 SG_ VCLEFT_a194_vcbldcMotorTypeUnkno m194 : 18|1@1+ (1,0) [0|1] "" Vector__XXX
 SG_ VCLEFT_a194_nvramMotorTypeUnknow m194 : 19|1@1+ (1,0) [0|1] "" Vector__XXX
 SG_ VCLEFT_a194_vcbldcMotorId m194 : 20|2@1+ (1,0) [0|3] "" Vector__XXX
 SG_ VCLEFT_a194_nvramMotorId m194 : 22|2@1+ (1,0) [0|3] "" Vector__XXX
 SG_ VCLEFT_a196_outputState m196 : 16|1@1+ (1,0) [0|1] "" Vector__XXX
 SG_ VCLEFT_a196_NVRAMState m196 : 17|1@1+ (1,0) [0|1] "" Vector__XXX
 SG_ VCLEFT_a196_lockoutState m196 : 18|1@1+ (1,0) [0|1] "" Vector__XXX
 SG_ VCLEFT_a197_outputState m197 : 16|1@1+ (1,0) [0|1] "" Vector__XXX
 SG_ VCLEFT_a197_NVRAMState m197 : 17|1@1+ (1,0) [0|1] "" Vector__XXX
 SG_ VCLEFT_a197_lockoutState m197 : 18|1@1+ (1,0) [0|1] "" Vector__XXX
 SG_ VCLEFT_a202_unknownAllowed m202 : 16|1@1+ (1,0) [0|1] "" Vector__XXX
 SG_ VCLEFT_a202_openAllowed m202 : 17|1@1+ (1,0) [0|1] "" Vector__XXX
 SG_ VCLEFT_a202_dynamicAllowed m202 : 18|1@1+ (1,0) [0|1] "" Vector__XXX
 SG_ VCLEFT_a202_parkAllowed m202 : 19|1@1+ (1,0) [0|1] "" Vector__XXX
 SG_ VCLEFT_a202_startAllowed m202 : 20|1@1+ (1,0) [0|1] "" Vector__XXX
 SG_ VCLEFT_a202_serviceAllowed m202 : 21|1@1+ (1,0) [0|1] "" Vector__XXX
 SG_ VCLEFT_a202_winchAllowed m202 : 22|1@1+ (1,0) [0|1] "" Vector__XXX
 SG_ VCLEFT_a202_winchReleaseAllowed m202 : 23|1@1+ (1,0) [0|1] "" Vector__XXX
 SG_ VCLEFT_a202_parkingAllowed m202 : 24|1@1+ (1,0) [0|1] "" Vector__XXX
 SG_ VCLEFT_a202_dynApplyAllowed m202 : 25|1@1+ (1,0) [0|1] "" Vector__XXX
 SG_ VCLEFT_a202_releaseAllowed m202 : 26|1@1+ (1,0) [0|1] "" Vector__XXX
 SG_ VCLEFT_a202_parkPendingAllowed m202 : 27|1@1+ (1,0) [0|1] "" Vector__XXX
 SG_ VCLEFT_a202_wenchPendingAllowed m202 : 28|1@1+ (1,0) [0|1] "" Vector__XXX
 SG_ VCLEFT_a202_desyncCount m202 : 32|6@1+ (1,0) [0|63] "" Vector__XXX
 SG_ VCLEFT_a202_current m202 : 38|10@1+ (0.05,0) [0|51.15] "A" Vector__XXX
 SG_ VCLEFT_a202_epbConfig m202 : 48|4@1+ (1,0) [0|15] "" Vector__XXX
 SG_ VCLEFT_a203_unknownAllowed m203 : 16|1@1+ (1,0) [0|1] "" Vector__XXX
 SG_ VCLEFT_a203_openAllowed m203 : 17|1@1+ (1,0) [0|1] "" Vector__XXX
 SG_ VCLEFT_a203_dynamicAllowed m203 : 18|1@1+ (1,0) [0|1] "" Vector__XXX
 SG_ VCLEFT_a203_parkAllowed m203 : 19|1@1+ (1,0) [0|1] "" Vector__XXX
 SG_ VCLEFT_a203_startAllowed m203 : 20|1@1+ (1,0) [0|1] "" Vector__XXX
 SG_ VCLEFT_a203_serviceAllowed m203 : 21|1@1+ (1,0) [0|1] "" Vector__XXX
 SG_ VCLEFT_a203_winchAllowed m203 : 22|1@1+ (1,0) [0|1] "" Vector__XXX
 SG_ VCLEFT_a203_winchReleaseAllowed m203 : 23|1@1+ (1,0) [0|1] "" Vector__XXX
 SG_ VCLEFT_a203_parkingAllowed m203 : 24|1@1+ (1,0) [0|1] "" Vector__XXX
 SG_ VCLEFT_a203_dynApplyAllowed m203 : 25|1@1+ (1,0) [0|1] "" Vector__XXX
 SG_ VCLEFT_a203_releaseAllowed m203 : 26|1@1+ (1,0) [0|1] "" Vector__XXX
 SG_ VCLEFT_a203_parkPendingAllowed m203 : 27|1@1+ (1,0) [0|1] "" Vector__XXX
 SG_ VCLEFT_a203_wenchPendingAllowed m203 : 28|1@1+ (1,0) [0|1] "" Vector__XXX
 SG_ VCLEFT_a203_desyncCount m203 : 32|6@1+ (1,0) [0|63] "" Vector__XXX
 SG_ VCLEFT_a203_current m203 : 38|10@1+ (0.05,0) [0|51.15] "A" Vector__XXX
 SG_ VCLEFT_a203_epbConfig m203 : 48|4@1+ (1,0) [0|15] "" Vector__XXX
 SG_ VCLEFT_a204_unknownAllowed m204 : 16|1@1+ (1,0) [0|1] "" Vector__XXX
 SG_ VCLEFT_a204_openAllowed m204 : 17|1@1+ (1,0) [0|1] "" Vector__XXX
 SG_ VCLEFT_a204_dynamicAllowed m204 : 18|1@1+ (1,0) [0|1] "" Vector__XXX
 SG_ VCLEFT_a204_parkAllowed m204 : 19|1@1+ (1,0) [0|1] "" Vector__XXX
 SG_ VCLEFT_a204_startAllowed m204 : 20|1@1+ (1,0) [0|1] "" Vector__XXX
 SG_ VCLEFT_a204_serviceAllowed m204 : 21|1@1+ (1,0) [0|1] "" Vector__XXX
 SG_ VCLEFT_a204_winchAllowed m204 : 22|1@1+ (1,0) [0|1] "" Vector__XXX
 SG_ VCLEFT_a204_winchReleaseAllowed m204 : 23|1@1+ (1,0) [0|1] "" Vector__XXX
 SG_ VCLEFT_a204_parkingAllowed m204 : 24|1@1+ (1,0) [0|1] "" Vector__XXX
 SG_ VCLEFT_a204_dynApplyAllowed m204 : 25|1@1+ (1,0) [0|1] "" Vector__XXX
 SG_ VCLEFT_a204_releaseAllowed m204 : 26|1@1+ (1,0) [0|1] "" Vector__XXX
 SG_ VCLEFT_a204_parkPendingAllowed m204 : 27|1@1+ (1,0) [0|1] "" Vector__XXX
 SG_ VCLEFT_a204_wenchPendingAllowed m204 : 28|1@1+ (1,0) [0|1] "" Vector__XXX
 SG_ VCLEFT_a204_desyncCount m204 : 32|6@1+ (1,0) [0|63] "" Vector__XXX
 SG_ VCLEFT_a204_current m204 : 38|10@1+ (0.05,0) [0|51.15] "A" Vector__XXX
 SG_ VCLEFT_a204_epbConfig m204 : 48|4@1+ (1,0) [0|15] "" Vector__XXX
 SG_ VCLEFT_a205_unknownAllowed m205 : 16|1@1+ (1,0) [0|1] "" Vector__XXX
 SG_ VCLEFT_a205_openAllowed m205 : 17|1@1+ (1,0) [0|1] "" Vector__XXX
 SG_ VCLEFT_a205_dynamicAllowed m205 : 18|1@1+ (1,0) [0|1] "" Vector__XXX
 SG_ VCLEFT_a205_parkAllowed m205 : 19|1@1+ (1,0) [0|1] "" Vector__XXX
 SG_ VCLEFT_a205_startAllowed m205 : 20|1@1+ (1,0) [0|1] "" Vector__XXX
 SG_ VCLEFT_a205_serviceAllowed m205 : 21|1@1+ (1,0) [0|1] "" Vector__XXX
 SG_ VCLEFT_a205_winchAllowed m205 : 22|1@1+ (1,0) [0|1] "" Vector__XXX
 SG_ VCLEFT_a205_winchReleaseAllowed m205 : 23|1@1+ (1,0) [0|1] "" Vector__XXX
 SG_ VCLEFT_a205_parkingAllowed m205 : 24|1@1+ (1,0) [0|1] "" Vector__XXX
 SG_ VCLEFT_a205_dynApplyAllowed m205 : 25|1@1+ (1,0) [0|1] "" Vector__XXX
 SG_ VCLEFT_a205_releaseAllowed m205 : 26|1@1+ (1,0) [0|1] "" Vector__XXX
 SG_ VCLEFT_a205_parkPendingAllowed m205 : 27|1@1+ (1,0) [0|1] "" Vector__XXX
 SG_ VCLEFT_a205_wenchPendingAllowed m205 : 28|1@1+ (1,0) [0|1] "" Vector__XXX
 SG_ VCLEFT_a205_desyncCount m205 : 32|6@1+ (1,0) [0|63] "" Vector__XXX
 SG_ VCLEFT_a205_current m205 : 38|10@1+ (0.05,0) [0|51.15] "A" Vector__XXX
 SG_ VCLEFT_a205_epbConfig m205 : 48|4@1+ (1,0) [0|15] "" Vector__XXX
 SG_ VCLEFT_a206_unknownAllowed m206 : 16|1@1+ (1,0) [0|1] "" Vector__XXX
 SG_ VCLEFT_a206_openAllowed m206 : 17|1@1+ (1,0) [0|1] "" Vector__XXX
 SG_ VCLEFT_a206_dynamicAllowed m206 : 18|1@1+ (1,0) [0|1] "" Vector__XXX
 SG_ VCLEFT_a206_parkAllowed m206 : 19|1@1+ (1,0) [0|1] "" Vector__XXX
 SG_ VCLEFT_a206_startAllowed m206 : 20|1@1+ (1,0) [0|1] "" Vector__XXX
 SG_ VCLEFT_a206_serviceAllowed m206 : 21|1@1+ (1,0) [0|1] "" Vector__XXX
 SG_ VCLEFT_a206_winchAllowed m206 : 22|1@1+ (1,0) [0|1] "" Vector__XXX
 SG_ VCLEFT_a206_winchReleaseAllowed m206 : 23|1@1+ (1,0) [0|1] "" Vector__XXX
 SG_ VCLEFT_a206_parkingAllowed m206 : 24|1@1+ (1,0) [0|1] "" Vector__XXX
 SG_ VCLEFT_a206_dynApplyAllowed m206 : 25|1@1+ (1,0) [0|1] "" Vector__XXX
 SG_ VCLEFT_a206_releaseAllowed m206 : 26|1@1+ (1,0) [0|1] "" Vector__XXX
 SG_ VCLEFT_a206_parkPendingAllowed m206 : 27|1@1+ (1,0) [0|1] "" Vector__XXX
 SG_ VCLEFT_a206_wenchPendingAllowed m206 : 28|1@1+ (1,0) [0|1] "" Vector__XXX
 SG_ VCLEFT_a206_unitStatusEPB m206 : 32|5@1+ (1,0) [0|31] "" Vector__XXX
 SG_ VCLEFT_a206_unitStatusEPBM m206 : 40|5@1+ (1,0) [0|31] "" Vector__XXX
 SG_ VCLEFT_a207_unknownAllowed m207 : 16|1@1+ (1,0) [0|1] "" Vector__XXX
 SG_ VCLEFT_a207_openAllowed m207 : 17|1@1+ (1,0) [0|1] "" Vector__XXX
 SG_ VCLEFT_a207_dynamicAllowed m207 : 18|1@1+ (1,0) [0|1] "" Vector__XXX
 SG_ VCLEFT_a207_parkAllowed m207 : 19|1@1+ (1,0) [0|1] "" Vector__XXX
 SG_ VCLEFT_a207_startAllowed m207 : 20|1@1+ (1,0) [0|1] "" Vector__XXX
 SG_ VCLEFT_a207_serviceAllowed m207 : 21|1@1+ (1,0) [0|1] "" Vector__XXX
 SG_ VCLEFT_a207_winchAllowed m207 : 22|1@1+ (1,0) [0|1] "" Vector__XXX
 SG_ VCLEFT_a207_winchReleaseAllowed m207 : 23|1@1+ (1,0) [0|1] "" Vector__XXX
 SG_ VCLEFT_a207_parkingAllowed m207 : 24|1@1+ (1,0) [0|1] "" Vector__XXX
 SG_ VCLEFT_a207_dynApplyAllowed m207 : 25|1@1+ (1,0) [0|1] "" Vector__XXX
 SG_ VCLEFT_a207_releaseAllowed m207 : 26|1@1+ (1,0) [0|1] "" Vector__XXX
 SG_ VCLEFT_a207_parkPendingAllowed m207 : 27|1@1+ (1,0) [0|1] "" Vector__XXX
 SG_ VCLEFT_a207_wenchPendingAllowed m207 : 28|1@1+ (1,0) [0|1] "" Vector__XXX
 SG_ VCLEFT_a207_unitStatusEPB m207 : 32|5@1+ (1,0) [0|31] "" Vector__XXX
 SG_ VCLEFT_a207_unitStatusEPBM m207 : 40|5@1+ (1,0) [0|31] "" Vector__XXX
 SG_ VCLEFT_a208_unknownAllowed m208 : 16|1@1+ (1,0) [0|1] "" Vector__XXX
 SG_ VCLEFT_a208_openAllowed m208 : 17|1@1+ (1,0) [0|1] "" Vector__XXX
 SG_ VCLEFT_a208_dynamicAllowed m208 : 18|1@1+ (1,0) [0|1] "" Vector__XXX
 SG_ VCLEFT_a208_parkAllowed m208 : 19|1@1+ (1,0) [0|1] "" Vector__XXX
 SG_ VCLEFT_a208_startAllowed m208 : 20|1@1+ (1,0) [0|1] "" Vector__XXX
 SG_ VCLEFT_a208_serviceAllowed m208 : 21|1@1+ (1,0) [0|1] "" Vector__XXX
 SG_ VCLEFT_a208_winchAllowed m208 : 22|1@1+ (1,0) [0|1] "" Vector__XXX
 SG_ VCLEFT_a208_winchReleaseAllowed m208 : 23|1@1+ (1,0) [0|1] "" Vector__XXX
 SG_ VCLEFT_a208_parkingAllowed m208 : 24|1@1+ (1,0) [0|1] "" Vector__XXX
 SG_ VCLEFT_a208_dynApplyAllowed m208 : 25|1@1+ (1,0) [0|1] "" Vector__XXX
 SG_ VCLEFT_a208_releaseAllowed m208 : 26|1@1+ (1,0) [0|1] "" Vector__XXX
 SG_ VCLEFT_a208_parkPendingAllowed m208 : 27|1@1+ (1,0) [0|1] "" Vector__XXX
 SG_ VCLEFT_a208_wenchPendingAllowed m208 : 28|1@1+ (1,0) [0|1] "" Vector__XXX
 SG_ VCLEFT_a208_unitStatusEPB m208 : 32|5@1+ (1,0) [0|31] "" Vector__XXX
 SG_ VCLEFT_a208_unitStatusEPBM m208 : 40|5@1+ (1,0) [0|31] "" Vector__XXX
 SG_ VCLEFT_a209_unknownAllowed m209 : 16|1@1+ (1,0) [0|1] "" Vector__XXX
 SG_ VCLEFT_a209_openAllowed m209 : 17|1@1+ (1,0) [0|1] "" Vector__XXX
 SG_ VCLEFT_a209_dynamicAllowed m209 : 18|1@1+ (1,0) [0|1] "" Vector__XXX
 SG_ VCLEFT_a209_parkAllowed m209 : 19|1@1+ (1,0) [0|1] "" Vector__XXX
 SG_ VCLEFT_a209_startAllowed m209 : 20|1@1+ (1,0) [0|1] "" Vector__XXX
 SG_ VCLEFT_a209_serviceAllowed m209 : 21|1@1+ (1,0) [0|1] "" Vector__XXX
 SG_ VCLEFT_a209_winchAllowed m209 : 22|1@1+ (1,0) [0|1] "" Vector__XXX
 SG_ VCLEFT_a209_winchReleaseAllowed m209 : 23|1@1+ (1,0) [0|1] "" Vector__XXX
 SG_ VCLEFT_a209_parkingAllowed m209 : 24|1@1+ (1,0) [0|1] "" Vector__XXX
 SG_ VCLEFT_a209_dynApplyAllowed m209 : 25|1@1+ (1,0) [0|1] "" Vector__XXX
 SG_ VCLEFT_a209_releaseAllowed m209 : 26|1@1+ (1,0) [0|1] "" Vector__XXX
 SG_ VCLEFT_a209_parkPendingAllowed m209 : 27|1@1+ (1,0) [0|1] "" Vector__XXX
 SG_ VCLEFT_a209_wenchPendingAllowed m209 : 28|1@1+ (1,0) [0|1] "" Vector__XXX
 SG_ VCLEFT_a209_unitStatusEPB m209 : 32|5@1+ (1,0) [0|31] "" Vector__XXX
 SG_ VCLEFT_a209_unitStatusEPBM m209 : 40|5@1+ (1,0) [0|31] "" Vector__XXX
 SG_ VCLEFT_a210_unknownAllowed m210 : 16|1@1+ (1,0) [0|1] "" Vector__XXX
 SG_ VCLEFT_a210_openAllowed m210 : 17|1@1+ (1,0) [0|1] "" Vector__XXX
 SG_ VCLEFT_a210_dynamicAllowed m210 : 18|1@1+ (1,0) [0|1] "" Vector__XXX
 SG_ VCLEFT_a210_parkAllowed m210 : 19|1@1+ (1,0) [0|1] "" Vector__XXX
 SG_ VCLEFT_a210_startAllowed m210 : 20|1@1+ (1,0) [0|1] "" Vector__XXX
 SG_ VCLEFT_a210_serviceAllowed m210 : 21|1@1+ (1,0) [0|1] "" Vector__XXX
 SG_ VCLEFT_a210_winchAllowed m210 : 22|1@1+ (1,0) [0|1] "" Vector__XXX
 SG_ VCLEFT_a210_winchReleaseAllowed m210 : 23|1@1+ (1,0) [0|1] "" Vector__XXX
 SG_ VCLEFT_a210_parkingAllowed m210 : 24|1@1+ (1,0) [0|1] "" Vector__XXX
 SG_ VCLEFT_a210_dynApplyAllowed m210 : 25|1@1+ (1,0) [0|1] "" Vector__XXX
 SG_ VCLEFT_a210_releaseAllowed m210 : 26|1@1+ (1,0) [0|1] "" Vector__XXX
 SG_ VCLEFT_a210_parkPendingAllowed m210 : 27|1@1+ (1,0) [0|1] "" Vector__XXX
 SG_ VCLEFT_a210_wenchPendingAllowed m210 : 28|1@1+ (1,0) [0|1] "" Vector__XXX
 SG_ VCLEFT_a210_unitStatusEPB m210 : 32|5@1+ (1,0) [0|31] "" Vector__XXX
 SG_ VCLEFT_a210_unitStatusEPBM m210 : 40|5@1+ (1,0) [0|31] "" Vector__XXX
 SG_ VCLEFT_a221_vbatProtVoltage m221 : 16|8@1+ (0.1,0) [0|25.5] "V" Vector__XXX
 SG_ VCLEFT_a221_vbatProtCurrent m221 : 24|10@1+ (0.1,0) [0|102.3] "A" Vector__XXX
 SG_ VCLEFT_a221_uvLoadshedVoltage m221 : 40|8@1+ (0.1,0) [0|25.5] "V" Vector__XXX
 SG_ VCLEFT_a221_loadshedFromBattMoni m221 : 48|8@1+ (0.02,0) [0|5.1] "V" Vector__XXX
 SG_ VCLEFT_a221_faultInjectActive m221 : 56|1@1+ (1,0) [0|1] "" Vector__XXX
 SG_ VCLEFT_a221_loadshedResetActive m221 : 57|1@1+ (1,0) [0|1] "" Vector__XXX
 SG_ VCLEFT_a221_loadshedArmPrimary m221 : 58|1@1+ (1,0) [0|1] "" Vector__XXX
 SG_ VCLEFT_a224_seatMotorCalibrated m224 : 16|1@1+ (1,0) [0|1] "" Vector__XXX
 SG_ VCLEFT_a224_seatMotorCurrent m224 : 17|12@1- (0.01,0) [-20.48|20.47] "A" Vector__XXX
 SG_ VCLEFT_a224_seatMotorState m224 : 29|3@1+ (1,0) [0|7] "" Vector__XXX
 SG_ VCLEFT_a224_seatSwitchBack m224 : 32|2@1+ (1,0) [1|3] "" Vector__XXX
 SG_ VCLEFT_a224_seatSwitchForward m224 : 34|2@1+ (1,0) [1|3] "" Vector__XXX
 SG_ VCLEFT_a225_seatMotorCalibrated m225 : 16|1@1+ (1,0) [0|1] "" Vector__XXX
 SG_ VCLEFT_a225_seatMotorCurrent m225 : 17|12@1- (0.01,0) [-20.48|20.47] "A" Vector__XXX
 SG_ VCLEFT_a225_seatMotorState m225 : 29|3@1+ (1,0) [0|7] "" Vector__XXX
 SG_ VCLEFT_a225_seatSwitchBack m225 : 32|2@1+ (1,0) [1|3] "" Vector__XXX
 SG_ VCLEFT_a225_seatSwitchForward m225 : 34|2@1+ (1,0) [1|3] "" Vector__XXX
 SG_ VCLEFT_a226_seatMotorCalibrated m226 : 16|1@1+ (1,0) [0|1] "" Vector__XXX
 SG_ VCLEFT_a226_seatMotorCurrent m226 : 17|12@1- (0.01,0) [-20.48|20.47] "A" Vector__XXX
 SG_ VCLEFT_a226_seatMotorState m226 : 29|3@1+ (1,0) [0|7] "" Vector__XXX
 SG_ VCLEFT_a226_seatSwitchBack m226 : 32|2@1+ (1,0) [1|3] "" Vector__XXX
 SG_ VCLEFT_a226_seatSwitchForward m226 : 34|2@1+ (1,0) [1|3] "" Vector__XXX
 SG_ VCLEFT_a227_seatMotorCalibrated m227 : 16|1@1+ (1,0) [0|1] "" Vector__XXX
 SG_ VCLEFT_a227_seatMotorCurrent m227 : 17|12@1- (0.01,0) [-20.48|20.47] "A" Vector__XXX
 SG_ VCLEFT_a227_seatMotorState m227 : 29|3@1+ (1,0) [0|7] "" Vector__XXX
 SG_ VCLEFT_a227_seatSwitchBack m227 : 32|2@1+ (1,0) [1|3] "" Vector__XXX
 SG_ VCLEFT_a227_seatSwitchForward m227 : 34|2@1+ (1,0) [1|3] "" Vector__XXX
 SG_ VCLEFT_a228_seatMotorCalibrated m228 : 16|1@1+ (1,0) [0|1] "" Vector__XXX
 SG_ VCLEFT_a228_seatMotorCurrent m228 : 17|12@1- (0.01,0) [-20.48|20.47] "A" Vector__XXX
 SG_ VCLEFT_a228_seatMotorPosReal m228 : 32|12@1- (1,0) [-2048|2047] "mm" Vector__XXX
 SG_ VCLEFT_a228_seatMotorState m228 : 44|3@1+ (1,0) [0|7] "" Vector__XXX

BO_TX_BU_ 737 : VCFRONT;
BO_TX_BU_ 1349 : VCFRONT;
BO_TX_BU_ 1537 : VCFRONT;
BO_TX_BU_ 929 : VCFRONT;
BO_TX_BU_ 507 : VCLEFT;
BO_TX_BU_ 1373 : VCLEFT;
CM_ BO_ 737 "Front body controller message: status; frame length observed on a vehicle bus";
CM_ SG_ 737 VCFRONT_statusIndex "Front body controller: status index";
CM_ SG_ 737 VCFRONT_frunkLatchStatus "Front body controller: frunk latch status; raw 0 = signal not available (SNA)";
CM_ SG_ 737 VCFRONT_wiperSpeed "Front body controller: wiper speed; raw 0 = signal not available (SNA)";
CM_ SG_ 737 VCFRONT_wiperPosition "Wiper position; raw 0 = signal not available (SNA)";
CM_ SG_ 737 VCFRONT_wiperBlocked "Wiper ECU is reporting a block";
CM_ SG_ 737 VCFRONT_wiperState "Front body controller: wiper state; raw 0 = signal not available (SNA)";
CM_ SG_ 737 VCFRONT_crashDetectedType "Front body controller: crash detected type";
CM_ SG_ 737 VCFRONT_crashState "Front body controller: crash state";
CM_ SG_ 737 VCFRONT_crashUnlockOverrideSet "Indication that vehicle lock state has been overridden due to a collision.";
CM_ SG_ 737 VCFRONT_washPumpState "Front body controller: wash pump state; raw 1 = signal not available (SNA)";
CM_ SG_ 737 VCFRONT_turnIndicatorControlType "Turn indicator control hardware variant";
CM_ SG_ 737 VCFRONT_wiperHealth "Health metric to track the power and communication state of the wiper module";
CM_ SG_ 737 VCFRONT_wiperLINHealth "Health metric to track the power and communication state of the wiper module";
CM_ SG_ 737 VCFRONT_frunkLatchCurrent "Reports the current used by the frunk latch.";
CM_ SG_ 737 VCFRONT_frunkInteriorRelSwitch "State of the frunk interior release switch";
CM_ SG_ 737 VCFRONT_anyClosureOpen "Front body controller: any closure open";
CM_ SG_ 737 VCFRONT_anyDoorOpen "Front body controller: any door open";
CM_ SG_ 737 VCFRONT_hornOn "Indication that the horn is on";
CM_ SG_ 737 VCFRONT_radarHeaterState "Front body controller: radar heater state; raw 0 = signal not available (SNA)";
CM_ SG_ 737 VCFRONT_trunkExteriorWakeSwitch "State of the trunk exterior switch, used for wake only";
CM_ SG_ 737 VCFRONT_passengerBuckleStatus "State of the passenger's seat belt buckle";
CM_ SG_ 737 VCFRONT_frunkLatchType "Front body controller: frunk latch type";
CM_ SG_ 737 VCFRONT_headlampLeftFanStatus "Front body controller: headlamp left fan status";
CM_ SG_ 737 VCFRONT_headlampRightFanStatus "Front body controller: headlamp right fan status";
CM_ SG_ 737 VCFRONT_frunkAccessPost "Front body controller: frunk access post";
CM_ SG_ 737 VCFRONT_isActiveHeatingBattery "Front body controller: is active heating battery";
CM_ SG_ 737 VCFRONT_iBoosterWakeLine "Front body controller: i booster wake line";
CM_ SG_ 737 VCFRONT_epasWakeLine "Front body controller: epas wake line";
CM_ SG_ 737 VCFRONT_iBoosterStateDBG "Front body controller: i booster state DBG";
CM_ SG_ 737 VCFRONT_vehicleStatusDBG "Vehicle state machine state debug; raw 18 = signal not available (SNA)";
CM_ SG_ 737 VCFRONT_timeSpentSleeping "Measures time elapsed while the vehicle has been sleeping.";
CM_ SG_ 737 VCFRONT_sleepCurrent "Calculated electrical current into the 12V battery during VCFRONT sleep; raw 4095 = signal not available (SNA)";
CM_ SG_ 737 VCFRONT_hibernationState "Front body controller: hibernation state";
CM_ SG_ 737 VCFRONT_wiperECUType "Wiper ECU type detected";
CM_ SG_ 737 VCFRONT_wiperHeaterState "Indicates the state of the wiper heater; raw 0 = signal not available (SNA)";
CM_ SG_ 737 VCFRONT_occupantCount "Front body controller: occupant count";
CM_ SG_ 737 VCFRONT_closureEasterEggState "Front body controller: closure easter egg state";
CM_ SG_ 737 VCFRONT_espWakeLine "Front body controller: esp wake line";
CM_ SG_ 737 VCFRONT_allowEvapInLowAmbient "Front body controller: allow evap in low ambient";
CM_ SG_ 737 VCFRONT_potentialRadiatorSteam "Front body controller: potential radiator steam";
CM_ SG_ 737 VCFRONT_potentialRadiatorSteamUI "Front body controller: potential radiator steam UI";
CM_ SG_ 737 VCFRONT_hvacReqOffForFasterCharg "Reports if turning Heating, Ventilation, and Air Conditioning (HVAC) off may improve supercharging power.";
CM_ SG_ 737 VCFRONT_limitedSplitTempDeltaEnf "Front body controller: limited split temp delta enforced";
CM_ SG_ 737 VCFRONT_batteryDischArbState "Front body controller: battery disch arb state";
CM_ SG_ 737 VCFRONT_maxEvapHeatRejection "Front body controller: max evap heat rejection";
CM_ SG_ 737 VCFRONT_minEvapHeatRejection "Front body controller: min evap heat rejection";
CM_ SG_ 737 VCFRONT_freezeEvapITerm "Front body controller: freeze evap i term";
CM_ SG_ 737 VCFRONT_isEvapOperationAllowed "Front body controller: is evap operation allowed";
CM_ SG_ 737 VCFRONT_chillerDemandActive "Front body controller: chiller demand active";
CM_ SG_ 737 VCFRONT_compPerfRecoveryLimited "Front body controller: comp perf recovery limited";
CM_ SG_ 737 VCFRONT_hvacModeNotAttainable "Front body controller: hvac mode not attainable";
CM_ SG_ 737 VCFRONT_hasLowRefrigerant "Front body controller: has low refrigerant";
CM_ SG_ 737 VCFRONT_isColdStartRunning "Front body controller: is cold start running";
CM_ SG_ 737 VCFRONT_isHeatPumpOilPurgeActive "Front body controller: is heat pump oil purge active";
CM_ SG_ 737 VCFRONT_pressureRefrigSuction "Refrigerant system suction pressure; raw 127 = signal not available (SNA)";
CM_ SG_ 737 VCFRONT_pressureRefrigDischarge "Refrigerant system discharge pressure; raw 511 = signal not available (SNA)";
CM_ SG_ 737 VCFRONT_hvacPerfTestCommand "Front body controller: hvac perf test command";
CM_ SG_ 737 VCFRONT_coolantFillRoutineStatus "Front body controller: coolant fill routine status";
CM_ SG_ 737 VCFRONT_refrigFillRoutineStatus "Front body controller: refrig fill routine status";
CM_ SG_ 737 VCFRONT_isCOP1Running "Front body controller: is COP1 running";
CM_ SG_ 737 VCFRONT_closeValvesRoutineStatus "Front body controller: close valves routine status";
CM_ SG_ 737 VCFRONT_thermalPerfTestRunning "Front body controller: thermal perf test running";
CM_ SG_ 737 VCFRONT_extendedHvacPerfTestComm "Front body controller: extended hvac perf test command";
CM_ SG_ 737 VCFRONT_5VARailStable "Front body controller: 5 VA rail stable";
CM_ SG_ 737 VCFRONT_5VBRailStable "Front body controller: 5 VB rail stable";
CM_ SG_ 737 VCFRONT_12VARailStable "Front body controller: 12 VA rail stable";
CM_ SG_ 737 VCFRONT_12VBRailStable "Front body controller: 12 VB rail stable";
CM_ SG_ 737 VCFRONT_railAState "Front body controller: rail a state";
CM_ SG_ 737 VCFRONT_railBState "Front body controller: rail b state";
CM_ SG_ 737 VCFRONT_ChargePumpVoltageStable "Front body controller: charge pump voltage stable";
CM_ SG_ 737 VCFRONT_PEResetLineState "Front body controller: PE reset line state";
CM_ SG_ 737 VCFRONT_HSDInitCompleteU13 "Front body controller: HSD init complete U13";
CM_ SG_ 737 VCFRONT_HSDInitCompleteU16 "Front body controller: HSD init complete U16";
CM_ SG_ 737 VCFRONT_vbatMonitorVoltage "Front body controller: vbat monitor voltage; raw 4095 = signal not available (SNA)";
CM_ SG_ 737 VCFRONT_AS8510Voltage "Front body controller: AS8510 voltage; raw 4095 = signal not available (SNA)";
CM_ SG_ 737 VCFRONT_vbatProt "Front body controller: vbat prot";
CM_ SG_ 737 VCFRONT_logVerbosity "Front body controller: log verbosity";
CM_ SG_ 737 VCFRONT_IBSFault "Indicates that a fault has been diagnosed with the Low Voltage (LV) battery sensor. Position from firmware; message assignment inferred.";
CM_ SG_ 737 VCFRONT_12VOverchargeCounter "Position from firmware; message assignment inferred.";
CM_ SG_ 737 VCFRONT_compPowerSupportingHvac "Front body controller: comp power supporting hvac";
CM_ SG_ 737 VCFRONT_compPowerSupportingPT "Front body controller: comp power supporting PT";
CM_ SG_ 737 VCFRONT_maxHeatingPowerLeftCC "Front body controller: max heating power left CC";
CM_ SG_ 737 VCFRONT_maxHeatingPowerRightCC "Front body controller: max heating power right CC";
CM_ SG_ 737 VCFRONT_activeLouverOpenPos "The actual position for the active louver";
CM_ SG_ 737 VCFRONT_activeLouverState "State of the active louver circuit";
CM_ SG_ 737 VCFRONT_windshieldCameraHeaterPo "Front body controller: windshield camera heater power; raw 63 = signal not available (SNA)";
CM_ BO_ 1349 "Front body controller message: system status; frame length observed on a vehicle bus";
CM_ SG_ 1349 VCFRONT_systemStatusMuxIndex "Front body controller: system status mux index";
CM_ SG_ 1349 VCFRONT_systemStatusCounter "Front body controller: system status counter";
CM_ SG_ 1349 VCFRONT_systemStatusChecksum "Front body controller: system status checksum";
CM_ SG_ 1349 VCFRONT_loadShedReason "Front body controller: load shed reason";
CM_ SG_ 1349 VCFRONT_VCRightEFuseLoadShedStag "Front body controller: VC right e fuse load shed stage";
CM_ SG_ 1349 VCFRONT_VCLeftEFuseLoadShedStage "Front body controller: VC left e fuse load shed stage";
CM_ SG_ 1349 VCFRONT_DCDCSaturationLoadShedSt "Front body controller: DCDC saturation load shed stage";
CM_ SG_ 1349 VCFRONT_vehicleLoadShedStage "Front body controller: vehicle load shed stage";
CM_ SG_ 1349 VCFRONT_HVFaultVehicleLoadShedRe "Front body controller: HV fault vehicle load shed request";
CM_ SG_ 1349 VCFRONT_postCrashVehicleLoadShed "Front body controller: post crash vehicle load shed active";
CM_ SG_ 1349 VCFRONT_HVFaultVehicleLoadShedAc "Front body controller: HV fault vehicle load shed active";
CM_ SG_ 1349 VCFRONT_factoryVehicleLoadShedAc "Indicates that vehicle is factory load shedding";
CM_ SG_ 1349 VCFRONT_anyVehicleLoadShedActive "Front body controller: any vehicle load shed active";
CM_ SG_ 1349 VCFRONT_DIVehLoadShedActive "Front body controller: DI veh load shed active";
CM_ SG_ 1349 VCFRONT_HVFaultLoadShedStateDBG "Front body controller: HV fault load shed state DBG";
CM_ SG_ 1349 VCFRONT_LVUnhealthyVehicleLoadSh "Front body controller: LV unhealthy vehicle load shed active";
CM_ SG_ 1349 VCFRONT_loadShedStsCondenserFan "Front body controller: load shed sts condenser fan";
CM_ SG_ 1349 VCFRONT_loadShedStsPTPump "Front body controller: load shed sts PT pump";
CM_ SG_ 1349 VCFRONT_loadShedMCUAudio "Front body controller: load shed MCU audio";
CM_ SG_ 1349 VCFRONT_loadShedHVDownTriggerDBG "Front body controller: load shed HV down trigger DBG";
CM_ SG_ 1349 VCFRONT_loadShedPCSSatTriggerDBG "Front body controller: load shed PCS sat trigger DBG";
CM_ SG_ 1349 VCFRONT_loadShedStsBatteryPump "Front body controller: load shed sts battery pump";
CM_ SG_ 1349 VCFRONT_loadShedStsAPGlassHeater "Front body controller: load shed sts AP glass heater";
CM_ SG_ 1349 VCFRONT_loadShedStsMCUGraphics "Front body controller: load shed sts MCU graphics";
CM_ SG_ 1349 VCFRONT_IBSCurrentRMS_loadShed "Front body controller: IBS current RMS load shed";
CM_ SG_ 1349 VCFRONT_loadShedAhLeakyBktCntDBG "Front body controller: load shed ah leaky bkt cnt DBG";
CM_ SG_ 1349 VCFRONT_loadShedPcs "Front body controller: load shed pcs";
CM_ SG_ 1349 VCFRONT_loadShedGTWDownstrmRails "Front body controller: load shed GTW downstrm rails";
CM_ SG_ 1349 VCFRONT_loadShedPCSMIATriggerDBG "Front body controller: load shed PCSMIA trigger DBG";
CM_ SG_ 1349 VCFRONT_loadShedTAS "Front body controller: load shed TAS";
CM_ SG_ 1349 VCFRONT_loadShedBackStopBktCntDB "Front body controller: load shed back stop bkt cnt DBG";
CM_ SG_ 1349 VCFRONT_loadShedPCSLeakyBktCtDBG "Front body controller: load shed PCS leaky bkt ct DBG";
CM_ SG_ 1349 VCFRONT_loadShedUI "Front body controller: load shed UI";
CM_ SG_ 1349 VCFRONT_loadShedAutoPilot "Front body controller: load shed auto pilot";
CM_ BO_ 1537 "Front body controller message: uds response; frame length from the layout, not yet observed on a vehicle bus";
CM_ SG_ 1537 VCFRONT_udsResponseData "Front body controller: uds response data";
CM_ BO_ 929 "Front body controller message: vehicle status; frame length observed on a vehicle bus";
CM_ SG_ 929 VCFRONT_vehicleStatusMuxIndex "Front body controller: vehicle status mux index";
CM_ SG_ 929 VCFRONT_vehicleStatusCounter "Front body controller: vehicle status counter";
CM_ SG_ 929 VCFRONT_vehicleStatusChecksum "Front body controller: vehicle status checksum";
CM_ SG_ 929 VCFRONT_preconditionRequest "Front body controller: precondition request";
CM_ SG_ 929 VCFRONT_APGlassHeaterState "Front body controller: AP glass heater state; raw 0 = signal not available (SNA)";
CM_ SG_ 929 VCFRONT_thermalSystemType "Front body controller: thermal system type; raw 1 = signal not available (SNA)";
CM_ SG_ 929 VCFRONT_standbySupplySupported "Front body controller: standby supply supported";
CM_ SG_ 929 VCFRONT_driverPresent "Front body controller: driver present";
CM_ SG_ 929 VCFRONT_passengerPresent "Front body controller: passenger present";
CM_ SG_ 929 VCFRONT_accPlusAvailable "Front body controller: acc plus available";
CM_ SG_ 929 VCFRONT_diPowerOnState "Front body controller: di power on state";
CM_ SG_ 929 VCFRONT_12vStatusForDrive "Front body controller: 12v status for drive";
CM_ SG_ 929 VCFRONT_dcr12VMilliOhms "Front body controller: dcr12 v milli ohms";
CM_ SG_ 929 VC_userPresenceState "User presence state";
CM_ SG_ 929 VCFRONT_factoryLimitsOverrideOk "Front body controller: factory limits override ok";
CM_ SG_ 929 VCFRONT_ota12VSupportRequest "Front body controller: ota12 v support request";
CM_ SG_ 929 VCFRONT_driverBuckleStatus "Front body controller: driver buckle status";
CM_ SG_ 929 VCFRONT_driverDoorStatus "Front body controller: driver door status";
CM_ SG_ 929 VCFRONT_driverUnbuckled "Front body controller: driver unbuckled; raw 2 = signal not available (SNA)";
CM_ SG_ 929 VCFRONT_passengerUnbuckled "Front body controller: passenger unbuckled; raw 2 = signal not available (SNA)";
CM_ SG_ 929 VCFRONT_2RowLeftUnbuckled "Front body controller: 2 row left unbuckled; raw 2 = signal not available (SNA)";
CM_ SG_ 929 VCFRONT_2RowCenterUnbuckled "Front body controller: 2 row center unbuckled; raw 2 = signal not available (SNA)";
CM_ SG_ 929 VCFRONT_2RowRightUnbuckled "Front body controller: 2 row right unbuckled; raw 2 = signal not available (SNA)";
CM_ SG_ 929 VCFRONT_pcsEFuseVoltage "Front body controller: pcs e fuse voltage; raw 1023 = signal not available (SNA)";
CM_ SG_ 929 VCFRONT_bmsHvChargeEnable "Front body controller: bms hv charge enable";
CM_ SG_ 929 VCFRONT_3RowLeftUnbuckled "Indication that the third row left passenger has unbuckled their seat belt; raw 2 = signal not available (SNA)";
CM_ SG_ 929 VCFRONT_3RowRightUnbuckled "Indication that the third row right passenger has unbuckled their seat belt; raw 2 = signal not available (SNA)";
CM_ SG_ 929 VCFRONT_maxBattHeatRejection "Radiator max heat rejection estimated at zero vehicle speed.";
CM_ SG_ 929 VCFRONT_hvacReqBattCoolOutTemp "Battery outlet coolant temp target to allow HVAC min comfort";
CM_ SG_ 929 VCFRONT_PCSCurrent "Front body controller: PCS current";
CM_ SG_ 929 VCFRONT_refSystemNominal "Front body controller: ref system nominal";
CM_ SG_ 929 VCFRONT_driverEnteredCabinEstima "Front body controller: driver entered cabin estimate DBG";
CM_ SG_ 929 VCFRONT_anySWEFuseActive "Front body controller: any SWE fuse active";
CM_ SG_ 929 VCFRONT_hpBattHeatingPowerTrgt "Reports the heat pump battery heating power target.";
CM_ SG_ 929 VCFRONT_LVStatusForDriveVEH "Front body controller: LV status for drive VEH";
CM_ BO_ 507 "Left body controller message: TLC status; frame length observed on a vehicle bus";
CM_ SG_ 507 VCLEFT_TLCStatusIndex "Left body controller: TLC status index";
CM_ SG_ 507 VCLEFT_TLCTemperature "Monitors board temperatures for electrical validation; raw 128 = signal not available (SNA)";
CM_ SG_ 507 VCLEFT_TLCLeftTurnVoltage "Reports voltage for analysis of in field issues; raw 255 = signal not available (SNA)";
CM_ SG_ 507 VCLEFT_TLCRightTurnVoltage "Reports voltage for analysis of in field issues; raw 255 = signal not available (SNA)";
CM_ SG_ 507 VCLEFT_TLCState_LeftTurn "Reports trailer light status; raw 5 = signal not available (SNA)";
CM_ SG_ 507 VCLEFT_TLCState_RightTurn "Reports trailer light status; raw 5 = signal not available (SNA)";
CM_ SG_ 507 VCLEFT_TLCState_Tail "Reports trailer light status; raw 5 = signal not available (SNA)";
CM_ SG_ 507 VCLEFT_TLCState_Stop "Reports trailer light status; raw 5 = signal not available (SNA)";
CM_ SG_ 507 VCLEFT_TLCState_Fog "Reports trailer light status; raw 5 = signal not available (SNA)";
CM_ SG_ 507 VCLEFT_TLCState_Reverse "Reports trailer light status; raw 5 = signal not available (SNA)";
CM_ BO_ 1373 "Left body controller message: alert log; frame length observed on a vehicle bus";
CM_ SG_ 1373 VCLEFT_alertID "Left body controller: alert ID";
CM_ SG_ 1373 VCLEFT_alertState "Left body controller: alert state";
CM_ SG_ 1373 VCLEFT_a001_InternalWatchdog "Left body controller: a001 internal watchdog";
CM_ SG_ 1373 VCLEFT_a010_UnderVoltageDetected "Left body controller: a010 under voltage detected";
CM_ SG_ 1373 VCLEFT_a010_UnderVoltageTimeout "Left body controller: a010 under voltage timeout";
CM_ SG_ 1373 VCLEFT_a015_NVMMMemOverflow "Left body controller: a015 NVMM mem overflow";
CM_ SG_ 1373 VCLEFT_a015_NVMMFilesystemError "Left body controller: a015 NVMM filesystem error";
CM_ SG_ 1373 VCLEFT_a015_NVMMRecordIDError "Left body controller: a015 NVMM record ID error";
CM_ SG_ 1373 VCLEFT_a057_VEH_cpControl "Left body controller: a057 VEH cp control";
CM_ SG_ 1373 VCLEFT_a059_voltageDrop "Left body controller: a059 voltage drop";
CM_ SG_ 1373 VCLEFT_a059_resistanceEstimate "Left body controller: a059 resistance estimate";
CM_ SG_ 1373 VCLEFT_a059_current "Left body controller: a059 current";
CM_ SG_ 1373 VCLEFT_a063_switchChannel "Left body controller: a063 switch channel";
CM_ SG_ 1373 VCLEFT_a063_switchType "Left body controller: a063 switch type";
CM_ SG_ 1373 VCLEFT_a063_ADCVoltage "Left body controller: a063 ADC voltage";
CM_ SG_ 1373 VCLEFT_a063_disconnected "Left body controller: a063 disconnected";
CM_ SG_ 1373 VCLEFT_a063_indeterminate "Left body controller: a063 indeterminate";
CM_ SG_ 1373 VCLEFT_a063_stuckActive "Left body controller: a063 stuck active";
CM_ SG_ 1373 VCLEFT_a063_faulted "Left body controller: a063 faulted";
CM_ SG_ 1373 VCLEFT_a082_RIPC_epbPrivateState "Left body controller: a082 RIPC epb private state";
CM_ SG_ 1373 VCLEFT_a082_RIPC_remoteHSD "Left body controller: a082 RIPC remote HSD";
CM_ SG_ 1373 VCLEFT_a082_RIPC_railStatus "Left body controller: a082 RIPC rail status";
CM_ SG_ 1373 VCLEFT_a082_RIPC_remoteMux "Left body controller: a082 RIPC remote mux";
CM_ SG_ 1373 VCLEFT_a083_LIPC_epbPrivateState "Left body controller: a083 LIPC epb private state";
CM_ SG_ 1373 VCLEFT_a083_LIPC_remoteHSD "Left body controller: a083 LIPC remote HSD";
CM_ SG_ 1373 VCLEFT_a083_LIPC_railStatus "Left body controller: a083 LIPC rail status";
CM_ SG_ 1373 VCLEFT_a083_LIPC_HSDFaults "Left body controller: a083 LIPC HSD faults";
CM_ SG_ 1373 VCLEFT_a084_CH_StatusC "Left body controller: a084 CH status c";
CM_ SG_ 1373 VCLEFT_a085_PARTY_buttonStatus "Left body controller: a085 PARTY button status";
CM_ SG_ 1373 VCLEFT_a086_VEH_LVBMS_statusHigh "Left body controller: a086 VEH LVBMS status high";
CM_ SG_ 1373 VCLEFT_a086_VEH_LVBMS_statusLow "Left body controller: a086 VEH LVBMS status low";
CM_ SG_ 1373 VCLEFT_a086_VEH_status "Left body controller: a086 VEH status";
CM_ SG_ 1373 VCLEFT_a086_VEH_12VBatteryStatus "Left body controller: a086 VEH 12 v battery status";
CM_ SG_ 1373 VCLEFT_a086_VEH_LVPowerState "Left body controller: a086 VEH LV power state";
CM_ SG_ 1373 VCLEFT_a086_VEH_lightStatus "Left body controller: a086 VEH light status";
CM_ SG_ 1373 VCLEFT_a086_VEH_systemStatus "Left body controller: a086 VEH system status";
CM_ SG_ 1373 VCLEFT_a086_VEH_thermalStatus "Left body controller: a086 VEH thermal status";
CM_ SG_ 1373 VCLEFT_a086_VEH_vehNm "Left body controller: a086 VEH veh nm";
CM_ SG_ 1373 VCLEFT_a086_BDY_LVSelfTests "Left body controller: a086 BDY LV self tests";
CM_ SG_ 1373 VCLEFT_a086_VEH_LVSelfTests "Left body controller: a086 VEH LV self tests";
CM_ SG_ 1373 VCLEFT_a086_VEH_LVHealth "Left body controller: a086 VEH LV health";
CM_ SG_ 1373 VCLEFT_a086_BDY_12VBatteryStatus "Left body controller: a086 BDY 12 v battery status";
CM_ SG_ 1373 VCLEFT_a087_VEH_temperature "Left body controller: a087 VEH temperature";
CM_ SG_ 1373 VCLEFT_a087_VEH_thermalControl "Left body controller: a087 VEH thermal control";
CM_ SG_ 1373 VCLEFT_a087_VEH_torque "Left body controller: a087 VEH torque";
CM_ SG_ 1373 VCLEFT_a087_VEH_status "Left body controller: a087 VEH status";
CM_ SG_ 1373 VCLEFT_a087_PARTY_torque "Left body controller: a087 PARTY torque";
CM_ SG_ 1373 VCLEFT_a087_PARTY_status "Left body controller: a087 PARTY status";
CM_ SG_ 1373 VCLEFT_a087_PARTY_temperature "Left body controller: a087 PARTY temperature";
CM_ SG_ 1373 VCLEFT_a087_PARTY_thermalControl "Left body controller: a087 PARTY thermal control";
CM_ SG_ 1373 VCLEFT_a087_VEH_motorStatus "Left body controller: a087 VEH motor status";
CM_ SG_ 1373 VCLEFT_a088_VEH_temperature "Left body controller: a088 VEH temperature";
CM_ SG_ 1373 VCLEFT_a088_VEH_thermalControl "Left body controller: a088 VEH thermal control";
CM_ SG_ 1373 VCLEFT_a088_VEH_torque "Left body controller: a088 VEH torque";
CM_ SG_ 1373 VCLEFT_a088_VEH_status "Left body controller: a088 VEH status";
CM_ SG_ 1373 VCLEFT_a088_PARTY_torque "Left body controller: a088 PARTY torque";
CM_ SG_ 1373 VCLEFT_a088_PARTY_status "Left body controller: a088 PARTY status";
CM_ SG_ 1373 VCLEFT_a088_PARTY_temperature "Left body controller: a088 PARTY temperature";
CM_ SG_ 1373 VCLEFT_a088_PARTY_thermalControl "Left body controller: a088 PARTY thermal control";
CM_ SG_ 1373 VCLEFT_a088_VEH_motorStatus "Left body controller: a088 VEH motor status";
CM_ SG_ 1373 VCLEFT_a089_PARTY_party1 "Left body controller: a089 PARTY party1";
CM_ SG_ 1373 VCLEFT_a089_PARTY_status "Left body controller: a089 PARTY status";
CM_ SG_ 1373 VCLEFT_a089_VEH_status "Left body controller: a089 VEH status";
CM_ SG_ 1373 VCLEFT_a089_BDY_party1 "Left body controller: a089 BDY party1";
CM_ SG_ 1373 VCLEFT_a089_BDY_status "Left body controller: a089 BDY status";
CM_ SG_ 1373 VCLEFT_a089_CH_status "Left body controller: a089 CH status";
CM_ SG_ 1373 VCLEFT_a089_CH_party1 "Left body controller: a089 CH party1";
CM_ SG_ 1373 VCLEFT_a089_CH_party3 "Left body controller: a089 CH party3";
CM_ SG_ 1373 VCLEFT_a089_VEH_party1 "Left body controller: a089 VEH party1";
CM_ SG_ 1373 VCLEFT_a089_VEH_party3 "Left body controller: a089 VEH party3";
CM_ SG_ 1373 VCLEFT_a091_VEH_faultsAndExtras "Left body controller: a091 VEH faults and extras";
CM_ SG_ 1373 VCLEFT_a091_VEH_info "Left body controller: a091 VEH info";
CM_ SG_ 1373 VCLEFT_a091_VEH_state "Left body controller: a091 VEH state";
CM_ SG_ 1373 VCLEFT_a092_VEH_restraintStatus "Left body controller: a092 VEH restraint status";
CM_ SG_ 1373 VCLEFT_a092_VEH_switchStatus "Left body controller: a092 VEH switch status";
CM_ SG_ 1373 VCLEFT_a092_VEH_seatStatus2 "Left body controller: a092 VEH seat status2";
CM_ SG_ 1373 VCLEFT_a092_VEH_vehNm "Left body controller: a092 VEH veh nm";
CM_ SG_ 1373 VCLEFT_a093_VEH_restraintStatus "Left body controller: a093 VEH restraint status";
CM_ SG_ 1373 VCLEFT_a093_VEH_switchStatus "Left body controller: a093 VEH switch status";
CM_ SG_ 1373 VCLEFT_a093_VEH_seatStatus2 "Left body controller: a093 VEH seat status2";
CM_ SG_ 1373 VCLEFT_a093_VEH_vehNm "Left body controller: a093 VEH veh nm";
CM_ SG_ 1373 VCLEFT_a094_VEH_sysStatus "Left body controller: a094 VEH sys status";
CM_ SG_ 1373 VCLEFT_a094_PARTY_sysStatus "Left body controller: a094 PARTY sys status";
CM_ SG_ 1373 VCLEFT_a094_CH_sysStatus "Left body controller: a094 CH sys status";
CM_ SG_ 1373 VCLEFT_a095_PT_ptNm "Left body controller: a095 PT pt nm";
CM_ SG_ 1373 VCLEFT_a095_PT_status "Left body controller: a095 PT status";
CM_ SG_ 1373 VCLEFT_a096_VEH_status "Left body controller: a096 VEH status";
CM_ SG_ 1373 VCLEFT_a096_CH_status "Left body controller: a096 CH status";
CM_ SG_ 1373 VCLEFT_a097_VEH_HVStatus "Left body controller: a097 VEH HV status";
CM_ SG_ 1373 VCLEFT_a097_VEH_state "Left body controller: a097 VEH state";
CM_ SG_ 1373 VCLEFT_a098_CH_torque "Left body controller: a098 CH torque";
CM_ SG_ 1373 VCLEFT_a098_VEH_hvStatus "Left body controller: a098 VEH hv status";
CM_ SG_ 1373 VCLEFT_a098_VEH_status "Left body controller: a098 VEH status";
CM_ SG_ 1373 VCLEFT_a098_VEH_thermalControl "Left body controller: a098 VEH thermal control";
CM_ SG_ 1373 VCLEFT_a098_VEH_temperature "Left body controller: a098 VEH temperature";
CM_ SG_ 1373 VCLEFT_a098_VEH_torque "Left body controller: a098 VEH torque";
CM_ SG_ 1373 VCLEFT_a098_PARTY_status "Left body controller: a098 PARTY status";
CM_ SG_ 1373 VCLEFT_a098_PARTY_temperature "Left body controller: a098 PARTY temperature";
CM_ SG_ 1373 VCLEFT_a098_PARTY_thermalControl "Left body controller: a098 PARTY thermal control";
CM_ SG_ 1373 VCLEFT_a098_PARTY_torque "Left body controller: a098 PARTY torque";
CM_ SG_ 1373 VCLEFT_a098_PT_thermalControl "Left body controller: a098 PT thermal control";
CM_ SG_ 1373 VCLEFT_a098_PT_temperature "Left body controller: a098 PT temperature";
CM_ SG_ 1373 VCLEFT_a098_PARTY_motorStatus "Left body controller: a098 PARTY motor status";
CM_ SG_ 1373 VCLEFT_a098_VEH_motorStatus "Left body controller: a098 VEH motor status";
CM_ SG_ 1373 VCLEFT_a099_VEH_oocStatus "Left body controller: a099 VEH ooc status";
CM_ SG_ 1373 VCLEFT_a100_VEH "Left body controller: a100 VEH";
CM_ SG_ 1373 VCLEFT_a100_PARTY "Left body controller: a100 PARTY";
CM_ SG_ 1373 VCLEFT_a100_PT "Left body controller: a100 PT";
CM_ SG_ 1373 VCLEFT_a100_CH "Left body controller: a100 CH";
CM_ SG_ 1373 VCLEFT_a100_OBD "Left body controller: a100 OBD";
CM_ SG_ 1373 VCLEFT_a101_VEH_state "Left body controller: a101 VEH state";
CM_ SG_ 1373 VCLEFT_a101_PARTY_locState "Left body controller: a101 PARTY loc state";
CM_ SG_ 1373 VCLEFT_a101_LIPC_externalWatchdo "Left body controller: a101 LIPC external watchdog heart beat";
CM_ SG_ 1373 VCLEFT_a101_VEH_locState "Left body controller: a101 VEH loc state";
CM_ SG_ 1373 VCLEFT_a101_BDY_locState "Left body controller: a101 BDY loc state";
CM_ SG_ 1373 VCLEFT_a102_VEH_faultsAndExtras "Left body controller: a102 VEH faults and extras";
CM_ SG_ 1373 VCLEFT_a102_VEH_feedbackStatus "Left body controller: a102 VEH feedback status";
CM_ SG_ 1373 VCLEFT_a102_VEH_sensorStatus "Left body controller: a102 VEH sensor status";
CM_ SG_ 1373 VCLEFT_a102_VEH_rods "Left body controller: a102 VEH rods";
CM_ SG_ 1373 VCLEFT_a103_VEH_hvsNm "Left body controller: a103 VEH hvs nm";
CM_ SG_ 1373 VCLEFT_a103_VEH_vehNm "Left body controller: a103 VEH veh nm";
CM_ SG_ 1373 VCLEFT_a103_VEH_status "Left body controller: a103 VEH status";
CM_ SG_ 1373 VCLEFT_a103_PT_ptNm "Left body controller: a103 PT pt nm";
CM_ SG_ 1373 VCLEFT_a103_PT_status "Left body controller: a103 PT status";
CM_ SG_ 1373 VCLEFT_a103_VEH_evseStatus "Left body controller: a103 VEH evse status";
CM_ SG_ 1373 VCLEFT_a105_VEH_states "Left body controller: a105 VEH states";
CM_ SG_ 1373 VCLEFT_a105_VEH_chNm "Left body controller: a105 VEH ch nm";
CM_ SG_ 1373 VCLEFT_a105_VEH_dampingStates "Left body controller: a105 VEH damping states";
CM_ SG_ 1373 VCLEFT_a106_VEH_dcdcStatus "Left body controller: a106 VEH dcdc status";
CM_ SG_ 1373 VCLEFT_a106_VEH_thermalControl "Left body controller: a106 VEH thermal control";
CM_ SG_ 1373 VCLEFT_a106_VEH_dcdcRailStatus "Left body controller: a106 VEH dcdc rail status";
CM_ SG_ 1373 VCLEFT_a106_CH_dcdcRailStatus "Left body controller: a106 CH dcdc rail status";
CM_ SG_ 1373 VCLEFT_a106_CH_alertMatrix "Left body controller: a106 CH alert matrix";
CM_ SG_ 1373 VCLEFT_a107_VEH_hvsNm "Left body controller: a107 VEH hvs nm";
CM_ SG_ 1373 VCLEFT_a107_VEH_vehNm "Left body controller: a107 VEH veh nm";
CM_ SG_ 1373 VCLEFT_a107_VEH_status "Left body controller: a107 VEH status";
CM_ SG_ 1373 VCLEFT_a107_VEH_thermalStatus "Left body controller: a107 VEH thermal status";
CM_ SG_ 1373 VCLEFT_a107_VEH_bmbMinMax "Left body controller: a107 VEH bmb min max";
CM_ SG_ 1373 VCLEFT_a107_VEH_powerAvailable "Left body controller: a107 VEH power available";
CM_ SG_ 1373 VCLEFT_a107_PT_ptNm "Left body controller: a107 PT pt nm";
CM_ SG_ 1373 VCLEFT_a107_PT_status "Left body controller: a107 PT status";
CM_ SG_ 1373 VCLEFT_a107_PT_thermalStatus "Left body controller: a107 PT thermal status";
CM_ SG_ 1373 VCLEFT_a107_PT_socStatus "Left body controller: a107 PT soc status";
CM_ SG_ 1373 VCLEFT_a107_VEH_socStatus "Left body controller: a107 VEH soc status";
CM_ SG_ 1373 VCLEFT_a107_VEH_packConfig "Left body controller: a107 VEH pack config";
CM_ SG_ 1373 VCLEFT_a107_VEH_energyStatus "Left body controller: a107 VEH energy status";
CM_ SG_ 1373 VCLEFT_a107_VEH_chargeInfo "Left body controller: a107 VEH charge info";
CM_ SG_ 1373 VCLEFT_a108_VEH_hvStatus "Left body controller: a108 VEH hv status";
CM_ SG_ 1373 VCLEFT_a108_VEH_temperature "Left body controller: a108 VEH temperature";
CM_ SG_ 1373 VCLEFT_a108_VEH_thermalControl "Left body controller: a108 VEH thermal control";
CM_ SG_ 1373 VCLEFT_a108_VEH_torque "Left body controller: a108 VEH torque";
CM_ SG_ 1373 VCLEFT_a108_VEH_status "Left body controller: a108 VEH status";
CM_ SG_ 1373 VCLEFT_a108_PARTY_torque "Left body controller: a108 PARTY torque";
CM_ SG_ 1373 VCLEFT_a108_PARTY_status "Left body controller: a108 PARTY status";
CM_ SG_ 1373 VCLEFT_a108_PARTY_temperature "Left body controller: a108 PARTY temperature";
CM_ SG_ 1373 VCLEFT_a108_PARTY_thermalControl "Left body controller: a108 PARTY thermal control";
CM_ SG_ 1373 VCLEFT_a108_PT_temperature "Left body controller: a108 PT temperature";
CM_ SG_ 1373 VCLEFT_a108_PT_thermalControl "Left body controller: a108 PT thermal control";
CM_ SG_ 1373 VCLEFT_a108_PARTY_motorStatus "Left body controller: a108 PARTY motor status";
CM_ SG_ 1373 VCLEFT_a108_VEH_motorStatus "Left body controller: a108 VEH motor status";
CM_ SG_ 1373 VCLEFT_a108_CH_torque "Left body controller: a108 CH torque";
CM_ SG_ 1373 VCLEFT_a110_VEH_carState "Left body controller: a110 VEH car state";
CM_ SG_ 1373 VCLEFT_a110_VEH_carConfig "Left body controller: a110 VEH car config";
CM_ SG_ 1373 VCLEFT_a110_VEH_time "Left body controller: a110 VEH time";
CM_ SG_ 1373 VCLEFT_a110_VEH_updateStatus "Left body controller: a110 VEH update status";
CM_ SG_ 1373 VCLEFT_a110_VEH_vehNm "Left body controller: a110 VEH veh nm";
CM_ SG_ 1373 VCLEFT_a110_VEH_mismatchFault "Left body controller: a110 VEH mismatch fault";
CM_ SG_ 1373 VCLEFT_a110_VEH_vin "Left body controller: a110 VEH vin";
CM_ SG_ 1373 VCLEFT_a110_VEH_bmpDebug "Left body controller: a110 VEH bmp debug";
CM_ SG_ 1373 VCLEFT_a110_VEH_gearControl "Left body controller: a110 VEH gear control";
CM_ SG_ 1373 VCLEFT_a110_VEH_canLogAvailabili "Left body controller: a110 VEH can log availability";
CM_ SG_ 1373 VCLEFT_a110_CH_airbagCutoffStatu "Left body controller: a110 CH airbag cutoff status";
CM_ SG_ 1373 VCLEFT_a110_CH_carConfig "Left body controller: a110 CH car config";
CM_ SG_ 1373 VCLEFT_a110_CH_carState "Left body controller: a110 CH car state";
CM_ SG_ 1373 VCLEFT_a110_CH_vin "Left body controller: a110 CH vin";
CM_ SG_ 1373 VCLEFT_a110_CH_chNm "Left body controller: a110 CH ch nm";
CM_ SG_ 1373 VCLEFT_a110_CH_epochTimeGtw "Left body controller: a110 CH epoch time gtw";
CM_ SG_ 1373 VCLEFT_a110_PARTY_carConfig "Left body controller: a110 PARTY car config";
CM_ SG_ 1373 VCLEFT_a111_VEH_internalStatus "Left body controller: a111 VEH internal status";
CM_ SG_ 1373 VCLEFT_a111_VEH_status "Left body controller: a111 VEH status";
CM_ SG_ 1373 VCLEFT_a111_VEH_vehNm "Left body controller: a111 VEH veh nm";
CM_ SG_ 1373 VCLEFT_a111_RIPC_LVPowerState "Left body controller: a111 RIPC LV power state";
CM_ SG_ 1373 VCLEFT_a111_RIPC_epbPrivateState "Left body controller: a111 RIPC epb private state";
CM_ SG_ 1373 VCLEFT_a111_RIPC_railStatus "Left body controller: a111 RIPC rail status";
CM_ SG_ 1373 VCLEFT_a111_RIPC_remoteADC "Left body controller: a111 RIPC remote ADC";
CM_ SG_ 1373 VCLEFT_a111_RIPC_switchStatus "Left body controller: a111 RIPC switch status";
CM_ SG_ 1373 VCLEFT_a111_VEH_LVPowerState "Left body controller: a111 VEH LV power state";
CM_ SG_ 1373 VCLEFT_a111_VEH_seatStatus "Left body controller: a111 VEH seat status";
CM_ SG_ 1373 VCLEFT_a111_PARTY_status "Left body controller: a111 PARTY status";
CM_ SG_ 1373 VCLEFT_a111_CH_status "Left body controller: a111 CH status";
CM_ SG_ 1373 VCLEFT_a112_VEH_internalStatus "Left body controller: a112 VEH internal status";
CM_ SG_ 1373 VCLEFT_a112_VEH_status "Left body controller: a112 VEH status";
CM_ SG_ 1373 VCLEFT_a112_VEH_vehNm "Left body controller: a112 VEH veh nm";
CM_ SG_ 1373 VCLEFT_a112_LIPC_LVPowerState "Left body controller: a112 LIPC LV power state";
CM_ SG_ 1373 VCLEFT_a112_LIPC_epbPrivateState "Left body controller: a112 LIPC epb private state";
CM_ SG_ 1373 VCLEFT_a112_LIPC_railStatus "Left body controller: a112 LIPC rail status";
CM_ SG_ 1373 VCLEFT_a112_LIPC_remoteADC "Left body controller: a112 LIPC remote ADC";
CM_ SG_ 1373 VCLEFT_a112_LIPC_switchStatus "Left body controller: a112 LIPC switch status";
CM_ SG_ 1373 VCLEFT_a112_VEH_LVPowerState "Left body controller: a112 VEH LV power state";
CM_ SG_ 1373 VCLEFT_a112_PARTY_status "Left body controller: a112 PARTY status";
CM_ SG_ 1373 VCLEFT_a112_CH_status "Left body controller: a112 CH status";
CM_ SG_ 1373 VCLEFT_a114_PARTY_status "Left body controller: a114 PARTY status";
CM_ SG_ 1373 VCLEFT_a114_PARTY_wheelSpeeds "Left body controller: a114 PARTY wheel speeds";
CM_ SG_ 1373 VCLEFT_a114_VEH_wheelSpeeds "Left body controller: a114 VEH wheel speeds";
CM_ SG_ 1373 VCLEFT_a114_CH_wheelSpeeds "Left body controller: a114 CH wheel speeds";
CM_ SG_ 1373 VCLEFT_a114_PARTY_party3 "Left body controller: a114 PARTY party3";
CM_ SG_ 1373 VCLEFT_a114_VEH_party3 "Left body controller: a114 VEH party3";
CM_ SG_ 1373 VCLEFT_a114_VEH_status "Left body controller: a114 VEH status";
CM_ SG_ 1373 VCLEFT_a114_PARTY_wheelRotation "Left body controller: a114 PARTY wheel rotation";
CM_ SG_ 1373 VCLEFT_a114_CH_wheelRotation "Left body controller: a114 CH wheel rotation";
CM_ SG_ 1373 VCLEFT_a114_VEH_wheelRotation "Left body controller: a114 VEH wheel rotation";
CM_ SG_ 1373 VCLEFT_a114_PARTY_brakeTorque "Left body controller: a114 PARTY brake torque";
CM_ SG_ 1373 VCLEFT_a114_PARTY_offsets "Left body controller: a114 PARTY offsets";
CM_ SG_ 1373 VCLEFT_a114_BDY_offsets "Left body controller: a114 BDY offsets";
CM_ SG_ 1373 VCLEFT_a114_BDY_party3 "Left body controller: a114 BDY party3";
CM_ SG_ 1373 VCLEFT_a114_BDY_status "Left body controller: a114 BDY status";
CM_ SG_ 1373 VCLEFT_a114_BDY_wheelRotation "Left body controller: a114 BDY wheel rotation";
CM_ SG_ 1373 VCLEFT_a114_BDY_wheelSpeeds "Left body controller: a114 BDY wheel speeds";
CM_ SG_ 1373 VCLEFT_a114_CH_party1 "Left body controller: a114 CH party1";
CM_ SG_ 1373 VCLEFT_a114_CH_party3 "Left body controller: a114 CH party3";
CM_ SG_ 1373 VCLEFT_a114_CH_status "Left body controller: a114 CH status";
CM_ SG_ 1373 VCLEFT_a115_VEH_RSSI "Left body controller: a115 VEH RSSI";
CM_ SG_ 1373 VCLEFT_a115_VEH_authenticationWi "Left body controller: a115 VEH authentication with mac";
CM_ SG_ 1373 VCLEFT_a115_VEH_endpointTemp "Left body controller: a115 VEH endpoint temp";
CM_ SG_ 1373 VCLEFT_a115_VEH_ChildSeatStatus "Left body controller: a115 VEH child seat status";
CM_ SG_ 1373 VCLEFT_a115_BDY_ChildSeatStatus "Left body controller: a115 BDY child seat status";
CM_ SG_ 1373 VCLEFT_a115_VEH_vehNm "Left body controller: a115 VEH veh nm";
CM_ SG_ 1373 VCLEFT_a115_VEH_authentication "Left body controller: a115 VEH authentication";
CM_ SG_ 1373 VCLEFT_a115_VEH_BLEResetRequest "Left body controller: a115 VEH BLE reset request";
CM_ SG_ 1373 VCLEFT_a115_VEH_requests "Left body controller: a115 VEH requests";
CM_ SG_ 1373 VCLEFT_a115_VEH_requests2 "Left body controller: a115 VEH requests2";
CM_ SG_ 1373 VCLEFT_a115_REM_authentication "Left body controller: a115 REM authentication";
CM_ SG_ 1373 VCLEFT_a115_UI_corianderVehicleC "Left body controller: a115 UI coriander vehicle control";
CM_ SG_ 1373 VCLEFT_a115_CH_TPMSDisplay "Left body controller: a115 CH TPMS display";
CM_ SG_ 1373 VCLEFT_a115_BDY_BLEResetRequest "Left body controller: a115 BDY BLE reset request";
CM_ SG_ 1373 VCLEFT_a115_BDY_RSSI "Left body controller: a115 BDY RSSI";
CM_ SG_ 1373 VCLEFT_a115_BDY_authentication "Left body controller: a115 BDY authentication";
CM_ SG_ 1373 VCLEFT_a115_BDY_requests "Left body controller: a115 BDY requests";
CM_ SG_ 1373 VCLEFT_a115_BDY_requests2 "Left body controller: a115 BDY requests2";
CM_ SG_ 1373 VCLEFT_a115_BDY_vehNm "Left body controller: a115 BDY veh nm";
CM_ SG_ 1373 VCLEFT_a115_BDY_authenticationWi "Left body controller: a115 BDY authentication with mac";
CM_ SG_ 1373 VCLEFT_a116_PARTY_epbmStatus "Left body controller: a116 PARTY epbm status";
CM_ SG_ 1373 VCLEFT_a116_VEH_vehNm "Left body controller: a116 VEH veh nm";
CM_ SG_ 1373 VCLEFT_a116_VEH_hvacRequest "Left body controller: a116 VEH hvac request";
CM_ SG_ 1373 VCLEFT_a116_VEH_hvacStatus "Left body controller: a116 VEH hvac status";
CM_ SG_ 1373 VCLEFT_a116_VEH_LVPowerState "Left body controller: a116 VEH LV power state";
CM_ SG_ 1373 VCLEFT_a116_VEH_lightStatus "Left body controller: a116 VEH light status";
CM_ SG_ 1373 VCLEFT_a116_VEH_seatStatus "Left body controller: a116 VEH seat status";
CM_ SG_ 1373 VCLEFT_a116_VEH_thsStatus "Left body controller: a116 VEH ths status";
CM_ SG_ 1373 VCLEFT_a116_VEH_doorStatus "Left body controller: a116 VEH door status";
CM_ SG_ 1373 VCLEFT_a116_VEH_seatHeatStatus "Left body controller: a116 VEH seat heat status";
CM_ SG_ 1373 VCLEFT_a116_VEH_restraintStatus "Left body controller: a116 VEH restraint status";
CM_ SG_ 1373 VCLEFT_a116_VEH_switchStatus "Left body controller: a116 VEH switch status";
CM_ SG_ 1373 VCLEFT_a116_VEH_logging1Hz "Left body controller: a116 VEH logging1 hz";
CM_ SG_ 1373 VCLEFT_a116_VEH_seatStatus2 "Left body controller: a116 VEH seat status2";
CM_ SG_ 1373 VCLEFT_a116_VEH_status "Left body controller: a116 VEH status";
CM_ SG_ 1373 VCLEFT_a116_VEH_thermalCommand "Left body controller: a116 VEH thermal command";
CM_ SG_ 1373 VCLEFT_a116_VEH_windowStatus "Left body controller: a116 VEH window status";
CM_ SG_ 1373 VCLEFT_a116_PARTY_restraintStatu "Left body controller: a116 PARTY restraint status";
CM_ SG_ 1373 VCLEFT_a116_PARTY_doorStatus "Left body controller: a116 PARTY door status";
CM_ SG_ 1373 VCLEFT_a116_BDY_epbmStatus "Left body controller: a116 BDY epbm status";
CM_ SG_ 1373 VCLEFT_a116_BDY_restraintStatus "Left body controller: a116 BDY restraint status";
CM_ SG_ 1373 VCLEFT_a116_BDY_switchStatus "Left body controller: a116 BDY switch status";
CM_ SG_ 1373 VCLEFT_a116_BDY_status "Left body controller: a116 BDY status";
CM_ SG_ 1373 VCLEFT_a116_BDY_logging1Hz "Left body controller: a116 BDY logging1 hz";
CM_ SG_ 1373 VCLEFT_a116_BDY_hvacStatus "Left body controller: a116 BDY hvac status";
CM_ SG_ 1373 VCLEFT_a116_BDY_hvacRequest "Left body controller: a116 BDY hvac request";
CM_ SG_ 1373 VCLEFT_a116_VEH_liftgateFollower "Left body controller: a116 VEH liftgate follower response";
CM_ SG_ 1373 VCLEFT_a116_VEH_liftgateFol_0001 "Left body controller: a116 VEH liftgate follower status";
CM_ SG_ 1373 VCLEFT_a116_VEH_hvacStatus2 "Left body controller: a116 VEH hvac status2";
CM_ SG_ 1373 VCLEFT_a117_BDY_epbmStatus "Left body controller: a117 BDY epbm status";
CM_ SG_ 1373 VCLEFT_a117_BDY_restraintStatus "Left body controller: a117 BDY restraint status";
CM_ SG_ 1373 VCLEFT_a117_VEH_prndStatus "Left body controller: a117 VEH prnd status";
CM_ SG_ 1373 VCLEFT_a117_PARTY_epbmStatus "Left body controller: a117 PARTY epbm status";
CM_ SG_ 1373 VCLEFT_a117_VEH_vehNm "Left body controller: a117 VEH veh nm";
CM_ SG_ 1373 VCLEFT_a117_VEH_hvacBlowerFdb "Left body controller: a117 VEH hvac blower fdb";
CM_ SG_ 1373 VCLEFT_a117_VEH_LVPowerState "Left body controller: a117 VEH LV power state";
CM_ SG_ 1373 VCLEFT_a117_VEH_restraintStatus "Left body controller: a117 VEH restraint status";
CM_ SG_ 1373 VCLEFT_a117_VEH_lightStatus "Left body controller: a117 VEH light status";
CM_ SG_ 1373 VCLEFT_a117_VEH_seatStatus "Left body controller: a117 VEH seat status";
CM_ SG_ 1373 VCLEFT_a117_BDY_falconSwitchStat "Left body controller: a117 BDY falcon switch status";
CM_ SG_ 1373 VCLEFT_a117_VEH_doorStatus "Left body controller: a117 VEH door status";
CM_ SG_ 1373 VCLEFT_a117_VEH_doorStatus2 "Left body controller: a117 VEH door status2";
CM_ SG_ 1373 VCLEFT_a117_VEH_windowStatus "Left body controller: a117 VEH window status";
CM_ SG_ 1373 VCLEFT_a117_VEH_switchStatus "Left body controller: a117 VEH switch status";
CM_ SG_ 1373 VCLEFT_a117_VEH_intrusionSensorS "Left body controller: a117 VEH intrusion sensor status";
CM_ SG_ 1373 VCLEFT_a117_VEH_liftgateStatus "Left body controller: a117 VEH liftgate status";
CM_ SG_ 1373 VCLEFT_a117_VEH_seatStatus2 "Left body controller: a117 VEH seat status2";
CM_ SG_ 1373 VCLEFT_a117_PARTY_restraintStatu "Left body controller: a117 PARTY restraint status";
CM_ SG_ 1373 VCLEFT_a117_VEH_thermalStatus "Left body controller: a117 VEH thermal status";
CM_ SG_ 1373 VCLEFT_a117_PARTY_doorStatus "Left body controller: a117 PARTY door status";
CM_ SG_ 1373 VCLEFT_a117_VEH_status "Left body controller: a117 VEH status";
CM_ SG_ 1373 VCLEFT_a117_PARTY_prndStatus "Left body controller: a117 PARTY prnd status";
CM_ SG_ 1373 VCLEFT_a117_PARTY_lightingSecond "Left body controller: a117 PARTY lighting secondary";
CM_ SG_ 1373 VCLEFT_a118_VEH_vehNm "Left body controller: a118 VEH veh nm";
CM_ SG_ 1373 VCLEFT_a118_VEH_lighting "Left body controller: a118 VEH lighting";
CM_ SG_ 1373 VCLEFT_a118_VEH_sensors "Left body controller: a118 VEH sensors";
CM_ SG_ 1373 VCLEFT_a118_VEH_status "Left body controller: a118 VEH status";
CM_ SG_ 1373 VCLEFT_a118_VEH_okToUseHighPwr "Left body controller: a118 VEH ok to use high pwr";
CM_ SG_ 1373 VCLEFT_a118_VEH_LVPowerState "Left body controller: a118 VEH LV power state";
CM_ SG_ 1373 VCLEFT_a118_VEH_coolant "Left body controller: a118 VEH coolant";
CM_ SG_ 1373 VCLEFT_a118_VEH_vehicleStatus "Left body controller: a118 VEH vehicle status";
CM_ SG_ 1373 VCLEFT_a118_VEH_12VBatteryStatus "Left body controller: a118 VEH 12 v battery status";
CM_ SG_ 1373 VCLEFT_a118_VEH_systemStatus "Left body controller: a118 VEH system status";
CM_ SG_ 1373 VCLEFT_a118_PARTY_LVPowerState "Left body controller: a118 PARTY LV power state";
CM_ SG_ 1373 VCLEFT_a118_PARTY_outputPowerSta "Left body controller: a118 PARTY output power status";
CM_ SG_ 1373 VCLEFT_a118_PARTY_vehicleTime "Left body controller: a118 PARTY vehicle time";
CM_ SG_ 1373 VCLEFT_a118_VEH_thermalCommand "Left body controller: a118 VEH thermal command";
CM_ SG_ 1373 VCLEFT_a118_CH_LVPowerState "Left body controller: a118 CH LV power state";
CM_ SG_ 1373 VCLEFT_a118_PARTY_sensors "Left body controller: a118 PARTY sensors";
CM_ SG_ 1373 VCLEFT_a118_CH_sensors "Left body controller: a118 CH sensors";
CM_ SG_ 1373 VCLEFT_a118_VEH_interNodeResista "Left body controller: a118 VEH inter node resistance";
CM_ SG_ 1373 VCLEFT_a118_CH_lighting "Left body controller: a118 CH lighting";
CM_ SG_ 1373 VCLEFT_a118_VEH_lightStatus "Left body controller: a118 VEH light status";
CM_ SG_ 1373 VCLEFT_a118_PARTY_vehNm "Left body controller: a118 PARTY veh nm";
CM_ SG_ 1373 VCLEFT_a118_CH_12VBatteryStatus "Left body controller: a118 CH 12 v battery status";
CM_ SG_ 1373 VCLEFT_a118_CH_LVBMS_statusHigh "Left body controller: a118 CH LVBMS status high";
CM_ SG_ 1373 VCLEFT_a118_CH_alertMatrix "Left body controller: a118 CH alert matrix";
CM_ SG_ 1373 VCLEFT_a118_BDY_outputPowerStatu "Left body controller: a118 BDY output power status";
CM_ SG_ 1373 VCLEFT_a118_BDY_vehicleTime "Left body controller: a118 BDY vehicle time";
CM_ SG_ 1373 VCLEFT_a118_PARTY_AP_vehicleStat "Left body controller: a118 PARTY AP vehicle state1 hz muxed";
CM_ SG_ 1373 VCLEFT_a118_BDY_AP_vehicleState1 "Left body controller: a118 BDY AP vehicle state1 hz muxed";
CM_ SG_ 1373 VCLEFT_a118_PARTY_VCFRONT_camera "Left body controller: a118 PARTY VCFRONT camera cleaning status";
CM_ SG_ 1373 VCLEFT_a118_BDY_LVHealth "Left body controller: a118 BDY LV health";
CM_ SG_ 1373 VCLEFT_a119_VEH_steerAngle "Left body controller: a119 VEH steer angle";
CM_ SG_ 1373 VCLEFT_a119_VEH_leftStalk "Left body controller: a119 VEH left stalk";
CM_ SG_ 1373 VCLEFT_a119_VEH_rightStalk "Left body controller: a119 VEH right stalk";
CM_ SG_ 1373 VCLEFT_a119_PARTY_rightStalk "Left body controller: a119 PARTY right stalk";
CM_ SG_ 1373 VCLEFT_a119_CH_steerAngle "Left body controller: a119 CH steer angle";
CM_ SG_ 1373 VCLEFT_a119_PARTY_steerAngle "Left body controller: a119 PARTY steer angle";
CM_ SG_ 1373 VCLEFT_a120_PARTY_chassisCntl "Left body controller: a120 PARTY chassis cntl";
CM_ SG_ 1373 VCLEFT_a120_VEH_systemStatus "Left body controller: a120 VEH system status";
CM_ SG_ 1373 VCLEFT_a120_CH_chassisCntl "Left body controller: a120 CH chassis cntl";
CM_ SG_ 1373 VCLEFT_a120_PARTY_systemStatus "Left body controller: a120 PARTY system status";
CM_ SG_ 1373 VCLEFT_a120_PARTY_torque "Left body controller: a120 PARTY torque";
CM_ SG_ 1373 VCLEFT_a120_VEH_torque "Left body controller: a120 VEH torque";
CM_ SG_ 1373 VCLEFT_a120_PARTY_locStatus "Left body controller: a120 PARTY loc status";
CM_ SG_ 1373 VCLEFT_a120_PARTY_speed "Left body controller: a120 PARTY speed";
CM_ SG_ 1373 VCLEFT_a120_VEH_speed "Left body controller: a120 VEH speed";
CM_ SG_ 1373 VCLEFT_a120_PARTY_status "Left body controller: a120 PARTY status";
CM_ SG_ 1373 VCLEFT_a120_PT_speed "Left body controller: a120 PT speed";
CM_ SG_ 1373 VCLEFT_a120_PT_systemStatus "Left body controller: a120 PT system status";
CM_ SG_ 1373 VCLEFT_a120_PARTY_vehicleEstimat "Left body controller: a120 PARTY vehicle estimates";
CM_ SG_ 1373 VCLEFT_a120_VEH_aggregatedAxleSp "Left body controller: a120 VEH aggregated axle speed";
CM_ SG_ 1373 VCLEFT_a120_PARTY_aggregatedAxle "Left body controller: a120 PARTY aggregated axle speed";
CM_ SG_ 1373 VCLEFT_a120_VEH_systemPower "Left body controller: a120 VEH system power";
CM_ SG_ 1373 VCLEFT_a120_PARTY_autonomyHealth "Left body controller: a120 PARTY autonomy health";
CM_ SG_ 1373 VCLEFT_a120_VEH_autonomyHealth "Left body controller: a120 VEH autonomy health";
CM_ SG_ 1373 VCLEFT_a120_PT_systemPower "Left body controller: a120 PT system power";
CM_ SG_ 1373 VCLEFT_a120_PARTY_stalklessInter "Left body controller: a120 PARTY stalkless interfaces";
CM_ SG_ 1373 VCLEFT_a120_CH_speed "Left body controller: a120 CH speed";
CM_ SG_ 1373 VCLEFT_a120_VEH_estimatedBrakeTe "Left body controller: a120 VEH estimated brake temp";
CM_ SG_ 1373 VCLEFT_a120_PARTY_prndControl "Left body controller: a120 PARTY prnd control";
CM_ SG_ 1373 VCLEFT_a120_PARTY_locStatus2 "Left body controller: a120 PARTY loc status2";
CM_ SG_ 1373 VCLEFT_a120_VEH_chassisCntl "Left body controller: a120 VEH chassis cntl";
CM_ SG_ 1373 VCLEFT_a120_CH_locStatus2 "Left body controller: a120 CH loc status2";
CM_ SG_ 1373 VCLEFT_a120_VEH_locStatus "Left body controller: a120 VEH loc status";
CM_ SG_ 1373 VCLEFT_a120_VEH_locStatus2 "Left body controller: a120 VEH loc status2";
CM_ SG_ 1373 VCLEFT_a120_VEH_prndControl "Left body controller: a120 VEH prnd control";
CM_ SG_ 1373 VCLEFT_a120_VEH_vehicleEstimates "Left body controller: a120 VEH vehicle estimates";
CM_ SG_ 1373 VCLEFT_a120_PARTY_motorStatus "Left body controller: a120 PARTY motor status";
CM_ SG_ 1373 VCLEFT_a120_VEH_motorStatus "Left body controller: a120 VEH motor status";
CM_ SG_ 1373 VCLEFT_a120_BDY_speed "Left body controller: a120 BDY speed";
CM_ SG_ 1373 VCLEFT_a121_OBD_status "Left body controller: a121 OBD status";
CM_ SG_ 1373 VCLEFT_a123_OBD_alcoholInterlock "Left body controller: a123 OBD alcohol interlock request";
CM_ SG_ 1373 VCLEFT_a124_PARTY_status "Left body controller: a124 PARTY status";
CM_ SG_ 1373 VCLEFT_a124_BDY_status "Left body controller: a124 BDY status";
CM_ SG_ 1373 VCLEFT_a124_VEH_status "Left body controller: a124 VEH status";
CM_ SG_ 1373 VCLEFT_a125_PARTY_actuation "Left body controller: a125 PARTY actuation";
CM_ SG_ 1373 VCLEFT_a125_BDY_actuation "Left body controller: a125 BDY actuation";
CM_ SG_ 1373 VCLEFT_a125_PARTY_status "Left body controller: a125 PARTY status";
CM_ SG_ 1373 VCLEFT_a125_BDY_status "Left body controller: a125 BDY status";
CM_ SG_ 1373 VCLEFT_a129_overCurrentError "Left body controller: a129 over current error";
CM_ SG_ 1373 VCLEFT_a129_fetShortCircuit "Left body controller: a129 fet short circuit";
CM_ SG_ 1373 VCLEFT_a129_lockedRotor "Left body controller: a129 locked rotor";
CM_ SG_ 1373 VCLEFT_a129_VDS_HA "Left body controller: a129 VDS HA";
CM_ SG_ 1373 VCLEFT_a129_VDS_LA "Left body controller: a129 VDS LA";
CM_ SG_ 1373 VCLEFT_a129_VDS_HB "Left body controller: a129 VDS HB";
CM_ SG_ 1373 VCLEFT_a129_VDS_LB "Left body controller: a129 VDS LB";
CM_ SG_ 1373 VCLEFT_a129_VDS_HC "Left body controller: a129 VDS HC";
CM_ SG_ 1373 VCLEFT_a129_VDS_LC "Left body controller: a129 VDS LC";
CM_ SG_ 1373 VCLEFT_a129_SNS_C_OCP "Left body controller: a129 SNS c OCP";
CM_ SG_ 1373 VCLEFT_a129_SNS_B_OCP "Left body controller: a129 SNS b OCP";
CM_ SG_ 1373 VCLEFT_a129_SNS_A_OCP "Left body controller: a129 SNS a OCP";
CM_ SG_ 1373 VCLEFT_a129_PVDD_UVLO2 "Left body controller: a129 PVDD UVLO2";
CM_ SG_ 1373 VCLEFT_a129_WD_FAULT "Left body controller: a129 WD FAULT";
CM_ SG_ 1373 VCLEFT_a129_OTSD "Left body controller: a129 OTSD";
CM_ SG_ 1373 VCLEFT_a129_VREG_UV "Left body controller: a129 VREG UV";
CM_ SG_ 1373 VCLEFT_a129_AVDD_UVLO "Left body controller: a129 AVDD UVLO";
CM_ SG_ 1373 VCLEFT_a129_VCP_LSD_UVLO2 "Left body controller: a129 VCP LSD UVLO2";
CM_ SG_ 1373 VCLEFT_a129_VCPH_UVLO2 "Left body controller: a129 VCPH UVLO2";
CM_ SG_ 1373 VCLEFT_a129_VCPH_UVLO "Left body controller: a129 VCPH UVLO";
CM_ SG_ 1373 VCLEFT_a129_VCPH_OVLO_ABS "Left body controller: a129 VCPH OVLO ABS";
CM_ SG_ 1373 VCLEFT_a129_VGS_HA "Left body controller: a129 VGS HA";
CM_ SG_ 1373 VCLEFT_a129_VGS_LA "Left body controller: a129 VGS LA";
CM_ SG_ 1373 VCLEFT_a129_VGS_HB "Left body controller: a129 VGS HB";
CM_ SG_ 1373 VCLEFT_a129_VGS_LB "Left body controller: a129 VGS LB";
CM_ SG_ 1373 VCLEFT_a129_VGS_HC "Left body controller: a129 VGS HC";
CM_ SG_ 1373 VCLEFT_a129_VGS_LC "Left body controller: a129 VGS LC";
CM_ SG_ 1373 VCLEFT_a130_junctionTempWarning "Left body controller: a130 junction temp warning";
CM_ SG_ 1373 VCLEFT_a130_junctionOverTemp "Left body controller: a130 junction over temp";
CM_ SG_ 1373 VCLEFT_a130_startUpOperation "Left body controller: a130 start up operation";
CM_ SG_ 1373 VCLEFT_a130_lossOfSpeedLock "Left body controller: a130 loss of speed lock";
CM_ SG_ 1373 VCLEFT_a130_vccUnderVoltage "Left body controller: a130 vcc under voltage";
CM_ SG_ 1373 VCLEFT_a130_TEMP_FLAG4 "Left body controller: a130 TEMP FLAG4";
CM_ SG_ 1373 VCLEFT_a130_PVDD_UVFL "Left body controller: a130 PVDD UVFL";
CM_ SG_ 1373 VCLEFT_a130_PVDD_OVFL "Left body controller: a130 PVDD OVFL";
CM_ SG_ 1373 VCLEFT_a130_VDS_STATUS "Left body controller: a130 VDS STATUS";
CM_ SG_ 1373 VCLEFT_a130_VCPH_UVFL "Left body controller: a130 VCPH UVFL";
CM_ SG_ 1373 VCLEFT_a130_TEMP_FLAG1 "Left body controller: a130 TEMP FLAG1";
CM_ SG_ 1373 VCLEFT_a130_TEMP_FLAG2 "Left body controller: a130 TEMP FLAG2";
CM_ SG_ 1373 VCLEFT_a130_TEMP_FLAG3 "Left body controller: a130 TEMP FLAG3";
CM_ SG_ 1373 VCLEFT_a130_OTW "Left body controller: a130 OTW";
CM_ SG_ 1373 VCLEFT_a131_vsUnderVoltage "Left body controller: a131 vs under voltage";
CM_ SG_ 1373 VCLEFT_a131_vsOverVoltage "Left body controller: a131 vs over voltage";
CM_ SG_ 1373 VCLEFT_a131_chpUnderVoltage "Left body controller: a131 chp under voltage";
CM_ SG_ 1373 VCLEFT_a131_vglUnderVoltage "Left body controller: a131 vgl under voltage";
CM_ SG_ 1373 VCLEFT_a131_thOverTemperature "Left body controller: a131 th over temperature";
CM_ SG_ 1373 VCLEFT_a132_RPMActual "Left body controller: a132 RPM actual";
CM_ SG_ 1373 VCLEFT_a132_RPMTarget "Left body controller: a132 RPM target";
CM_ SG_ 1373 VCLEFT_a133_RPMActual "Left body controller: a133 RPM actual";
CM_ SG_ 1373 VCLEFT_a133_RPMTarget "Left body controller: a133 RPM target";
CM_ SG_ 1373 VCLEFT_a141_outputCurrent "Left body controller: a141 output current";
CM_ SG_ 1373 VCLEFT_a145_brakeSwitch "Left body controller: a145 brake switch; raw 0 = signal not available (SNA)";
CM_ SG_ 1373 VCLEFT_a145_ibstRodPosition "Left body controller: a145 ibst rod position";
CM_ SG_ 1373 VCLEFT_a145_ibstRodPositionQF "Left body controller: a145 ibst rod position QF";
CM_ SG_ 1373 VCLEFT_a150_windowPosition "Left body controller: a150 window position";
CM_ SG_ 1373 VCLEFT_a150_movementTimeMs "Left body controller: a150 movement time ms";
CM_ SG_ 1373 VCLEFT_a150_windowPinchReason "Left body controller: a150 window pinch reason";
CM_ SG_ 1373 VCLEFT_a150_lookbackIndex "Left body controller: a150 lookback index";
CM_ SG_ 1373 VCLEFT_a150_absAccelExceedance "Left body controller: a150 abs accel exceedance";
CM_ SG_ 1373 VCLEFT_a150_relAccelExceedance "Left body controller: a150 rel accel exceedance";
CM_ SG_ 1373 VCLEFT_a150_speedExpScore "Left body controller: a150 speed exp score";
CM_ SG_ 1373 VCLEFT_a150_treatedInGear "Left body controller: a150 treated in gear";
CM_ SG_ 1373 VCLEFT_a151_windowPosition "Left body controller: a151 window position";
CM_ SG_ 1373 VCLEFT_a151_movementTimeMs "Left body controller: a151 movement time ms";
CM_ SG_ 1373 VCLEFT_a151_windowPinchReason "Left body controller: a151 window pinch reason";
CM_ SG_ 1373 VCLEFT_a151_lookbackIndex "Left body controller: a151 lookback index";
CM_ SG_ 1373 VCLEFT_a151_absAccelExceedance "Left body controller: a151 abs accel exceedance";
CM_ SG_ 1373 VCLEFT_a151_relAccelExceedance "Left body controller: a151 rel accel exceedance";
CM_ SG_ 1373 VCLEFT_a151_speedExpScore "Left body controller: a151 speed exp score";
CM_ SG_ 1373 VCLEFT_a151_treatedInGear "Left body controller: a151 treated in gear";
CM_ SG_ 1373 VCLEFT_a152_zeroed "Left body controller: a152 zeroed";
CM_ SG_ 1373 VCLEFT_a152_endStopTrusted "Left body controller: a152 end stop trusted";
CM_ SG_ 1373 VCLEFT_a152_speedTableStatus "Left body controller: a152 speed table status; raw 0 = signal not available (SNA)";
CM_ SG_ 1373 VCLEFT_a152_causedByBackoffs "Left body controller: a152 caused by backoffs";
CM_ SG_ 1373 VCLEFT_a153_zeroed "Left body controller: a153 zeroed";
CM_ SG_ 1373 VCLEFT_a153_endStopTrusted "Left body controller: a153 end stop trusted";
CM_ SG_ 1373 VCLEFT_a153_speedTableStatus "Left body controller: a153 speed table status; raw 0 = signal not available (SNA)";
CM_ SG_ 1373 VCLEFT_a153_causedByBackoffs "Left body controller: a153 caused by backoffs";
CM_ SG_ 1373 VCLEFT_a154_windowThermalMode "Left body controller: a154 window thermal mode; raw 0 = signal not available (SNA)";
CM_ SG_ 1373 VCLEFT_a154_lightShowActive "Left body controller: a154 light show active";
CM_ SG_ 1373 VCLEFT_a155_windowThermalMode "Left body controller: a155 window thermal mode; raw 0 = signal not available (SNA)";
CM_ SG_ 1373 VCLEFT_a155_lightShowActive "Left body controller: a155 light show active";
CM_ SG_ 1373 VCLEFT_a180_intButtonPressed "Left body controller: a180 int button pressed";
CM_ SG_ 1373 VCLEFT_a180_extHandlePWM "Left body controller: a180 ext handle PWM";
CM_ SG_ 1373 VCLEFT_a180_extHandlePulled "Left body controller: a180 ext handle pulled";
CM_ SG_ 1373 VCLEFT_a180_releasePWM "Left body controller: a180 release PWM";
CM_ SG_ 1373 VCLEFT_a180_latchStatus "Left body controller: a180 latch status; raw 0 = signal not available (SNA)";
CM_ SG_ 1373 VCLEFT_a180_latchClawStatus "Left body controller: a180 latch claw status";
CM_ SG_ 1373 VCLEFT_a181_intButtonPressed "Left body controller: a181 int button pressed";
CM_ SG_ 1373 VCLEFT_a181_extHandlePWM "Left body controller: a181 ext handle PWM";
CM_ SG_ 1373 VCLEFT_a181_extHandlePulled "Left body controller: a181 ext handle pulled";
CM_ SG_ 1373 VCLEFT_a181_releasePWM "Left body controller: a181 release PWM";
CM_ SG_ 1373 VCLEFT_a181_latchStatus "Left body controller: a181 latch status; raw 0 = signal not available (SNA)";
CM_ SG_ 1373 VCLEFT_a181_latchClawStatus "Left body controller: a181 latch claw status";
CM_ SG_ 1373 VCLEFT_a186_voltage "Left body controller: a186 voltage";
CM_ SG_ 1373 VCLEFT_a186_temperature "Left body controller: a186 temperature";
CM_ SG_ 1373 VCLEFT_a187_voltage "Left body controller: a187 voltage";
CM_ SG_ 1373 VCLEFT_a187_temperature "Left body controller: a187 temperature";
CM_ SG_ 1373 VCLEFT_a188_voltage "Left body controller: a188 voltage";
CM_ SG_ 1373 VCLEFT_a188_temperature "Left body controller: a188 temperature";
CM_ SG_ 1373 VCLEFT_a189_voltage "Left body controller: a189 voltage";
CM_ SG_ 1373 VCLEFT_a189_temperature "Left body controller: a189 temperature";
CM_ SG_ 1373 VCLEFT_a190_eFuseTripCount "Left body controller: a190 e fuse trip count";
CM_ SG_ 1373 VCLEFT_a192_motorFaulted "Left body controller: a192 motor faulted";
CM_ SG_ 1373 VCLEFT_a192_motorLocked "Left body controller: a192 motor locked";
CM_ SG_ 1373 VCLEFT_a192_ecuReset "Left body controller: a192 ecu reset";
CM_ SG_ 1373 VCLEFT_a192_fetTempIrrational "Left body controller: a192 fet temp irrational";
CM_ SG_ 1373 VCLEFT_a192_motorControlError "Left body controller: a192 motor control error";
CM_ SG_ 1373 VCLEFT_a192_underVoltage "Left body controller: a192 under voltage";
CM_ SG_ 1373 VCLEFT_a192_overVoltage "Left body controller: a192 over voltage";
CM_ SG_ 1373 VCLEFT_a192_hardwareOvercurrent "Left body controller: a192 hardware overcurrent";
CM_ SG_ 1373 VCLEFT_a192_motorOpenPhase "Left body controller: a192 motor open phase";
CM_ SG_ 1373 VCLEFT_a192_motorSoftOpenPhase "Left body controller: a192 motor soft open phase";
CM_ SG_ 1373 VCLEFT_a192_motorOvertemp "Left body controller: a192 motor overtemp";
CM_ SG_ 1373 VCLEFT_a192_dcOvercurrent "Left body controller: a192 dc overcurrent";
CM_ SG_ 1373 VCLEFT_a192_motorStalled "Left body controller: a192 motor stalled";
CM_ SG_ 1373 VCLEFT_a192_selfTestFailed "Left body controller: a192 self test failed";
CM_ SG_ 1373 VCLEFT_a192_selfTestResult "Left body controller: a192 self test result";
CM_ SG_ 1373 VCLEFT_a192_linChecksumError "Left body controller: a192 lin checksum error";
CM_ SG_ 1373 VCLEFT_a192_linFramingError "Left body controller: a192 lin framing error";
CM_ SG_ 1373 VCLEFT_a192_phaseShorted "Left body controller: a192 phase shorted";
CM_ SG_ 1373 VCLEFT_a192_busVoltageIrrational "Left body controller: a192 bus voltage irrational";
CM_ SG_ 1373 VCLEFT_a192_dcCurrentIrrational "Left body controller: a192 dc current irrational";
CM_ SG_ 1373 VCLEFT_a192_motorSpeedIrrational "Left body controller: a192 motor speed irrational";
CM_ SG_ 1373 VCLEFT_a192_supplyVoltageIrratio "Left body controller: a192 supply voltage irrational";
CM_ SG_ 1373 VCLEFT_a192_motorPhaseCurrentIrr "Left body controller: a192 motor phase current irrational";
CM_ SG_ 1373 VCLEFT_a192_chipOvertemp "Left body controller: a192 chip overtemp";
CM_ SG_ 1373 VCLEFT_a192_motorSpeedTooHigh "Left body controller: a192 motor speed too high";
CM_ SG_ 1373 VCLEFT_a192_phaseOvercurrent "Left body controller: a192 phase overcurrent";
CM_ SG_ 1373 VCLEFT_a192_vddaOvercurrent "Left body controller: a192 vdda overcurrent";
CM_ SG_ 1373 VCLEFT_a192_busVoltageUnhealthy "Left body controller: a192 bus voltage unhealthy";
CM_ SG_ 1373 VCLEFT_a192_hsVdsOvervoltage "Left body controller: a192 hs vds overvoltage";
CM_ SG_ 1373 VCLEFT_a192_hsVdsOvervoltageMask "Left body controller: a192 hs vds overvoltage mask";
CM_ SG_ 1373 VCLEFT_a192_lsVdsOvervoltage "Left body controller: a192 ls vds overvoltage";
CM_ SG_ 1373 VCLEFT_a192_lsVdsOvervoltageMask "Left body controller: a192 ls vds overvoltage mask";
CM_ SG_ 1373 VCLEFT_a192_payloadBitsNotSet "Left body controller: a192 payload bits not set";
CM_ SG_ 1373 VCLEFT_a192_motorNotIdentified "Left body controller: a192 motor not identified";
CM_ SG_ 1373 VCLEFT_a192_motorType "Left body controller: a192 motor type";
CM_ SG_ 1373 VCLEFT_a194_motorTypeUnknown "Left body controller: a194 motor type unknown";
CM_ SG_ 1373 VCLEFT_a194_configurationMismatc "Left body controller: a194 configuration mismatch";
CM_ SG_ 1373 VCLEFT_a194_vcbldcMotorTypeUnkno "Left body controller: a194 vcbldc motor type unknown";
CM_ SG_ 1373 VCLEFT_a194_nvramMotorTypeUnknow "Left body controller: a194 nvram motor type unknown";
CM_ SG_ 1373 VCLEFT_a194_vcbldcMotorId "Left body controller: a194 vcbldc motor id";
CM_ SG_ 1373 VCLEFT_a194_nvramMotorId "Left body controller: a194 nvram motor id";
CM_ SG_ 1373 VCLEFT_a196_outputState "Left body controller: a196 output state";
CM_ SG_ 1373 VCLEFT_a196_NVRAMState "Left body controller: a196 NVRAM state";
CM_ SG_ 1373 VCLEFT_a196_lockoutState "Left body controller: a196 lockout state";
CM_ SG_ 1373 VCLEFT_a197_outputState "Left body controller: a197 output state";
CM_ SG_ 1373 VCLEFT_a197_NVRAMState "Left body controller: a197 NVRAM state";
CM_ SG_ 1373 VCLEFT_a197_lockoutState "Left body controller: a197 lockout state";
CM_ SG_ 1373 VCLEFT_a202_unknownAllowed "Left body controller: a202 unknown allowed";
CM_ SG_ 1373 VCLEFT_a202_openAllowed "Left body controller: a202 open allowed";
CM_ SG_ 1373 VCLEFT_a202_dynamicAllowed "Left body controller: a202 dynamic allowed";
CM_ SG_ 1373 VCLEFT_a202_parkAllowed "Left body controller: a202 park allowed";
CM_ SG_ 1373 VCLEFT_a202_startAllowed "Left body controller: a202 start allowed";
CM_ SG_ 1373 VCLEFT_a202_serviceAllowed "Left body controller: a202 service allowed";
CM_ SG_ 1373 VCLEFT_a202_winchAllowed "Left body controller: a202 winch allowed";
CM_ SG_ 1373 VCLEFT_a202_winchReleaseAllowed "Left body controller: a202 winch release allowed";
CM_ SG_ 1373 VCLEFT_a202_parkingAllowed "Left body controller: a202 parking allowed";
CM_ SG_ 1373 VCLEFT_a202_dynApplyAllowed "Left body controller: a202 dyn apply allowed";
CM_ SG_ 1373 VCLEFT_a202_releaseAllowed "Left body controller: a202 release allowed";
CM_ SG_ 1373 VCLEFT_a202_parkPendingAllowed "Left body controller: a202 park pending allowed";
CM_ SG_ 1373 VCLEFT_a202_wenchPendingAllowed "Left body controller: a202 wench pending allowed";
CM_ SG_ 1373 VCLEFT_a202_desyncCount "Left body controller: a202 desync count";
CM_ SG_ 1373 VCLEFT_a202_current "Left body controller: a202 current";
CM_ SG_ 1373 VCLEFT_a202_epbConfig "Left body controller: a202 epb config";
CM_ SG_ 1373 VCLEFT_a203_unknownAllowed "Left body controller: a203 unknown allowed";
CM_ SG_ 1373 VCLEFT_a203_openAllowed "Left body controller: a203 open allowed";
CM_ SG_ 1373 VCLEFT_a203_dynamicAllowed "Left body controller: a203 dynamic allowed";
CM_ SG_ 1373 VCLEFT_a203_parkAllowed "Left body controller: a203 park allowed";
CM_ SG_ 1373 VCLEFT_a203_startAllowed "Left body controller: a203 start allowed";
CM_ SG_ 1373 VCLEFT_a203_serviceAllowed "Left body controller: a203 service allowed";
CM_ SG_ 1373 VCLEFT_a203_winchAllowed "Left body controller: a203 winch allowed";
CM_ SG_ 1373 VCLEFT_a203_winchReleaseAllowed "Left body controller: a203 winch release allowed";
CM_ SG_ 1373 VCLEFT_a203_parkingAllowed "Left body controller: a203 parking allowed";
CM_ SG_ 1373 VCLEFT_a203_dynApplyAllowed "Left body controller: a203 dyn apply allowed";
CM_ SG_ 1373 VCLEFT_a203_releaseAllowed "Left body controller: a203 release allowed";
CM_ SG_ 1373 VCLEFT_a203_parkPendingAllowed "Left body controller: a203 park pending allowed";
CM_ SG_ 1373 VCLEFT_a203_wenchPendingAllowed "Left body controller: a203 wench pending allowed";
CM_ SG_ 1373 VCLEFT_a203_desyncCount "Left body controller: a203 desync count";
CM_ SG_ 1373 VCLEFT_a203_current "Left body controller: a203 current";
CM_ SG_ 1373 VCLEFT_a203_epbConfig "Left body controller: a203 epb config";
CM_ SG_ 1373 VCLEFT_a204_unknownAllowed "Left body controller: a204 unknown allowed";
CM_ SG_ 1373 VCLEFT_a204_openAllowed "Left body controller: a204 open allowed";
CM_ SG_ 1373 VCLEFT_a204_dynamicAllowed "Left body controller: a204 dynamic allowed";
CM_ SG_ 1373 VCLEFT_a204_parkAllowed "Left body controller: a204 park allowed";
CM_ SG_ 1373 VCLEFT_a204_startAllowed "Left body controller: a204 start allowed";
CM_ SG_ 1373 VCLEFT_a204_serviceAllowed "Left body controller: a204 service allowed";
CM_ SG_ 1373 VCLEFT_a204_winchAllowed "Left body controller: a204 winch allowed";
CM_ SG_ 1373 VCLEFT_a204_winchReleaseAllowed "Left body controller: a204 winch release allowed";
CM_ SG_ 1373 VCLEFT_a204_parkingAllowed "Left body controller: a204 parking allowed";
CM_ SG_ 1373 VCLEFT_a204_dynApplyAllowed "Left body controller: a204 dyn apply allowed";
CM_ SG_ 1373 VCLEFT_a204_releaseAllowed "Left body controller: a204 release allowed";
CM_ SG_ 1373 VCLEFT_a204_parkPendingAllowed "Left body controller: a204 park pending allowed";
CM_ SG_ 1373 VCLEFT_a204_wenchPendingAllowed "Left body controller: a204 wench pending allowed";
CM_ SG_ 1373 VCLEFT_a204_desyncCount "Left body controller: a204 desync count";
CM_ SG_ 1373 VCLEFT_a204_current "Left body controller: a204 current";
CM_ SG_ 1373 VCLEFT_a204_epbConfig "Left body controller: a204 epb config";
CM_ SG_ 1373 VCLEFT_a205_unknownAllowed "Left body controller: a205 unknown allowed";
CM_ SG_ 1373 VCLEFT_a205_openAllowed "Left body controller: a205 open allowed";
CM_ SG_ 1373 VCLEFT_a205_dynamicAllowed "Left body controller: a205 dynamic allowed";
CM_ SG_ 1373 VCLEFT_a205_parkAllowed "Left body controller: a205 park allowed";
CM_ SG_ 1373 VCLEFT_a205_startAllowed "Left body controller: a205 start allowed";
CM_ SG_ 1373 VCLEFT_a205_serviceAllowed "Left body controller: a205 service allowed";
CM_ SG_ 1373 VCLEFT_a205_winchAllowed "Left body controller: a205 winch allowed";
CM_ SG_ 1373 VCLEFT_a205_winchReleaseAllowed "Left body controller: a205 winch release allowed";
CM_ SG_ 1373 VCLEFT_a205_parkingAllowed "Left body controller: a205 parking allowed";
CM_ SG_ 1373 VCLEFT_a205_dynApplyAllowed "Left body controller: a205 dyn apply allowed";
CM_ SG_ 1373 VCLEFT_a205_releaseAllowed "Left body controller: a205 release allowed";
CM_ SG_ 1373 VCLEFT_a205_parkPendingAllowed "Left body controller: a205 park pending allowed";
CM_ SG_ 1373 VCLEFT_a205_wenchPendingAllowed "Left body controller: a205 wench pending allowed";
CM_ SG_ 1373 VCLEFT_a205_desyncCount "Left body controller: a205 desync count";
CM_ SG_ 1373 VCLEFT_a205_current "Left body controller: a205 current";
CM_ SG_ 1373 VCLEFT_a205_epbConfig "Left body controller: a205 epb config";
CM_ SG_ 1373 VCLEFT_a206_unknownAllowed "Left body controller: a206 unknown allowed";
CM_ SG_ 1373 VCLEFT_a206_openAllowed "Left body controller: a206 open allowed";
CM_ SG_ 1373 VCLEFT_a206_dynamicAllowed "Left body controller: a206 dynamic allowed";
CM_ SG_ 1373 VCLEFT_a206_parkAllowed "Left body controller: a206 park allowed";
CM_ SG_ 1373 VCLEFT_a206_startAllowed "Left body controller: a206 start allowed";
CM_ SG_ 1373 VCLEFT_a206_serviceAllowed "Left body controller: a206 service allowed";
CM_ SG_ 1373 VCLEFT_a206_winchAllowed "Left body controller: a206 winch allowed";
CM_ SG_ 1373 VCLEFT_a206_winchReleaseAllowed "Left body controller: a206 winch release allowed";
CM_ SG_ 1373 VCLEFT_a206_parkingAllowed "Left body controller: a206 parking allowed";
CM_ SG_ 1373 VCLEFT_a206_dynApplyAllowed "Left body controller: a206 dyn apply allowed";
CM_ SG_ 1373 VCLEFT_a206_releaseAllowed "Left body controller: a206 release allowed";
CM_ SG_ 1373 VCLEFT_a206_parkPendingAllowed "Left body controller: a206 park pending allowed";
CM_ SG_ 1373 VCLEFT_a206_wenchPendingAllowed "Left body controller: a206 wench pending allowed";
CM_ SG_ 1373 VCLEFT_a206_unitStatusEPB "Left body controller: a206 unit status EPB";
CM_ SG_ 1373 VCLEFT_a206_unitStatusEPBM "Left body controller: a206 unit status EPBM";
CM_ SG_ 1373 VCLEFT_a207_unknownAllowed "Left body controller: a207 unknown allowed";
CM_ SG_ 1373 VCLEFT_a207_openAllowed "Left body controller: a207 open allowed";
CM_ SG_ 1373 VCLEFT_a207_dynamicAllowed "Left body controller: a207 dynamic allowed";
CM_ SG_ 1373 VCLEFT_a207_parkAllowed "Left body controller: a207 park allowed";
CM_ SG_ 1373 VCLEFT_a207_startAllowed "Left body controller: a207 start allowed";
CM_ SG_ 1373 VCLEFT_a207_serviceAllowed "Left body controller: a207 service allowed";
CM_ SG_ 1373 VCLEFT_a207_winchAllowed "Left body controller: a207 winch allowed";
CM_ SG_ 1373 VCLEFT_a207_winchReleaseAllowed "Left body controller: a207 winch release allowed";
CM_ SG_ 1373 VCLEFT_a207_parkingAllowed "Left body controller: a207 parking allowed";
CM_ SG_ 1373 VCLEFT_a207_dynApplyAllowed "Left body controller: a207 dyn apply allowed";
CM_ SG_ 1373 VCLEFT_a207_releaseAllowed "Left body controller: a207 release allowed";
CM_ SG_ 1373 VCLEFT_a207_parkPendingAllowed "Left body controller: a207 park pending allowed";
CM_ SG_ 1373 VCLEFT_a207_wenchPendingAllowed "Left body controller: a207 wench pending allowed";
CM_ SG_ 1373 VCLEFT_a207_unitStatusEPB "Left body controller: a207 unit status EPB";
CM_ SG_ 1373 VCLEFT_a207_unitStatusEPBM "Left body controller: a207 unit status EPBM";
CM_ SG_ 1373 VCLEFT_a208_unknownAllowed "Left body controller: a208 unknown allowed";
CM_ SG_ 1373 VCLEFT_a208_openAllowed "Left body controller: a208 open allowed";
CM_ SG_ 1373 VCLEFT_a208_dynamicAllowed "Left body controller: a208 dynamic allowed";
CM_ SG_ 1373 VCLEFT_a208_parkAllowed "Left body controller: a208 park allowed";
CM_ SG_ 1373 VCLEFT_a208_startAllowed "Left body controller: a208 start allowed";
CM_ SG_ 1373 VCLEFT_a208_serviceAllowed "Left body controller: a208 service allowed";
CM_ SG_ 1373 VCLEFT_a208_winchAllowed "Left body controller: a208 winch allowed";
CM_ SG_ 1373 VCLEFT_a208_winchReleaseAllowed "Left body controller: a208 winch release allowed";
CM_ SG_ 1373 VCLEFT_a208_parkingAllowed "Left body controller: a208 parking allowed";
CM_ SG_ 1373 VCLEFT_a208_dynApplyAllowed "Left body controller: a208 dyn apply allowed";
CM_ SG_ 1373 VCLEFT_a208_releaseAllowed "Left body controller: a208 release allowed";
CM_ SG_ 1373 VCLEFT_a208_parkPendingAllowed "Left body controller: a208 park pending allowed";
CM_ SG_ 1373 VCLEFT_a208_wenchPendingAllowed "Left body controller: a208 wench pending allowed";
CM_ SG_ 1373 VCLEFT_a208_unitStatusEPB "Left body controller: a208 unit status EPB";
CM_ SG_ 1373 VCLEFT_a208_unitStatusEPBM "Left body controller: a208 unit status EPBM";
CM_ SG_ 1373 VCLEFT_a209_unknownAllowed "Left body controller: a209 unknown allowed";
CM_ SG_ 1373 VCLEFT_a209_openAllowed "Left body controller: a209 open allowed";
CM_ SG_ 1373 VCLEFT_a209_dynamicAllowed "Left body controller: a209 dynamic allowed";
CM_ SG_ 1373 VCLEFT_a209_parkAllowed "Left body controller: a209 park allowed";
CM_ SG_ 1373 VCLEFT_a209_startAllowed "Left body controller: a209 start allowed";
CM_ SG_ 1373 VCLEFT_a209_serviceAllowed "Left body controller: a209 service allowed";
CM_ SG_ 1373 VCLEFT_a209_winchAllowed "Left body controller: a209 winch allowed";
CM_ SG_ 1373 VCLEFT_a209_winchReleaseAllowed "Left body controller: a209 winch release allowed";
CM_ SG_ 1373 VCLEFT_a209_parkingAllowed "Left body controller: a209 parking allowed";
CM_ SG_ 1373 VCLEFT_a209_dynApplyAllowed "Left body controller: a209 dyn apply allowed";
CM_ SG_ 1373 VCLEFT_a209_releaseAllowed "Left body controller: a209 release allowed";
CM_ SG_ 1373 VCLEFT_a209_parkPendingAllowed "Left body controller: a209 park pending allowed";
CM_ SG_ 1373 VCLEFT_a209_wenchPendingAllowed "Left body controller: a209 wench pending allowed";
CM_ SG_ 1373 VCLEFT_a209_unitStatusEPB "Left body controller: a209 unit status EPB";
CM_ SG_ 1373 VCLEFT_a209_unitStatusEPBM "Left body controller: a209 unit status EPBM";
CM_ SG_ 1373 VCLEFT_a210_unknownAllowed "Left body controller: a210 unknown allowed";
CM_ SG_ 1373 VCLEFT_a210_openAllowed "Left body controller: a210 open allowed";
CM_ SG_ 1373 VCLEFT_a210_dynamicAllowed "Left body controller: a210 dynamic allowed";
CM_ SG_ 1373 VCLEFT_a210_parkAllowed "Left body controller: a210 park allowed";
CM_ SG_ 1373 VCLEFT_a210_startAllowed "Left body controller: a210 start allowed";
CM_ SG_ 1373 VCLEFT_a210_serviceAllowed "Left body controller: a210 service allowed";
CM_ SG_ 1373 VCLEFT_a210_winchAllowed "Left body controller: a210 winch allowed";
CM_ SG_ 1373 VCLEFT_a210_winchReleaseAllowed "Left body controller: a210 winch release allowed";
CM_ SG_ 1373 VCLEFT_a210_parkingAllowed "Left body controller: a210 parking allowed";
CM_ SG_ 1373 VCLEFT_a210_dynApplyAllowed "Left body controller: a210 dyn apply allowed";
CM_ SG_ 1373 VCLEFT_a210_releaseAllowed "Left body controller: a210 release allowed";
CM_ SG_ 1373 VCLEFT_a210_parkPendingAllowed "Left body controller: a210 park pending allowed";
CM_ SG_ 1373 VCLEFT_a210_wenchPendingAllowed "Left body controller: a210 wench pending allowed";
CM_ SG_ 1373 VCLEFT_a210_unitStatusEPB "Left body controller: a210 unit status EPB";
CM_ SG_ 1373 VCLEFT_a210_unitStatusEPBM "Left body controller: a210 unit status EPBM";
CM_ SG_ 1373 VCLEFT_a221_vbatProtVoltage "Left body controller: a221 vbat prot voltage";
CM_ SG_ 1373 VCLEFT_a221_vbatProtCurrent "Left body controller: a221 vbat prot current";
CM_ SG_ 1373 VCLEFT_a221_uvLoadshedVoltage "Left body controller: a221 uv loadshed voltage";
CM_ SG_ 1373 VCLEFT_a221_loadshedFromBattMoni "Left body controller: a221 loadshed from batt monitor";
CM_ SG_ 1373 VCLEFT_a221_faultInjectActive "Left body controller: a221 fault inject active";
CM_ SG_ 1373 VCLEFT_a221_loadshedResetActive "Left body controller: a221 loadshed reset active";
CM_ SG_ 1373 VCLEFT_a221_loadshedArmPrimary "Left body controller: a221 loadshed arm primary";
CM_ SG_ 1373 VCLEFT_a224_seatMotorCalibrated "Left body controller: a224 seat motor calibrated";
CM_ SG_ 1373 VCLEFT_a224_seatMotorCurrent "Left body controller: a224 seat motor current";
CM_ SG_ 1373 VCLEFT_a224_seatMotorState "Left body controller: a224 seat motor state";
CM_ SG_ 1373 VCLEFT_a224_seatSwitchBack "Left body controller: a224 seat switch back; raw 0 = signal not available (SNA)";
CM_ SG_ 1373 VCLEFT_a224_seatSwitchForward "Left body controller: a224 seat switch forward; raw 0 = signal not available (SNA)";
CM_ SG_ 1373 VCLEFT_a225_seatMotorCalibrated "Left body controller: a225 seat motor calibrated";
CM_ SG_ 1373 VCLEFT_a225_seatMotorCurrent "Left body controller: a225 seat motor current";
CM_ SG_ 1373 VCLEFT_a225_seatMotorState "Left body controller: a225 seat motor state";
CM_ SG_ 1373 VCLEFT_a225_seatSwitchBack "Left body controller: a225 seat switch back; raw 0 = signal not available (SNA)";
CM_ SG_ 1373 VCLEFT_a225_seatSwitchForward "Left body controller: a225 seat switch forward; raw 0 = signal not available (SNA)";
CM_ SG_ 1373 VCLEFT_a226_seatMotorCalibrated "Left body controller: a226 seat motor calibrated";
CM_ SG_ 1373 VCLEFT_a226_seatMotorCurrent "Left body controller: a226 seat motor current";
CM_ SG_ 1373 VCLEFT_a226_seatMotorState "Left body controller: a226 seat motor state";
CM_ SG_ 1373 VCLEFT_a226_seatSwitchBack "Left body controller: a226 seat switch back; raw 0 = signal not available (SNA)";
CM_ SG_ 1373 VCLEFT_a226_seatSwitchForward "Left body controller: a226 seat switch forward; raw 0 = signal not available (SNA)";
CM_ SG_ 1373 VCLEFT_a227_seatMotorCalibrated "Left body controller: a227 seat motor calibrated";
CM_ SG_ 1373 VCLEFT_a227_seatMotorCurrent "Left body controller: a227 seat motor current";
CM_ SG_ 1373 VCLEFT_a227_seatMotorState "Left body controller: a227 seat motor state";
CM_ SG_ 1373 VCLEFT_a227_seatSwitchBack "Left body controller: a227 seat switch back; raw 0 = signal not available (SNA)";
CM_ SG_ 1373 VCLEFT_a227_seatSwitchForward "Left body controller: a227 seat switch forward; raw 0 = signal not available (SNA)";
CM_ SG_ 1373 VCLEFT_a228_seatMotorCalibrated "Left body controller: a228 seat motor calibrated";
CM_ SG_ 1373 VCLEFT_a228_seatMotorCurrent "Left body controller: a228 seat motor current";
CM_ SG_ 1373 VCLEFT_a228_seatMotorPosReal "Left body controller: a228 seat motor pos real";
CM_ SG_ 1373 VCLEFT_a228_seatMotorState "Left body controller: a228 seat motor state";
BA_DEF_ BO_ "GenMsgCycleTime" INT 0 3600000;
BA_DEF_ BO_ "GenMsgSendType" ENUM "Cyclic","NotUsed","NotUsed","NotUsed","NotUsed","NotUsed","NotUsed","IfActive","NoMsgSendType","NotUsed";
BA_DEF_ BO_ "VFrameFormat" ENUM "StandardCAN","ExtendedCAN","reserved","J1939PG","reserved","reserved","reserved","reserved","reserved","reserved","reserved","reserved","reserved","reserved","StandardCAN_FD","ExtendedCAN_FD";
BA_DEF_ BO_ "CANFD_BRS" ENUM "0","1";
BA_DEF_ SG_ "GenSigSNA" STRING;
BA_DEF_ SG_ "SystemSignalLongSymbol" STRING;
BA_DEF_ SG_ "Confidence" ENUM "validated","plausible","layout-only","contradicted";
BA_DEF_DEF_ "GenMsgCycleTime" 0;
BA_DEF_DEF_ "GenMsgSendType" "NoMsgSendType";
BA_DEF_DEF_ "VFrameFormat" "StandardCAN";
BA_DEF_DEF_ "CANFD_BRS" "1";
BA_DEF_DEF_ "GenSigSNA" "";
BA_DEF_DEF_ "SystemSignalLongSymbol" "";
BA_DEF_DEF_ "Confidence" "layout-only";
BA_ "GenMsgCycleTime" BO_ 737 16;
BA_ "GenMsgSendType" BO_ 737 0;
BA_ "GenMsgCycleTime" BO_ 1349 33;
BA_ "GenMsgSendType" BO_ 1349 0;
BA_ "GenMsgCycleTime" BO_ 929 50;
BA_ "GenMsgSendType" BO_ 929 0;
BA_ "GenMsgCycleTime" BO_ 507 5000;
BA_ "GenMsgSendType" BO_ 507 0;
BA_ "Confidence" SG_ 737 VCFRONT_statusIndex 0;
BA_ "Confidence" SG_ 737 VCFRONT_frunkLatchStatus 0;
BA_ "GenSigSNA" SG_ 737 VCFRONT_frunkLatchStatus "0";
BA_ "Confidence" SG_ 737 VCFRONT_wiperSpeed 0;
BA_ "GenSigSNA" SG_ 737 VCFRONT_wiperSpeed "0";
BA_ "Confidence" SG_ 737 VCFRONT_wiperPosition 0;
BA_ "GenSigSNA" SG_ 737 VCFRONT_wiperPosition "0";
BA_ "Confidence" SG_ 737 VCFRONT_wiperBlocked 0;
BA_ "Confidence" SG_ 737 VCFRONT_wiperState 0;
BA_ "GenSigSNA" SG_ 737 VCFRONT_wiperState "0";
BA_ "Confidence" SG_ 737 VCFRONT_crashDetectedType 0;
BA_ "Confidence" SG_ 737 VCFRONT_crashState 0;
BA_ "Confidence" SG_ 737 VCFRONT_crashUnlockOverrideSet 0;
BA_ "Confidence" SG_ 737 VCFRONT_washPumpState 0;
BA_ "GenSigSNA" SG_ 737 VCFRONT_washPumpState "1";
BA_ "Confidence" SG_ 737 VCFRONT_turnIndicatorControlType 0;
BA_ "Confidence" SG_ 737 VCFRONT_wiperHealth 0;
BA_ "Confidence" SG_ 737 VCFRONT_wiperLINHealth 0;
BA_ "Confidence" SG_ 737 VCFRONT_frunkLatchCurrent 0;
BA_ "Confidence" SG_ 737 VCFRONT_frunkInteriorRelSwitch 0;
BA_ "Confidence" SG_ 737 VCFRONT_anyClosureOpen 0;
BA_ "Confidence" SG_ 737 VCFRONT_anyDoorOpen 0;
BA_ "Confidence" SG_ 737 VCFRONT_hornOn 0;
BA_ "Confidence" SG_ 737 VCFRONT_radarHeaterState 0;
BA_ "GenSigSNA" SG_ 737 VCFRONT_radarHeaterState "0";
BA_ "Confidence" SG_ 737 VCFRONT_trunkExteriorWakeSwitch 0;
BA_ "Confidence" SG_ 737 VCFRONT_passengerBuckleStatus 0;
BA_ "Confidence" SG_ 737 VCFRONT_frunkLatchType 0;
BA_ "Confidence" SG_ 737 VCFRONT_headlampLeftFanStatus 0;
BA_ "Confidence" SG_ 737 VCFRONT_headlampRightFanStatus 0;
BA_ "Confidence" SG_ 737 VCFRONT_frunkAccessPost 0;
BA_ "Confidence" SG_ 737 VCFRONT_isActiveHeatingBattery 0;
BA_ "Confidence" SG_ 737 VCFRONT_iBoosterWakeLine 0;
BA_ "Confidence" SG_ 737 VCFRONT_epasWakeLine 0;
BA_ "Confidence" SG_ 737 VCFRONT_iBoosterStateDBG 0;
BA_ "Confidence" SG_ 737 VCFRONT_vehicleStatusDBG 0;
BA_ "GenSigSNA" SG_ 737 VCFRONT_vehicleStatusDBG "18";
BA_ "Confidence" SG_ 737 VCFRONT_timeSpentSleeping 0;
BA_ "Confidence" SG_ 737 VCFRONT_sleepCurrent 0;
BA_ "GenSigSNA" SG_ 737 VCFRONT_sleepCurrent "4095";
BA_ "Confidence" SG_ 737 VCFRONT_hibernationState 0;
BA_ "Confidence" SG_ 737 VCFRONT_wiperECUType 0;
BA_ "Confidence" SG_ 737 VCFRONT_wiperHeaterState 0;
BA_ "GenSigSNA" SG_ 737 VCFRONT_wiperHeaterState "0";
BA_ "Confidence" SG_ 737 VCFRONT_occupantCount 0;
BA_ "Confidence" SG_ 737 VCFRONT_closureEasterEggState 0;
BA_ "Confidence" SG_ 737 VCFRONT_espWakeLine 0;
BA_ "Confidence" SG_ 737 VCFRONT_allowEvapInLowAmbient 0;
BA_ "Confidence" SG_ 737 VCFRONT_potentialRadiatorSteam 0;
BA_ "Confidence" SG_ 737 VCFRONT_potentialRadiatorSteamUI 0;
BA_ "Confidence" SG_ 737 VCFRONT_hvacReqOffForFasterCharg 0;
BA_ "SystemSignalLongSymbol" SG_ 737 VCFRONT_hvacReqOffForFasterCharg "VCFRONT_hvacReqOffForFasterCharge";
BA_ "Confidence" SG_ 737 VCFRONT_limitedSplitTempDeltaEnf 0;
BA_ "SystemSignalLongSymbol" SG_ 737 VCFRONT_limitedSplitTempDeltaEnf "VCFRONT_limitedSplitTempDeltaEnforced";
BA_ "Confidence" SG_ 737 VCFRONT_batteryDischArbState 0;
BA_ "Confidence" SG_ 737 VCFRONT_maxEvapHeatRejection 0;
BA_ "Confidence" SG_ 737 VCFRONT_minEvapHeatRejection 0;
BA_ "Confidence" SG_ 737 VCFRONT_freezeEvapITerm 0;
BA_ "Confidence" SG_ 737 VCFRONT_isEvapOperationAllowed 0;
BA_ "Confidence" SG_ 737 VCFRONT_chillerDemandActive 0;
BA_ "Confidence" SG_ 737 VCFRONT_compPerfRecoveryLimited 0;
BA_ "Confidence" SG_ 737 VCFRONT_hvacModeNotAttainable 0;
BA_ "Confidence" SG_ 737 VCFRONT_hasLowRefrigerant 0;
BA_ "Confidence" SG_ 737 VCFRONT_isColdStartRunning 0;
BA_ "Confidence" SG_ 737 VCFRONT_isHeatPumpOilPurgeActive 0;
BA_ "Confidence" SG_ 737 VCFRONT_pressureRefrigSuction 0;
BA_ "GenSigSNA" SG_ 737 VCFRONT_pressureRefrigSuction "127";
BA_ "Confidence" SG_ 737 VCFRONT_pressureRefrigDischarge 0;
BA_ "GenSigSNA" SG_ 737 VCFRONT_pressureRefrigDischarge "511";
BA_ "Confidence" SG_ 737 VCFRONT_hvacPerfTestCommand 0;
BA_ "Confidence" SG_ 737 VCFRONT_coolantFillRoutineStatus 0;
BA_ "Confidence" SG_ 737 VCFRONT_refrigFillRoutineStatus 0;
BA_ "Confidence" SG_ 737 VCFRONT_isCOP1Running 0;
BA_ "Confidence" SG_ 737 VCFRONT_closeValvesRoutineStatus 0;
BA_ "Confidence" SG_ 737 VCFRONT_thermalPerfTestRunning 0;
BA_ "Confidence" SG_ 737 VCFRONT_extendedHvacPerfTestComm 0;
BA_ "SystemSignalLongSymbol" SG_ 737 VCFRONT_extendedHvacPerfTestComm "VCFRONT_extendedHvacPerfTestCommand";
BA_ "Confidence" SG_ 737 VCFRONT_5VARailStable 0;
BA_ "Confidence" SG_ 737 VCFRONT_5VBRailStable 0;
BA_ "Confidence" SG_ 737 VCFRONT_12VARailStable 0;
BA_ "Confidence" SG_ 737 VCFRONT_12VBRailStable 0;
BA_ "Confidence" SG_ 737 VCFRONT_railAState 0;
BA_ "Confidence" SG_ 737 VCFRONT_railBState 0;
BA_ "Confidence" SG_ 737 VCFRONT_ChargePumpVoltageStable 0;
BA_ "Confidence" SG_ 737 VCFRONT_PEResetLineState 0;
BA_ "Confidence" SG_ 737 VCFRONT_HSDInitCompleteU13 0;
BA_ "Confidence" SG_ 737 VCFRONT_HSDInitCompleteU16 0;
BA_ "Confidence" SG_ 737 VCFRONT_vbatMonitorVoltage 0;
BA_ "GenSigSNA" SG_ 737 VCFRONT_vbatMonitorVoltage "4095";
BA_ "Confidence" SG_ 737 VCFRONT_AS8510Voltage 0;
BA_ "GenSigSNA" SG_ 737 VCFRONT_AS8510Voltage "4095";
BA_ "Confidence" SG_ 737 VCFRONT_vbatProt 0;
BA_ "Confidence" SG_ 737 VCFRONT_logVerbosity 0;
BA_ "Confidence" SG_ 737 VCFRONT_IBSFault 1;
BA_ "Confidence" SG_ 737 VCFRONT_12VOverchargeCounter 1;
BA_ "Confidence" SG_ 737 VCFRONT_compPowerSupportingHvac 0;
BA_ "Confidence" SG_ 737 VCFRONT_compPowerSupportingPT 0;
BA_ "Confidence" SG_ 737 VCFRONT_maxHeatingPowerLeftCC 0;
BA_ "Confidence" SG_ 737 VCFRONT_maxHeatingPowerRightCC 0;
BA_ "Confidence" SG_ 737 VCFRONT_activeLouverOpenPos 0;
BA_ "Confidence" SG_ 737 VCFRONT_activeLouverState 0;
BA_ "Confidence" SG_ 737 VCFRONT_windshieldCameraHeaterPo 0;
BA_ "GenSigSNA" SG_ 737 VCFRONT_windshieldCameraHeaterPo "63";
BA_ "SystemSignalLongSymbol" SG_ 737 VCFRONT_windshieldCameraHeaterPo "VCFRONT_windshieldCameraHeaterPower";
BA_ "Confidence" SG_ 1349 VCFRONT_systemStatusMuxIndex 0;
BA_ "Confidence" SG_ 1349 VCFRONT_systemStatusCounter 0;
BA_ "Confidence" SG_ 1349 VCFRONT_systemStatusChecksum 0;
BA_ "Confidence" SG_ 1349 VCFRONT_loadShedReason 0;
BA_ "Confidence" SG_ 1349 VCFRONT_VCRightEFuseLoadShedStag 0;
BA_ "SystemSignalLongSymbol" SG_ 1349 VCFRONT_VCRightEFuseLoadShedStag "VCFRONT_VCRightEFuseLoadShedStage";
BA_ "Confidence" SG_ 1349 VCFRONT_VCLeftEFuseLoadShedStage 0;
BA_ "Confidence" SG_ 1349 VCFRONT_DCDCSaturationLoadShedSt 0;
BA_ "SystemSignalLongSymbol" SG_ 1349 VCFRONT_DCDCSaturationLoadShedSt "VCFRONT_DCDCSaturationLoadShedStage";
BA_ "Confidence" SG_ 1349 VCFRONT_vehicleLoadShedStage 0;
BA_ "Confidence" SG_ 1349 VCFRONT_HVFaultVehicleLoadShedRe 0;
BA_ "SystemSignalLongSymbol" SG_ 1349 VCFRONT_HVFaultVehicleLoadShedRe "VCFRONT_HVFaultVehicleLoadShedRequest";
BA_ "Confidence" SG_ 1349 VCFRONT_postCrashVehicleLoadShed 0;
BA_ "SystemSignalLongSymbol" SG_ 1349 VCFRONT_postCrashVehicleLoadShed "VCFRONT_postCrashVehicleLoadShedActive";
BA_ "Confidence" SG_ 1349 VCFRONT_HVFaultVehicleLoadShedAc 0;
BA_ "SystemSignalLongSymbol" SG_ 1349 VCFRONT_HVFaultVehicleLoadShedAc "VCFRONT_HVFaultVehicleLoadShedActive";
BA_ "Confidence" SG_ 1349 VCFRONT_factoryVehicleLoadShedAc 0;
BA_ "SystemSignalLongSymbol" SG_ 1349 VCFRONT_factoryVehicleLoadShedAc "VCFRONT_factoryVehicleLoadShedActive";
BA_ "Confidence" SG_ 1349 VCFRONT_anyVehicleLoadShedActive 0;
BA_ "Confidence" SG_ 1349 VCFRONT_DIVehLoadShedActive 0;
BA_ "Confidence" SG_ 1349 VCFRONT_HVFaultLoadShedStateDBG 0;
BA_ "Confidence" SG_ 1349 VCFRONT_LVUnhealthyVehicleLoadSh 0;
BA_ "SystemSignalLongSymbol" SG_ 1349 VCFRONT_LVUnhealthyVehicleLoadSh "VCFRONT_LVUnhealthyVehicleLoadShedActive";
BA_ "Confidence" SG_ 1349 VCFRONT_loadShedStsCondenserFan 0;
BA_ "Confidence" SG_ 1349 VCFRONT_loadShedStsPTPump 0;
BA_ "Confidence" SG_ 1349 VCFRONT_loadShedMCUAudio 0;
BA_ "Confidence" SG_ 1349 VCFRONT_loadShedHVDownTriggerDBG 0;
BA_ "Confidence" SG_ 1349 VCFRONT_loadShedPCSSatTriggerDBG 0;
BA_ "Confidence" SG_ 1349 VCFRONT_loadShedStsBatteryPump 0;
BA_ "Confidence" SG_ 1349 VCFRONT_loadShedStsAPGlassHeater 0;
BA_ "Confidence" SG_ 1349 VCFRONT_loadShedStsMCUGraphics 0;
BA_ "Confidence" SG_ 1349 VCFRONT_IBSCurrentRMS_loadShed 0;
BA_ "Confidence" SG_ 1349 VCFRONT_loadShedAhLeakyBktCntDBG 0;
BA_ "Confidence" SG_ 1349 VCFRONT_loadShedPcs 0;
BA_ "Confidence" SG_ 1349 VCFRONT_loadShedGTWDownstrmRails 0;
BA_ "Confidence" SG_ 1349 VCFRONT_loadShedPCSMIATriggerDBG 0;
BA_ "Confidence" SG_ 1349 VCFRONT_loadShedTAS 0;
BA_ "Confidence" SG_ 1349 VCFRONT_loadShedBackStopBktCntDB 0;
BA_ "SystemSignalLongSymbol" SG_ 1349 VCFRONT_loadShedBackStopBktCntDB "VCFRONT_loadShedBackStopBktCntDBG";
BA_ "Confidence" SG_ 1349 VCFRONT_loadShedPCSLeakyBktCtDBG 0;
BA_ "Confidence" SG_ 1349 VCFRONT_loadShedUI 0;
BA_ "Confidence" SG_ 1349 VCFRONT_loadShedAutoPilot 0;
BA_ "Confidence" SG_ 1537 VCFRONT_udsResponseData 1;
BA_ "Confidence" SG_ 929 VCFRONT_vehicleStatusMuxIndex 0;
BA_ "Confidence" SG_ 929 VCFRONT_vehicleStatusCounter 0;
BA_ "Confidence" SG_ 929 VCFRONT_vehicleStatusChecksum 0;
BA_ "Confidence" SG_ 929 VCFRONT_preconditionRequest 0;
BA_ "Confidence" SG_ 929 VCFRONT_APGlassHeaterState 0;
BA_ "GenSigSNA" SG_ 929 VCFRONT_APGlassHeaterState "0";
BA_ "Confidence" SG_ 929 VCFRONT_thermalSystemType 0;
BA_ "GenSigSNA" SG_ 929 VCFRONT_thermalSystemType "1";
BA_ "Confidence" SG_ 929 VCFRONT_standbySupplySupported 0;
BA_ "Confidence" SG_ 929 VCFRONT_driverPresent 0;
BA_ "Confidence" SG_ 929 VCFRONT_passengerPresent 0;
BA_ "Confidence" SG_ 929 VCFRONT_accPlusAvailable 0;
BA_ "Confidence" SG_ 929 VCFRONT_diPowerOnState 0;
BA_ "Confidence" SG_ 929 VCFRONT_12vStatusForDrive 0;
BA_ "Confidence" SG_ 929 VCFRONT_dcr12VMilliOhms 0;
BA_ "Confidence" SG_ 929 VC_userPresenceState 0;
BA_ "Confidence" SG_ 929 VCFRONT_factoryLimitsOverrideOk 0;
BA_ "Confidence" SG_ 929 VCFRONT_ota12VSupportRequest 0;
BA_ "Confidence" SG_ 929 VCFRONT_driverBuckleStatus 0;
BA_ "Confidence" SG_ 929 VCFRONT_driverDoorStatus 0;
BA_ "Confidence" SG_ 929 VCFRONT_driverUnbuckled 0;
BA_ "GenSigSNA" SG_ 929 VCFRONT_driverUnbuckled "2";
BA_ "Confidence" SG_ 929 VCFRONT_passengerUnbuckled 0;
BA_ "GenSigSNA" SG_ 929 VCFRONT_passengerUnbuckled "2";
BA_ "Confidence" SG_ 929 VCFRONT_2RowLeftUnbuckled 0;
BA_ "GenSigSNA" SG_ 929 VCFRONT_2RowLeftUnbuckled "2";
BA_ "Confidence" SG_ 929 VCFRONT_2RowCenterUnbuckled 0;
BA_ "GenSigSNA" SG_ 929 VCFRONT_2RowCenterUnbuckled "2";
BA_ "Confidence" SG_ 929 VCFRONT_2RowRightUnbuckled 0;
BA_ "GenSigSNA" SG_ 929 VCFRONT_2RowRightUnbuckled "2";
BA_ "Confidence" SG_ 929 VCFRONT_pcsEFuseVoltage 0;
BA_ "GenSigSNA" SG_ 929 VCFRONT_pcsEFuseVoltage "1023";
BA_ "Confidence" SG_ 929 VCFRONT_bmsHvChargeEnable 0;
BA_ "Confidence" SG_ 929 VCFRONT_3RowLeftUnbuckled 0;
BA_ "GenSigSNA" SG_ 929 VCFRONT_3RowLeftUnbuckled "2";
BA_ "Confidence" SG_ 929 VCFRONT_3RowRightUnbuckled 0;
BA_ "GenSigSNA" SG_ 929 VCFRONT_3RowRightUnbuckled "2";
BA_ "Confidence" SG_ 929 VCFRONT_maxBattHeatRejection 0;
BA_ "Confidence" SG_ 929 VCFRONT_hvacReqBattCoolOutTemp 0;
BA_ "Confidence" SG_ 929 VCFRONT_PCSCurrent 0;
BA_ "Confidence" SG_ 929 VCFRONT_refSystemNominal 0;
BA_ "Confidence" SG_ 929 VCFRONT_driverEnteredCabinEstima 0;
BA_ "SystemSignalLongSymbol" SG_ 929 VCFRONT_driverEnteredCabinEstima "VCFRONT_driverEnteredCabinEstimateDBG";
BA_ "Confidence" SG_ 929 VCFRONT_anySWEFuseActive 0;
BA_ "Confidence" SG_ 929 VCFRONT_hpBattHeatingPowerTrgt 0;
BA_ "Confidence" SG_ 929 VCFRONT_LVStatusForDriveVEH 0;
BA_ "Confidence" SG_ 507 VCLEFT_TLCStatusIndex 1;
BA_ "Confidence" SG_ 507 VCLEFT_TLCTemperature 0;
BA_ "GenSigSNA" SG_ 507 VCLEFT_TLCTemperature "128";
BA_ "Confidence" SG_ 507 VCLEFT_TLCLeftTurnVoltage 0;
BA_ "GenSigSNA" SG_ 507 VCLEFT_TLCLeftTurnVoltage "255";
BA_ "Confidence" SG_ 507 VCLEFT_TLCRightTurnVoltage 0;
BA_ "GenSigSNA" SG_ 507 VCLEFT_TLCRightTurnVoltage "255";
BA_ "Confidence" SG_ 507 VCLEFT_TLCState_LeftTurn 0;
BA_ "GenSigSNA" SG_ 507 VCLEFT_TLCState_LeftTurn "5";
BA_ "Confidence" SG_ 507 VCLEFT_TLCState_RightTurn 0;
BA_ "GenSigSNA" SG_ 507 VCLEFT_TLCState_RightTurn "5";
BA_ "Confidence" SG_ 507 VCLEFT_TLCState_Tail 0;
BA_ "GenSigSNA" SG_ 507 VCLEFT_TLCState_Tail "5";
BA_ "Confidence" SG_ 507 VCLEFT_TLCState_Stop 0;
BA_ "GenSigSNA" SG_ 507 VCLEFT_TLCState_Stop "5";
BA_ "Confidence" SG_ 507 VCLEFT_TLCState_Fog 0;
BA_ "GenSigSNA" SG_ 507 VCLEFT_TLCState_Fog "5";
BA_ "Confidence" SG_ 507 VCLEFT_TLCState_Reverse 0;
BA_ "GenSigSNA" SG_ 507 VCLEFT_TLCState_Reverse "5";
BA_ "Confidence" SG_ 1373 VCLEFT_alertID 1;
BA_ "Confidence" SG_ 1373 VCLEFT_alertState 1;
BA_ "Confidence" SG_ 1373 VCLEFT_a059_voltageDrop 1;
BA_ "Confidence" SG_ 1373 VCLEFT_a059_resistanceEstimate 1;
BA_ "Confidence" SG_ 1373 VCLEFT_a059_current 1;
BA_ "Confidence" SG_ 1373 VCLEFT_a063_ADCVoltage 1;
BA_ "SystemSignalLongSymbol" SG_ 1373 VCLEFT_a101_LIPC_externalWatchdo "VCLEFT_a101_LIPC_externalWatchdogHeartBeat";
BA_ "SystemSignalLongSymbol" SG_ 1373 VCLEFT_a110_VEH_canLogAvailabili "VCLEFT_a110_VEH_canLogAvailability";
BA_ "SystemSignalLongSymbol" SG_ 1373 VCLEFT_a110_CH_airbagCutoffStatu "VCLEFT_a110_CH_airbagCutoffStatus";
BA_ "SystemSignalLongSymbol" SG_ 1373 VCLEFT_a115_VEH_authenticationWi "VCLEFT_a115_VEH_authenticationWithMac";
BA_ "SystemSignalLongSymbol" SG_ 1373 VCLEFT_a115_UI_corianderVehicleC "VCLEFT_a115_UI_corianderVehicleControl";
BA_ "SystemSignalLongSymbol" SG_ 1373 VCLEFT_a115_BDY_authenticationWi "VCLEFT_a115_BDY_authenticationWithMac";
BA_ "SystemSignalLongSymbol" SG_ 1373 VCLEFT_a116_PARTY_restraintStatu "VCLEFT_a116_PARTY_restraintStatus";
BA_ "SystemSignalLongSymbol" SG_ 1373 VCLEFT_a116_VEH_liftgateFollower "VCLEFT_a116_VEH_liftgateFollowerResponse";
BA_ "SystemSignalLongSymbol" SG_ 1373 VCLEFT_a116_VEH_liftgateFol_0001 "VCLEFT_a116_VEH_liftgateFollowerStatus";
BA_ "SystemSignalLongSymbol" SG_ 1373 VCLEFT_a117_BDY_falconSwitchStat "VCLEFT_a117_BDY_falconSwitchStatus";
BA_ "SystemSignalLongSymbol" SG_ 1373 VCLEFT_a117_VEH_intrusionSensorS "VCLEFT_a117_VEH_intrusionSensorStatus";
BA_ "SystemSignalLongSymbol" SG_ 1373 VCLEFT_a117_PARTY_restraintStatu "VCLEFT_a117_PARTY_restraintStatus";
BA_ "SystemSignalLongSymbol" SG_ 1373 VCLEFT_a117_PARTY_lightingSecond "VCLEFT_a117_PARTY_lightingSecondary";
BA_ "SystemSignalLongSymbol" SG_ 1373 VCLEFT_a118_PARTY_outputPowerSta "VCLEFT_a118_PARTY_outputPowerStatus";
BA_ "SystemSignalLongSymbol" SG_ 1373 VCLEFT_a118_VEH_interNodeResista "VCLEFT_a118_VEH_interNodeResistance";
BA_ "SystemSignalLongSymbol" SG_ 1373 VCLEFT_a118_BDY_outputPowerStatu "VCLEFT_a118_BDY_outputPowerStatus";
BA_ "SystemSignalLongSymbol" SG_ 1373 VCLEFT_a118_PARTY_AP_vehicleStat "VCLEFT_a118_PARTY_AP_vehicleState1HzMuxed";
BA_ "SystemSignalLongSymbol" SG_ 1373 VCLEFT_a118_BDY_AP_vehicleState1 "VCLEFT_a118_BDY_AP_vehicleState1HzMuxed";
BA_ "SystemSignalLongSymbol" SG_ 1373 VCLEFT_a118_PARTY_VCFRONT_camera "VCLEFT_a118_PARTY_VCFRONT_cameraCleaningStatus";
BA_ "SystemSignalLongSymbol" SG_ 1373 VCLEFT_a120_PARTY_vehicleEstimat "VCLEFT_a120_PARTY_vehicleEstimates";
BA_ "SystemSignalLongSymbol" SG_ 1373 VCLEFT_a120_VEH_aggregatedAxleSp "VCLEFT_a120_VEH_aggregatedAxleSpeed";
BA_ "SystemSignalLongSymbol" SG_ 1373 VCLEFT_a120_PARTY_aggregatedAxle "VCLEFT_a120_PARTY_aggregatedAxleSpeed";
BA_ "SystemSignalLongSymbol" SG_ 1373 VCLEFT_a120_PARTY_stalklessInter "VCLEFT_a120_PARTY_stalklessInterfaces";
BA_ "SystemSignalLongSymbol" SG_ 1373 VCLEFT_a120_VEH_estimatedBrakeTe "VCLEFT_a120_VEH_estimatedBrakeTemp";
BA_ "SystemSignalLongSymbol" SG_ 1373 VCLEFT_a123_OBD_alcoholInterlock "VCLEFT_a123_OBD_alcoholInterlockRequest";
BA_ "Confidence" SG_ 1373 VCLEFT_a132_RPMActual 1;
BA_ "Confidence" SG_ 1373 VCLEFT_a132_RPMTarget 1;
BA_ "Confidence" SG_ 1373 VCLEFT_a133_RPMActual 1;
BA_ "Confidence" SG_ 1373 VCLEFT_a133_RPMTarget 1;
BA_ "Confidence" SG_ 1373 VCLEFT_a141_outputCurrent 1;
BA_ "Confidence" SG_ 1373 VCLEFT_a145_brakeSwitch 1;
BA_ "GenSigSNA" SG_ 1373 VCLEFT_a145_brakeSwitch "0";
BA_ "Confidence" SG_ 1373 VCLEFT_a145_ibstRodPosition 1;
BA_ "Confidence" SG_ 1373 VCLEFT_a145_ibstRodPositionQF 1;
BA_ "Confidence" SG_ 1373 VCLEFT_a150_windowPosition 1;
BA_ "Confidence" SG_ 1373 VCLEFT_a150_movementTimeMs 1;
BA_ "Confidence" SG_ 1373 VCLEFT_a150_windowPinchReason 1;
BA_ "Confidence" SG_ 1373 VCLEFT_a150_absAccelExceedance 1;
BA_ "Confidence" SG_ 1373 VCLEFT_a150_relAccelExceedance 1;
BA_ "Confidence" SG_ 1373 VCLEFT_a150_speedExpScore 1;
BA_ "Confidence" SG_ 1373 VCLEFT_a151_windowPosition 1;
BA_ "Confidence" SG_ 1373 VCLEFT_a151_movementTimeMs 1;
BA_ "Confidence" SG_ 1373 VCLEFT_a151_windowPinchReason 1;
BA_ "Confidence" SG_ 1373 VCLEFT_a151_absAccelExceedance 1;
BA_ "Confidence" SG_ 1373 VCLEFT_a151_relAccelExceedance 1;
BA_ "Confidence" SG_ 1373 VCLEFT_a151_speedExpScore 1;
BA_ "Confidence" SG_ 1373 VCLEFT_a152_speedTableStatus 1;
BA_ "GenSigSNA" SG_ 1373 VCLEFT_a152_speedTableStatus "0";
BA_ "Confidence" SG_ 1373 VCLEFT_a153_speedTableStatus 1;
BA_ "GenSigSNA" SG_ 1373 VCLEFT_a153_speedTableStatus "0";
BA_ "Confidence" SG_ 1373 VCLEFT_a154_windowThermalMode 1;
BA_ "GenSigSNA" SG_ 1373 VCLEFT_a154_windowThermalMode "0";
BA_ "Confidence" SG_ 1373 VCLEFT_a155_windowThermalMode 1;
BA_ "GenSigSNA" SG_ 1373 VCLEFT_a155_windowThermalMode "0";
BA_ "Confidence" SG_ 1373 VCLEFT_a180_extHandlePWM 1;
BA_ "Confidence" SG_ 1373 VCLEFT_a180_releasePWM 1;
BA_ "Confidence" SG_ 1373 VCLEFT_a180_latchStatus 1;
BA_ "GenSigSNA" SG_ 1373 VCLEFT_a180_latchStatus "0";
BA_ "Confidence" SG_ 1373 VCLEFT_a181_extHandlePWM 1;
BA_ "Confidence" SG_ 1373 VCLEFT_a181_releasePWM 1;
BA_ "Confidence" SG_ 1373 VCLEFT_a181_latchStatus 1;
BA_ "GenSigSNA" SG_ 1373 VCLEFT_a181_latchStatus "0";
BA_ "Confidence" SG_ 1373 VCLEFT_a186_voltage 1;
BA_ "Confidence" SG_ 1373 VCLEFT_a186_temperature 1;
BA_ "Confidence" SG_ 1373 VCLEFT_a187_voltage 1;
BA_ "Confidence" SG_ 1373 VCLEFT_a187_temperature 1;
BA_ "Confidence" SG_ 1373 VCLEFT_a188_voltage 1;
BA_ "Confidence" SG_ 1373 VCLEFT_a188_temperature 1;
BA_ "Confidence" SG_ 1373 VCLEFT_a189_voltage 1;
BA_ "Confidence" SG_ 1373 VCLEFT_a189_temperature 1;
BA_ "Confidence" SG_ 1373 VCLEFT_a192_selfTestResult 1;
BA_ "SystemSignalLongSymbol" SG_ 1373 VCLEFT_a192_supplyVoltageIrratio "VCLEFT_a192_supplyVoltageIrrational";
BA_ "SystemSignalLongSymbol" SG_ 1373 VCLEFT_a192_motorPhaseCurrentIrr "VCLEFT_a192_motorPhaseCurrentIrrational";
BA_ "Confidence" SG_ 1373 VCLEFT_a192_motorType 1;
BA_ "SystemSignalLongSymbol" SG_ 1373 VCLEFT_a194_configurationMismatc "VCLEFT_a194_configurationMismatch";
BA_ "SystemSignalLongSymbol" SG_ 1373 VCLEFT_a194_vcbldcMotorTypeUnkno "VCLEFT_a194_vcbldcMotorTypeUnknown";
BA_ "SystemSignalLongSymbol" SG_ 1373 VCLEFT_a194_nvramMotorTypeUnknow "VCLEFT_a194_nvramMotorTypeUnknown";
BA_ "Confidence" SG_ 1373 VCLEFT_a194_vcbldcMotorId 1;
BA_ "Confidence" SG_ 1373 VCLEFT_a194_nvramMotorId 1;
BA_ "Confidence" SG_ 1373 VCLEFT_a202_current 1;
BA_ "Confidence" SG_ 1373 VCLEFT_a202_epbConfig 1;
BA_ "Confidence" SG_ 1373 VCLEFT_a203_current 1;
BA_ "Confidence" SG_ 1373 VCLEFT_a203_epbConfig 1;
BA_ "Confidence" SG_ 1373 VCLEFT_a204_current 1;
BA_ "Confidence" SG_ 1373 VCLEFT_a204_epbConfig 1;
BA_ "Confidence" SG_ 1373 VCLEFT_a205_current 1;
BA_ "Confidence" SG_ 1373 VCLEFT_a205_epbConfig 1;
BA_ "Confidence" SG_ 1373 VCLEFT_a206_unitStatusEPB 1;
BA_ "Confidence" SG_ 1373 VCLEFT_a206_unitStatusEPBM 1;
BA_ "Confidence" SG_ 1373 VCLEFT_a207_unitStatusEPB 1;
BA_ "Confidence" SG_ 1373 VCLEFT_a207_unitStatusEPBM 1;
BA_ "Confidence" SG_ 1373 VCLEFT_a208_unitStatusEPB 1;
BA_ "Confidence" SG_ 1373 VCLEFT_a208_unitStatusEPBM 1;
BA_ "Confidence" SG_ 1373 VCLEFT_a209_unitStatusEPB 1;
BA_ "Confidence" SG_ 1373 VCLEFT_a209_unitStatusEPBM 1;
BA_ "Confidence" SG_ 1373 VCLEFT_a210_unitStatusEPB 1;
BA_ "Confidence" SG_ 1373 VCLEFT_a210_unitStatusEPBM 1;
BA_ "Confidence" SG_ 1373 VCLEFT_a221_vbatProtVoltage 1;
BA_ "Confidence" SG_ 1373 VCLEFT_a221_vbatProtCurrent 1;
BA_ "Confidence" SG_ 1373 VCLEFT_a221_uvLoadshedVoltage 1;
BA_ "Confidence" SG_ 1373 VCLEFT_a221_loadshedFromBattMoni 1;
BA_ "SystemSignalLongSymbol" SG_ 1373 VCLEFT_a221_loadshedFromBattMoni "VCLEFT_a221_loadshedFromBattMonitor";
BA_ "Confidence" SG_ 1373 VCLEFT_a224_seatMotorCurrent 1;
BA_ "Confidence" SG_ 1373 VCLEFT_a224_seatMotorState 1;
BA_ "Confidence" SG_ 1373 VCLEFT_a224_seatSwitchBack 1;
BA_ "GenSigSNA" SG_ 1373 VCLEFT_a224_seatSwitchBack "0";
BA_ "Confidence" SG_ 1373 VCLEFT_a224_seatSwitchForward 1;
BA_ "GenSigSNA" SG_ 1373 VCLEFT_a224_seatSwitchForward "0";
BA_ "Confidence" SG_ 1373 VCLEFT_a225_seatMotorCurrent 1;
BA_ "Confidence" SG_ 1373 VCLEFT_a225_seatMotorState 1;
BA_ "Confidence" SG_ 1373 VCLEFT_a225_seatSwitchBack 1;
BA_ "GenSigSNA" SG_ 1373 VCLEFT_a225_seatSwitchBack "0";
BA_ "Confidence" SG_ 1373 VCLEFT_a225_seatSwitchForward 1;
BA_ "GenSigSNA" SG_ 1373 VCLEFT_a225_seatSwitchForward "0";
BA_ "Confidence" SG_ 1373 VCLEFT_a226_seatMotorCurrent 1;
BA_ "Confidence" SG_ 1373 VCLEFT_a226_seatMotorState 1;
BA_ "Confidence" SG_ 1373 VCLEFT_a226_seatSwitchBack 1;
BA_ "GenSigSNA" SG_ 1373 VCLEFT_a226_seatSwitchBack "0";
BA_ "Confidence" SG_ 1373 VCLEFT_a226_seatSwitchForward 1;
BA_ "GenSigSNA" SG_ 1373 VCLEFT_a226_seatSwitchForward "0";
BA_ "Confidence" SG_ 1373 VCLEFT_a227_seatMotorCurrent 1;
BA_ "Confidence" SG_ 1373 VCLEFT_a227_seatMotorState 1;
BA_ "Confidence" SG_ 1373 VCLEFT_a227_seatSwitchBack 1;
BA_ "GenSigSNA" SG_ 1373 VCLEFT_a227_seatSwitchBack "0";
BA_ "Confidence" SG_ 1373 VCLEFT_a227_seatSwitchForward 1;
BA_ "GenSigSNA" SG_ 1373 VCLEFT_a227_seatSwitchForward "0";
BA_ "Confidence" SG_ 1373 VCLEFT_a228_seatMotorCurrent 1;
BA_ "Confidence" SG_ 1373 VCLEFT_a228_seatMotorPosReal 1;
BA_ "Confidence" SG_ 1373 VCLEFT_a228_seatMotorState 1;
VAL_ 737 VCFRONT_statusIndex 6 "INVALID" 5 "USER_PRESENCE" 4 "THERMAL" 3 "SYSTEM_HEALTH" 2 "REFRIGERANT_SYSTEM" 1 "VEHICLE_STATE" 0 "BODY_CONTROLS" ;
VAL_ 737 VCFRONT_frunkLatchStatus 8 "LATCH_FAULT" 7 "LATCH_DEFAULT" 6 "LATCH_TIMEOUT" 5 "LATCH_AJAR" 4 "LATCH_OPENING" 3 "LATCH_CLOSING" 2 "LATCH_CLOSED" 1 "LATCH_OPENED" 0 "LATCH_SNA" ;
VAL_ 737 VCFRONT_wiperSpeed 9 "WIPER_SPEED_NARROW" 8 "WIPER_SPEED_HIGH" 7 "WIPER_SPEED_LOW" 6 "WIPER_SPEED_5" 5 "WIPER_SPEED_4" 4 "WIPER_SPEED_3" 3 "WIPER_SPEED_2" 2 "WIPER_SPEED_1" 1 "WIPER_SPEED_OFF" 0 "WIPER_SPEED_SNA" ;
VAL_ 737 VCFRONT_wiperPosition 4 "WIPER_POSITION_WIPING" 3 "WIPER_POSITION_DELAYED_REST" 2 "WIPER_POSITION_DEPRESSED_PARK" 1 "WIPER_POSITION_SERVICE" 0 "WIPER_POSITION_SNA" ;
VAL_ 737 VCFRONT_wiperState 14 "WIPER_STATE_NARROW_WASH" 13 "WIPER_STATE_NARROW_WIPE" 12 "WIPER_STATE_INT_AUTO_HIGH" 11 "WIPER_STATE_INT_AUTO_LOW" 10 "WIPER_STATE_CONT_SLOW" 9 "WIPER_STATE_CONT_FAST" 8 "WIPER_STATE_INTERMITTENT_LOW" 7 "WIPER_STATE_INTERMITTENT_HIGH" 6 "WIPER_STATE_MOMENTARY_WIPE" 5 "WIPER_STATE_WASH" 4 "WIPER_STATE_PARK" 3 "WIPER_STATE_DELAYED_REST" 2 "WIPER_STATE_FAULT" 1 "WIPER_STATE_SERVICE" 0 "WIPER_STATE_SNA" ;
VAL_ 737 VCFRONT_crashDetectedType 3 "CRASH_DETECTED_TYPE_SEVERE" 2 "CRASH_DETECTED_TYPE_MINOR_2" 1 "CRASH_DETECTED_TYPE_MINOR_1" 0 "CRASH_DETECTED_TYPE_NONE" ;
VAL_ 737 VCFRONT_crashState 3 "CRASH_STATE_SEVERE" 2 "CRASH_STATE_MINOR_2" 1 "CRASH_STATE_MINOR_1" 0 "CRASH_STATE_IDLE" ;
VAL_ 737 VCFRONT_washPumpState 3 "WASH_PUMP_BIDIRECTIONAL_STATE_SNA" 2 "WASH_PUMP_BIDIRECTIONAL_STATE_DRIVING_SECONDARY" 1 "WASH_PUMP_BIDIRECTIONAL_STATE_DRIVING_PRIMARY" 0 "WASH_PUMP_BIDIRECTIONAL_STATE_OFF" ;
VAL_ 737 VCFRONT_turnIndicatorControlType 2 "TURN_INDICATOR_CONTROL_TYPE_SWS_BUTTON" 1 "TURN_INDICATOR_CONTROL_TYPE_SINGLE_DETENT_STALK" 0 "TURN_INDICATOR_CONTROL_TYPE_UNKNOWN" ;
VAL_ 737 VCFRONT_wiperHealth 7 "WIPER_HEALTH_RESERVED" 5 "WIPER_HEALTH_FAULT" 4 "WIPER_HEALTH_UPDATING" 3 "WIPER_HEALTH_TIMEOUT" 2 "WIPER_HEALTH_OK" 1 "WIPER_HEALTH_WAIT" 0 "WIPER_HEALTH_OFF" ;
VAL_ 737 VCFRONT_wiperLINHealth 7 "WIPER_HEALTH_RESERVED" 5 "WIPER_HEALTH_FAULT" 4 "WIPER_HEALTH_UPDATING" 3 "WIPER_HEALTH_TIMEOUT" 2 "WIPER_HEALTH_OK" 1 "WIPER_HEALTH_WAIT" 0 "WIPER_HEALTH_OFF" ;
VAL_ 737 VCFRONT_radarHeaterState 4 "HEATER_STATE_FAULT" 3 "HEATER_STATE_OFF_UNAVAILABLE" 2 "HEATER_STATE_OFF" 1 "HEATER_STATE_ON" 0 "HEATER_STATE_SNA" ;
VAL_ 737 VCFRONT_passengerBuckleStatus 1 "BUCKLED" 0 "UNBUCKLED" ;
VAL_ 737 VCFRONT_frunkLatchType 2 "FRUNK_LATCH_TYPE_DOUBLE_PULL" 1 "FRUNK_LATCH_TYPE_DOUBLE_ACTUATOR" 0 "FRUNK_LATCH_TYPE_UNKNOWN" ;
VAL_ 737 VCFRONT_iBoosterStateDBG 4 "IBOOSTER_FORCE_OFF" 3 "IBOOSTER_WRITING_DATA_SHUTDOWN" 2 "IBOOSTER_GOING_DOWN" 1 "IBOOSTER_ON" 0 "IBOOSTER_OFF" ;
VAL_ 737 VCFRONT_vehicleStatusDBG 18 "VEHICLE_STATUS_SNA" 17 "VEHICLE_STATUS_RESET" 16 "VEHICLE_STATUS_TURN_ON_RAILS" 15 "VEHICLE_STATUS_OTA" 14 "VEHICLE_STATUS_CRASH" 13 "VEHICLE_STATUS_DRIVE" 12 "VEHICLE_STATUS_CONDITIONING" 11 "VEHICLE_STATUS_ACCESSORY_PLUS" 10 "VEHICLE_STATUS_ACCESSORY" 9 "VEHICLE_STATUS_HV_UP_STANDBY" 8 "VEHICLE_STATUS_LV_AWAKE" 7 "VEHICLE_STATUS_LV_SHUTDOWN" 6 "VEHICLE_STATUS_SLEEP_STANDBY" 5 "VEHICLE_STATUS_SLEEP_SHUTDOWN" 4 "VEHICLE_STATUS_SYSTEM_CHECKS" 3 "VEHICLE_STATUS_BATTERY_POST_WAKE" 2 "VEHICLE_STATUS_SILENT_WAKE" 1 "VEHICLE_STATUS_LOW_POWER_STANDBY" 0 "VEHICLE_STATUS_INIT" ;
VAL_ 737 VCFRONT_sleepCurrent 4095 "SNA" ;
VAL_ 737 VCFRONT_hibernationState 5 "VC_HIBERNATION_STATE_PREP" 4 "VC_HIBERNATION_STATE_EXIT" 3 "VC_HIBERNATION_STATE_RECOVERY" 2 "VC_HIBERNATION_STATE_ACTIVE" 1 "VC_HIBERNATION_STATE_NOT_ACTIVE" 0 "VC_HIBERNATION_STATE_INIT" ;
VAL_ 737 VCFRONT_wiperECUType 3 "WIPER_ECU_TYPE_VALEO" 2 "WIPER_ECU_TYPE_SHB" 1 "WIPER_ECU_TYPE_BOSCH" 0 "WIPER_ECU_TYPE_UNKNOWN" ;
VAL_ 737 VCFRONT_wiperHeaterState 4 "HEATER_STATE_FAULT" 3 "HEATER_STATE_OFF_UNAVAILABLE" 2 "HEATER_STATE_OFF" 1 "HEATER_STATE_ON" 0 "HEATER_STATE_SNA" ;
VAL_ 737 VCFRONT_closureEasterEggState 5 "CLOSURE_EASTEREGG_STATE_SHOW_CLEANUP" 4 "CLOSURE_EASTEREGG_STATE_PLAY" 3 "CLOSURE_EASTEREGG_STATE_WAITING_FOR_SYNC_PULSE" 2 "CLOSURE_EASTEREGG_STATE_WAITING_FOR_PLAY" 1 "CLOSURE_EASTEREGG_STATE_WAITING_FOR_START_CONDITIONS" 0 "CLOSURE_EASTEREGG_STATE_IDLE" ;
VAL_ 737 VCFRONT_batteryDischArbState 5 "FAULTED" 4 "INHIBIT_FOR_REST" 3 "BATTERY_DISCHARGE" 2 "BATTERY_HEATING" 1 "READY" 0 "NOT_READY" ;
VAL_ 737 VCFRONT_pressureRefrigSuction 127 "SNA" ;
VAL_ 737 VCFRONT_pressureRefrigDischarge 511 "SNA" ;
VAL_ 737 VCFRONT_hvacPerfTestCommand 5 "PRECONDITION" 4 "STOP" 3 "BLOW_BILEVEL" 2 "BLOW" 1 "INIT" 0 "NOT_STARTED" ;
VAL_ 737 VCFRONT_coolantFillRoutineStatus 3 "FAULTED" 2 "READY_TO_FILL" 1 "MOVING_TO_FILL_POSITION" 0 "NOT_READY" ;
VAL_ 737 VCFRONT_refrigFillRoutineStatus 3 "FAULTED" 2 "READY_TO_FILL" 1 "MOVING_TO_FILL_POSITION" 0 "NOT_READY" ;
VAL_ 737 VCFRONT_closeValvesRoutineStatus 3 "FAULTED" 2 "READY_TO_FILL" 1 "MOVING_TO_FILL_POSITION" 0 "NOT_READY" ;
VAL_ 737 VCFRONT_extendedHvacPerfTestComm 10 "STOP" 9 "COUNT" 8 "8_CABIN_PURGE" 7 "7_BATTERY_COOL" 6 "6_BATTERY_HEAT_COP1" 5 "5_CABIN_HEAT_COP1" 4 "4_CABIN_COOL" 3 "3_SPLIT_REHEAT_COOL_DOMINANT" 2 "2_BATT_HEAT_CABIN_REHEAT_AS" 1 "1_CABIN_HEAT_AS" 0 "INIT" ;
VAL_ 737 VCFRONT_vbatMonitorVoltage 4095 "SNA" ;
VAL_ 737 VCFRONT_AS8510Voltage 4095 "SNA" ;
VAL_ 737 VCFRONT_activeLouverState 17 "AUTO_DETECT_MEASURE_3" 16 "AUTO_DETECT_WAIT_3" 15 "AUTO_DETECT_PAUSE_3" 14 "AUTO_DETECT_MEASURE_2" 13 "AUTO_DETECT_WAIT_2" 12 "AUTO_DETECT_PAUSE_2" 11 "AUTO_DETECT_MEASURE_1" 10 "AUTO_DETECT_WAIT_1" 9 "AUTO_DETECT_PAUSE_1" 8 "AUTO_DETECT_BACKOFF" 7 "FAILSAFE_LOCKED" 6 "FAILSAFE_OPEN" 5 "FAULTED" 4 "READY" 3 "CALIB_OPEN" 2 "CALIB_CLOSE" 1 "UNCALIBRATED" 0 "NOT_READY" ;
VAL_ 737 VCFRONT_windshieldCameraHeaterPo 63 "SNA" ;
VAL_ 1349 VCFRONT_systemStatusMuxIndex 2 "LOAD_SHED_STATUSES_AND_COMMANDS" 1 "ACTIVE_LOAD_SHED_REASONS" 0 "SYSTEM_DATA" ;
VAL_ 1349 VCFRONT_loadShedReason 256 "VCFRONT_LOAD_SHED_REASON_LV_HEALTH" 128 "VCFRONT_LOAD_SHED_REASON_PRECHARGE" 64 "VCFRONT_LOAD_SHED_REASON_CUSTOM" 32 "VCFRONT_LOAD_SHED_REASON_FACTORY" 16 "VCFRONT_LOAD_SHED_REASON_HV_FAULT" 8 "VCFRONT_LOAD_SHED_REASON_POST_CRASH" 4 "VCFRONT_LOAD_SHED_REASON_VCRIGHT_EFUSE_PROTECTION" 2 "VCFRONT_LOAD_SHED_REASON_VCLEFT_EFUSE_PROTECTION" 1 "VCFRONT_LOAD_SHED_REASON_DCDC_SATURATION" 0 "VCFRONT_LOAD_SHED_REASON_NONE" ;
VAL_ 1349 VCFRONT_VCRightEFuseLoadShedStag 31 "MAX" 0 "IDLE" ;
VAL_ 1349 VCFRONT_VCLeftEFuseLoadShedStage 31 "MAX" 0 "IDLE" ;
VAL_ 1349 VCFRONT_DCDCSaturationLoadShedSt 31 "MAX" 0 "IDLE" ;
VAL_ 1349 VCFRONT_vehicleLoadShedStage 3 "VEHICLE_LOADSHEDDING_STAGE_3" 2 "VEHICLE_LOADSHEDDING_STAGE_2" 1 "VEHICLE_LOADSHEDDING_STAGE_1" 0 "VEHICLE_LOADSHEDDING_STAGE_IDLE_OR_UNDEFINED" ;
VAL_ 1349 VCFRONT_HVFaultLoadShedStateDBG 3 "HV_FAULT_LOADSHED_SM_STATE_ACTIVE" 2 "HV_FAULT_LOADSHED_SM_STATE_BLOCKED" 1 "HV_FAULT_LOADSHED_SM_STATE_IDLE" 0 "HV_FAULT_LOADSHED_SM_STATE_INIT" ;
VAL_ 929 VCFRONT_vehicleStatusMuxIndex 1 "MUX1" 0 "MUX0" ;
VAL_ 929 VCFRONT_APGlassHeaterState 4 "HEATER_STATE_FAULT" 3 "HEATER_STATE_OFF_UNAVAILABLE" 2 "HEATER_STATE_OFF" 1 "HEATER_STATE_ON" 0 "HEATER_STATE_SNA" ;
VAL_ 929 VCFRONT_thermalSystemType 1 "HEAT_PUMP_THERMAL_SYSTEM" 0 "LEGACY_THERMAL_SYSTEM" ;
VAL_ 929 VCFRONT_diPowerOnState 5 "DI_POWERED_ON_FOR_WINCH" 4 "DI_POWER_GOING_DOWN" 3 "DI_POWERED_ON_FOR_DRIVE" 2 "DI_POWERED_ON_FOR_STATIONARY_HEAT" 1 "DI_POWERED_ON_FOR_SUMMON" 0 "DI_POWERED_OFF" ;
VAL_ 929 VCFRONT_12vStatusForDrive 2 "EXIT_DRIVE_REQUESTED_12V" 1 "READY_FOR_DRIVE_12V" 0 "NOT_READY_FOR_DRIVE_12V" ;
VAL_ 929 VC_userPresenceState 3 "TIMED_OUT" 2 "PRESENT" 1 "NOT_PRESENT" 0 "INIT" ;
VAL_ 929 VCFRONT_driverBuckleStatus 1 "BUCKLED" 0 "UNBUCKLED" ;
VAL_ 929 VCFRONT_driverDoorStatus 1 "DOOR_CLOSED" 0 "DOOR_OPEN" ;
VAL_ 929 VCFRONT_driverUnbuckled 2 "CHIME_SNA" 1 "CHIME_OCCUPIED_AND_UNBUCKLED" 0 "CHIME_NONE" ;
VAL_ 929 VCFRONT_passengerUnbuckled 2 "CHIME_SNA" 1 "CHIME_OCCUPIED_AND_UNBUCKLED" 0 "CHIME_NONE" ;
VAL_ 929 VCFRONT_2RowLeftUnbuckled 2 "CHIME_SNA" 1 "CHIME_OCCUPIED_AND_UNBUCKLED" 0 "CHIME_NONE" ;
VAL_ 929 VCFRONT_2RowCenterUnbuckled 2 "CHIME_SNA" 1 "CHIME_OCCUPIED_AND_UNBUCKLED" 0 "CHIME_NONE" ;
VAL_ 929 VCFRONT_2RowRightUnbuckled 2 "CHIME_SNA" 1 "CHIME_OCCUPIED_AND_UNBUCKLED" 0 "CHIME_NONE" ;
VAL_ 929 VCFRONT_pcsEFuseVoltage 1023 "SNA" ;
VAL_ 929 VCFRONT_3RowLeftUnbuckled 2 "CHIME_SNA" 1 "CHIME_OCCUPIED_AND_UNBUCKLED" 0 "CHIME_NONE" ;
VAL_ 929 VCFRONT_3RowRightUnbuckled 2 "CHIME_SNA" 1 "CHIME_OCCUPIED_AND_UNBUCKLED" 0 "CHIME_NONE" ;
VAL_ 929 VCFRONT_LVStatusForDriveVEH 6 "STATUS_FOR_DRIVE_ACTIVE_DECEL" 5 "STATUS_FOR_DRIVE_PULL_TO_SHOULDER" 4 "STATUS_FOR_DRIVE_LIMP" 3 "STATUS_FOR_DRIVE_RETURN_TO_SERVICE" 2 "STATUS_FOR_DRIVE_READY_LIMITED" 1 "STATUS_FOR_DRIVE_READY" 0 "STATUS_FOR_DRIVE_NOT_READY" ;
VAL_ 507 VCLEFT_TLCStatusIndex 2 "INVALID" 1 "1" 0 "0" ;
VAL_ 507 VCLEFT_TLCTemperature -128 "SNA" ;
VAL_ 507 VCLEFT_TLCLeftTurnVoltage 255 "SNA" ;
VAL_ 507 VCLEFT_TLCRightTurnVoltage 255 "SNA" ;
VAL_ 507 VCLEFT_TLCState_LeftTurn 5 "VCLEFT_TLC_LIGHT_STATE_SNA" 4 "VCLEFT_TLC_LIGHT_STATE_FAULT" 3 "VCLEFT_TLC_LIGHT_STATE_ON_WITH_LOAD" 2 "VCLEFT_TLC_LIGHT_STATE_ON_WITHOUT_LOAD" 1 "VCLEFT_TLC_LIGHT_STATE_OFF_WITH_LOAD" 0 "VCLEFT_TLC_LIGHT_STATE_OFF_WITHOUT_LOAD" ;
VAL_ 507 VCLEFT_TLCState_RightTurn 5 "VCLEFT_TLC_LIGHT_STATE_SNA" 4 "VCLEFT_TLC_LIGHT_STATE_FAULT" 3 "VCLEFT_TLC_LIGHT_STATE_ON_WITH_LOAD" 2 "VCLEFT_TLC_LIGHT_STATE_ON_WITHOUT_LOAD" 1 "VCLEFT_TLC_LIGHT_STATE_OFF_WITH_LOAD" 0 "VCLEFT_TLC_LIGHT_STATE_OFF_WITHOUT_LOAD" ;
VAL_ 507 VCLEFT_TLCState_Tail 5 "VCLEFT_TLC_LIGHT_STATE_SNA" 4 "VCLEFT_TLC_LIGHT_STATE_FAULT" 3 "VCLEFT_TLC_LIGHT_STATE_ON_WITH_LOAD" 2 "VCLEFT_TLC_LIGHT_STATE_ON_WITHOUT_LOAD" 1 "VCLEFT_TLC_LIGHT_STATE_OFF_WITH_LOAD" 0 "VCLEFT_TLC_LIGHT_STATE_OFF_WITHOUT_LOAD" ;
VAL_ 507 VCLEFT_TLCState_Stop 5 "VCLEFT_TLC_LIGHT_STATE_SNA" 4 "VCLEFT_TLC_LIGHT_STATE_FAULT" 3 "VCLEFT_TLC_LIGHT_STATE_ON_WITH_LOAD" 2 "VCLEFT_TLC_LIGHT_STATE_ON_WITHOUT_LOAD" 1 "VCLEFT_TLC_LIGHT_STATE_OFF_WITH_LOAD" 0 "VCLEFT_TLC_LIGHT_STATE_OFF_WITHOUT_LOAD" ;
VAL_ 507 VCLEFT_TLCState_Fog 5 "VCLEFT_TLC_LIGHT_STATE_SNA" 4 "VCLEFT_TLC_LIGHT_STATE_FAULT" 3 "VCLEFT_TLC_LIGHT_STATE_ON_WITH_LOAD" 2 "VCLEFT_TLC_LIGHT_STATE_ON_WITHOUT_LOAD" 1 "VCLEFT_TLC_LIGHT_STATE_OFF_WITH_LOAD" 0 "VCLEFT_TLC_LIGHT_STATE_OFF_WITHOUT_LOAD" ;
VAL_ 507 VCLEFT_TLCState_Reverse 5 "VCLEFT_TLC_LIGHT_STATE_SNA" 4 "VCLEFT_TLC_LIGHT_STATE_FAULT" 3 "VCLEFT_TLC_LIGHT_STATE_ON_WITH_LOAD" 2 "VCLEFT_TLC_LIGHT_STATE_ON_WITHOUT_LOAD" 1 "VCLEFT_TLC_LIGHT_STATE_OFF_WITH_LOAD" 0 "VCLEFT_TLC_LIGHT_STATE_OFF_WITHOUT_LOAD" ;
VAL_ 1373 VCLEFT_alertID 617 "a617_APP_MIA" 605 "a605_CANMsgMACVerificationKeyMismatch" 601 "a601_wakeToOpenDoorDbg" 599 "a599_LVBatteryTypeUnsupported" 597 "a597_rearDoorLatchUnexpectedVoltage" 596 "a596_frontDoorLatchUnexpectedVoltage" 595 "a595_seatThighSupportHCEncStlDbg" 594 "a594_seatThighSupportStallDebug" 593 "a593_seatEncOverThighSupport" 592 "a592_seatUncalThighSupport" 591 "a591_seatCurrUnderThighSupport" 590 "a590_seatEncStallThighSupport" 589 "a589_lipcCanFault" 587 "a587_VCSEAT2L_MIA" 586 "a586_doorRemoteUnlatchFailedRear" 585 "a585_doorRemoteUnlatchFailedFront" 584 "a584_doorRemoteUnlatchedRear" 583 "a583_doorRemoteUnlatchedFront" 582 "a582_seat2RControllerTrip" 581 "a581_reverseLightFault" 580 "a580_rightSteeringWheelCtrlTypeMismatch" 579 "a579_leftSteeringWheelCtrlTypeMismatch" 578 "a578_RGBLightFault" 577 "a577_bsiHardwareIssue" 576 "a576_liftgateStrutPositionMismatch" 575 "a575_3RowSeatStatsFromLastStateDbg2" 574 "a574_2RowSeatStatsFromLastStateDbg2" 573 "a573_seatHeatDisabledRearR" 572 "a572_seatHeatDisabledRearC" 571 "a571_seatHeatDisabledRearL" 570 "a570_seatHeatDisabledF" 569 "a569_2RowSeatOverfolded" 568 "a568_2RowSeatClashAvoidanceBlocked" 567 "a567_2RowSeatRequestWhileUncalibrated" 566 "a566_2RowSeatStatsFromLastStateDbg" 565 "a565_2RowSeatAbsPosSensorTransitionDbg" 564 "a564_2RowSeatTempHigh" 563 "a563_2RowSeatObstacleDetected" 562 "a562_2RowSeatAbsPosOffsetApplied" 561 "a561_2RowSeatPositionNonsensical" 560 "a560_2RowSeatUncalibrated" 555 "a555_steeringWheelHeaterCompromised" 554 "a554_RCM2_MIA" 551 "a551_interiorDoorRequestInhibited" 550 "a550_ambientTempDelta" 546 "a546_mirrorFoldTypeChanged" 545 "a545_LVBatteryTypeUnknown" 536 "a536_trunkFoldFlatSwitchFault" 528 "a528_unableToRunStuckOnTest" 527 "a527_continuousFeedUnexpectedVoltage" 526 "a526_pcbaOverTemperature" 525 "a525_LVBatterySWMisconfiguration" 523 "a523_eFuseThresholdsIncorrect" 522 "a522_trailerLightUnexpectedVoltage" 521 "a521_seatHeatPadUnexpectedVoltage" 520 "a520_configMismatch" 519 "a519_3RowSeatOverfolded" 518 "a518_3RowSeatClashAvoidanceBlocked" 517 "a517_3RowSeatRequestWhileUncalibrated" 516 "a516_3RowSeatStatsFromLastStateDbg" 515 "a515_3RowSeatAbsPosSensorTransitionDbg" 514 "a514_3RowSeatTempHigh" 513 "a513_3RowSeatObstacleDetected" 512 "a512_3RowSeatAbsPosOffsetApplied" 511 "a511_3RowSeatPositionNonsensical" 510 "a510_3RowSeatUncalibrated" 501 "a501_vnf1048ConfigurationMismatch" 500 "a500_eFuseASICStateMismatch" 499 "a499_epbmInvalidateCdp" 498 "a498_CANMsgMACVerificationFailure" 497 "a497_CANMsgMACVerificationKeyNotProvisioned" 494 "a494_12vSocketRearEFuseTrip" 493 "a493_12vSocketFrontEFuseTrip" 490 "a490_vehicleOccupiedOnOTAStart" 489 "a489_undervoltageSelfTestStuckOn" 488 "a488_undervoltageSelfTestStuckOnDebug" 485 "a485_uvSelfTestLoadUnattemptedOnDbg" 484 "a484_leftBrakeLightFaultUser" 483 "a483_leftTurnLightFaultUser" 482 "a482_NCV77XXFault" 481 "a481_vnf1048SelfTestFailure" 480 "a480_vnf1048Fault" 478 "a478_BPillarCameraHeaterFault" 477 "a477_hvac2RRightAirwaveLateralUncalib" 476 "a476_hvac2RRightAirwaveLateralWarning" 475 "a475_hvac2RRightAirwaveLateralFault" 474 "a474_hvac2RRightAirwaveVerticalUncalib" 473 "a473_hvac2RRightAirwaveVerticalWarning" 472 "a472_hvac2RRightAirwaveVerticalFault" 471 "a471_hvac2RLeftAirwaveLateralUncalib" 470 "a470_hvac2RLeftAirwaveLateralWarning" 469 "a469_hvac2RLeftAirwaveLateralFault" 468 "a468_hvac2RLeftAirwaveVerticalUncalib" 467 "a467_hvac2RLeftAirwaveVerticalWarning" 466 "a466_hvac2RLeftAirwaveVerticalFault" 460 "a460_etcDebug" 455 "a455_liftgateUnexpectedShutfaceSwPressed" 454 "a454_wirelessChargerFault" 453 "a453_liftgatePinchDetected" 451 "a451_wirelessChargerMIA" 450 "a450_steerColUpDownMotorShadowAlgoResetOffset" 449 "a449_steerColInOutMotorShadowAlgoResetOffset" 448 "a448_steeringColUpDownEndstopCal" 447 "a447_steeringColInOutEndstopCal" 446 "a446_trailerAuxReversePower" 445 "a445_drv8703SpiFaultDBG" 444 "a444_drv8703Fault" 442 "a442_swsLongTouchEvent" 441 "a441_prndMIA" 440 "a440_hvacRearRightLateralDriverFaulted" 439 "a439_hvacRearRightVerticalDriverFaulted" 438 "a438_hvacRearLeftLateralDriverFaulted" 437 "a437_hvacRearLeftVerticalDriverFaulted" 436 "a436_swsNoReasonForceFault" 435 "a435_swsNoReasonTouchFault" 434 "a434_swsScrollWheelPushData" 433 "a433_fohmForceCalibrationInvalid" 432 "a432_fohmMiscFault" 431 "a431_fohmVbatFault" 430 "a430_fohmRearDomeLightPowerSupplyFault" 429 "a429_seatAbuseBufferFull" 428 "a428_seatAbuseBufferWarn" 427 "a427_seatAbuseMotorStop" 426 "a426_seatAbuseMotorWarn" 425 "a425_fohmVanityPowerSupplyFault" 424 "a424_fohmAmberLEDFault" 423 "a423_fohmForceI2cError" 422 "a422_undervoltageSelfTestStuckOff" 421 "a421_fohmForceOutOfRangeFault" 420 "a420_fohmTouchSensorsImplausible" 419 "a419_fohmTouchStuck" 418 "a418_fohmTouchVarianceFail" 417 "a417_fohmTouchOutOfRangeFault" 416 "a416_fohmTouchAdcCheckFail" 415 "a415_swsMiscFault" 414 "a414_swsHapticMotorFault" 413 "a413_undervoltageSelfTestFailure" 412 "a412_leftBrakeTailLightFault" 411 "a411_swsScrollWheelScrollFault" 410 "a410_swsScrollWheelTiltFault" 409 "a409_swsScrollWheelPushFault" 408 "a408_swsForceTouchSensorFault" 407 "a407_swsForceNvmFault" 406 "a406_swsForceParametersFault" 405 "a405_swsForceCalibrationFault" 404 "a404_swsForceI2cError" 403 "a403_swsForceAdcCheckFail" 402 "a402_swsForceOutOfRange" 401 "a401_swsForceTestPatternViolation" 400 "a400_swsTouchDebouncedProcessingError" 399 "a399_swsTouchNoisyBaselineInitialization" 398 "a398_swsTouchNvmFault" 397 "a397_swsTouchOutOfRangeFault" 396 "a396_swsTouchStuckFault" 395 "a395_swsTouchAdcCheckFail" 394 "a394_swsTouchTooNegativeDelta" 393 "a393_pitchEstimationNoGPSFusion" 392 "a392_pitchEstimationGPSImprovedReinit" 391 "a391_pitchEstimationImplausible" 390 "a390_steerColUpDownEncoderOutOfRange" 389 "a389_steerColInOutEncoderOutOfRange" 388 "a388_steerColUpDownMotorEncoderStalled" 387 "a387_steerColInOutMotorEncoderStalled" 386 "a386_steerColUpDownMotorUnderCurrent" 385 "a385_steerColInOutMotorUnderCurrent" 384 "a384_steerColUpDownMotorStallCurrent" 383 "a383_steerColInOutMotorStallCurrent" 382 "a382_pitchEstimation2" 381 "a381_pitchEstimation1" 380 "a380_steerColThermalLimited" 376 "a376_seat2RowBridgeCurrentExceeded" 375 "a375_windowPinchOverrideNudge" 374 "a374_trailerLightFaultModelY" 373 "a373_windowSwOpenReqInDogMode" 372 "a372_seat2RowBackrestUnlatched" 371 "a371_seat2RowTrackUnlatched" 370 "a370_seat2RowPitchUnlatched" 366 "a366_liftgateLatchEntryDBG" 365 "a365_pitchUnlatchDisabled" 363 "a363_liftgateOpenAngleSetReq" 362 "a362_movingThresholdsIncorrect" 361 "a361_stationaryThresholdsIncorrect" 360 "a360_detectedStationaryWhileMoving" 359 "a359_liftgateLatchExitNoPositionChange" 358 "a358_debugLiftgateCurrentDropout" 357 "a357_liftgateUncalibrated" 356 "a356_liftgateFactoryTest" 355 "a355_liftgateUnexpectedStop" 354 "a354_eFuseMgmtLiftGate" 353 "a353_eFuseMgmtSteeringColumn" 352 "a352_liftgateClosingLatchEntryFailed" 351 "a351_debugLiftgateCurrentSpike" 350 "a350_ensOutOfRange" 349 "a349_CPSleepUndervoltage" 348 "a348_CPSleepOvercurrent" 347 "a347_nonContMonitorClearedDBG" 346 "a346_eFuseMgmtVbatFused2" 345 "a345_chargePortPowerCycling" 342 "a342_trailerLightControllerFault" 341 "a341_trailerLightFault" 340 "a340_trailerRightTurnLightNotDetected" 339 "a339_trailerLeftTurnLightNotDetected" 338 "a338_trailerLightControllerMIA" 337 "a337_windowDropRevThermalR" 336 "a336_windowDropRevThermalF" 335 "a335_intrusionSensorInternalFault" 334 "a334_overheadConsoleInternalFault" 333 "a333_overheadConsoleMIA" 332 "a332_intrusionSensorMIA" 331 "a331_shortDropFailedR" 330 "a330_shortDropFailedF" 329 "a329_noRideHeightCalib" 328 "a328_hghtSnsrFaultRL" 327 "a327_hghtSnsrFaultFL" 326 "a326_hghtSnsrUnplgdRL" 325 "a325_hghtSnsrUnplgdFL" 324 "a324_mirrorHeatFault" 323 "a323_mirrorCalibrated" 322 "a322_windowRezeroedDebugR" 321 "a321_windowRezeroedDebugF" 320 "a320_windowReportCrackedAtTrimClear" 319 "a319_brakePressPrimaryInputFaulted" 318 "a318_trailerIncorrectConfig" 317 "a317_epbmLimpModeEnabled" 316 "a316_mirrorPrematureFoldStall" 315 "a315_leftInteriorTrunkLightFault" 314 "a314_leftMapPocketLightFault" 313 "a313_leftFootwellLightFault" 312 "a312_leftTailLightFault" 311 "a311_leftBrakeLightFault" 310 "a310_mirrorFoldStall" 309 "a309_brakeSwitchFaulted" 308 "a308_sirenMIA" 307 "a307_handleDisconnectedR" 306 "a306_handleDisconnectedF" 305 "a305_rearIntHandleUnexpectedVoltage" 304 "a304_frontIntHandleUnexpectedVoltage" 303 "a303_eFuseMgmtWindowLift" 302 "a302_blowerGeneralFault" 301 "a301_swcOverVoltage" 300 "a300_swcUnderVoltage" 299 "a299_swcMIA" 297 "a297_seatBelowMinPumpTmp" 296 "a296_buckleFaultedRearC" 295 "a295_buckleFaultedRearL" 294 "a294_occupancyFaultedRearR" 293 "a293_occupancyFaultedRearC" 292 "a292_occupancyFaultedRearL" 291 "a291_buckleFaultedFront" 290 "a290_occupancyFaultedFront" 289 "a289_handlePWMPeriodR" 288 "a288_handlePWMPeriodF" 287 "a287_windowSpeedInvalidR" 286 "a286_windowSpeedInvalidF" 285 "a285_blowerChipComms" 284 "a284_blowerFbkSanity" 283 "a283_latchUnexpectedArmR" 282 "a282_latchUnexpectedArmF" 281 "a281_latchDidNotDisarmR" 280 "a280_latchDidNotDisarmF" 279 "a279_VCSECUnderVoltage" 278 "a278_BLERearUnderVoltage" 277 "a277_BLELeftUnderVoltage" 276 "a276_mirrorDebug" 275 "a275_leftTurnLightFault" 274 "a274_handleStuckActiveR" 273 "a273_handleStuckActiveF" 272 "a272_vhclPwrStateMsmtch" 270 "a270_seatLiftHCEncStlDbg" 269 "a269_seatTiltHCEncStlDbg" 268 "a268_seatBackHCEncStlDbg" 267 "a267_seatTrackHCEncStlDbg" 266 "a266_seatLiftStallDebug" 265 "a265_seatTiltStallDebug" 264 "a264_seatBackStallDebug" 263 "a263_seatTrackStallDebug" 261 "a261_emergencyLatchRelRear" 260 "a260_latchDisarmDelayR" 259 "a259_latchDisarmDelayF" 257 "a257_USBMIA" 256 "a256_nxppca9539Fault" 254 "a254_seatUncalLift" 253 "a253_seatUncalTilt" 252 "a252_seatUncalBack" 251 "a251_seatUncalTrack" 250 "a250_seatHeatMIARearR" 249 "a249_seatHeatShortRearR" 248 "a248_seatHeatIRearR" 247 "a247_seatHeatMIARearC" 246 "a246_seatHeatShortRearC" 245 "a245_seatHeatIRearC" 244 "a244_seatHeatMIARearL" 243 "a243_seatHeatShortRearL" 242 "a242_seatHeatIRearL" 241 "a241_seatHeatMIAFront" 240 "a240_seatHeatShortFront" 239 "a239_seatHeatIFront" 238 "a238_lumbarValveMIA" 237 "a237_lumbarOverPresB" 236 "a236_lumbarOverPresA" 235 "a235_seatCurrUnderLift" 234 "a234_seatCurrUnderTilt" 233 "a233_seatCurrUnderBack" 232 "a232_seatCurrUnderTrack" 231 "a231_seatEncOverLift" 230 "a230_seatEncOverTilt" 229 "a229_seatEncOverBack" 228 "a228_seatEncOverTrack" 227 "a227_seatEncStallLift" 226 "a226_seatEncStallTilt" 225 "a225_seatEncStallBack" 224 "a224_seatEncStallTrack" 223 "a223_VCBATT1_MIA" 221 "a221_hardwareLoadshedTriggered" 220 "a220_reverseLightFaultUser" 219 "a219_motorCurrentDropout" 218 "a218_motorDriverFault" 217 "a217_SPI_MIA_debugData2" 216 "a216_SPI_MIA_debugData1" 215 "a215_currentDesyncWarning" 214 "a214_epbmOverIDynNew" 213 "a213_epbmUnderIDynNew" 212 "a212_epbmOverIStaticNew" 211 "a211_epbmUnderIStaticNew" 210 "a210_epbStateTime" 209 "a209_epbStateMisTime" 208 "a208_epbFaulted" 207 "a207_epbmEnableWrong" 206 "a206_epbWrongDirection" 205 "a205_epbmOverIDyn" 204 "a204_epbmUnderIDyn" 203 "a203_epbmOverIStatic" 202 "a202_epbmUnderIStatic" 201 "a201_motorDutyEncDisabl" 200 "a200_motorPhantomEncoder" 197 "a197_VEHCANUndertrminate" 196 "a196_VEHCANOverterminate" 195 "a195_blowerIdentificationFailed" 194 "a194_blowerUnidentified" 193 "a193_blowerMIA" 192 "a192_blowerGeneralFault" 191 "a191_TLCOvercurrent" 190 "a190_eFuseMgmtVbatFused" 189 "a189_latchUnableToRearmR" 188 "a188_latchUnableToRearmF" 187 "a187_latchReleaseFailedR" 186 "a186_latchReleaseFailedF" 185 "a185_summonAborted" 183 "a183_doorStateFactoryTest" 182 "a182_emergencyLatchRel" 181 "a181_rearDoorLatchRehome" 180 "a180_frontDoorLatchRehome" 176 "a176_windowSealDefectRear" 175 "a175_windowSealDefectFront" 173 "a173_windowBtnDoorOpen" 172 "a172_SPI_MIA" 170 "a170_windowCurrentPeakR" 169 "a169_windowCurrentPeakF" 168 "a168_windowDebugPinchR" 167 "a167_windowDebugPinchF" 166 "a166_windowDebug" 165 "a165_windowFactoryTest2" 164 "a164_windowFactoryTest" 163 "a163_windowEncoderStallR" 162 "a162_windowEncoderStallF" 161 "a161_windowUndercurrentR" 160 "a160_windowUndercurrentF" 159 "a159_windowPinchOverideR" 158 "a158_windowPinchOverideF" 157 "a157_windowNoInputRear" 156 "a156_windowNoInputFront" 155 "a155_windowThermalRear" 154 "a154_windowThermalFront" 153 "a153_windowUncalRear" 152 "a152_windowUncalFront" 151 "a151_windowPinchRear" 150 "a150_windowPinchFront" 148 "a148_brakePressInputMismatch" 145 "a145_brakeSwitchStuck" 143 "a143_mirrorManuallyFolded" 141 "a141_12VAuxPowerTrip" 140 "a140_BLELeftPowerCycled" 139 "a139_BLERearPowerCycled" 138 "a138_consoleDoorAssist" 137 "a137_VCSECPowerCycled" 136 "a136_brakeSwitchMismatch" 135 "a135_SteerColInOutUnCal" 134 "a134_SteerColUpDownUnCal" 133 "a133_blowerLowRPMCBang" 132 "a132_blowerSoftStall" 131 "a131_blowerICTransFault" 130 "a130_blowerICWarning" 129 "a129_blowerICLatchFault" 125 "a125_RCU_MIA" 124 "a124_BB_MIA" 123 "a123_AID_MIA" 122 "a122_ICR_MIA" 121 "a121_ETC_MIA" 120 "a120_DI_DRIVE_MIA" 119 "a119_SCCM_MIA" 118 "a118_VCFRONT_MIA" 117 "a117_VCLEFT_MIA" 116 "a116_VCRIGHT_MIA" 115 "a115_VCSEC_MIA" 114 "a114_ESP_MIA" 113 "a113_UI_MIA" 112 "a112_EPBL_MIA" 111 "a111_EPBR_MIA" 110 "a110_GTW_MIA" 109 "a109_RCM_MIA" 108 "a108_DIF_MIA" 107 "a107_BMS_MIA" 106 "a106_PCS_MIA" 105 "a105_TAS_MIA" 104 "a104_DAS_MIA" 103 "a103_CP_MIA" 102 "a102_PTC_MIA" 101 "a101_PM_MIA" 100 "a100_CANbus_MIA" 99 "a099_PARK_MIA" 98 "a098_DIR_MIA" 97 "a097_CMP_MIA" 96 "a096_OCS1P_MIA" 95 "a095_CHG_MIA" 94 "a094_EPAS3P_MIA" 93 "a093_VCSEATP_MIA" 92 "a092_VCSEATD_MIA" 91 "a091_CMPD_MIA" 90 "a090_APS_MIA" 89 "a089_IBST_MIA" 88 "a088_DIRER_MIA" 87 "a087_DIREL_MIA" 86 "a086_VCBATT_MIA" 85 "a085_CCCM_MIA" 84 "a084_TPMS_MIA" 83 "a083_VCLEFT_IPC_MIA" 82 "a082_VCRIGHT_IPC_MIA" 66 "a066_emiosIsrShortPeriodDetectedDbg" 65 "a065_emiosIsrRateLimitedDbg" 64 "a064_busSleepReqTimeout" 63 "a063_SwitchFault" 62 "a062_XCPWasConnected" 61 "a061_XCPConnected" 60 "a060_engineeringBuild" 59 "a059_inputResistanceHigh" 58 "a058_inputRHighSyncDebug" 57 "a057_HVP_MIA" 46 "a046_Task1000msError" 45 "a045_Task100msError" 44 "a044_Task10msError" 43 "a043_Task1msError" 42 "a042_HighStackUsage" 41 "a041_HighCPULoad" 31 "a031_UDSActive" 30 "a030_ECULogUploadRequest" 29 "a029_CoreDump" 22 "a022_TaskInitError" 21 "a021_TaskSchedulerError" 17 "a017_NVMMStatusDbg" 16 "a016_NVMMRecordError" 15 "a015_NVMMError" 13 "a013_AlertManagerFault" 12 "a012_CPUReset" 10 "a010_ExtSupplyVoltError" 6 "a006_CANTX_cyclicError" 5 "a005_CANTXError" 3 "a003_SWAssertion" 2 "a002_PowerLossReset" 1 "a001_WatchdogReset" 0 "ALERT_DO_NOT_USE_ZERO" ;
VAL_ 1373 VCLEFT_alertState 1 "SET" 0 "CLEARED" ;
VAL_ 1373 VCLEFT_a145_brakeSwitch 3 "FAULT" 2 "ON" 1 "OFF" 0 "SNA" ;
VAL_ 1373 VCLEFT_a145_ibstRodPositionQF 2 "FAULT" 1 "NORMAL" 0 "NOT_INITIALIZED" ;
VAL_ 1373 VCLEFT_a150_windowPinchReason 5 "UNUSED" 4 "ACCEL_LOOKBACK" 3 "POWER_CRUDE" 2 "POWER_DIV_SPEED" 1 "POWER" 0 "NONE" ;
VAL_ 1373 VCLEFT_a151_windowPinchReason 5 "UNUSED" 4 "ACCEL_LOOKBACK" 3 "POWER_CRUDE" 2 "POWER_DIV_SPEED" 1 "POWER" 0 "NONE" ;
VAL_ 1373 VCLEFT_a152_speedTableStatus 2 "FULLY_BUILT" 1 "SENSITIVE_BUILT" 0 "EMPTY_SNA" ;
VAL_ 1373 VCLEFT_a153_speedTableStatus 2 "FULLY_BUILT" 1 "SENSITIVE_BUILT" 0 "EMPTY_SNA" ;
VAL_ 1373 VCLEFT_a154_windowThermalMode 3 "CRITICAL" 2 "ALERT" 1 "NORMAL" 0 "SNA" ;
VAL_ 1373 VCLEFT_a155_windowThermalMode 3 "CRITICAL" 2 "ALERT" 1 "NORMAL" 0 "SNA" ;
VAL_ 1373 VCLEFT_a180_latchStatus 8 "FAULT" 7 "DEFAULT" 6 "TIMEOUT" 5 "AJAR" 4 "OPENING" 3 "CLOSING" 2 "CLOSED" 1 "OPENED" 0 "SNA" ;
VAL_ 1373 VCLEFT_a181_latchStatus 8 "FAULT" 7 "DEFAULT" 6 "TIMEOUT" 5 "AJAR" 4 "OPENING" 3 "CLOSING" 2 "CLOSED" 1 "OPENED" 0 "SNA" ;
VAL_ 1373 VCLEFT_a192_selfTestResult 7 "PASSED" 6 "UNKNOWN" 5 "OPEN_PHASE_W" 4 "OPEN_PHASE_V" 3 "OPEN_PHASE_U" 2 "SHORT_GROUND" 1 "SHORT_SUPPLY" 0 "NOT_TESTED" ;
VAL_ 1373 VCLEFT_a192_motorType 2 "BOSCH" 1 "DELTA" 0 "UNKNOWN" ;
VAL_ 1373 VCLEFT_a194_vcbldcMotorId 2 "BOSCH" 1 "DELTA" 0 "UNKNOWN" ;
VAL_ 1373 VCLEFT_a194_nvramMotorId 2 "BOSCH" 1 "DELTA" 0 "UNKNOWN" ;
VAL_ 1373 VCLEFT_a202_epbConfig 11 "CT_MANDO" 10 "MODEL3_ZF" 9 "MODELS_CERAMIC" 8 "MODELY_PERFORMANCE_V2" 7 "MODEL3_PERFORMANCE_V2" 6 "MODELX_BASE" 5 "MODELY_PERFORMANCE" 4 "MODELY_BASE" 3 "MODELS_BASE" 2 "MODEL3_PERFORMANCE" 1 "MODEL3_BASE" 0 "UNKNOWN" ;
VAL_ 1373 VCLEFT_a203_epbConfig 11 "CT_MANDO" 10 "MODEL3_ZF" 9 "MODELS_CERAMIC" 8 "MODELY_PERFORMANCE_V2" 7 "MODEL3_PERFORMANCE_V2" 6 "MODELX_BASE" 5 "MODELY_PERFORMANCE" 4 "MODELY_BASE" 3 "MODELS_BASE" 2 "MODEL3_PERFORMANCE" 1 "MODEL3_BASE" 0 "UNKNOWN" ;
VAL_ 1373 VCLEFT_a204_epbConfig 11 "CT_MANDO" 10 "MODEL3_ZF" 9 "MODELS_CERAMIC" 8 "MODELY_PERFORMANCE_V2" 7 "MODEL3_PERFORMANCE_V2" 6 "MODELX_BASE" 5 "MODELY_PERFORMANCE" 4 "MODELY_BASE" 3 "MODELS_BASE" 2 "MODEL3_PERFORMANCE" 1 "MODEL3_BASE" 0 "UNKNOWN" ;
VAL_ 1373 VCLEFT_a205_epbConfig 11 "CT_MANDO" 10 "MODEL3_ZF" 9 "MODELS_CERAMIC" 8 "MODELY_PERFORMANCE_V2" 7 "MODEL3_PERFORMANCE_V2" 6 "MODELX_BASE" 5 "MODELY_PERFORMANCE" 4 "MODELY_BASE" 3 "MODELS_BASE" 2 "MODEL3_PERFORMANCE" 1 "MODEL3_BASE" 0 "UNKNOWN" ;
VAL_ 1373 VCLEFT_a206_unitStatusEPB 23 "COUNT" 22 "AUTONOMY_OPEN" 21 "FREE_ROLL_MODE" 20 "DYNAMIC_PARKING" 19 "EXTERNAL_PARKING" 18 "RELEASING_FOR_EXTERNAL_PARK" 17 "EXTERNAL_DYNAMIC" 16 "SUMMON_PARKING" 15 "SUMMON_RELEASING" 14 "SUMMON" 13 "WINCHMODE_PENDING" 12 "PARK_PENDING" 11 "SERVICE_RELEASING" 10 "RELEASING" 9 "DYNAMIC_APPLYING" 8 "PARKING" 7 "WINCHMODE_RELEASING" 6 "WINCHMODE" 5 "SERVICE" 4 "START" 3 "PARK" 2 "DYNAMIC" 1 "OPEN" 0 "UNKNOWN" ;
VAL_ 1373 VCLEFT_a206_unitStatusEPBM 23 "COUNT" 22 "AUTONOMY_OPEN" 21 "FREE_ROLL_MODE" 20 "DYNAMIC_PARKING" 19 "EXTERNAL_PARKING" 18 "RELEASING_FOR_EXTERNAL_PARK" 17 "EXTERNAL_DYNAMIC" 16 "SUMMON_PARKING" 15 "SUMMON_RELEASING" 14 "SUMMON" 13 "WINCHMODE_PENDING" 12 "PARK_PENDING" 11 "SERVICE_RELEASING" 10 "RELEASING" 9 "DYNAMIC_APPLYING" 8 "PARKING" 7 "WINCHMODE_RELEASING" 6 "WINCHMODE" 5 "SERVICE" 4 "START" 3 "PARK" 2 "DYNAMIC" 1 "OPEN" 0 "UNKNOWN" ;
VAL_ 1373 VCLEFT_a207_unitStatusEPB 23 "COUNT" 22 "AUTONOMY_OPEN" 21 "FREE_ROLL_MODE" 20 "DYNAMIC_PARKING" 19 "EXTERNAL_PARKING" 18 "RELEASING_FOR_EXTERNAL_PARK" 17 "EXTERNAL_DYNAMIC" 16 "SUMMON_PARKING" 15 "SUMMON_RELEASING" 14 "SUMMON" 13 "WINCHMODE_PENDING" 12 "PARK_PENDING" 11 "SERVICE_RELEASING" 10 "RELEASING" 9 "DYNAMIC_APPLYING" 8 "PARKING" 7 "WINCHMODE_RELEASING" 6 "WINCHMODE" 5 "SERVICE" 4 "START" 3 "PARK" 2 "DYNAMIC" 1 "OPEN" 0 "UNKNOWN" ;
VAL_ 1373 VCLEFT_a207_unitStatusEPBM 23 "COUNT" 22 "AUTONOMY_OPEN" 21 "FREE_ROLL_MODE" 20 "DYNAMIC_PARKING" 19 "EXTERNAL_PARKING" 18 "RELEASING_FOR_EXTERNAL_PARK" 17 "EXTERNAL_DYNAMIC" 16 "SUMMON_PARKING" 15 "SUMMON_RELEASING" 14 "SUMMON" 13 "WINCHMODE_PENDING" 12 "PARK_PENDING" 11 "SERVICE_RELEASING" 10 "RELEASING" 9 "DYNAMIC_APPLYING" 8 "PARKING" 7 "WINCHMODE_RELEASING" 6 "WINCHMODE" 5 "SERVICE" 4 "START" 3 "PARK" 2 "DYNAMIC" 1 "OPEN" 0 "UNKNOWN" ;
VAL_ 1373 VCLEFT_a208_unitStatusEPB 23 "COUNT" 22 "AUTONOMY_OPEN" 21 "FREE_ROLL_MODE" 20 "DYNAMIC_PARKING" 19 "EXTERNAL_PARKING" 18 "RELEASING_FOR_EXTERNAL_PARK" 17 "EXTERNAL_DYNAMIC" 16 "SUMMON_PARKING" 15 "SUMMON_RELEASING" 14 "SUMMON" 13 "WINCHMODE_PENDING" 12 "PARK_PENDING" 11 "SERVICE_RELEASING" 10 "RELEASING" 9 "DYNAMIC_APPLYING" 8 "PARKING" 7 "WINCHMODE_RELEASING" 6 "WINCHMODE" 5 "SERVICE" 4 "START" 3 "PARK" 2 "DYNAMIC" 1 "OPEN" 0 "UNKNOWN" ;
VAL_ 1373 VCLEFT_a208_unitStatusEPBM 23 "COUNT" 22 "AUTONOMY_OPEN" 21 "FREE_ROLL_MODE" 20 "DYNAMIC_PARKING" 19 "EXTERNAL_PARKING" 18 "RELEASING_FOR_EXTERNAL_PARK" 17 "EXTERNAL_DYNAMIC" 16 "SUMMON_PARKING" 15 "SUMMON_RELEASING" 14 "SUMMON" 13 "WINCHMODE_PENDING" 12 "PARK_PENDING" 11 "SERVICE_RELEASING" 10 "RELEASING" 9 "DYNAMIC_APPLYING" 8 "PARKING" 7 "WINCHMODE_RELEASING" 6 "WINCHMODE" 5 "SERVICE" 4 "START" 3 "PARK" 2 "DYNAMIC" 1 "OPEN" 0 "UNKNOWN" ;
VAL_ 1373 VCLEFT_a209_unitStatusEPB 23 "COUNT" 22 "AUTONOMY_OPEN" 21 "FREE_ROLL_MODE" 20 "DYNAMIC_PARKING" 19 "EXTERNAL_PARKING" 18 "RELEASING_FOR_EXTERNAL_PARK" 17 "EXTERNAL_DYNAMIC" 16 "SUMMON_PARKING" 15 "SUMMON_RELEASING" 14 "SUMMON" 13 "WINCHMODE_PENDING" 12 "PARK_PENDING" 11 "SERVICE_RELEASING" 10 "RELEASING" 9 "DYNAMIC_APPLYING" 8 "PARKING" 7 "WINCHMODE_RELEASING" 6 "WINCHMODE" 5 "SERVICE" 4 "START" 3 "PARK" 2 "DYNAMIC" 1 "OPEN" 0 "UNKNOWN" ;
VAL_ 1373 VCLEFT_a209_unitStatusEPBM 23 "COUNT" 22 "AUTONOMY_OPEN" 21 "FREE_ROLL_MODE" 20 "DYNAMIC_PARKING" 19 "EXTERNAL_PARKING" 18 "RELEASING_FOR_EXTERNAL_PARK" 17 "EXTERNAL_DYNAMIC" 16 "SUMMON_PARKING" 15 "SUMMON_RELEASING" 14 "SUMMON" 13 "WINCHMODE_PENDING" 12 "PARK_PENDING" 11 "SERVICE_RELEASING" 10 "RELEASING" 9 "DYNAMIC_APPLYING" 8 "PARKING" 7 "WINCHMODE_RELEASING" 6 "WINCHMODE" 5 "SERVICE" 4 "START" 3 "PARK" 2 "DYNAMIC" 1 "OPEN" 0 "UNKNOWN" ;
VAL_ 1373 VCLEFT_a210_unitStatusEPB 23 "COUNT" 22 "AUTONOMY_OPEN" 21 "FREE_ROLL_MODE" 20 "DYNAMIC_PARKING" 19 "EXTERNAL_PARKING" 18 "RELEASING_FOR_EXTERNAL_PARK" 17 "EXTERNAL_DYNAMIC" 16 "SUMMON_PARKING" 15 "SUMMON_RELEASING" 14 "SUMMON" 13 "WINCHMODE_PENDING" 12 "PARK_PENDING" 11 "SERVICE_RELEASING" 10 "RELEASING" 9 "DYNAMIC_APPLYING" 8 "PARKING" 7 "WINCHMODE_RELEASING" 6 "WINCHMODE" 5 "SERVICE" 4 "START" 3 "PARK" 2 "DYNAMIC" 1 "OPEN" 0 "UNKNOWN" ;
VAL_ 1373 VCLEFT_a210_unitStatusEPBM 23 "COUNT" 22 "AUTONOMY_OPEN" 21 "FREE_ROLL_MODE" 20 "DYNAMIC_PARKING" 19 "EXTERNAL_PARKING" 18 "RELEASING_FOR_EXTERNAL_PARK" 17 "EXTERNAL_DYNAMIC" 16 "SUMMON_PARKING" 15 "SUMMON_RELEASING" 14 "SUMMON" 13 "WINCHMODE_PENDING" 12 "PARK_PENDING" 11 "SERVICE_RELEASING" 10 "RELEASING" 9 "DYNAMIC_APPLYING" 8 "PARKING" 7 "WINCHMODE_RELEASING" 6 "WINCHMODE" 5 "SERVICE" 4 "START" 3 "PARK" 2 "DYNAMIC" 1 "OPEN" 0 "UNKNOWN" ;
VAL_ 1373 VCLEFT_a224_seatMotorState 5 "UNDEFINED" 4 "CALIBRATING" 3 "RECALLING" 2 "MOVING_DOWN" 1 "MOVING_UP" 0 "STOPPED" ;
VAL_ 1373 VCLEFT_a224_seatSwitchBack 3 "FAULT" 2 "ON" 1 "OFF" 0 "SNA" ;
VAL_ 1373 VCLEFT_a224_seatSwitchForward 3 "FAULT" 2 "ON" 1 "OFF" 0 "SNA" ;
VAL_ 1373 VCLEFT_a225_seatMotorState 5 "UNDEFINED" 4 "CALIBRATING" 3 "RECALLING" 2 "MOVING_DOWN" 1 "MOVING_UP" 0 "STOPPED" ;
VAL_ 1373 VCLEFT_a225_seatSwitchBack 3 "FAULT" 2 "ON" 1 "OFF" 0 "SNA" ;
VAL_ 1373 VCLEFT_a225_seatSwitchForward 3 "FAULT" 2 "ON" 1 "OFF" 0 "SNA" ;
VAL_ 1373 VCLEFT_a226_seatMotorState 5 "UNDEFINED" 4 "CALIBRATING" 3 "RECALLING" 2 "MOVING_DOWN" 1 "MOVING_UP" 0 "STOPPED" ;
VAL_ 1373 VCLEFT_a226_seatSwitchBack 3 "FAULT" 2 "ON" 1 "OFF" 0 "SNA" ;
VAL_ 1373 VCLEFT_a226_seatSwitchForward 3 "FAULT" 2 "ON" 1 "OFF" 0 "SNA" ;
VAL_ 1373 VCLEFT_a227_seatMotorState 5 "UNDEFINED" 4 "CALIBRATING" 3 "RECALLING" 2 "MOVING_DOWN" 1 "MOVING_UP" 0 "STOPPED" ;
VAL_ 1373 VCLEFT_a227_seatSwitchBack 3 "FAULT" 2 "ON" 1 "OFF" 0 "SNA" ;
VAL_ 1373 VCLEFT_a227_seatSwitchForward 3 "FAULT" 2 "ON" 1 "OFF" 0 "SNA" ;
VAL_ 1373 VCLEFT_a228_seatMotorState 5 "UNDEFINED" 4 "CALIBRATING" 3 "RECALLING" 2 "MOVING_DOWN" 1 "MOVING_UP" 0 "STOPPED" ;
