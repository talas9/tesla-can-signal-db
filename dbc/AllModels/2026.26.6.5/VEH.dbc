VERSION "dbc-export 1 2026.26.6.5"

NS_ :

BS_:

BU_: APP APS BMS CC CMP CMPD CP DAS DI DIF DIR EPBL EPBR EVSE FC GTW HCML HCMR HVP ICR PCS PCS2 PLG PM PMF PMR PTC SCCM SCM SCS SDCR TAS UMC V2G VC VCBATT VCBATT0 VCBATT1 VCBATT2 VCFRONT VCFRONT1 VCFRONT2 VCLEFT VCRIGHT VCSEAT2L VCSEAT2R VCSEC

BO_ 1335 VCFRONT1_alertLog: 8 VCFRONT1
 SG_ VCFRONT1_alertID M : 0|10@1+ (1,0) [0|1023] "" Vector__XXX
 SG_ VCFRONT1_alertState : 15|1@1+ (1,0) [0|1] "" Vector__XXX
 SG_ VCFRONT1_a001_InternalWatchdog m1 : 16|1@1+ (1,0) [0|1] "" Vector__XXX
 SG_ VCFRONT1_a015_NVMMMemOverflow m15 : 16|1@1+ (1,0) [0|1] "" Vector__XXX
 SG_ VCFRONT1_a015_NVMMFilesystemErro m15 : 17|1@1+ (1,0) [0|1] "" Vector__XXX
 SG_ VCFRONT1_a015_NVMMRecordIDError m15 : 18|1@1+ (1,0) [0|1] "" Vector__XXX
 SG_ VCFRONT1_a059_voltageDrop m59 : 16|12@1+ (0.005443676,0) [0|22.29185322] "V" Vector__XXX
 SG_ VCFRONT1_a059_resistanceEstimate m59 : 28|12@1+ (0.00244,0) [0|9.9918] "Ohms" Vector__XXX
 SG_ VCFRONT1_a059_current m59 : 40|12@1+ (0.05,0) [0|204.75] "A" Vector__XXX
 SG_ VCFRONT1_a063_switchChannel m63 : 16|8@1+ (1,0) [0|255] "" Vector__XXX
 SG_ VCFRONT1_a063_switchType m63 : 24|8@1+ (1,0) [0|255] "" Vector__XXX
 SG_ VCFRONT1_a063_ADCVoltage m63 : 32|8@1+ (0.025,0) [0|6.375] "V" Vector__XXX
 SG_ VCFRONT1_a063_disconnected m63 : 40|1@1+ (1,0) [0|1] "" Vector__XXX
 SG_ VCFRONT1_a063_indeterminate m63 : 41|1@1+ (1,0) [0|1] "" Vector__XXX
 SG_ VCFRONT1_a063_stuckActive m63 : 42|1@1+ (1,0) [0|1] "" Vector__XXX
 SG_ VCFRONT1_a063_faulted m63 : 43|1@1+ (1,0) [0|1] "" Vector__XXX
 SG_ VCFRONT1_a091_FRONTIPC_faultsAnd m91 : 16|1@1+ (1,0) [0|1] "" Vector__XXX
 SG_ VCFRONT1_a091_FRONTIPC_state m91 : 17|1@1+ (1,0) [0|1] "" Vector__XXX
 SG_ VCFRONT1_a096_FRONTIPC_status m96 : 16|1@1+ (1,0) [0|1] "" Vector__XXX
 SG_ VCFRONT1_a098_FRONTIPC_temperatu m98 : 16|1@1+ (1,0) [0|1] "" Vector__XXX
 SG_ VCFRONT1_a098_FRONTIPC_thermalCo m98 : 17|1@1+ (1,0) [0|1] "" Vector__XXX
 SG_ VCFRONT1_a106_BATTIPC_dcdcRailSt m106 : 16|1@1+ (1,0) [0|1] "" Vector__XXX
 SG_ VCFRONT1_a106_BATTIPC_dcdcStatus m106 : 17|1@1+ (1,0) [0|1] "" Vector__XXX
 SG_ VCFRONT1_a106_VEH_dcdcStatus m106 : 18|1@1+ (1,0) [0|1] "" Vector__XXX
 SG_ VCFRONT1_a106_VEH_thermalControl m106 : 19|1@1+ (1,0) [0|1] "" Vector__XXX
 SG_ VCFRONT1_a106_VEH_dcdcRailStatus m106 : 20|1@1+ (1,0) [0|1] "" Vector__XXX
 SG_ VCFRONT1_a106_CH_dcdcRailStatus m106 : 21|1@1+ (1,0) [0|1] "" Vector__XXX
 SG_ VCFRONT1_a106_CH_alertMatrix m106 : 22|1@1+ (1,0) [0|1] "" Vector__XXX
 SG_ VCFRONT1_a106_FRONTIPC_thermalCo m106 : 23|1@1+ (1,0) [0|1] "" Vector__XXX
 SG_ VCFRONT1_a106_FRONTIPC_dcdcRailS m106 : 24|1@1+ (1,0) [0|1] "" Vector__XXX
 SG_ VCFRONT1_a106_FRONTIPC_dcdcStatu m106 : 25|1@1+ (1,0) [0|1] "" Vector__XXX
 SG_ VCFRONT1_a108_FRONTIPC_status m108 : 16|1@1+ (1,0) [0|1] "" Vector__XXX
 SG_ VCFRONT1_a108_FRONTIPC_temperatu m108 : 17|1@1+ (1,0) [0|1] "" Vector__XXX
 SG_ VCFRONT1_a108_FRONTIPC_thermalCo m108 : 18|1@1+ (1,0) [0|1] "" Vector__XXX
 SG_ VCFRONT1_a108_FRONTIPC_motorStat m108 : 19|1@1+ (1,0) [0|1] "" Vector__XXX
 SG_ VCFRONT1_a120_BATTIPC_speed m120 : 16|1@1+ (1,0) [0|1] "" Vector__XXX
 SG_ VCFRONT1_a120_FRONTIPC_speed m120 : 17|1@1+ (1,0) [0|1] "" Vector__XXX
 SG_ VCFRONT1_a120_FRONTIPC_systemSta m120 : 18|1@1+ (1,0) [0|1] "" Vector__XXX
 SG_ VCFRONT1_a120_BATTIPC_systemStat m120 : 19|1@1+ (1,0) [0|1] "" Vector__XXX
 SG_ VCFRONT1_a120_FRONTIPC_systemPow m120 : 20|1@1+ (1,0) [0|1] "" Vector__XXX
 SG_ VCFRONT1_a120_FRONTIPC_autonomyH m120 : 21|1@1+ (1,0) [0|1] "" Vector__XXX
 SG_ VCFRONT1_a120_BATTIPC_chassisCon m120 : 22|1@1+ (1,0) [0|1] "" Vector__XXX
 SG_ VCFRONT1_a120_FRONTIPC_chassisCo m120 : 23|1@1+ (1,0) [0|1] "" Vector__XXX
 SG_ VCFRONT1_a120_FRONTIPC_odometerS m120 : 24|1@1+ (1,0) [0|1] "" Vector__XXX
 SG_ VCFRONT1_a124_FRONTIPC_status m124 : 16|1@1+ (1,0) [0|1] "" Vector__XXX
 SG_ VCFRONT1_a124_BATTIPC_status m124 : 17|1@1+ (1,0) [0|1] "" Vector__XXX
 SG_ VCFRONT1_a125_FRONTIPC_leftStalk m125 : 16|1@1+ (1,0) [0|1] "" Vector__XXX
 SG_ VCFRONT1_a125_FRONTIPC_steerAngl m125 : 17|1@1+ (1,0) [0|1] "" Vector__XXX
 SG_ VCFRONT1_a125_FRONTIPC_info m125 : 18|1@1+ (1,0) [0|1] "" Vector__XXX
 SG_ VCFRONT1_a126_FRONTIPC_sysStatus m126 : 16|1@1+ (1,0) [0|1] "" Vector__XXX
 SG_ VCFRONT1_a126_BATTIPC_sysStatus m126 : 17|1@1+ (1,0) [0|1] "" Vector__XXX
 SG_ VCFRONT1_a126_FRONTIPC_status m126 : 18|1@1+ (1,0) [0|1] "" Vector__XXX
 SG_ VCFRONT1_a126_BATTIPC_status m126 : 19|1@1+ (1,0) [0|1] "" Vector__XXX
 SG_ VCFRONT1_a127_iBoosterEFuseCurre m127 : 16|16@1+ (0.1,0) [0|6553.5] "A" Vector__XXX
 SG_ VCFRONT1_a127_iBoosterEFuseVolta m127 : 32|16@1+ (0.1,0) [0|6553.5] "V" Vector__XXX
 SG_ VCFRONT1_a127_iBoosterEFuseTemp m127 : 48|11@1+ (0.125,-40) [-40|215.875] "degC" Vector__XXX
 SG_ VCFRONT1_a128_vcrightEFuseCurren m128 : 16|16@1+ (0.1,0) [0|6553.5] "A" Vector__XXX
 SG_ VCFRONT1_a128_vcrightEFuseVoltag m128 : 32|16@1+ (0.1,0) [0|6553.5] "V" Vector__XXX
 SG_ VCFRONT1_a128_vcrightEFuseTemp m128 : 48|11@1+ (0.125,-40) [-40|215.875] "degC" Vector__XXX
 SG_ VCFRONT1_a128_vcrightEFuseRemain m128 : 59|4@1+ (1,0) [0|15] "" Vector__XXX
 SG_ VCFRONT1_a129_pcsEFuseCurrent m129 : 16|16@1+ (0.1,0) [0|6553.5] "A" Vector__XXX
 SG_ VCFRONT1_a129_pcsEFuseVoltage m129 : 32|16@1+ (0.1,0) [0|6553.5] "V" Vector__XXX
 SG_ VCFRONT1_a129_pcsEFuseTemp m129 : 48|11@1+ (0.125,-40) [-40|215.875] "degC" Vector__XXX
 SG_ VCFRONT1_a129_pcsEFuseRemainingR m129 : 59|4@1+ (1,0) [0|15] "" Vector__XXX
 SG_ VCFRONT1_a130_autopilot2EFuseCur m130 : 16|16@1+ (0.1,0) [0|6553.5] "A" Vector__XXX
 SG_ VCFRONT1_a130_autopilot2EFuseVol m130 : 32|16@1+ (0.1,0) [0|6553.5] "V" Vector__XXX
 SG_ VCFRONT1_a130_autopilot2EFuseTem m130 : 48|11@1+ (0.125,-40) [-40|215.875] "degC" Vector__XXX
 SG_ VCFRONT1_a130_autopilot2EFuseRem m130 : 59|4@1+ (1,0) [0|15] "" Vector__XXX
 SG_ VCFRONT1_a131_FRONTIPC_power m131 : 16|1@1+ (1,0) [0|1] "" Vector__XXX
 SG_ VCFRONT1_a131_BATTIPC_power m131 : 17|1@1+ (1,0) [0|1] "" Vector__XXX
 SG_ VCFRONT1_a132_epas2EFuseCurrent m132 : 16|16@1+ (0.1,0) [0|6553.5] "A" Vector__XXX
 SG_ VCFRONT1_a132_epas2EFuseVoltage m132 : 32|16@1+ (0.1,0) [0|6553.5] "V" Vector__XXX
 SG_ VCFRONT1_a132_epas2EFuseTemp m132 : 48|11@1+ (0.125,-40) [-40|215.875] "degC" Vector__XXX
 SG_ VCFRONT1_a133_BATTIPC_primaryAct m133 : 16|1@1+ (1,0) [0|1] "" Vector__XXX
 SG_ VCFRONT1_a133_FRONTIPC_secondary m133 : 17|1@1+ (1,0) [0|1] "" Vector__XXX
 SG_ VCFRONT1_a135_leftHeadlightEFuse m135 : 16|16@1+ (0.1,0) [0|6553.5] "A" Vector__XXX
 SG_ VCFRONT1_a144_FRONTIPC_status m144 : 16|1@1+ (1,0) [0|1] "" Vector__XXX
 SG_ VCFRONT1_a144_BATTIPC_status m144 : 17|1@1+ (1,0) [0|1] "" Vector__XXX
 SG_ VCFRONT1_a164_lockoutVoltage m164 : 16|16@1+ (0.1,0) [0|6553.5] "V" Vector__XXX
 SG_ VCFRONT1_a165_lockoutVoltage m165 : 16|16@1+ (0.1,0) [0|6553.5] "V" Vector__XXX
 SG_ VCFRONT1_a177_mcuAudioEFuseCurre m177 : 16|10@1+ (0.1,0) [0|102.3] "A" Vector__XXX
 SG_ VCFRONT1_a177_mcuAudioEFuseVolta m177 : 32|16@1+ (0.1,0) [0|6553.5] "V" Vector__XXX
 SG_ VCFRONT1_a191_vehiclePowerState m191 : 16|2@1+ (1,0) [0|3] "" Vector__XXX
 SG_ VCFRONT1_a191_hvState m191 : 18|3@1+ (1,0) [0|7] "" Vector__XXX
 SG_ VCFRONT1_a191_busVoltage m191 : 24|8@1+ (0.08741903,0) [0|22.29185265] "V" Vector__XXX
 SG_ VCFRONT1_a191_serviceMode m191 : 32|1@1+ (1,0) [0|1] "" Vector__XXX
 SG_ VCFRONT1_a191_frunkOpen m191 : 33|1@1+ (1,0) [0|1] "" Vector__XXX
 SG_ VCFRONT1_a191_exitDriveWarningTi m191 : 34|1@1+ (1,0) [0|1] "" Vector__XXX
 SG_ VCFRONT1_a191_NotEnoughPowerForS m191 : 35|1@1+ (1,0) [0|1] "" Vector__XXX
 SG_ VCFRONT1_a191_bmsState m191 : 36|4@1+ (1,0) [0|15] "" Vector__XXX
 SG_ VCFRONT1_a204_vbusVoltage m204 : 16|10@1+ (0.025,0) [0|25.575] "V" Vector__XXX
 SG_ VCFRONT1_a204_BRailLocked m204 : 26|1@1+ (1,0) [0|1] "" Vector__XXX
 SG_ VCFRONT1_a204_uvLoadshedFaultInj m204 : 27|1@1+ (1,0) [0|1] "" Vector__XXX
 SG_ VCFRONT1_a204_pcsBridgeCurrent m204 : 32|16@1- (0.0625,0) [-2048|2047.9375] "A" Vector__XXX
 SG_ VCFRONT1_a205_busVoltage m205 : 16|10@1+ (0.025,0) [0|25.575] "V" Vector__XXX
 SG_ VCFRONT1_a205_BRailLocked m205 : 26|1@1+ (1,0) [0|1] "" Vector__XXX
 SG_ VCFRONT1_a205_ovLoadshedFaultInj m205 : 27|1@1+ (1,0) [0|1] "" Vector__XXX
 SG_ VCFRONT1_a205_pcsBridgeCurrent m205 : 32|16@1- (0.0625,0) [-2048|2047.9375] "A" Vector__XXX
 SG_ VCFRONT1_a216_inDrive m216 : 16|1@1+ (1,0) [0|1] "" Vector__XXX
 SG_ VCFRONT1_a216_hvState m216 : 17|3@1+ (1,0) [0|7] "" Vector__XXX
 SG_ VCFRONT1_a216_vcrightFastBlowImm m216 : 20|1@1+ (1,0) [0|1] "" Vector__XXX
 SG_ VCFRONT1_a216_vcrightFastBlowDeb m216 : 21|1@1+ (1,0) [0|1] "" Vector__XXX
 SG_ VCFRONT1_a216_vcrightStaticImmin m216 : 22|1@1+ (1,0) [0|1] "" Vector__XXX
 SG_ VCFRONT1_a216_vcrightDynamicImmi m216 : 23|1@1+ (1,0) [0|1] "" Vector__XXX
 SG_ VCFRONT1_a220_DI_gear m220 : 16|3@1+ (1,0) [0|6] "" Vector__XXX
 SG_ VCFRONT1_a220_redundancyRequired m220 : 19|1@1+ (1,0) [0|1] "" Vector__XXX
 SG_ VCFRONT1_a220_vehicleSpeed m220 : 20|12@1+ (0.08,-40) [-40|287.6] "kph" Vector__XXX
 SG_ VCFRONT1_a220_lvHealthStatus m220 : 32|3@1+ (1,0) [0|7] "" Vector__XXX
 SG_ VCFRONT1_a220_factoryMode m220 : 35|1@1+ (1,0) [0|1] "" Vector__XXX
 SG_ VCFRONT1_a220_serviceMode m220 : 36|1@1+ (1,0) [0|1] "" Vector__XXX
 SG_ VCFRONT1_a220_unhealthyReason m220 : 40|5@1+ (1,0) [0|31] "" Vector__XXX
 SG_ VCFRONT1_a223_failedArmingSetup m223 : 16|1@1+ (1,0) [0|1] "" Vector__XXX
 SG_ VCFRONT1_a223_failedFaultInject m223 : 17|1@1+ (1,0) [0|1] "" Vector__XXX
 SG_ VCFRONT1_a223_overvoltageFaultAc m223 : 18|1@1+ (1,0) [0|1] "" Vector__XXX
 SG_ VCFRONT1_a223_sharedBridgeShutdo m223 : 19|1@1+ (1,0) [0|1] "" Vector__XXX
 SG_ VCFRONT1_a223_timedOut m223 : 20|1@1+ (1,0) [0|1] "" Vector__XXX
 SG_ VCFRONT1_a229_bridgeOpened m229 : 16|1@1+ (1,0) [0|1] "" Vector__XXX
 SG_ VCFRONT1_a229_pcsMIA m229 : 17|1@1+ (1,0) [0|1] "" Vector__XXX
 SG_ VCFRONT1_a229_pcsNotSupporting m229 : 18|1@1+ (1,0) [0|1] "" Vector__XXX
 SG_ VCFRONT1_a250_pcsOvShutdownFault m250 : 16|1@1+ (1,0) [0|1] "" Vector__XXX
 SG_ VCFRONT1_a250_pcsOvShutdownArmed m250 : 17|1@1+ (1,0) [0|1] "" Vector__XXX
 SG_ VCFRONT1_a250_battDomainHealthy m250 : 18|1@1+ (1,0) [0|1] "" Vector__XXX
 SG_ VCFRONT1_a250_busVoltage m250 : 19|10@1+ (0.025,0) [0|25.575] "V" Vector__XXX
 SG_ VCFRONT1_a250_dcdcEnableLineVolt m250 : 29|9@1+ (0.05,0) [0|25.55] "V" Vector__XXX
 SG_ VCFRONT1_a250_ovClampBusVoltage m250 : 38|10@1+ (0.025,0) [0|25.575] "V" Vector__XXX
 SG_ VCFRONT1_a250_ovClampReferenceVo m250 : 48|7@1+ (0.025,0) [0|3.175] "V" Vector__XXX
 SG_ VCFRONT1_a250_ovClampMonitorVolt m250 : 55|9@1+ (0.05,0) [0|25.55] "V" Vector__XXX
 SG_ VCFRONT1_a251_rationalitySetupCh m251 : 16|2@1+ (1,0) [0|3] "" Vector__XXX
 SG_ VCFRONT1_a251_rationalitySetupFa m251 : 18|3@1+ (1,0) [0|7] "" Vector__XXX
 SG_ VCFRONT1_a251_clampLowSideCheckR m251 : 21|2@1+ (1,0) [0|3] "" Vector__XXX
 SG_ VCFRONT1_a251_clampLowSideFailur m251 : 24|3@1+ (1,0) [0|7] "" Vector__XXX
 SG_ VCFRONT1_a251_rationalityShutdow m251 : 27|2@1+ (1,0) [0|3] "" Vector__XXX
 SG_ VCFRONT1_a251_rationalitySh_0001 m251 : 29|3@1+ (1,0) [0|7] "" Vector__XXX
 SG_ VCFRONT1_a251_clampHighSideCheck m251 : 32|2@1+ (1,0) [0|3] "" Vector__XXX
 SG_ VCFRONT1_a251_clampHighSideFailu m251 : 34|3@1+ (1,0) [0|7] "" Vector__XXX
 SG_ VCFRONT1_a251_rationalityPcsShut m251 : 37|2@1+ (1,0) [0|3] "" Vector__XXX
 SG_ VCFRONT1_a251_rationalityPc_0001 m251 : 40|3@1+ (1,0) [0|7] "" Vector__XXX
 SG_ VCFRONT1_a251_testTimedOut m251 : 43|1@1+ (1,0) [0|1] "" Vector__XXX
 SG_ VCFRONT1_a252_stage m252 : 16|3@1+ (1,0) [0|7] "" Vector__XXX
 SG_ VCFRONT1_a252_incorrectPinConfig m252 : 19|1@1+ (1,0) [0|1] "" Vector__XXX
 SG_ VCFRONT1_a252_incorrectClampMoni m252 : 20|1@1+ (1,0) [0|1] "" Vector__XXX
 SG_ VCFRONT1_a252_incorrectClam_0001 m252 : 21|1@1+ (1,0) [0|1] "" Vector__XXX
 SG_ VCFRONT1_a252_incorrectClam_0002 m252 : 22|1@1+ (1,0) [0|1] "" Vector__XXX
 SG_ VCFRONT1_a252_incorrectPcsEnable m252 : 23|1@1+ (1,0) [0|1] "" Vector__XXX
 SG_ VCFRONT1_a252_incorrectPcsTripSt m252 : 24|1@1+ (1,0) [0|1] "" Vector__XXX
 SG_ VCFRONT1_a252_incorrectPcsSuppor m252 : 25|1@1+ (1,0) [0|1] "" Vector__XXX
 SG_ VCFRONT1_a252_incorrectPcsDcdcEn m252 : 26|1@1+ (1,0) [0|1] "" Vector__XXX
 SG_ VCFRONT1_a252_pcsOvShutdownFault m252 : 27|1@1+ (1,0) [0|1] "" Vector__XXX
 SG_ VCFRONT1_a252_pcsOvShutdownArmed m252 : 28|1@1+ (1,0) [0|1] "" Vector__XXX
 SG_ VCFRONT1_a252_pcsSupporting m252 : 29|1@1+ (1,0) [0|1] "" Vector__XXX
 SG_ VCFRONT1_a252_pcsDcdcEnableFeedb m252 : 30|1@1+ (1,0) [0|1] "" Vector__XXX
 SG_ VCFRONT1_a252_pcsOvClampArmed m252 : 31|1@1+ (1,0) [0|1] "" Vector__XXX
 SG_ VCFRONT1_a252_pcsOvSelfTestEnabl m252 : 32|1@1+ (1,0) [0|1] "" Vector__XXX
 SG_ VCFRONT1_a252_busVoltage m252 : 33|10@1+ (0.025,0) [0|25.575] "V" Vector__XXX
 SG_ VCFRONT1_a252_dcdcEnableLineVolt m252 : 43|10@1+ (0.025,0) [0|25.575] "V" Vector__XXX
 SG_ VCFRONT1_a252_ovClampMonitorChan m252 : 53|2@1+ (1,0) [0|3] "" Vector__XXX
 SG_ VCFRONT1_a252_ovClampMonitorVolt m252 : 55|9@1+ (0.05,0) [0|25.55] "V" Vector__XXX
 SG_ VCFRONT1_a262_eFuseVoltage m262 : 16|16@1+ (0.1,0) [0|6553.5] "V" Vector__XXX
 SG_ VCFRONT1_a262_vbatProtVoltage m262 : 32|16@1+ (0.1,0) [0|6553.5] "V" Vector__XXX
 SG_ VCFRONT1_a263_eFuseVoltage m263 : 16|16@1+ (0.1,0) [0|6553.5] "V" Vector__XXX
 SG_ VCFRONT1_a263_vbatProtVoltage m263 : 32|16@1+ (0.1,0) [0|6553.5] "V" Vector__XXX
 SG_ VCFRONT1_a264_eFuseVoltage m264 : 16|16@1+ (0.1,0) [0|6553.5] "V" Vector__XXX
 SG_ VCFRONT1_a264_vbatProtVoltage m264 : 32|16@1+ (0.1,0) [0|6553.5] "V" Vector__XXX
 SG_ VCFRONT1_a266_eFuseVoltage m266 : 16|16@1+ (0.1,0) [0|6553.5] "V" Vector__XXX
 SG_ VCFRONT1_a266_vbatProtVoltage m266 : 32|16@1+ (0.1,0) [0|6553.5] "V" Vector__XXX
 SG_ VCFRONT1_a414_failureReason m414 : 16|6@1+ (1,0) [0|63] "" Vector__XXX
 SG_ VCFRONT1_a414_loadUnattemptedOnF m414 : 22|1@1+ (1,0) [0|1] "" Vector__XXX
 SG_ VCFRONT1_a414_deviceStuckOnFailu m414 : 23|1@1+ (1,0) [0|1] "" Vector__XXX
 SG_ VCFRONT1_a414_followerVCRightSel m414 : 24|1@1+ (1,0) [0|1] "" Vector__XXX
 SG_ VCFRONT1_a414_bridgeFailedToOpen m414 : 25|1@1+ (1,0) [0|1] "" Vector__XXX
 SG_ VCFRONT1_a414_uvLoadshedVsenseDi m414 : 26|1@1+ (1,0) [0|1] "" Vector__XXX
 SG_ VCFRONT1_a415_upstreamEFuseStuck m415 : 16|1@1+ (1,0) [0|1] "" Vector__XXX
 SG_ VCFRONT1_a475_channel m475 : 16|3@1+ (1,0) [0|7] "" Vector__XXX
 SG_ VCFRONT1_a475_reset m475 : 19|1@1+ (1,0) [0|1] "" Vector__XXX
 SG_ VCFRONT1_a475_spiError m475 : 20|1@1+ (1,0) [0|1] "" Vector__XXX
 SG_ VCFRONT1_a475_autoOn m475 : 21|1@1+ (1,0) [0|1] "" Vector__XXX
 SG_ VCFRONT1_a475_diagnosticBit m475 : 22|1@1+ (1,0) [0|1] "" Vector__XXX
 SG_ VCFRONT1_a475_deviceError m475 : 23|1@1+ (1,0) [0|1] "" Vector__XXX
 SG_ VCFRONT1_a475_unexpectedLock m475 : 24|1@1+ (1,0) [0|1] "" Vector__XXX
 SG_ VCFRONT1_a475_unexpectedFailSafe m475 : 25|1@1+ (1,0) [0|1] "" Vector__XXX
 SG_ VCFRONT1_a475_disableOutputFault m475 : 26|1@1+ (1,0) [0|1] "" Vector__XXX
 SG_ VCFRONT1_a475_vsUndervoltage m475 : 27|1@1+ (1,0) [0|1] "" Vector__XXX
 SG_ VCFRONT1_a475_hardShort m475 : 28|1@1+ (1,0) [0|1] "" Vector__XXX
 SG_ VCFRONT1_a475_prechargeFailure m475 : 29|1@1+ (1,0) [0|1] "" Vector__XXX
 SG_ VCFRONT1_a475_vdsMax m475 : 30|1@1+ (1,0) [0|1] "" Vector__XXX
 SG_ VCFRONT1_a475_bypassSaturation m475 : 31|1@1+ (1,0) [0|1] "" Vector__XXX
 SG_ VCFRONT1_a475_fuseLatch m475 : 32|1@1+ (1,0) [0|1] "" Vector__XXX
 SG_ VCFRONT1_a475_deviceOvertemperat m475 : 33|1@1+ (1,0) [0|1] "" Vector__XXX
 SG_ VCFRONT1_a475_ntcOvertemperature m475 : 34|1@1+ (1,0) [0|1] "" Vector__XXX
 SG_ VCFRONT1_a475_vgsLow m475 : 35|1@1+ (1,0) [0|1] "" Vector__XXX
 SG_ VCFRONT1_a475_chargePumpLow m475 : 36|1@1+ (1,0) [0|1] "" Vector__XXX
 SG_ VCFRONT1_a475_watchdog m475 : 37|1@1+ (1,0) [0|1] "" Vector__XXX
 SG_ VCFRONT1_a475_spiNotDone m475 : 38|1@1+ (1,0) [0|1] "" Vector__XXX
 SG_ VCFRONT1_a475_csUndervoltage m475 : 39|1@1+ (1,0) [0|1] "" Vector__XXX
 SG_ VCFRONT1_a475_configIncorrect m475 : 40|1@1+ (1,0) [0|1] "" Vector__XXX
 SG_ VCFRONT1_a475_bufferFull m475 : 41|1@1+ (1,0) [0|1] "" Vector__XXX
 SG_ VCFRONT1_a475_hitAlertRateLimit m475 : 42|1@1+ (1,0) [0|1] "" Vector__XXX
 SG_ VCFRONT1_a475_hwlo m475 : 43|1@1+ (1,0) [0|1] "" Vector__XXX
 SG_ VCFRONT1_a475_dinState m475 : 44|1@1+ (1,0) [0|1] "" Vector__XXX
 SG_ VCFRONT1_a475_enable m475 : 45|1@1+ (1,0) [0|1] "" Vector__XXX
 SG_ VCFRONT1_a480_channel m480 : 16|2@1+ (1,0) [0|3] "" Vector__XXX
 SG_ VCFRONT1_a480_reset m480 : 18|1@1+ (1,0) [0|1] "" Vector__XXX
 SG_ VCFRONT1_a480_spiError m480 : 19|1@1+ (1,0) [0|1] "" Vector__XXX
 SG_ VCFRONT1_a480_autoOn m480 : 20|1@1+ (1,0) [0|1] "" Vector__XXX
 SG_ VCFRONT1_a480_diagnosticBit m480 : 21|1@1+ (1,0) [0|1] "" Vector__XXX
 SG_ VCFRONT1_a480_deviceError m480 : 22|1@1+ (1,0) [0|1] "" Vector__XXX
 SG_ VCFRONT1_a480_overcurrent m480 : 23|1@1+ (1,0) [0|1] "" Vector__XXX
 SG_ VCFRONT1_a480_unexpectedLock m480 : 24|1@1+ (1,0) [0|1] "" Vector__XXX
 SG_ VCFRONT1_a480_disableOutputFault m480 : 25|1@1+ (1,0) [0|1] "" Vector__XXX
 SG_ VCFRONT1_a480_vsUndervoltage m480 : 26|1@1+ (1,0) [0|1] "" Vector__XXX
 SG_ VCFRONT1_a480_hardShort m480 : 27|1@1+ (1,0) [0|1] "" Vector__XXX
 SG_ VCFRONT1_a480_vdsMax m480 : 28|1@1+ (1,0) [0|1] "" Vector__XXX
 SG_ VCFRONT1_a480_bypassSaturation m480 : 29|1@1+ (1,0) [0|1] "" Vector__XXX
 SG_ VCFRONT1_a480_fuseLatch m480 : 30|1@1+ (1,0) [0|1] "" Vector__XXX
 SG_ VCFRONT1_a480_deviceOvertemperat m480 : 31|1@1+ (1,0) [0|1] "" Vector__XXX
 SG_ VCFRONT1_a480_ntcOvertemperature m480 : 32|1@1+ (1,0) [0|1] "" Vector__XXX
 SG_ VCFRONT1_a480_vgsLow m480 : 33|1@1+ (1,0) [0|1] "" Vector__XXX
 SG_ VCFRONT1_a480_chargePumpLow m480 : 34|1@1+ (1,0) [0|1] "" Vector__XXX
 SG_ VCFRONT1_a480_watchdog m480 : 35|1@1+ (1,0) [0|1] "" Vector__XXX
 SG_ VCFRONT1_a480_spiNotDone m480 : 36|1@1+ (1,0) [0|1] "" Vector__XXX
 SG_ VCFRONT1_a480_configIncorrect m480 : 37|1@1+ (1,0) [0|1] "" Vector__XXX
 SG_ VCFRONT1_a480_bufferFull m480 : 38|1@1+ (1,0) [0|1] "" Vector__XXX
 SG_ VCFRONT1_a480_hitAlertRateLimit m480 : 39|1@1+ (1,0) [0|1] "" Vector__XXX
 SG_ VCFRONT1_a480_hwlo m480 : 40|1@1+ (1,0) [0|1] "" Vector__XXX
 SG_ VCFRONT1_a480_enable m480 : 41|1@1+ (1,0) [0|1] "" Vector__XXX
 SG_ VCFRONT1_a482_lvBridgeEFuseCurre m482 : 16|16@1+ (0.1,0) [0|6553.5] "A" Vector__XXX
 SG_ VCFRONT1_a482_lvBridgeEFuseVolta m482 : 32|16@1+ (0.1,0) [0|6553.5] "V" Vector__XXX
 SG_ VCFRONT1_a482_lvBridgeEFuseTemp m482 : 48|11@1+ (0.125,-40) [-40|215.875] "degC" Vector__XXX
 SG_ VCFRONT1_a484_upstreamEFuseStuck m484 : 16|1@1+ (1,0) [0|1] "" Vector__XXX
 SG_ VCFRONT1_a484_upstreamEFuseVolta m484 : 17|6@1+ (1,0) [0|63] "V" Vector__XXX
 SG_ VCFRONT1_a484_vbusVoltage m484 : 24|6@1+ (1,0) [0|63] "V" Vector__XXX
 SG_ VCFRONT1_a484_upstreamEFuseRatio m484 : 32|7@1+ (1,0) [0|127] "%" Vector__XXX
 SG_ VCFRONT1_a485_upstreamEfuseUnatt m485 : 16|1@1+ (1,0) [0|1] "" Vector__XXX
 SG_ VCFRONT1_a486_bridgeFailedArming m486 : 16|1@1+ (1,0) [0|1] "" Vector__XXX
 SG_ VCFRONT1_a486_bridgeFailedSyncCh m486 : 17|1@1+ (1,0) [0|1] "" Vector__XXX
 SG_ VCFRONT1_a486_localBridgeOutputO m486 : 18|1@1+ (1,0) [0|1] "" Vector__XXX
 SG_ VCFRONT1_a486_localBridgeSyncArm m486 : 19|1@1+ (1,0) [0|1] "" Vector__XXX
 SG_ VCFRONT1_a486_localBridgeDinStat m486 : 20|1@1+ (1,0) [0|1] "" Vector__XXX
 SG_ VCFRONT1_a486_remoteBridgeOutput m486 : 21|1@1+ (1,0) [0|1] "" Vector__XXX
 SG_ VCFRONT1_a486_remoteBridgeO_0001 m486 : 22|1@1+ (1,0) [0|1] "" Vector__XXX
 SG_ VCFRONT1_a486_remoteBridgeSyncAr m486 : 23|1@1+ (1,0) [0|1] "" Vector__XXX
 SG_ VCFRONT1_a486_remoteBridgeS_0001 m486 : 24|1@1+ (1,0) [0|1] "" Vector__XXX
 SG_ VCFRONT1_a486_remoteBridgeDinSta m486 : 25|1@1+ (1,0) [0|1] "" Vector__XXX
 SG_ VCFRONT1_a486_remoteBridgeD_0001 m486 : 26|1@1+ (1,0) [0|1] "" Vector__XXX
 SG_ VCFRONT1_a496_serviceMode m496 : 16|1@1+ (1,0) [0|1] "" Vector__XXX
 SG_ VCFRONT1_a496_frunkOpen m496 : 17|1@1+ (1,0) [0|1] "" Vector__XXX
 SG_ VCFRONT1_a496_NotEnoughPowerForS m496 : 18|1@1+ (1,0) [0|1] "" Vector__XXX
 SG_ VCFRONT1_a496_bmsState m496 : 19|4@1+ (1,0) [0|15] "" Vector__XXX
 SG_ VCFRONT1_a500_channel m500 : 16|8@1+ (1,0) [0|255] "" Vector__XXX
 SG_ VCFRONT1_a500_mismatchedState m500 : 24|3@1+ (1,0) [0|7] "" Vector__XXX
 SG_ VCFRONT1_a509_channel m509 : 16|3@1+ (1,0) [0|7] "" Vector__XXX
 SG_ VCFRONT1_a509_state m509 : 19|3@1+ (1,0) [0|7] "" Vector__XXX
 SG_ VCFRONT1_a509_expectedState m509 : 24|3@1+ (1,0) [0|7] "" Vector__XXX
 SG_ VCFRONT1_a509_hardwareLockout m509 : 27|1@1+ (1,0) [0|1] "" Vector__XXX
 SG_ VCFRONT1_a509_unlocksRemaining m509 : 32|8@1+ (1,0) [0|255] "" Vector__XXX
 SG_ VCFRONT1_a523_channel m523 : 16|8@1+ (1,0) [0|255] "" Vector__XXX
 SG_ VCFRONT1_a523_control2Byte1 m523 : 24|8@1+ (1,0) [0|255] "" Vector__XXX
 SG_ VCFRONT1_a523_control2Byte2 m523 : 32|8@1+ (1,0) [0|255] "" Vector__XXX
 SG_ VCFRONT1_a523_control2Byte3 m523 : 40|8@1+ (1,0) [0|255] "" Vector__XXX
 SG_ VCFRONT1_a523_control3Byte2 m523 : 48|8@1+ (1,0) [0|255] "" Vector__XXX
 SG_ VCFRONT1_a523_control3Byte3 m523 : 56|8@1+ (1,0) [0|255] "" Vector__XXX
 SG_ VCFRONT1_a574_frontDriveInverter m574 : 16|16@1+ (0.1,0) [0|6553.5] "A" Vector__XXX
 SG_ VCFRONT1_a574_frontDriveInv_0001 m574 : 32|8@1+ (1,0) [0|255] "" Vector__XXX
 SG_ VCFRONT1_a596_vcrightCutoffEFuse m596 : 16|1@1+ (1,0) [0|1] "" Vector__XXX
 SG_ VCFRONT1_a596_vcrightCutoffCurve m596 : 17|3@1+ (1,0) [0|7] "" Vector__XXX
 SG_ VCFRONT1_a596_vcrightCutoffATerm m596 : 24|16@1+ (50,0) [0|3276700] "-" Vector__XXX
 SG_ VCFRONT1_a596_vcrightCutoffBTerm m596 : 40|8@1- (1,-78) [-206|49] "-" Vector__XXX
 SG_ VCFRONT1_a596_vcrightCutoffCTerm m596 : 48|16@1- (50,0) [-1638400|1638350] "-" Vector__XXX
 SG_ VCFRONT1_a597_vcrightCutoffEFuse m597 : 16|1@1+ (1,0) [0|1] "" Vector__XXX
 SG_ VCFRONT1_a597_vcrightCutoffCurre m597 : 17|12@1+ (0.1,0) [0|409.5] "A" Vector__XXX
 SG_ VCFRONT1_a597_vcrightCutoffTimin m597 : 32|16@1+ (1,0) [0|65535] "" Vector__XXX
 SG_ VCFRONT1_a597_vcrightCutoffMaxCo m597 : 48|5@1+ (1,0) [0|31] "" Vector__XXX

BO_ 833 VCFRONT1_alertMatrix: 8 VCFRONT1
 SG_ VCFRONT1_matrixIndex M : 0|4@1+ (1,0) [0|15] "" Vector__XXX
 SG_ VCFRONT1_a001_WatchdogReset m0 : 4|1@1+ (1,0) [0|1] "" Vector__XXX
 SG_ VCFRONT1_a002_PowerLossReset m0 : 5|1@1+ (1,0) [0|1] "" Vector__XXX
 SG_ VCFRONT1_a003_SWAssertion m0 : 6|1@1+ (1,0) [0|1] "" Vector__XXX
 SG_ VCFRONT1_a005_CANTXError m0 : 8|1@1+ (1,0) [0|1] "" Vector__XXX
 SG_ VCFRONT1_a006_CANTX_cyclicError m0 : 9|1@1+ (1,0) [0|1] "" Vector__XXX
 SG_ VCFRONT1_a012_CPUReset m0 : 15|1@1+ (1,0) [0|1] "" Vector__XXX
 SG_ VCFRONT1_a013_AlertManagerFault m0 : 16|1@1+ (1,0) [0|1] "" Vector__XXX
 SG_ VCFRONT1_a015_NVMMError m0 : 18|1@1+ (1,0) [0|1] "" Vector__XXX
 SG_ VCFRONT1_a016_NVMMRecordError m0 : 19|1@1+ (1,0) [0|1] "" Vector__XXX
 SG_ VCFRONT1_a017_NVMMStatusDbg m0 : 20|1@1+ (1,0) [0|1] "" Vector__XXX
 SG_ VCFRONT1_a018_HardFault m0 : 21|1@1+ (1,0) [0|1] "" Vector__XXX
 SG_ VCFRONT1_a019_BusFault m0 : 22|1@1+ (1,0) [0|1] "" Vector__XXX
 SG_ VCFRONT1_a021_TaskSchedulerError m0 : 24|1@1+ (1,0) [0|1] "" Vector__XXX
 SG_ VCFRONT1_a022_TaskInitError m0 : 25|1@1+ (1,0) [0|1] "" Vector__XXX
 SG_ VCFRONT1_a028_UsageFault m0 : 31|1@1+ (1,0) [0|1] "" Vector__XXX
 SG_ VCFRONT1_a029_CoreDump m0 : 32|1@1+ (1,0) [0|1] "" Vector__XXX
 SG_ VCFRONT1_a030_ECULogUploadReques m0 : 33|1@1+ (1,0) [0|1] "" Vector__XXX
 SG_ VCFRONT1_a031_UDSActive m0 : 34|1@1+ (1,0) [0|1] "" Vector__XXX
 SG_ VCFRONT1_a036_UnknownIrq m0 : 39|1@1+ (1,0) [0|1] "" Vector__XXX
 SG_ VCFRONT1_a037_MemManageFault m0 : 40|1@1+ (1,0) [0|1] "" Vector__XXX
 SG_ VCFRONT1_a038_ProtFaultInfo m0 : 41|1@1+ (1,0) [0|1] "" Vector__XXX
 SG_ VCFRONT1_a039_ProtFaultAddress m0 : 42|1@1+ (1,0) [0|1] "" Vector__XXX
 SG_ VCFRONT1_a040_Backtrace m0 : 43|1@1+ (1,0) [0|1] "" Vector__XXX
 SG_ VCFRONT1_a041_HighCPULoad m0 : 44|1@1+ (1,0) [0|1] "" Vector__XXX
 SG_ VCFRONT1_a042_HighStackUsage m0 : 45|1@1+ (1,0) [0|1] "" Vector__XXX
 SG_ VCFRONT1_a043_Task1msError m0 : 46|1@1+ (1,0) [0|1] "" Vector__XXX
 SG_ VCFRONT1_a044_Task10msError m0 : 47|1@1+ (1,0) [0|1] "" Vector__XXX
 SG_ VCFRONT1_a045_Task100msError m0 : 48|1@1+ (1,0) [0|1] "" Vector__XXX
 SG_ VCFRONT1_a046_Task1000msError m0 : 49|1@1+ (1,0) [0|1] "" Vector__XXX
 SG_ VCFRONT1_a058_inputRHighSyncDebu m0 : 61|1@1+ (1,0) [0|1] "" Vector__XXX
 SG_ VCFRONT1_a059_inputResistanceHig m0 : 62|1@1+ (1,0) [0|1] "" Vector__XXX
 SG_ VCFRONT1_a060_engineeringBuild m0 : 63|1@1+ (1,0) [0|1] "" Vector__XXX
 SG_ VCFRONT1_a061_XCPConnected m1 : 4|1@1+ (1,0) [0|1] "" Vector__XXX
 SG_ VCFRONT1_a062_XCPWasConnected m1 : 5|1@1+ (1,0) [0|1] "" Vector__XXX
 SG_ VCFRONT1_a063_SwitchFault m1 : 6|1@1+ (1,0) [0|1] "" Vector__XXX
 SG_ VCFRONT1_a064_busSleepReqTimeout m1 : 7|1@1+ (1,0) [0|1] "" Vector__XXX
 SG_ VCFRONT1_a077_VCBATT0_MIA m1 : 20|1@1+ (1,0) [0|1] "" Vector__XXX
 SG_ VCFRONT1_a078_VCBATT1_MIA m1 : 21|1@1+ (1,0) [0|1] "" Vector__XXX
 SG_ VCFRONT1_a079_VCBATT2_MIA m1 : 22|1@1+ (1,0) [0|1] "" Vector__XXX
 SG_ VCFRONT1_a080_VCFRONT0_MIA m1 : 23|1@1+ (1,0) [0|1] "" Vector__XXX
 SG_ VCFRONT1_a081_VCFRONT1_MIA m1 : 24|1@1+ (1,0) [0|1] "" Vector__XXX
 SG_ VCFRONT1_a082_VCFRONT2_MIA m1 : 25|1@1+ (1,0) [0|1] "" Vector__XXX
 SG_ VCFRONT1_a086_VCBATT_MIA m1 : 29|1@1+ (1,0) [0|1] "" Vector__XXX
 SG_ VCFRONT1_a090_APS_MIA m1 : 33|1@1+ (1,0) [0|1] "" Vector__XXX
 SG_ VCFRONT1_a091_CMPD_MIA m1 : 34|1@1+ (1,0) [0|1] "" Vector__XXX
 SG_ VCFRONT1_a096_OCS1P_MIA m1 : 39|1@1+ (1,0) [0|1] "" Vector__XXX
 SG_ VCFRONT1_a098_DIR_MIA m1 : 41|1@1+ (1,0) [0|1] "" Vector__XXX
 SG_ VCFRONT1_a100_CANbus_MIA m1 : 43|1@1+ (1,0) [0|1] "" Vector__XXX
 SG_ VCFRONT1_a103_CP_MIA m1 : 46|1@1+ (1,0) [0|1] "" Vector__XXX
 SG_ VCFRONT1_a104_DAS_MIA m1 : 47|1@1+ (1,0) [0|1] "" Vector__XXX
 SG_ VCFRONT1_a105_TAS_MIA m1 : 48|1@1+ (1,0) [0|1] "" Vector__XXX
 SG_ VCFRONT1_a106_PCS_MIA m1 : 49|1@1+ (1,0) [0|1] "" Vector__XXX
 SG_ VCFRONT1_a107_BMS_MIA m1 : 50|1@1+ (1,0) [0|1] "" Vector__XXX
 SG_ VCFRONT1_a108_DIF_MIA m1 : 51|1@1+ (1,0) [0|1] "" Vector__XXX
 SG_ VCFRONT1_a109_RCM_MIA m1 : 52|1@1+ (1,0) [0|1] "" Vector__XXX
 SG_ VCFRONT1_a110_GTW_MIA m1 : 53|1@1+ (1,0) [0|1] "" Vector__XXX
 SG_ VCFRONT1_a111_EPBR_MIA m1 : 54|1@1+ (1,0) [0|1] "" Vector__XXX
 SG_ VCFRONT1_a112_EPBL_MIA m1 : 55|1@1+ (1,0) [0|1] "" Vector__XXX
 SG_ VCFRONT1_a113_UI_MIA m1 : 56|1@1+ (1,0) [0|1] "" Vector__XXX
 SG_ VCFRONT1_a114_ESP_MIA m1 : 57|1@1+ (1,0) [0|1] "" Vector__XXX
 SG_ VCFRONT1_a115_VCSEC_MIA m1 : 58|1@1+ (1,0) [0|1] "" Vector__XXX
 SG_ VCFRONT1_a116_VCRIGHT_MIA m1 : 59|1@1+ (1,0) [0|1] "" Vector__XXX
 SG_ VCFRONT1_a117_VCLEFT_MIA m1 : 60|1@1+ (1,0) [0|1] "" Vector__XXX
 SG_ VCFRONT1_a118_VCFRONT_MIA m1 : 61|1@1+ (1,0) [0|1] "" Vector__XXX
 SG_ VCFRONT1_a119_SCCM_MIA m1 : 62|1@1+ (1,0) [0|1] "" Vector__XXX
 SG_ VCFRONT1_a120_DI_DRIVE_MIA m1 : 63|1@1+ (1,0) [0|1] "" Vector__XXX
 SG_ VCFRONT1_a122_ICR_MIA m2 : 5|1@1+ (1,0) [0|1] "" Vector__XXX
 SG_ VCFRONT1_a124_BB_MIA m2 : 7|1@1+ (1,0) [0|1] "" Vector__XXX
 SG_ VCFRONT1_a125_SCCM_MIA m2 : 8|1@1+ (1,0) [0|1] "" Vector__XXX
 SG_ VCFRONT1_a126_EPAS3P_MIA m2 : 9|1@1+ (1,0) [0|1] "" Vector__XXX
 SG_ VCFRONT1_a127_iBoosterEFuseTrip m2 : 10|1@1+ (1,0) [0|1] "" Vector__XXX
 SG_ VCFRONT1_a128_vcrightEFuseTrip m2 : 11|1@1+ (1,0) [0|1] "" Vector__XXX
 SG_ VCFRONT1_a129_pcsEFuseTrip m2 : 12|1@1+ (1,0) [0|1] "" Vector__XXX
 SG_ VCFRONT1_a130_autopilot2EFuseTri m2 : 13|1@1+ (1,0) [0|1] "" Vector__XXX
 SG_ VCFRONT1_a131_PCSCOMMON_MIA m2 : 14|1@1+ (1,0) [0|1] "" Vector__XXX
 SG_ VCFRONT1_a132_epas2EFuseTrip m2 : 15|1@1+ (1,0) [0|1] "" Vector__XXX
 SG_ VCFRONT1_a133_BRAKE_MIA m2 : 16|1@1+ (1,0) [0|1] "" Vector__XXX
 SG_ VCFRONT1_a134_hvContactorsEFuseT m2 : 17|1@1+ (1,0) [0|1] "" Vector__XXX
 SG_ VCFRONT1_a135_leftHeadlightEFuse m2 : 18|1@1+ (1,0) [0|1] "" Vector__XXX
 SG_ VCFRONT1_a144_EPAS3S_MIA m2 : 27|1@1+ (1,0) [0|1] "" Vector__XXX
 SG_ VCFRONT1_a164_eFuseLckoutMissing m2 : 47|1@1+ (1,0) [0|1] "" Vector__XXX
 SG_ VCFRONT1_a165_unxpctdEFuseLckout m2 : 48|1@1+ (1,0) [0|1] "" Vector__XXX
 SG_ VCFRONT1_a177_mcuAudioEFuseTrip m2 : 60|1@1+ (1,0) [0|1] "" Vector__XXX
 SG_ VCFRONT1_a188_sleepFailed m3 : 11|1@1+ (1,0) [0|1] "" Vector__XXX
 SG_ VCFRONT1_a191_exitDriveDomainDow m3 : 14|1@1+ (1,0) [0|1] "" Vector__XXX
 SG_ VCFRONT1_a204_undervoltageLoadsh m3 : 27|1@1+ (1,0) [0|1] "" Vector__XXX
 SG_ VCFRONT1_a205_overvoltageProtect m3 : 28|1@1+ (1,0) [0|1] "" Vector__XXX
 SG_ VCFRONT1_a214_openCircuitDetecte m3 : 37|1@1+ (1,0) [0|1] "" Vector__XXX
 SG_ VCFRONT1_a216_powerCutoffImminen m3 : 39|1@1+ (1,0) [0|1] "" Vector__XXX
 SG_ VCFRONT1_a220_LVUnhealthy m3 : 43|1@1+ (1,0) [0|1] "" Vector__XXX
 SG_ VCFRONT1_a223_bridgeOvervoltageS m3 : 46|1@1+ (1,0) [0|1] "" Vector__XXX
 SG_ VCFRONT1_a229_LVHealthCompromise m3 : 52|1@1+ (1,0) [0|1] "" Vector__XXX
 SG_ VCFRONT1_a230_autopilot2EFuseTri m3 : 53|1@1+ (1,0) [0|1] "" Vector__XXX
 SG_ VCFRONT1_a249_pcsOvClampTripped m4 : 12|1@1+ (1,0) [0|1] "" Vector__XXX
 SG_ VCFRONT1_a250_pcsOvShutdownTripp m4 : 13|1@1+ (1,0) [0|1] "" Vector__XXX
 SG_ VCFRONT1_a251_pcsOvShutdownSelfT m4 : 14|1@1+ (1,0) [0|1] "" Vector__XXX
 SG_ VCFRONT1_a252_pcsOvShutdownSelfT m4 : 15|1@1+ (1,0) [0|1] "" Vector__XXX
 SG_ VCFRONT1_a253_pcsOvShutdownHighS m4 : 16|1@1+ (1,0) [0|1] "" Vector__XXX
 SG_ VCFRONT1_a256_nxppca9539Fault m4 : 19|1@1+ (1,0) [0|1] "" Vector__XXX
 SG_ VCFRONT1_a262_vcrightVoltageMism m4 : 25|1@1+ (1,0) [0|1] "" Vector__XXX
 SG_ VCFRONT1_a263_pcsVoltageMismatch m4 : 26|1@1+ (1,0) [0|1] "" Vector__XXX
 SG_ VCFRONT1_a264_iBoosterVoltageMis m4 : 27|1@1+ (1,0) [0|1] "" Vector__XXX
 SG_ VCFRONT1_a266_EPAS2VoltageMismat m4 : 29|1@1+ (1,0) [0|1] "" Vector__XXX
 SG_ VCFRONT1_a414_undervoltageSelfTe m6 : 57|1@1+ (1,0) [0|1] "" Vector__XXX
 SG_ VCFRONT1_a415_undervoltageSelfTe m6 : 58|1@1+ (1,0) [0|1] "" Vector__XXX
 SG_ VCFRONT1_a423_rtosSleepFailed m7 : 6|1@1+ (1,0) [0|1] "" Vector__XXX
 SG_ VCFRONT1_a450_doorWakeToOpenDBG m7 : 33|1@1+ (1,0) [0|1] "" Vector__XXX
 SG_ VCFRONT1_a475_vnf1248Fault m7 : 58|1@1+ (1,0) [0|1] "" Vector__XXX
 SG_ VCFRONT1_a480_vnf1048Fault m7 : 63|1@1+ (1,0) [0|1] "" Vector__XXX
 SG_ VCFRONT1_a482_lvBridgeEFuseTrip m8 : 5|1@1+ (1,0) [0|1] "" Vector__XXX
 SG_ VCFRONT1_a483_vnf1048SelfTestFai m8 : 6|1@1+ (1,0) [0|1] "" Vector__XXX
 SG_ VCFRONT1_a484_undervoltageSelfTe m8 : 7|1@1+ (1,0) [0|1] "" Vector__XXX
 SG_ VCFRONT1_a485_uvSelfTestLoadUnat m8 : 8|1@1+ (1,0) [0|1] "" Vector__XXX
 SG_ VCFRONT1_a486_undervoltageSelfTe m8 : 9|1@1+ (1,0) [0|1] "" Vector__XXX
 SG_ VCFRONT1_a489_vnf1248SelfTestDeb m8 : 12|1@1+ (1,0) [0|1] "" Vector__XXX
 SG_ VCFRONT1_a490_vnf1248SelfTestFai m8 : 13|1@1+ (1,0) [0|1] "" Vector__XXX
 SG_ VCFRONT1_a491_vnf1248Configurati m8 : 14|1@1+ (1,0) [0|1] "" Vector__XXX
 SG_ VCFRONT1_a496_exitDriveWarningDo m8 : 19|1@1+ (1,0) [0|1] "" Vector__XXX
 SG_ VCFRONT1_a500_eFuseASICStateMism m8 : 23|1@1+ (1,0) [0|1] "" Vector__XXX
 SG_ VCFRONT1_a501_vnf1048Configurati m8 : 24|1@1+ (1,0) [0|1] "" Vector__XXX
 SG_ VCFRONT1_a509_eFuseASICManagerSt m8 : 32|1@1+ (1,0) [0|1] "" Vector__XXX
 SG_ VCFRONT1_a523_eFuseThresholdsInc m8 : 46|1@1+ (1,0) [0|1] "" Vector__XXX
 SG_ VCFRONT1_a574_frontDriveInverter m9 : 37|1@1+ (1,0) [0|1] "" Vector__XXX
 SG_ VCFRONT1_a575_frontDriveInverter m9 : 38|1@1+ (1,0) [0|1] "" Vector__XXX
 SG_ VCFRONT1_a578_vbusFusedLoadShedE m9 : 41|1@1+ (1,0) [0|1] "" Vector__XXX
 SG_ VCFRONT1_a581_harnessResistanceI m9 : 44|1@1+ (1,0) [0|1] "" Vector__XXX
 SG_ VCFRONT1_a590_vcrightPwrRational m9 : 53|1@1+ (1,0) [0|1] "" Vector__XXX
 SG_ VCFRONT1_a591_vcrightFastBlowDet m9 : 54|1@1+ (1,0) [0|1] "" Vector__XXX
 SG_ VCFRONT1_a596_vcrightCurvePowerC m9 : 59|1@1+ (1,0) [0|1] "" Vector__XXX
 SG_ VCFRONT1_a597_vcrightFastBlowPow m9 : 60|1@1+ (1,0) [0|1] "" Vector__XXX
 SG_ VCFRONT1_a617_APP_MIA m10 : 20|1@1+ (1,0) [0|1] "" Vector__XXX

BO_ 1027 VCFRONT1_eFuseDebugStatus: 7 VCFRONT1
 SG_ VCFRONT1_eFuseDebugStatusIndex M : 0|3@1+ (1,0) [0|7] "" Vector__XXX
 SG_ VCFRONT1_EPAS2EFuseState m0 : 3|3@1+ (1,0) [0|7] "" Vector__XXX
 SG_ VCFRONT1_EPAS2EFuseCurrent m0 : 8|12@1+ (0.05,0) [0|204.75] "A" Vector__XXX
 SG_ VCFRONT1_EPAS2EFuseOutput m0 : 20|1@1+ (1,0) [0|1] "" Vector__XXX
 SG_ VCFRONT1_EPAS2EFuseOutputDesired m0 : 21|1@1+ (1,0) [0|1] "" Vector__XXX
 SG_ VCFRONT1_EPAS2EFuseBypass m0 : 22|1@1+ (1,0) [0|1] "" Vector__XXX
 SG_ VCFRONT1_EPAS2EFuseBypassDesired m0 : 23|1@1+ (1,0) [0|1] "" Vector__XXX
 SG_ VCFRONT1_EPAS2EFuseVoltage m0 : 24|8@1+ (0.07,0) [0|17.85] "V" Vector__XXX
 SG_ VCFRONT1_EPAS2EFuseTemperature m0 : 32|8@1+ (1,-40) [-40|150] "degC" Vector__XXX
 SG_ VCFRONT1_EPAS2EFuseManagerState m0 : 40|4@1+ (1,0) [0|15] "" Vector__XXX
 SG_ VCFRONT1_EPAS2EFuseHardShortThre m0 : 44|4@1+ (1,0) [0|15] "" Vector__XXX
 SG_ VCFRONT1_EPAS2EFuseOCThreshold m0 : 48|5@1+ (1,0) [0|31] "" Vector__XXX
 SG_ VCFRONT1_EPAS2EFuseType m0 : 53|2@1+ (1,0) [0|3] "" Vector__XXX
 SG_ VCFRONT1_rightControllerEFuseSta m1 : 3|3@1+ (1,0) [0|7] "" Vector__XXX
 SG_ VCFRONT1_rightControllerEFuseCur m1 : 8|12@1+ (0.05,0) [0|204.75] "A" Vector__XXX
 SG_ VCFRONT1_rightControllerEFuseOut m1 : 20|1@1+ (1,0) [0|1] "" Vector__XXX
 SG_ VCFRONT1_rightControllerEFu_0002 m1 : 21|1@1+ (1,0) [0|1] "" Vector__XXX
 SG_ VCFRONT1_rightControllerEFuseByp m1 : 22|1@1+ (1,0) [0|1] "" Vector__XXX
 SG_ VCFRONT1_rightControllerEFu_0001 m1 : 23|1@1+ (1,0) [0|1] "" Vector__XXX
 SG_ VCFRONT1_rightControllerEFuseVol m1 : 24|8@1+ (0.07,0) [0|17.85] "V" Vector__XXX
 SG_ VCFRONT1_rightControllerEFuseTem m1 : 32|8@1+ (1,-40) [-40|150] "degC" Vector__XXX
 SG_ VCFRONT1_rightControllerEFuseMan m1 : 40|4@1+ (1,0) [0|15] "" Vector__XXX
 SG_ VCFRONT1_rightControllerEFuseHar m1 : 44|4@1+ (1,0) [0|15] "" Vector__XXX
 SG_ VCFRONT1_rightControllerEFuseOCT m1 : 48|5@1+ (1,0) [0|31] "" Vector__XXX
 SG_ VCFRONT1_rightControllerEFuseTyp m1 : 53|2@1+ (1,0) [0|3] "" Vector__XXX
 SG_ VCFRONT1_autopilot2EFuseState m3 : 3|3@1+ (1,0) [0|7] "" Vector__XXX
 SG_ VCFRONT1_autopilot2EFuseCurrent m3 : 8|12@1+ (0.05,0) [0|204.75] "A" Vector__XXX
 SG_ VCFRONT1_autopilot2EFuseOutput m3 : 20|1@1+ (1,0) [0|1] "" Vector__XXX
 SG_ VCFRONT1_autopilot2EFuseOutputDe m3 : 21|1@1+ (1,0) [0|1] "" Vector__XXX
 SG_ VCFRONT1_autopilot2EFuseBypass m3 : 22|1@1+ (1,0) [0|1] "" Vector__XXX
 SG_ VCFRONT1_autopilot2EFuseBypassDe m3 : 23|1@1+ (1,0) [0|1] "" Vector__XXX
 SG_ VCFRONT1_autopilot2EFuseVoltage m3 : 24|8@1+ (0.07,0) [0|17.85] "V" Vector__XXX
 SG_ VCFRONT1_autopilot2EFuseTemperat m3 : 32|8@1+ (1,-40) [-40|150] "degC" Vector__XXX
 SG_ VCFRONT1_autopilot2EFuseManagerS m3 : 40|4@1+ (1,0) [0|15] "" Vector__XXX
 SG_ VCFRONT1_autopilot2EFuseHardShor m3 : 44|4@1+ (1,0) [0|15] "" Vector__XXX
 SG_ VCFRONT1_autopilot2EFuseOCThresh m3 : 48|5@1+ (1,0) [0|31] "" Vector__XXX
 SG_ VCFRONT1_autopilot2EFuseType m3 : 53|2@1+ (1,0) [0|3] "" Vector__XXX

BO_ 1581 VCFRONT1_udsResponse: 8 VCFRONT1
 SG_ VCFRONT1_udsResponseData : 7|64@0+ (1,0) [0|1.84467440737e+19] "" Vector__XXX

BO_TX_BU_ 1335 : VCFRONT1;
BO_TX_BU_ 833 : VCFRONT1;
BO_TX_BU_ 1027 : VCFRONT1;
BO_TX_BU_ 1581 : VCFRONT1;
CM_ BO_ 1335 "VCFRONT1 ECU message: alert log; frame length from the layout, not yet observed on a vehicle bus";
CM_ SG_ 1335 VCFRONT1_alertID "VCFRONT1 ECU: alert ID";
CM_ SG_ 1335 VCFRONT1_alertState "VCFRONT1 ECU: alert state";
CM_ SG_ 1335 VCFRONT1_a001_InternalWatchdog "VCFRONT1 ECU: a001 internal watchdog";
CM_ SG_ 1335 VCFRONT1_a015_NVMMMemOverflow "VCFRONT1 ECU: a015 NVMM mem overflow";
CM_ SG_ 1335 VCFRONT1_a015_NVMMFilesystemErro "VCFRONT1 ECU: a015 NVMM filesystem error";
CM_ SG_ 1335 VCFRONT1_a015_NVMMRecordIDError "VCFRONT1 ECU: a015 NVMM record ID error";
CM_ SG_ 1335 VCFRONT1_a059_voltageDrop "VCFRONT1 ECU: a059 voltage drop";
CM_ SG_ 1335 VCFRONT1_a059_resistanceEstimate "VCFRONT1 ECU: a059 resistance estimate";
CM_ SG_ 1335 VCFRONT1_a059_current "VCFRONT1 ECU: a059 current";
CM_ SG_ 1335 VCFRONT1_a063_switchChannel "VCFRONT1 ECU: a063 switch channel";
CM_ SG_ 1335 VCFRONT1_a063_switchType "VCFRONT1 ECU: a063 switch type";
CM_ SG_ 1335 VCFRONT1_a063_ADCVoltage "VCFRONT1 ECU: a063 ADC voltage";
CM_ SG_ 1335 VCFRONT1_a063_disconnected "VCFRONT1 ECU: a063 disconnected";
CM_ SG_ 1335 VCFRONT1_a063_indeterminate "VCFRONT1 ECU: a063 indeterminate";
CM_ SG_ 1335 VCFRONT1_a063_stuckActive "VCFRONT1 ECU: a063 stuck active";
CM_ SG_ 1335 VCFRONT1_a063_faulted "VCFRONT1 ECU: a063 faulted";
CM_ SG_ 1335 VCFRONT1_a091_FRONTIPC_faultsAnd "VCFRONT1 ECU: a091 FRONTIPC faults and extras";
CM_ SG_ 1335 VCFRONT1_a091_FRONTIPC_state "VCFRONT1 ECU: a091 FRONTIPC state";
CM_ SG_ 1335 VCFRONT1_a096_FRONTIPC_status "VCFRONT1 ECU: a096 FRONTIPC status";
CM_ SG_ 1335 VCFRONT1_a098_FRONTIPC_temperatu "VCFRONT1 ECU: a098 FRONTIPC temperature";
CM_ SG_ 1335 VCFRONT1_a098_FRONTIPC_thermalCo "VCFRONT1 ECU: a098 FRONTIPC thermal control";
CM_ SG_ 1335 VCFRONT1_a106_BATTIPC_dcdcRailSt "VCFRONT1 ECU: a106 BATTIPC dcdc rail status";
CM_ SG_ 1335 VCFRONT1_a106_BATTIPC_dcdcStatus "VCFRONT1 ECU: a106 BATTIPC dcdc status";
CM_ SG_ 1335 VCFRONT1_a106_VEH_dcdcStatus "VCFRONT1 ECU: a106 VEH dcdc status";
CM_ SG_ 1335 VCFRONT1_a106_VEH_thermalControl "VCFRONT1 ECU: a106 VEH thermal control";
CM_ SG_ 1335 VCFRONT1_a106_VEH_dcdcRailStatus "VCFRONT1 ECU: a106 VEH dcdc rail status";
CM_ SG_ 1335 VCFRONT1_a106_CH_dcdcRailStatus "VCFRONT1 ECU: a106 CH dcdc rail status";
CM_ SG_ 1335 VCFRONT1_a106_CH_alertMatrix "VCFRONT1 ECU: a106 CH alert matrix";
CM_ SG_ 1335 VCFRONT1_a106_FRONTIPC_thermalCo "VCFRONT1 ECU: a106 FRONTIPC thermal control";
CM_ SG_ 1335 VCFRONT1_a106_FRONTIPC_dcdcRailS "VCFRONT1 ECU: a106 FRONTIPC dcdc rail status";
CM_ SG_ 1335 VCFRONT1_a106_FRONTIPC_dcdcStatu "VCFRONT1 ECU: a106 FRONTIPC dcdc status";
CM_ SG_ 1335 VCFRONT1_a108_FRONTIPC_status "VCFRONT1 ECU: a108 FRONTIPC status";
CM_ SG_ 1335 VCFRONT1_a108_FRONTIPC_temperatu "VCFRONT1 ECU: a108 FRONTIPC temperature";
CM_ SG_ 1335 VCFRONT1_a108_FRONTIPC_thermalCo "VCFRONT1 ECU: a108 FRONTIPC thermal control";
CM_ SG_ 1335 VCFRONT1_a108_FRONTIPC_motorStat "VCFRONT1 ECU: a108 FRONTIPC motor status";
CM_ SG_ 1335 VCFRONT1_a120_BATTIPC_speed "VCFRONT1 ECU: a120 BATTIPC speed";
CM_ SG_ 1335 VCFRONT1_a120_FRONTIPC_speed "VCFRONT1 ECU: a120 FRONTIPC speed";
CM_ SG_ 1335 VCFRONT1_a120_FRONTIPC_systemSta "VCFRONT1 ECU: a120 FRONTIPC system status";
CM_ SG_ 1335 VCFRONT1_a120_BATTIPC_systemStat "VCFRONT1 ECU: a120 BATTIPC system status";
CM_ SG_ 1335 VCFRONT1_a120_FRONTIPC_systemPow "VCFRONT1 ECU: a120 FRONTIPC system power";
CM_ SG_ 1335 VCFRONT1_a120_FRONTIPC_autonomyH "VCFRONT1 ECU: a120 FRONTIPC autonomy health";
CM_ SG_ 1335 VCFRONT1_a120_BATTIPC_chassisCon "VCFRONT1 ECU: a120 BATTIPC chassis control2";
CM_ SG_ 1335 VCFRONT1_a120_FRONTIPC_chassisCo "VCFRONT1 ECU: a120 FRONTIPC chassis control2";
CM_ SG_ 1335 VCFRONT1_a120_FRONTIPC_odometerS "VCFRONT1 ECU: a120 FRONTIPC odometer status";
CM_ SG_ 1335 VCFRONT1_a124_FRONTIPC_status "VCFRONT1 ECU: a124 FRONTIPC status";
CM_ SG_ 1335 VCFRONT1_a124_BATTIPC_status "VCFRONT1 ECU: a124 BATTIPC status";
CM_ SG_ 1335 VCFRONT1_a125_FRONTIPC_leftStalk "VCFRONT1 ECU: a125 FRONTIPC left stalk";
CM_ SG_ 1335 VCFRONT1_a125_FRONTIPC_steerAngl "VCFRONT1 ECU: a125 FRONTIPC steer angle";
CM_ SG_ 1335 VCFRONT1_a125_FRONTIPC_info "VCFRONT1 ECU: a125 FRONTIPC info";
CM_ SG_ 1335 VCFRONT1_a126_FRONTIPC_sysStatus "VCFRONT1 ECU: a126 FRONTIPC sys status";
CM_ SG_ 1335 VCFRONT1_a126_BATTIPC_sysStatus "VCFRONT1 ECU: a126 BATTIPC sys status";
CM_ SG_ 1335 VCFRONT1_a126_FRONTIPC_status "VCFRONT1 ECU: a126 FRONTIPC status";
CM_ SG_ 1335 VCFRONT1_a126_BATTIPC_status "VCFRONT1 ECU: a126 BATTIPC status";
CM_ SG_ 1335 VCFRONT1_a127_iBoosterEFuseCurre "VCFRONT1 ECU: a127 i booster e fuse current";
CM_ SG_ 1335 VCFRONT1_a127_iBoosterEFuseVolta "VCFRONT1 ECU: a127 i booster e fuse voltage";
CM_ SG_ 1335 VCFRONT1_a127_iBoosterEFuseTemp "VCFRONT1 ECU: a127 i booster e fuse temp";
CM_ SG_ 1335 VCFRONT1_a128_vcrightEFuseCurren "VCFRONT1 ECU: a128 vcright e fuse current";
CM_ SG_ 1335 VCFRONT1_a128_vcrightEFuseVoltag "VCFRONT1 ECU: a128 vcright e fuse voltage";
CM_ SG_ 1335 VCFRONT1_a128_vcrightEFuseTemp "VCFRONT1 ECU: a128 vcright e fuse temp";
CM_ SG_ 1335 VCFRONT1_a128_vcrightEFuseRemain "VCFRONT1 ECU: a128 vcright e fuse remaining retries";
CM_ SG_ 1335 VCFRONT1_a129_pcsEFuseCurrent "VCFRONT1 ECU: a129 pcs e fuse current";
CM_ SG_ 1335 VCFRONT1_a129_pcsEFuseVoltage "VCFRONT1 ECU: a129 pcs e fuse voltage";
CM_ SG_ 1335 VCFRONT1_a129_pcsEFuseTemp "VCFRONT1 ECU: a129 pcs e fuse temp";
CM_ SG_ 1335 VCFRONT1_a129_pcsEFuseRemainingR "VCFRONT1 ECU: a129 pcs e fuse remaining retries";
CM_ SG_ 1335 VCFRONT1_a130_autopilot2EFuseCur "VCFRONT1 ECU: a130 autopilot2 e fuse current";
CM_ SG_ 1335 VCFRONT1_a130_autopilot2EFuseVol "VCFRONT1 ECU: a130 autopilot2 e fuse voltage";
CM_ SG_ 1335 VCFRONT1_a130_autopilot2EFuseTem "VCFRONT1 ECU: a130 autopilot2 e fuse temp";
CM_ SG_ 1335 VCFRONT1_a130_autopilot2EFuseRem "VCFRONT1 ECU: a130 autopilot2 e fuse remaining retries";
CM_ SG_ 1335 VCFRONT1_a131_FRONTIPC_power "VCFRONT1 ECU: a131 FRONTIPC power";
CM_ SG_ 1335 VCFRONT1_a131_BATTIPC_power "VCFRONT1 ECU: a131 BATTIPC power";
CM_ SG_ 1335 VCFRONT1_a132_epas2EFuseCurrent "VCFRONT1 ECU: a132 epas2 e fuse current";
CM_ SG_ 1335 VCFRONT1_a132_epas2EFuseVoltage "VCFRONT1 ECU: a132 epas2 e fuse voltage";
CM_ SG_ 1335 VCFRONT1_a132_epas2EFuseTemp "VCFRONT1 ECU: a132 epas2 e fuse temp";
CM_ SG_ 1335 VCFRONT1_a133_BATTIPC_primaryAct "VCFRONT1 ECU: a133 BATTIPC primary actuator";
CM_ SG_ 1335 VCFRONT1_a133_FRONTIPC_secondary "VCFRONT1 ECU: a133 FRONTIPC secondary actuator";
CM_ SG_ 1335 VCFRONT1_a135_leftHeadlightEFuse "VCFRONT1 ECU: a135 left headlight e fuse current";
CM_ SG_ 1335 VCFRONT1_a144_FRONTIPC_status "VCFRONT1 ECU: a144 FRONTIPC status";
CM_ SG_ 1335 VCFRONT1_a144_BATTIPC_status "VCFRONT1 ECU: a144 BATTIPC status";
CM_ SG_ 1335 VCFRONT1_a164_lockoutVoltage "VCFRONT1 ECU: a164 lockout voltage";
CM_ SG_ 1335 VCFRONT1_a165_lockoutVoltage "VCFRONT1 ECU: a165 lockout voltage";
CM_ SG_ 1335 VCFRONT1_a177_mcuAudioEFuseCurre "VCFRONT1 ECU: a177 mcu audio e fuse current";
CM_ SG_ 1335 VCFRONT1_a177_mcuAudioEFuseVolta "VCFRONT1 ECU: a177 mcu audio e fuse voltage";
CM_ SG_ 1335 VCFRONT1_a191_vehiclePowerState "VCFRONT1 ECU: a191 vehicle power state";
CM_ SG_ 1335 VCFRONT1_a191_hvState "VCFRONT1 ECU: a191 hv state";
CM_ SG_ 1335 VCFRONT1_a191_busVoltage "VCFRONT1 ECU: a191 bus voltage";
CM_ SG_ 1335 VCFRONT1_a191_serviceMode "Signal reported by VCFRONT1 ECU";
CM_ SG_ 1335 VCFRONT1_a191_frunkOpen "VCFRONT1 ECU: a191 frunk open";
CM_ SG_ 1335 VCFRONT1_a191_exitDriveWarningTi "VCFRONT1 ECU: a191 exit drive warning timer expired";
CM_ SG_ 1335 VCFRONT1_a191_NotEnoughPowerForS "VCFRONT1 ECU: a191 not enough power for support";
CM_ SG_ 1335 VCFRONT1_a191_bmsState "VCFRONT1 ECU: a191 bms state; raw 9 = signal not available (SNA)";
CM_ SG_ 1335 VCFRONT1_a204_vbusVoltage "VCFRONT1 ECU: a204 vbus voltage";
CM_ SG_ 1335 VCFRONT1_a204_BRailLocked "VCFRONT1 ECU: a204 b rail locked";
CM_ SG_ 1335 VCFRONT1_a204_uvLoadshedFaultInj "VCFRONT1 ECU: a204 uv loadshed fault inject";
CM_ SG_ 1335 VCFRONT1_a204_pcsBridgeCurrent "VCFRONT1 ECU: a204 pcs bridge current";
CM_ SG_ 1335 VCFRONT1_a205_busVoltage "VCFRONT1 ECU: a205 bus voltage";
CM_ SG_ 1335 VCFRONT1_a205_BRailLocked "VCFRONT1 ECU: a205 b rail locked";
CM_ SG_ 1335 VCFRONT1_a205_ovLoadshedFaultInj "VCFRONT1 ECU: a205 ov loadshed fault inject";
CM_ SG_ 1335 VCFRONT1_a205_pcsBridgeCurrent "VCFRONT1 ECU: a205 pcs bridge current";
CM_ SG_ 1335 VCFRONT1_a216_inDrive "VCFRONT1 ECU: a216 in drive";
CM_ SG_ 1335 VCFRONT1_a216_hvState "VCFRONT1 ECU: a216 hv state";
CM_ SG_ 1335 VCFRONT1_a216_vcrightFastBlowImm "VCFRONT1 ECU: a216 vcright fast blow imminent";
CM_ SG_ 1335 VCFRONT1_a216_vcrightFastBlowDeb "VCFRONT1 ECU: a216 vcright fast blow debounce imminent";
CM_ SG_ 1335 VCFRONT1_a216_vcrightStaticImmin "VCFRONT1 ECU: a216 vcright static imminent";
CM_ SG_ 1335 VCFRONT1_a216_vcrightDynamicImmi "VCFRONT1 ECU: a216 vcright dynamic imminent";
CM_ SG_ 1335 VCFRONT1_a220_DI_gear "VCFRONT1 ECU: a220 DI gear; raw 7 = signal not available (SNA)";
CM_ SG_ 1335 VCFRONT1_a220_redundancyRequired "VCFRONT1 ECU: a220 redundancy required";
CM_ SG_ 1335 VCFRONT1_a220_vehicleSpeed "VCFRONT1 ECU: a220 vehicle speed";
CM_ SG_ 1335 VCFRONT1_a220_lvHealthStatus "VCFRONT1 ECU: a220 lv health status";
CM_ SG_ 1335 VCFRONT1_a220_factoryMode "VCFRONT1 ECU: a220 factory mode";
CM_ SG_ 1335 VCFRONT1_a220_serviceMode "Signal reported by VCFRONT1 ECU";
CM_ SG_ 1335 VCFRONT1_a220_unhealthyReason "VCFRONT1 ECU: a220 unhealthy reason";
CM_ SG_ 1335 VCFRONT1_a223_failedArmingSetup "VCFRONT1 ECU: a223 failed arming setup";
CM_ SG_ 1335 VCFRONT1_a223_failedFaultInject "VCFRONT1 ECU: a223 failed fault inject";
CM_ SG_ 1335 VCFRONT1_a223_overvoltageFaultAc "VCFRONT1 ECU: a223 overvoltage fault active";
CM_ SG_ 1335 VCFRONT1_a223_sharedBridgeShutdo "VCFRONT1 ECU: a223 shared bridge shutdown active";
CM_ SG_ 1335 VCFRONT1_a223_timedOut "VCFRONT1 ECU: a223 timed out";
CM_ SG_ 1335 VCFRONT1_a229_bridgeOpened "VCFRONT1 ECU: a229 bridge opened";
CM_ SG_ 1335 VCFRONT1_a229_pcsMIA "VCFRONT1 ECU: a229 pcs MIA";
CM_ SG_ 1335 VCFRONT1_a229_pcsNotSupporting "VCFRONT1 ECU: a229 pcs not supporting";
CM_ SG_ 1335 VCFRONT1_a250_pcsOvShutdownFault "VCFRONT1 ECU: a250 pcs ov shutdown fault pin active";
CM_ SG_ 1335 VCFRONT1_a250_pcsOvShutdownArmed "VCFRONT1 ECU: a250 pcs ov shutdown armed";
CM_ SG_ 1335 VCFRONT1_a250_battDomainHealthy "VCFRONT1 ECU: a250 batt domain healthy";
CM_ SG_ 1335 VCFRONT1_a250_busVoltage "VCFRONT1 ECU: a250 bus voltage";
CM_ SG_ 1335 VCFRONT1_a250_dcdcEnableLineVolt "VCFRONT1 ECU: a250 dcdc enable line voltage";
CM_ SG_ 1335 VCFRONT1_a250_ovClampBusVoltage "VCFRONT1 ECU: a250 ov clamp bus voltage";
CM_ SG_ 1335 VCFRONT1_a250_ovClampReferenceVo "VCFRONT1 ECU: a250 ov clamp reference voltage";
CM_ SG_ 1335 VCFRONT1_a250_ovClampMonitorVolt "VCFRONT1 ECU: a250 ov clamp monitor voltage1";
CM_ SG_ 1335 VCFRONT1_a251_rationalitySetupCh "VCFRONT1 ECU: a251 rationality setup check result";
CM_ SG_ 1335 VCFRONT1_a251_rationalitySetupFa "VCFRONT1 ECU: a251 rationality setup failure reason";
CM_ SG_ 1335 VCFRONT1_a251_clampLowSideCheckR "VCFRONT1 ECU: a251 clamp low side check result";
CM_ SG_ 1335 VCFRONT1_a251_clampLowSideFailur "VCFRONT1 ECU: a251 clamp low side failure reason";
CM_ SG_ 1335 VCFRONT1_a251_rationalityShutdow "VCFRONT1 ECU: a251 rationality shutdown armed check result";
CM_ SG_ 1335 VCFRONT1_a251_rationalitySh_0001 "VCFRONT1 ECU: a251 rationality shutdown armed failure reason";
CM_ SG_ 1335 VCFRONT1_a251_clampHighSideCheck "VCFRONT1 ECU: a251 clamp high side check result";
CM_ SG_ 1335 VCFRONT1_a251_clampHighSideFailu "VCFRONT1 ECU: a251 clamp high side failure reason";
CM_ SG_ 1335 VCFRONT1_a251_rationalityPcsShut "VCFRONT1 ECU: a251 rationality pcs shutdown check result";
CM_ SG_ 1335 VCFRONT1_a251_rationalityPc_0001 "VCFRONT1 ECU: a251 rationality pcs shutdown failure reason";
CM_ SG_ 1335 VCFRONT1_a251_testTimedOut "VCFRONT1 ECU: a251 test timed out";
CM_ SG_ 1335 VCFRONT1_a252_stage "VCFRONT1 ECU: a252 stage";
CM_ SG_ 1335 VCFRONT1_a252_incorrectPinConfig "VCFRONT1 ECU: a252 incorrect pin configuration";
CM_ SG_ 1335 VCFRONT1_a252_incorrectClampMoni "VCFRONT1 ECU: a252 incorrect clamp monitor1 voltage";
CM_ SG_ 1335 VCFRONT1_a252_incorrectClam_0001 "VCFRONT1 ECU: a252 incorrect clamp monitor2 voltage";
CM_ SG_ 1335 VCFRONT1_a252_incorrectClam_0002 "VCFRONT1 ECU: a252 incorrect clamp monitor3 voltage";
CM_ SG_ 1335 VCFRONT1_a252_incorrectPcsEnable "VCFRONT1 ECU: a252 incorrect pcs enable line voltage";
CM_ SG_ 1335 VCFRONT1_a252_incorrectPcsTripSt "VCFRONT1 ECU: a252 incorrect pcs trip state";
CM_ SG_ 1335 VCFRONT1_a252_incorrectPcsSuppor "VCFRONT1 ECU: a252 incorrect pcs support status";
CM_ SG_ 1335 VCFRONT1_a252_incorrectPcsDcdcEn "VCFRONT1 ECU: a252 incorrect pcs dcdc enable feedback";
CM_ SG_ 1335 VCFRONT1_a252_pcsOvShutdownFault "VCFRONT1 ECU: a252 pcs ov shutdown fault pin active";
CM_ SG_ 1335 VCFRONT1_a252_pcsOvShutdownArmed "VCFRONT1 ECU: a252 pcs ov shutdown armed";
CM_ SG_ 1335 VCFRONT1_a252_pcsSupporting "VCFRONT1 ECU: a252 pcs supporting";
CM_ SG_ 1335 VCFRONT1_a252_pcsDcdcEnableFeedb "VCFRONT1 ECU: a252 pcs dcdc enable feedback";
CM_ SG_ 1335 VCFRONT1_a252_pcsOvClampArmed "VCFRONT1 ECU: a252 pcs ov clamp armed";
CM_ SG_ 1335 VCFRONT1_a252_pcsOvSelfTestEnabl "VCFRONT1 ECU: a252 pcs ov self test enabled";
CM_ SG_ 1335 VCFRONT1_a252_busVoltage "VCFRONT1 ECU: a252 bus voltage";
CM_ SG_ 1335 VCFRONT1_a252_dcdcEnableLineVolt "VCFRONT1 ECU: a252 dcdc enable line voltage";
CM_ SG_ 1335 VCFRONT1_a252_ovClampMonitorChan "VCFRONT1 ECU: a252 ov clamp monitor channel";
CM_ SG_ 1335 VCFRONT1_a252_ovClampMonitorVolt "VCFRONT1 ECU: a252 ov clamp monitor voltage";
CM_ SG_ 1335 VCFRONT1_a262_eFuseVoltage "VCFRONT1 ECU: a262 e fuse voltage";
CM_ SG_ 1335 VCFRONT1_a262_vbatProtVoltage "VCFRONT1 ECU: a262 vbat prot voltage";
CM_ SG_ 1335 VCFRONT1_a263_eFuseVoltage "VCFRONT1 ECU: a263 e fuse voltage";
CM_ SG_ 1335 VCFRONT1_a263_vbatProtVoltage "VCFRONT1 ECU: a263 vbat prot voltage";
CM_ SG_ 1335 VCFRONT1_a264_eFuseVoltage "VCFRONT1 ECU: a264 e fuse voltage";
CM_ SG_ 1335 VCFRONT1_a264_vbatProtVoltage "VCFRONT1 ECU: a264 vbat prot voltage";
CM_ SG_ 1335 VCFRONT1_a266_eFuseVoltage "VCFRONT1 ECU: a266 e fuse voltage";
CM_ SG_ 1335 VCFRONT1_a266_vbatProtVoltage "VCFRONT1 ECU: a266 vbat prot voltage";
CM_ SG_ 1335 VCFRONT1_a414_failureReason "VCFRONT1 ECU: a414 failure reason";
CM_ SG_ 1335 VCFRONT1_a414_loadUnattemptedOnF "VCFRONT1 ECU: a414 load unattempted on failure";
CM_ SG_ 1335 VCFRONT1_a414_deviceStuckOnFailu "VCFRONT1 ECU: a414 device stuck on failure";
CM_ SG_ 1335 VCFRONT1_a414_followerVCRightSel "VCFRONT1 ECU: a414 follower VC right self test failure";
CM_ SG_ 1335 VCFRONT1_a414_bridgeFailedToOpen "VCFRONT1 ECU: a414 bridge failed to open";
CM_ SG_ 1335 VCFRONT1_a414_uvLoadshedVsenseDi "VCFRONT1 ECU: a414 uv loadshed vsense dig in";
CM_ SG_ 1335 VCFRONT1_a415_upstreamEFuseStuck "VCFRONT1 ECU: a415 upstream e fuse stuck off";
CM_ SG_ 1335 VCFRONT1_a475_channel "VCFRONT1 ECU: a475 channel";
CM_ SG_ 1335 VCFRONT1_a475_reset "VCFRONT1 ECU: a475 reset";
CM_ SG_ 1335 VCFRONT1_a475_spiError "VCFRONT1 ECU: a475 spi error";
CM_ SG_ 1335 VCFRONT1_a475_autoOn "VCFRONT1 ECU: a475 auto on";
CM_ SG_ 1335 VCFRONT1_a475_diagnosticBit "VCFRONT1 ECU: a475 diagnostic bit";
CM_ SG_ 1335 VCFRONT1_a475_deviceError "VCFRONT1 ECU: a475 device error";
CM_ SG_ 1335 VCFRONT1_a475_unexpectedLock "VCFRONT1 ECU: a475 unexpected lock";
CM_ SG_ 1335 VCFRONT1_a475_unexpectedFailSafe "VCFRONT1 ECU: a475 unexpected fail safe";
CM_ SG_ 1335 VCFRONT1_a475_disableOutputFault "VCFRONT1 ECU: a475 disable output fault";
CM_ SG_ 1335 VCFRONT1_a475_vsUndervoltage "VCFRONT1 ECU: a475 vs undervoltage";
CM_ SG_ 1335 VCFRONT1_a475_hardShort "VCFRONT1 ECU: a475 hard short";
CM_ SG_ 1335 VCFRONT1_a475_prechargeFailure "VCFRONT1 ECU: a475 precharge failure";
CM_ SG_ 1335 VCFRONT1_a475_vdsMax "VCFRONT1 ECU: a475 vds max";
CM_ SG_ 1335 VCFRONT1_a475_bypassSaturation "VCFRONT1 ECU: a475 bypass saturation";
CM_ SG_ 1335 VCFRONT1_a475_fuseLatch "VCFRONT1 ECU: a475 fuse latch";
CM_ SG_ 1335 VCFRONT1_a475_deviceOvertemperat "VCFRONT1 ECU: a475 device overtemperature";
CM_ SG_ 1335 VCFRONT1_a475_ntcOvertemperature "VCFRONT1 ECU: a475 ntc overtemperature";
CM_ SG_ 1335 VCFRONT1_a475_vgsLow "VCFRONT1 ECU: a475 vgs low";
CM_ SG_ 1335 VCFRONT1_a475_chargePumpLow "VCFRONT1 ECU: a475 charge pump low";
CM_ SG_ 1335 VCFRONT1_a475_watchdog "VCFRONT1 ECU: a475 watchdog";
CM_ SG_ 1335 VCFRONT1_a475_spiNotDone "VCFRONT1 ECU: a475 spi not done";
CM_ SG_ 1335 VCFRONT1_a475_csUndervoltage "VCFRONT1 ECU: a475 cs undervoltage";
CM_ SG_ 1335 VCFRONT1_a475_configIncorrect "VCFRONT1 ECU: a475 config incorrect";
CM_ SG_ 1335 VCFRONT1_a475_bufferFull "VCFRONT1 ECU: a475 buffer full";
CM_ SG_ 1335 VCFRONT1_a475_hitAlertRateLimit "VCFRONT1 ECU: a475 hit alert rate limit";
CM_ SG_ 1335 VCFRONT1_a475_hwlo "VCFRONT1 ECU: a475 hwlo";
CM_ SG_ 1335 VCFRONT1_a475_dinState "VCFRONT1 ECU: a475 din state";
CM_ SG_ 1335 VCFRONT1_a475_enable "VCFRONT1 ECU: a475 enable";
CM_ SG_ 1335 VCFRONT1_a480_channel "VCFRONT1 ECU: a480 channel";
CM_ SG_ 1335 VCFRONT1_a480_reset "VCFRONT1 ECU: a480 reset";
CM_ SG_ 1335 VCFRONT1_a480_spiError "VCFRONT1 ECU: a480 spi error";
CM_ SG_ 1335 VCFRONT1_a480_autoOn "VCFRONT1 ECU: a480 auto on";
CM_ SG_ 1335 VCFRONT1_a480_diagnosticBit "VCFRONT1 ECU: a480 diagnostic bit";
CM_ SG_ 1335 VCFRONT1_a480_deviceError "VCFRONT1 ECU: a480 device error";
CM_ SG_ 1335 VCFRONT1_a480_overcurrent "VCFRONT1 ECU: a480 overcurrent";
CM_ SG_ 1335 VCFRONT1_a480_unexpectedLock "VCFRONT1 ECU: a480 unexpected lock";
CM_ SG_ 1335 VCFRONT1_a480_disableOutputFault "VCFRONT1 ECU: a480 disable output fault";
CM_ SG_ 1335 VCFRONT1_a480_vsUndervoltage "VCFRONT1 ECU: a480 vs undervoltage";
CM_ SG_ 1335 VCFRONT1_a480_hardShort "VCFRONT1 ECU: a480 hard short";
CM_ SG_ 1335 VCFRONT1_a480_vdsMax "VCFRONT1 ECU: a480 vds max";
CM_ SG_ 1335 VCFRONT1_a480_bypassSaturation "VCFRONT1 ECU: a480 bypass saturation";
CM_ SG_ 1335 VCFRONT1_a480_fuseLatch "VCFRONT1 ECU: a480 fuse latch";
CM_ SG_ 1335 VCFRONT1_a480_deviceOvertemperat "VCFRONT1 ECU: a480 device overtemperature";
CM_ SG_ 1335 VCFRONT1_a480_ntcOvertemperature "VCFRONT1 ECU: a480 ntc overtemperature";
CM_ SG_ 1335 VCFRONT1_a480_vgsLow "VCFRONT1 ECU: a480 vgs low";
CM_ SG_ 1335 VCFRONT1_a480_chargePumpLow "VCFRONT1 ECU: a480 charge pump low";
CM_ SG_ 1335 VCFRONT1_a480_watchdog "VCFRONT1 ECU: a480 watchdog";
CM_ SG_ 1335 VCFRONT1_a480_spiNotDone "VCFRONT1 ECU: a480 spi not done";
CM_ SG_ 1335 VCFRONT1_a480_configIncorrect "VCFRONT1 ECU: a480 config incorrect";
CM_ SG_ 1335 VCFRONT1_a480_bufferFull "VCFRONT1 ECU: a480 buffer full";
CM_ SG_ 1335 VCFRONT1_a480_hitAlertRateLimit "VCFRONT1 ECU: a480 hit alert rate limit";
CM_ SG_ 1335 VCFRONT1_a480_hwlo "VCFRONT1 ECU: a480 hwlo";
CM_ SG_ 1335 VCFRONT1_a480_enable "VCFRONT1 ECU: a480 enable";
CM_ SG_ 1335 VCFRONT1_a482_lvBridgeEFuseCurre "VCFRONT1 ECU: a482 lv bridge e fuse current";
CM_ SG_ 1335 VCFRONT1_a482_lvBridgeEFuseVolta "VCFRONT1 ECU: a482 lv bridge e fuse voltage";
CM_ SG_ 1335 VCFRONT1_a482_lvBridgeEFuseTemp "VCFRONT1 ECU: a482 lv bridge e fuse temp";
CM_ SG_ 1335 VCFRONT1_a484_upstreamEFuseStuck "VCFRONT1 ECU: a484 upstream e fuse stuck on";
CM_ SG_ 1335 VCFRONT1_a484_upstreamEFuseVolta "VCFRONT1 ECU: a484 upstream e fuse voltage";
CM_ SG_ 1335 VCFRONT1_a484_vbusVoltage "VCFRONT1 ECU: a484 vbus voltage";
CM_ SG_ 1335 VCFRONT1_a484_upstreamEFuseRatio "VCFRONT1 ECU: a484 upstream e fuse ratio";
CM_ SG_ 1335 VCFRONT1_a485_upstreamEfuseUnatt "VCFRONT1 ECU: a485 upstream efuse unattempted on";
CM_ SG_ 1335 VCFRONT1_a486_bridgeFailedArming "VCFRONT1 ECU: a486 bridge failed arming setup";
CM_ SG_ 1335 VCFRONT1_a486_bridgeFailedSyncCh "VCFRONT1 ECU: a486 bridge failed sync check";
CM_ SG_ 1335 VCFRONT1_a486_localBridgeOutputO "VCFRONT1 ECU: a486 local bridge output on";
CM_ SG_ 1335 VCFRONT1_a486_localBridgeSyncArm "VCFRONT1 ECU: a486 local bridge sync armed";
CM_ SG_ 1335 VCFRONT1_a486_localBridgeDinStat "VCFRONT1 ECU: a486 local bridge din state";
CM_ SG_ 1335 VCFRONT1_a486_remoteBridgeOutput "VCFRONT1 ECU: a486 remote bridge output on";
CM_ SG_ 1335 VCFRONT1_a486_remoteBridgeO_0001 "VCFRONT1 ECU: a486 remote bridge output on valid";
CM_ SG_ 1335 VCFRONT1_a486_remoteBridgeSyncAr "VCFRONT1 ECU: a486 remote bridge sync armed";
CM_ SG_ 1335 VCFRONT1_a486_remoteBridgeS_0001 "VCFRONT1 ECU: a486 remote bridge sync armed valid";
CM_ SG_ 1335 VCFRONT1_a486_remoteBridgeDinSta "VCFRONT1 ECU: a486 remote bridge din state";
CM_ SG_ 1335 VCFRONT1_a486_remoteBridgeD_0001 "VCFRONT1 ECU: a486 remote bridge din state valid";
CM_ SG_ 1335 VCFRONT1_a496_serviceMode "Signal reported by VCFRONT1 ECU";
CM_ SG_ 1335 VCFRONT1_a496_frunkOpen "VCFRONT1 ECU: a496 frunk open";
CM_ SG_ 1335 VCFRONT1_a496_NotEnoughPowerForS "VCFRONT1 ECU: a496 not enough power for support";
CM_ SG_ 1335 VCFRONT1_a496_bmsState "VCFRONT1 ECU: a496 bms state; raw 9 = signal not available (SNA)";
CM_ SG_ 1335 VCFRONT1_a500_channel "VCFRONT1 ECU: a500 channel";
CM_ SG_ 1335 VCFRONT1_a500_mismatchedState "VCFRONT1 ECU: a500 mismatched state";
CM_ SG_ 1335 VCFRONT1_a509_channel "VCFRONT1 ECU: a509 channel";
CM_ SG_ 1335 VCFRONT1_a509_state "VCFRONT1 ECU: a509 state";
CM_ SG_ 1335 VCFRONT1_a509_expectedState "VCFRONT1 ECU: a509 expected state";
CM_ SG_ 1335 VCFRONT1_a509_hardwareLockout "VCFRONT1 ECU: a509 hardware lockout";
CM_ SG_ 1335 VCFRONT1_a509_unlocksRemaining "VCFRONT1 ECU: a509 unlocks remaining";
CM_ SG_ 1335 VCFRONT1_a523_channel "VCFRONT1 ECU: a523 channel";
CM_ SG_ 1335 VCFRONT1_a523_control2Byte1 "VCFRONT1 ECU: a523 control2 byte1";
CM_ SG_ 1335 VCFRONT1_a523_control2Byte2 "VCFRONT1 ECU: a523 control2 byte2";
CM_ SG_ 1335 VCFRONT1_a523_control2Byte3 "VCFRONT1 ECU: a523 control2 byte3";
CM_ SG_ 1335 VCFRONT1_a523_control3Byte2 "VCFRONT1 ECU: a523 control3 byte2";
CM_ SG_ 1335 VCFRONT1_a523_control3Byte3 "VCFRONT1 ECU: a523 control3 byte3";
CM_ SG_ 1335 VCFRONT1_a574_frontDriveInverter "VCFRONT1 ECU: a574 front drive inverter current";
CM_ SG_ 1335 VCFRONT1_a574_frontDriveInv_0001 "VCFRONT1 ECU: a574 front drive inverter remaining retries";
CM_ SG_ 1335 VCFRONT1_a596_vcrightCutoffEFuse "VCFRONT1 ECU: a596 vcright cutoff e fuse curve type";
CM_ SG_ 1335 VCFRONT1_a596_vcrightCutoffCurve "VCFRONT1 ECU: a596 vcright cutoff curve offset channel";
CM_ SG_ 1335 VCFRONT1_a596_vcrightCutoffATerm "VCFRONT1 ECU: a596 vcright cutoff a term; raw 65535 = signal not available (SNA)";
CM_ SG_ 1335 VCFRONT1_a596_vcrightCutoffBTerm "VCFRONT1 ECU: a596 vcright cutoff b term; raw 128 = signal not available (SNA)";
CM_ SG_ 1335 VCFRONT1_a596_vcrightCutoffCTerm "VCFRONT1 ECU: a596 vcright cutoff c term; raw 32768 = signal not available (SNA)";
CM_ SG_ 1335 VCFRONT1_a597_vcrightCutoffEFuse "VCFRONT1 ECU: a597 vcright cutoff e fuse fast blow type";
CM_ SG_ 1335 VCFRONT1_a597_vcrightCutoffCurre "VCFRONT1 ECU: a597 vcright cutoff current threshold";
CM_ SG_ 1335 VCFRONT1_a597_vcrightCutoffTimin "VCFRONT1 ECU: a597 vcright cutoff timing threshold ms";
CM_ SG_ 1335 VCFRONT1_a597_vcrightCutoffMaxCo "VCFRONT1 ECU: a597 vcright cutoff max count";
CM_ BO_ 833 "VCFRONT1 ECU message: alert matrix; frame length from the layout, not yet observed on a vehicle bus";
CM_ SG_ 833 VCFRONT1_matrixIndex "VCFRONT1 ECU: matrix index";
CM_ SG_ 833 VCFRONT1_a001_WatchdogReset "VCFRONT1 ECU: a001 watchdog reset";
CM_ SG_ 833 VCFRONT1_a002_PowerLossReset "VCFRONT1 ECU: a002 power loss reset";
CM_ SG_ 833 VCFRONT1_a003_SWAssertion "VCFRONT1 ECU: a003 SW assertion";
CM_ SG_ 833 VCFRONT1_a005_CANTXError "VCFRONT1 ECU: a005 CANTX error";
CM_ SG_ 833 VCFRONT1_a006_CANTX_cyclicError "VCFRONT1 ECU: a006 CANTX cyclic error";
CM_ SG_ 833 VCFRONT1_a012_CPUReset "VCFRONT1 ECU: a012 CPU reset";
CM_ SG_ 833 VCFRONT1_a013_AlertManagerFault "VCFRONT1 ECU: a013 alert manager fault";
CM_ SG_ 833 VCFRONT1_a015_NVMMError "VCFRONT1 ECU: a015 NVMM error";
CM_ SG_ 833 VCFRONT1_a016_NVMMRecordError "VCFRONT1 ECU: a016 NVMM record error";
CM_ SG_ 833 VCFRONT1_a017_NVMMStatusDbg "VCFRONT1 ECU: a017 NVMM status dbg";
CM_ SG_ 833 VCFRONT1_a018_HardFault "VCFRONT1 ECU: a018 hard fault";
CM_ SG_ 833 VCFRONT1_a019_BusFault "VCFRONT1 ECU: a019 bus fault";
CM_ SG_ 833 VCFRONT1_a021_TaskSchedulerError "VCFRONT1 ECU: a021 task scheduler error";
CM_ SG_ 833 VCFRONT1_a022_TaskInitError "VCFRONT1 ECU: a022 task init error";
CM_ SG_ 833 VCFRONT1_a028_UsageFault "VCFRONT1 ECU: a028 usage fault";
CM_ SG_ 833 VCFRONT1_a029_CoreDump "VCFRONT1 ECU: a029 core dump";
CM_ SG_ 833 VCFRONT1_a030_ECULogUploadReques "VCFRONT1 ECU: a030 ECU log upload request";
CM_ SG_ 833 VCFRONT1_a031_UDSActive "VCFRONT1 ECU: a031 UDS active";
CM_ SG_ 833 VCFRONT1_a036_UnknownIrq "VCFRONT1 ECU: a036 unknown irq";
CM_ SG_ 833 VCFRONT1_a037_MemManageFault "VCFRONT1 ECU: a037 mem manage fault";
CM_ SG_ 833 VCFRONT1_a038_ProtFaultInfo "VCFRONT1 ECU: a038 prot fault info";
CM_ SG_ 833 VCFRONT1_a039_ProtFaultAddress "VCFRONT1 ECU: a039 prot fault address";
CM_ SG_ 833 VCFRONT1_a040_Backtrace "VCFRONT1 ECU: a040 backtrace";
CM_ SG_ 833 VCFRONT1_a041_HighCPULoad "VCFRONT1 ECU: a041 high CPU load";
CM_ SG_ 833 VCFRONT1_a042_HighStackUsage "VCFRONT1 ECU: a042 high stack usage";
CM_ SG_ 833 VCFRONT1_a043_Task1msError "VCFRONT1 ECU: a043 task1ms error";
CM_ SG_ 833 VCFRONT1_a044_Task10msError "VCFRONT1 ECU: a044 task10ms error";
CM_ SG_ 833 VCFRONT1_a045_Task100msError "VCFRONT1 ECU: a045 task100ms error";
CM_ SG_ 833 VCFRONT1_a046_Task1000msError "VCFRONT1 ECU: a046 task1000ms error";
CM_ SG_ 833 VCFRONT1_a058_inputRHighSyncDebu "VCFRONT1 ECU: a058 input r high sync debug";
CM_ SG_ 833 VCFRONT1_a059_inputResistanceHig "VCFRONT1 ECU: a059 input resistance high";
CM_ SG_ 833 VCFRONT1_a060_engineeringBuild "VCFRONT1 ECU: a060 engineering build";
CM_ SG_ 833 VCFRONT1_a061_XCPConnected "VCFRONT1 ECU: a061 XCP connected";
CM_ SG_ 833 VCFRONT1_a062_XCPWasConnected "VCFRONT1 ECU: a062 XCP was connected";
CM_ SG_ 833 VCFRONT1_a063_SwitchFault "VCFRONT1 ECU: a063 switch fault";
CM_ SG_ 833 VCFRONT1_a064_busSleepReqTimeout "VCFRONT1 ECU: a064 bus sleep req timeout";
CM_ SG_ 833 VCFRONT1_a077_VCBATT0_MIA "VCFRONT1 ECU: a077 VCBATT0 MIA";
CM_ SG_ 833 VCFRONT1_a078_VCBATT1_MIA "VCFRONT1 ECU: a078 VCBATT1 MIA";
CM_ SG_ 833 VCFRONT1_a079_VCBATT2_MIA "VCFRONT1 ECU: a079 VCBATT2 MIA";
CM_ SG_ 833 VCFRONT1_a080_VCFRONT0_MIA "VCFRONT1 ECU: a080 VCFRONT0 MIA";
CM_ SG_ 833 VCFRONT1_a081_VCFRONT1_MIA "VCFRONT1 ECU: a081 VCFRONT1 MIA";
CM_ SG_ 833 VCFRONT1_a082_VCFRONT2_MIA "VCFRONT1 ECU: a082 VCFRONT2 MIA";
CM_ SG_ 833 VCFRONT1_a086_VCBATT_MIA "VCFRONT1 ECU: a086 VCBATT MIA";
CM_ SG_ 833 VCFRONT1_a090_APS_MIA "VCFRONT1 ECU: a090 APS MIA";
CM_ SG_ 833 VCFRONT1_a091_CMPD_MIA "VCFRONT1 ECU: a091 CMPD MIA";
CM_ SG_ 833 VCFRONT1_a096_OCS1P_MIA "VCFRONT1 ECU: a096 OCS1 p MIA";
CM_ SG_ 833 VCFRONT1_a098_DIR_MIA "VCFRONT1 ECU: a098 DIR MIA";
CM_ SG_ 833 VCFRONT1_a100_CANbus_MIA "VCFRONT1 ECU: a100 CA nbus MIA";
CM_ SG_ 833 VCFRONT1_a103_CP_MIA "VCFRONT1 ECU: a103 CP MIA";
CM_ SG_ 833 VCFRONT1_a104_DAS_MIA "VCFRONT1 ECU: a104 DAS MIA";
CM_ SG_ 833 VCFRONT1_a105_TAS_MIA "VCFRONT1 ECU: a105 TAS MIA";
CM_ SG_ 833 VCFRONT1_a106_PCS_MIA "VCFRONT1 ECU: a106 PCS MIA";
CM_ SG_ 833 VCFRONT1_a107_BMS_MIA "VCFRONT1 ECU: a107 BMS MIA";
CM_ SG_ 833 VCFRONT1_a108_DIF_MIA "VCFRONT1 ECU: a108 DIF MIA";
CM_ SG_ 833 VCFRONT1_a109_RCM_MIA "VCFRONT1 ECU: a109 RCM MIA";
CM_ SG_ 833 VCFRONT1_a110_GTW_MIA "VCFRONT1 ECU: a110 GTW MIA";
CM_ SG_ 833 VCFRONT1_a111_EPBR_MIA "VCFRONT1 ECU: a111 EPBR MIA";
CM_ SG_ 833 VCFRONT1_a112_EPBL_MIA "VCFRONT1 ECU: a112 EPBL MIA";
CM_ SG_ 833 VCFRONT1_a113_UI_MIA "VCFRONT1 ECU: a113 UI MIA";
CM_ SG_ 833 VCFRONT1_a114_ESP_MIA "VCFRONT1 ECU: a114 ESP MIA";
CM_ SG_ 833 VCFRONT1_a115_VCSEC_MIA "VCFRONT1 ECU: a115 VCSEC MIA";
CM_ SG_ 833 VCFRONT1_a116_VCRIGHT_MIA "VCFRONT1 ECU: a116 VCRIGHT MIA";
CM_ SG_ 833 VCFRONT1_a117_VCLEFT_MIA "VCFRONT1 ECU: a117 VCLEFT MIA";
CM_ SG_ 833 VCFRONT1_a118_VCFRONT_MIA "VCFRONT1 ECU: a118 VCFRONT MIA";
CM_ SG_ 833 VCFRONT1_a119_SCCM_MIA "VCFRONT1 ECU: a119 SCCM MIA";
CM_ SG_ 833 VCFRONT1_a120_DI_DRIVE_MIA "VCFRONT1 ECU: a120 DI DRIVE MIA";
CM_ SG_ 833 VCFRONT1_a122_ICR_MIA "VCFRONT1 ECU: a122 ICR MIA";
CM_ SG_ 833 VCFRONT1_a124_BB_MIA "VCFRONT1 ECU: a124 BB MIA";
CM_ SG_ 833 VCFRONT1_a125_SCCM_MIA "VCFRONT1 ECU: a125 SCCM MIA";
CM_ SG_ 833 VCFRONT1_a126_EPAS3P_MIA "VCFRONT1 ECU: a126 EPAS3 p MIA";
CM_ SG_ 833 VCFRONT1_a127_iBoosterEFuseTrip "VCFRONT1 ECU: a127 i booster e fuse trip";
CM_ SG_ 833 VCFRONT1_a128_vcrightEFuseTrip "VCFRONT1 ECU: a128 vcright e fuse trip";
CM_ SG_ 833 VCFRONT1_a129_pcsEFuseTrip "VCFRONT1 ECU: a129 pcs e fuse trip";
CM_ SG_ 833 VCFRONT1_a130_autopilot2EFuseTri "VCFRONT1 ECU: a130 autopilot2 e fuse trip";
CM_ SG_ 833 VCFRONT1_a131_PCSCOMMON_MIA "VCFRONT1 ECU: a131 PCSCOMMON MIA";
CM_ SG_ 833 VCFRONT1_a132_epas2EFuseTrip "VCFRONT1 ECU: a132 epas2 e fuse trip";
CM_ SG_ 833 VCFRONT1_a133_BRAKE_MIA "VCFRONT1 ECU: a133 BRAKE MIA";
CM_ SG_ 833 VCFRONT1_a134_hvContactorsEFuseT "VCFRONT1 ECU: a134 hv contactors e fuse trip";
CM_ SG_ 833 VCFRONT1_a135_leftHeadlightEFuse "VCFRONT1 ECU: a135 left headlight e fuse trip";
CM_ SG_ 833 VCFRONT1_a144_EPAS3S_MIA "VCFRONT1 ECU: a144 EPAS3 s MIA";
CM_ SG_ 833 VCFRONT1_a164_eFuseLckoutMissing "VCFRONT1 ECU: a164 e fuse lckout missing";
CM_ SG_ 833 VCFRONT1_a165_unxpctdEFuseLckout "VCFRONT1 ECU: a165 unxpctd e fuse lckout";
CM_ SG_ 833 VCFRONT1_a177_mcuAudioEFuseTrip "VCFRONT1 ECU: a177 mcu audio e fuse trip";
CM_ SG_ 833 VCFRONT1_a188_sleepFailed "VCFRONT1 ECU: a188 sleep failed";
CM_ SG_ 833 VCFRONT1_a191_exitDriveDomainDow "VCFRONT1 ECU: a191 exit drive domain down";
CM_ SG_ 833 VCFRONT1_a204_undervoltageLoadsh "VCFRONT1 ECU: a204 undervoltage loadshed triggered";
CM_ SG_ 833 VCFRONT1_a205_overvoltageProtect "VCFRONT1 ECU: a205 overvoltage protection triggered";
CM_ SG_ 833 VCFRONT1_a214_openCircuitDetecte "VCFRONT1 ECU: a214 open circuit detected";
CM_ SG_ 833 VCFRONT1_a216_powerCutoffImminen "VCFRONT1 ECU: a216 power cutoff imminent";
CM_ SG_ 833 VCFRONT1_a220_LVUnhealthy "VCFRONT1 ECU: a220 LV unhealthy";
CM_ SG_ 833 VCFRONT1_a223_bridgeOvervoltageS "VCFRONT1 ECU: a223 bridge overvoltage self test failure";
CM_ SG_ 833 VCFRONT1_a229_LVHealthCompromise "VCFRONT1 ECU: a229 LV health compromised";
CM_ SG_ 833 VCFRONT1_a230_autopilot2EFuseTri "VCFRONT1 ECU: a230 autopilot2 e fuse trip during OTA";
CM_ SG_ 833 VCFRONT1_a249_pcsOvClampTripped "VCFRONT1 ECU: a249 pcs ov clamp tripped";
CM_ SG_ 833 VCFRONT1_a250_pcsOvShutdownTripp "VCFRONT1 ECU: a250 pcs ov shutdown tripped";
CM_ SG_ 833 VCFRONT1_a251_pcsOvShutdownSelfT "VCFRONT1 ECU: a251 pcs ov shutdown self test failure";
CM_ SG_ 833 VCFRONT1_a252_pcsOvShutdownSelfT "VCFRONT1 ECU: a252 pcs ov shutdown self test stage failure";
CM_ SG_ 833 VCFRONT1_a253_pcsOvShutdownHighS "VCFRONT1 ECU: a253 pcs ov shutdown high side self test debug";
CM_ SG_ 833 VCFRONT1_a256_nxppca9539Fault "VCFRONT1 ECU: a256 nxppca9539 fault";
CM_ SG_ 833 VCFRONT1_a262_vcrightVoltageMism "VCFRONT1 ECU: a262 vcright voltage mismatch";
CM_ SG_ 833 VCFRONT1_a263_pcsVoltageMismatch "VCFRONT1 ECU: a263 pcs voltage mismatch";
CM_ SG_ 833 VCFRONT1_a264_iBoosterVoltageMis "VCFRONT1 ECU: a264 i booster voltage mismatch";
CM_ SG_ 833 VCFRONT1_a266_EPAS2VoltageMismat "VCFRONT1 ECU: a266 EPAS2 voltage mismatch";
CM_ SG_ 833 VCFRONT1_a414_undervoltageSelfTe "VCFRONT1 ECU: a414 undervoltage self test failure";
CM_ SG_ 833 VCFRONT1_a415_undervoltageSelfTe "VCFRONT1 ECU: a415 undervoltage self test stuck off";
CM_ SG_ 833 VCFRONT1_a423_rtosSleepFailed "VCFRONT1 ECU: a423 rtos sleep failed";
CM_ SG_ 833 VCFRONT1_a450_doorWakeToOpenDBG "VCFRONT1 ECU: a450 door wake to open DBG";
CM_ SG_ 833 VCFRONT1_a475_vnf1248Fault "VCFRONT1 ECU: a475 vnf1248 fault";
CM_ SG_ 833 VCFRONT1_a480_vnf1048Fault "VCFRONT1 ECU: a480 vnf1048 fault";
CM_ SG_ 833 VCFRONT1_a482_lvBridgeEFuseTrip "VCFRONT1 ECU: a482 lv bridge e fuse trip";
CM_ SG_ 833 VCFRONT1_a483_vnf1048SelfTestFai "VCFRONT1 ECU: a483 vnf1048 self test failure";
CM_ SG_ 833 VCFRONT1_a484_undervoltageSelfTe "VCFRONT1 ECU: a484 undervoltage self test stuck on";
CM_ SG_ 833 VCFRONT1_a485_uvSelfTestLoadUnat "VCFRONT1 ECU: a485 uv self test load unattempted on dbg";
CM_ SG_ 833 VCFRONT1_a486_undervoltageSelfTe "VCFRONT1 ECU: a486 undervoltage self test bridge sync failure";
CM_ SG_ 833 VCFRONT1_a489_vnf1248SelfTestDeb "VCFRONT1 ECU: a489 vnf1248 self test debug";
CM_ SG_ 833 VCFRONT1_a490_vnf1248SelfTestFai "VCFRONT1 ECU: a490 vnf1248 self test failure";
CM_ SG_ 833 VCFRONT1_a491_vnf1248Configurati "VCFRONT1 ECU: a491 vnf1248 configuration mismatch";
CM_ SG_ 833 VCFRONT1_a496_exitDriveWarningDo "VCFRONT1 ECU: a496 exit drive warning domain down";
CM_ SG_ 833 VCFRONT1_a500_eFuseASICStateMism "VCFRONT1 ECU: a500 e fuse ASIC state mismatch";
CM_ SG_ 833 VCFRONT1_a501_vnf1048Configurati "VCFRONT1 ECU: a501 vnf1048 configuration mismatch";
CM_ SG_ 833 VCFRONT1_a509_eFuseASICManagerSt "VCFRONT1 ECU: a509 e fuse ASIC manager state mismatch";
CM_ SG_ 833 VCFRONT1_a523_eFuseThresholdsInc "VCFRONT1 ECU: a523 e fuse thresholds incorrect";
CM_ SG_ 833 VCFRONT1_a574_frontDriveInverter "VCFRONT1 ECU: a574 front drive inverter e fuse trip";
CM_ SG_ 833 VCFRONT1_a575_frontDriveInverter "VCFRONT1 ECU: a575 front drive inverter e fuse trip DBG";
CM_ SG_ 833 VCFRONT1_a578_vbusFusedLoadShedE "VCFRONT1 ECU: a578 vbus fused load shed e fuse trip";
CM_ SG_ 833 VCFRONT1_a581_harnessResistanceI "VCFRONT1 ECU: a581 harness resistance info";
CM_ SG_ 833 VCFRONT1_a590_vcrightPwrRational "VCFRONT1 ECU: a590 vcright pwr rationality curve";
CM_ SG_ 833 VCFRONT1_a591_vcrightFastBlowDet "VCFRONT1 ECU: a591 vcright fast blow detection";
CM_ SG_ 833 VCFRONT1_a596_vcrightCurvePowerC "VCFRONT1 ECU: a596 vcright curve power cutoff";
CM_ SG_ 833 VCFRONT1_a597_vcrightFastBlowPow "VCFRONT1 ECU: a597 vcright fast blow power cutoff";
CM_ SG_ 833 VCFRONT1_a617_APP_MIA "VCFRONT1 ECU: a617 APP MIA";
CM_ BO_ 1027 "VCFRONT1 ECU message: e fuse debug status; frame length from the layout, not yet observed on a vehicle bus";
CM_ SG_ 1027 VCFRONT1_eFuseDebugStatusIndex "VCFRONT1 ECU: e fuse debug status index";
CM_ SG_ 1027 VCFRONT1_EPAS2EFuseState "VCFRONT1 ECU: EPAS2 e fuse state";
CM_ SG_ 1027 VCFRONT1_EPAS2EFuseCurrent "VCFRONT1 ECU: EPAS2 e fuse current";
CM_ SG_ 1027 VCFRONT1_EPAS2EFuseOutput "VCFRONT1 ECU: EPAS2 e fuse output";
CM_ SG_ 1027 VCFRONT1_EPAS2EFuseOutputDesired "VCFRONT1 ECU: EPAS2 e fuse output desired";
CM_ SG_ 1027 VCFRONT1_EPAS2EFuseBypass "VCFRONT1 ECU: EPAS2 e fuse bypass";
CM_ SG_ 1027 VCFRONT1_EPAS2EFuseBypassDesired "VCFRONT1 ECU: EPAS2 e fuse bypass desired";
CM_ SG_ 1027 VCFRONT1_EPAS2EFuseVoltage "VCFRONT1 ECU: EPAS2 e fuse voltage";
CM_ SG_ 1027 VCFRONT1_EPAS2EFuseTemperature "VCFRONT1 ECU: EPAS2 e fuse temperature";
CM_ SG_ 1027 VCFRONT1_EPAS2EFuseManagerState "VCFRONT1 ECU: EPAS2 e fuse manager state";
CM_ SG_ 1027 VCFRONT1_EPAS2EFuseHardShortThre "VCFRONT1 ECU: EPAS2 e fuse hard short threshold";
CM_ SG_ 1027 VCFRONT1_EPAS2EFuseOCThreshold "VCFRONT1 ECU: EPAS2 e fuse OC threshold";
CM_ SG_ 1027 VCFRONT1_EPAS2EFuseType "Reports the type of the EPAS2 eFuse.";
CM_ SG_ 1027 VCFRONT1_rightControllerEFuseSta "VCFRONT1 ECU: right controller e fuse state";
CM_ SG_ 1027 VCFRONT1_rightControllerEFuseCur "VCFRONT1 ECU: right controller e fuse current";
CM_ SG_ 1027 VCFRONT1_rightControllerEFuseOut "VCFRONT1 ECU: right controller e fuse output";
CM_ SG_ 1027 VCFRONT1_rightControllerEFu_0002 "VCFRONT1 ECU: right controller e fuse output desired";
CM_ SG_ 1027 VCFRONT1_rightControllerEFuseByp "VCFRONT1 ECU: right controller e fuse bypass";
CM_ SG_ 1027 VCFRONT1_rightControllerEFu_0001 "VCFRONT1 ECU: right controller e fuse bypass desired";
CM_ SG_ 1027 VCFRONT1_rightControllerEFuseVol "VCFRONT1 ECU: right controller e fuse voltage";
CM_ SG_ 1027 VCFRONT1_rightControllerEFuseTem "VCFRONT1 ECU: right controller e fuse temperature";
CM_ SG_ 1027 VCFRONT1_rightControllerEFuseMan "VCFRONT1 ECU: right controller e fuse manager state";
CM_ SG_ 1027 VCFRONT1_rightControllerEFuseHar "VCFRONT1 ECU: right controller e fuse hard short threshold";
CM_ SG_ 1027 VCFRONT1_rightControllerEFuseOCT "VCFRONT1 ECU: right controller e fuse OC threshold";
CM_ SG_ 1027 VCFRONT1_rightControllerEFuseTyp "Reports the type of the right controller eFuse.";
CM_ SG_ 1027 VCFRONT1_autopilot2EFuseState "VCFRONT1 ECU: autopilot2 e fuse state";
CM_ SG_ 1027 VCFRONT1_autopilot2EFuseCurrent "VCFRONT1 ECU: autopilot2 e fuse current";
CM_ SG_ 1027 VCFRONT1_autopilot2EFuseOutput "VCFRONT1 ECU: autopilot2 e fuse output";
CM_ SG_ 1027 VCFRONT1_autopilot2EFuseOutputDe "VCFRONT1 ECU: autopilot2 e fuse output desired";
CM_ SG_ 1027 VCFRONT1_autopilot2EFuseBypass "VCFRONT1 ECU: autopilot2 e fuse bypass";
CM_ SG_ 1027 VCFRONT1_autopilot2EFuseBypassDe "VCFRONT1 ECU: autopilot2 e fuse bypass desired";
CM_ SG_ 1027 VCFRONT1_autopilot2EFuseVoltage "VCFRONT1 ECU: autopilot2 e fuse voltage";
CM_ SG_ 1027 VCFRONT1_autopilot2EFuseTemperat "VCFRONT1 ECU: autopilot2 e fuse temperature";
CM_ SG_ 1027 VCFRONT1_autopilot2EFuseManagerS "VCFRONT1 ECU: autopilot2 e fuse manager state";
CM_ SG_ 1027 VCFRONT1_autopilot2EFuseHardShor "VCFRONT1 ECU: autopilot2 e fuse hard short threshold";
CM_ SG_ 1027 VCFRONT1_autopilot2EFuseOCThresh "VCFRONT1 ECU: autopilot2 e fuse OC threshold";
CM_ SG_ 1027 VCFRONT1_autopilot2EFuseType "Reports the type of the autopilot2 eFuse.";
CM_ BO_ 1581 "VCFRONT1 ECU message: uds response; frame length from the layout, not yet observed on a vehicle bus";
CM_ SG_ 1581 VCFRONT1_udsResponseData "VCFRONT1 ECU: uds response data";
BA_DEF_ BO_ "GenMsgCycleTime" INT 0 3600000;
BA_DEF_ BO_ "GenMsgSendType" ENUM "Cyclic","NotUsed","NotUsed","NotUsed","NotUsed","NotUsed","NotUsed","IfActive","NoMsgSendType","NotUsed";
BA_DEF_ BO_ "VFrameFormat" ENUM "StandardCAN","ExtendedCAN","reserved","J1939PG","reserved","reserved","reserved","reserved","reserved","reserved","reserved","reserved","reserved","reserved","StandardCAN_FD","ExtendedCAN_FD";
BA_DEF_ BO_ "CANFD_BRS" ENUM "0","1";
BA_DEF_ SG_ "GenSigSNA" STRING;
BA_DEF_ SG_ "SystemSignalLongSymbol" STRING;
BA_DEF_ SG_ "Confidence" ENUM "validated","plausible","layout-only","contradicted";
BA_DEF_DEF_ "GenMsgCycleTime" 0;
BA_DEF_DEF_ "GenMsgSendType" "NoMsgSendType";
BA_DEF_DEF_ "VFrameFormat" "StandardCAN";
BA_DEF_DEF_ "CANFD_BRS" "1";
BA_DEF_DEF_ "GenSigSNA" "";
BA_DEF_DEF_ "SystemSignalLongSymbol" "";
BA_DEF_DEF_ "Confidence" "layout-only";
BA_ "GenMsgCycleTime" BO_ 833 100;
BA_ "GenMsgSendType" BO_ 833 0;
BA_ "GenMsgCycleTime" BO_ 1027 200;
BA_ "GenMsgSendType" BO_ 1027 0;
BA_ "Confidence" SG_ 1335 VCFRONT1_alertID 1;
BA_ "Confidence" SG_ 1335 VCFRONT1_alertState 1;
BA_ "SystemSignalLongSymbol" SG_ 1335 VCFRONT1_a015_NVMMFilesystemErro "VCFRONT1_a015_NVMMFilesystemError";
BA_ "Confidence" SG_ 1335 VCFRONT1_a059_voltageDrop 1;
BA_ "Confidence" SG_ 1335 VCFRONT1_a059_resistanceEstimate 1;
BA_ "Confidence" SG_ 1335 VCFRONT1_a059_current 1;
BA_ "Confidence" SG_ 1335 VCFRONT1_a063_ADCVoltage 1;
BA_ "SystemSignalLongSymbol" SG_ 1335 VCFRONT1_a091_FRONTIPC_faultsAnd "VCFRONT1_a091_FRONTIPC_faultsAndExtras";
BA_ "SystemSignalLongSymbol" SG_ 1335 VCFRONT1_a098_FRONTIPC_temperatu "VCFRONT1_a098_FRONTIPC_temperature";
BA_ "SystemSignalLongSymbol" SG_ 1335 VCFRONT1_a098_FRONTIPC_thermalCo "VCFRONT1_a098_FRONTIPC_thermalControl";
BA_ "SystemSignalLongSymbol" SG_ 1335 VCFRONT1_a106_BATTIPC_dcdcRailSt "VCFRONT1_a106_BATTIPC_dcdcRailStatus";
BA_ "SystemSignalLongSymbol" SG_ 1335 VCFRONT1_a106_FRONTIPC_thermalCo "VCFRONT1_a106_FRONTIPC_thermalControl";
BA_ "SystemSignalLongSymbol" SG_ 1335 VCFRONT1_a106_FRONTIPC_dcdcRailS "VCFRONT1_a106_FRONTIPC_dcdcRailStatus";
BA_ "SystemSignalLongSymbol" SG_ 1335 VCFRONT1_a106_FRONTIPC_dcdcStatu "VCFRONT1_a106_FRONTIPC_dcdcStatus";
BA_ "SystemSignalLongSymbol" SG_ 1335 VCFRONT1_a108_FRONTIPC_temperatu "VCFRONT1_a108_FRONTIPC_temperature";
BA_ "SystemSignalLongSymbol" SG_ 1335 VCFRONT1_a108_FRONTIPC_thermalCo "VCFRONT1_a108_FRONTIPC_thermalControl";
BA_ "SystemSignalLongSymbol" SG_ 1335 VCFRONT1_a108_FRONTIPC_motorStat "VCFRONT1_a108_FRONTIPC_motorStatus";
BA_ "SystemSignalLongSymbol" SG_ 1335 VCFRONT1_a120_FRONTIPC_systemSta "VCFRONT1_a120_FRONTIPC_systemStatus";
BA_ "SystemSignalLongSymbol" SG_ 1335 VCFRONT1_a120_BATTIPC_systemStat "VCFRONT1_a120_BATTIPC_systemStatus";
BA_ "SystemSignalLongSymbol" SG_ 1335 VCFRONT1_a120_FRONTIPC_systemPow "VCFRONT1_a120_FRONTIPC_systemPower";
BA_ "SystemSignalLongSymbol" SG_ 1335 VCFRONT1_a120_FRONTIPC_autonomyH "VCFRONT1_a120_FRONTIPC_autonomyHealth";
BA_ "SystemSignalLongSymbol" SG_ 1335 VCFRONT1_a120_BATTIPC_chassisCon "VCFRONT1_a120_BATTIPC_chassisControl2";
BA_ "SystemSignalLongSymbol" SG_ 1335 VCFRONT1_a120_FRONTIPC_chassisCo "VCFRONT1_a120_FRONTIPC_chassisControl2";
BA_ "SystemSignalLongSymbol" SG_ 1335 VCFRONT1_a120_FRONTIPC_odometerS "VCFRONT1_a120_FRONTIPC_odometerStatus";
BA_ "SystemSignalLongSymbol" SG_ 1335 VCFRONT1_a125_FRONTIPC_steerAngl "VCFRONT1_a125_FRONTIPC_steerAngle";
BA_ "Confidence" SG_ 1335 VCFRONT1_a127_iBoosterEFuseCurre 1;
BA_ "SystemSignalLongSymbol" SG_ 1335 VCFRONT1_a127_iBoosterEFuseCurre "VCFRONT1_a127_iBoosterEFuseCurrent";
BA_ "Confidence" SG_ 1335 VCFRONT1_a127_iBoosterEFuseVolta 1;
BA_ "SystemSignalLongSymbol" SG_ 1335 VCFRONT1_a127_iBoosterEFuseVolta "VCFRONT1_a127_iBoosterEFuseVoltage";
BA_ "Confidence" SG_ 1335 VCFRONT1_a127_iBoosterEFuseTemp 1;
BA_ "Confidence" SG_ 1335 VCFRONT1_a128_vcrightEFuseCurren 1;
BA_ "SystemSignalLongSymbol" SG_ 1335 VCFRONT1_a128_vcrightEFuseCurren "VCFRONT1_a128_vcrightEFuseCurrent";
BA_ "Confidence" SG_ 1335 VCFRONT1_a128_vcrightEFuseVoltag 1;
BA_ "SystemSignalLongSymbol" SG_ 1335 VCFRONT1_a128_vcrightEFuseVoltag "VCFRONT1_a128_vcrightEFuseVoltage";
BA_ "Confidence" SG_ 1335 VCFRONT1_a128_vcrightEFuseTemp 1;
BA_ "SystemSignalLongSymbol" SG_ 1335 VCFRONT1_a128_vcrightEFuseRemain "VCFRONT1_a128_vcrightEFuseRemainingRetries";
BA_ "Confidence" SG_ 1335 VCFRONT1_a129_pcsEFuseCurrent 1;
BA_ "Confidence" SG_ 1335 VCFRONT1_a129_pcsEFuseVoltage 1;
BA_ "Confidence" SG_ 1335 VCFRONT1_a129_pcsEFuseTemp 1;
BA_ "SystemSignalLongSymbol" SG_ 1335 VCFRONT1_a129_pcsEFuseRemainingR "VCFRONT1_a129_pcsEFuseRemainingRetries";
BA_ "Confidence" SG_ 1335 VCFRONT1_a130_autopilot2EFuseCur 1;
BA_ "SystemSignalLongSymbol" SG_ 1335 VCFRONT1_a130_autopilot2EFuseCur "VCFRONT1_a130_autopilot2EFuseCurrent";
BA_ "Confidence" SG_ 1335 VCFRONT1_a130_autopilot2EFuseVol 1;
BA_ "SystemSignalLongSymbol" SG_ 1335 VCFRONT1_a130_autopilot2EFuseVol "VCFRONT1_a130_autopilot2EFuseVoltage";
BA_ "Confidence" SG_ 1335 VCFRONT1_a130_autopilot2EFuseTem 1;
BA_ "SystemSignalLongSymbol" SG_ 1335 VCFRONT1_a130_autopilot2EFuseTem "VCFRONT1_a130_autopilot2EFuseTemp";
BA_ "SystemSignalLongSymbol" SG_ 1335 VCFRONT1_a130_autopilot2EFuseRem "VCFRONT1_a130_autopilot2EFuseRemainingRetries";
BA_ "Confidence" SG_ 1335 VCFRONT1_a132_epas2EFuseCurrent 1;
BA_ "Confidence" SG_ 1335 VCFRONT1_a132_epas2EFuseVoltage 1;
BA_ "Confidence" SG_ 1335 VCFRONT1_a132_epas2EFuseTemp 1;
BA_ "SystemSignalLongSymbol" SG_ 1335 VCFRONT1_a133_BATTIPC_primaryAct "VCFRONT1_a133_BATTIPC_primaryActuator";
BA_ "SystemSignalLongSymbol" SG_ 1335 VCFRONT1_a133_FRONTIPC_secondary "VCFRONT1_a133_FRONTIPC_secondaryActuator";
BA_ "Confidence" SG_ 1335 VCFRONT1_a135_leftHeadlightEFuse 1;
BA_ "SystemSignalLongSymbol" SG_ 1335 VCFRONT1_a135_leftHeadlightEFuse "VCFRONT1_a135_leftHeadlightEFuseCurrent";
BA_ "Confidence" SG_ 1335 VCFRONT1_a164_lockoutVoltage 1;
BA_ "Confidence" SG_ 1335 VCFRONT1_a165_lockoutVoltage 1;
BA_ "Confidence" SG_ 1335 VCFRONT1_a177_mcuAudioEFuseCurre 1;
BA_ "SystemSignalLongSymbol" SG_ 1335 VCFRONT1_a177_mcuAudioEFuseCurre "VCFRONT1_a177_mcuAudioEFuseCurrent";
BA_ "Confidence" SG_ 1335 VCFRONT1_a177_mcuAudioEFuseVolta 1;
BA_ "SystemSignalLongSymbol" SG_ 1335 VCFRONT1_a177_mcuAudioEFuseVolta "VCFRONT1_a177_mcuAudioEFuseVoltage";
BA_ "Confidence" SG_ 1335 VCFRONT1_a191_vehiclePowerState 1;
BA_ "Confidence" SG_ 1335 VCFRONT1_a191_hvState 1;
BA_ "Confidence" SG_ 1335 VCFRONT1_a191_busVoltage 1;
BA_ "SystemSignalLongSymbol" SG_ 1335 VCFRONT1_a191_exitDriveWarningTi "VCFRONT1_a191_exitDriveWarningTimerExpired";
BA_ "SystemSignalLongSymbol" SG_ 1335 VCFRONT1_a191_NotEnoughPowerForS "VCFRONT1_a191_NotEnoughPowerForSupport";
BA_ "Confidence" SG_ 1335 VCFRONT1_a191_bmsState 1;
BA_ "GenSigSNA" SG_ 1335 VCFRONT1_a191_bmsState "9";
BA_ "Confidence" SG_ 1335 VCFRONT1_a204_vbusVoltage 1;
BA_ "SystemSignalLongSymbol" SG_ 1335 VCFRONT1_a204_uvLoadshedFaultInj "VCFRONT1_a204_uvLoadshedFaultInject";
BA_ "Confidence" SG_ 1335 VCFRONT1_a204_pcsBridgeCurrent 1;
BA_ "Confidence" SG_ 1335 VCFRONT1_a205_busVoltage 1;
BA_ "SystemSignalLongSymbol" SG_ 1335 VCFRONT1_a205_ovLoadshedFaultInj "VCFRONT1_a205_ovLoadshedFaultInject";
BA_ "Confidence" SG_ 1335 VCFRONT1_a205_pcsBridgeCurrent 1;
BA_ "Confidence" SG_ 1335 VCFRONT1_a216_hvState 1;
BA_ "SystemSignalLongSymbol" SG_ 1335 VCFRONT1_a216_vcrightFastBlowImm "VCFRONT1_a216_vcrightFastBlowImminent";
BA_ "SystemSignalLongSymbol" SG_ 1335 VCFRONT1_a216_vcrightFastBlowDeb "VCFRONT1_a216_vcrightFastBlowDebounceImminent";
BA_ "SystemSignalLongSymbol" SG_ 1335 VCFRONT1_a216_vcrightStaticImmin "VCFRONT1_a216_vcrightStaticImminent";
BA_ "SystemSignalLongSymbol" SG_ 1335 VCFRONT1_a216_vcrightDynamicImmi "VCFRONT1_a216_vcrightDynamicImminent";
BA_ "Confidence" SG_ 1335 VCFRONT1_a220_DI_gear 1;
BA_ "GenSigSNA" SG_ 1335 VCFRONT1_a220_DI_gear "7";
BA_ "Confidence" SG_ 1335 VCFRONT1_a220_vehicleSpeed 1;
BA_ "Confidence" SG_ 1335 VCFRONT1_a220_lvHealthStatus 1;
BA_ "Confidence" SG_ 1335 VCFRONT1_a220_unhealthyReason 1;
BA_ "SystemSignalLongSymbol" SG_ 1335 VCFRONT1_a223_overvoltageFaultAc "VCFRONT1_a223_overvoltageFaultActive";
BA_ "SystemSignalLongSymbol" SG_ 1335 VCFRONT1_a223_sharedBridgeShutdo "VCFRONT1_a223_sharedBridgeShutdownActive";
BA_ "SystemSignalLongSymbol" SG_ 1335 VCFRONT1_a250_pcsOvShutdownFault "VCFRONT1_a250_pcsOvShutdownFaultPinActive";
BA_ "Confidence" SG_ 1335 VCFRONT1_a250_busVoltage 1;
BA_ "Confidence" SG_ 1335 VCFRONT1_a250_dcdcEnableLineVolt 1;
BA_ "SystemSignalLongSymbol" SG_ 1335 VCFRONT1_a250_dcdcEnableLineVolt "VCFRONT1_a250_dcdcEnableLineVoltage";
BA_ "Confidence" SG_ 1335 VCFRONT1_a250_ovClampBusVoltage 1;
BA_ "Confidence" SG_ 1335 VCFRONT1_a250_ovClampReferenceVo 1;
BA_ "SystemSignalLongSymbol" SG_ 1335 VCFRONT1_a250_ovClampReferenceVo "VCFRONT1_a250_ovClampReferenceVoltage";
BA_ "Confidence" SG_ 1335 VCFRONT1_a250_ovClampMonitorVolt 1;
BA_ "SystemSignalLongSymbol" SG_ 1335 VCFRONT1_a250_ovClampMonitorVolt "VCFRONT1_a250_ovClampMonitorVoltage1";
BA_ "Confidence" SG_ 1335 VCFRONT1_a251_rationalitySetupCh 1;
BA_ "SystemSignalLongSymbol" SG_ 1335 VCFRONT1_a251_rationalitySetupCh "VCFRONT1_a251_rationalitySetupCheckResult";
BA_ "Confidence" SG_ 1335 VCFRONT1_a251_rationalitySetupFa 1;
BA_ "SystemSignalLongSymbol" SG_ 1335 VCFRONT1_a251_rationalitySetupFa "VCFRONT1_a251_rationalitySetupFailureReason";
BA_ "Confidence" SG_ 1335 VCFRONT1_a251_clampLowSideCheckR 1;
BA_ "SystemSignalLongSymbol" SG_ 1335 VCFRONT1_a251_clampLowSideCheckR "VCFRONT1_a251_clampLowSideCheckResult";
BA_ "Confidence" SG_ 1335 VCFRONT1_a251_clampLowSideFailur 1;
BA_ "SystemSignalLongSymbol" SG_ 1335 VCFRONT1_a251_clampLowSideFailur "VCFRONT1_a251_clampLowSideFailureReason";
BA_ "Confidence" SG_ 1335 VCFRONT1_a251_rationalityShutdow 1;
BA_ "SystemSignalLongSymbol" SG_ 1335 VCFRONT1_a251_rationalityShutdow "VCFRONT1_a251_rationalityShutdownArmedCheckResult";
BA_ "Confidence" SG_ 1335 VCFRONT1_a251_rationalitySh_0001 1;
BA_ "SystemSignalLongSymbol" SG_ 1335 VCFRONT1_a251_rationalitySh_0001 "VCFRONT1_a251_rationalityShutdownArmedFailureReason";
BA_ "Confidence" SG_ 1335 VCFRONT1_a251_clampHighSideCheck 1;
BA_ "SystemSignalLongSymbol" SG_ 1335 VCFRONT1_a251_clampHighSideCheck "VCFRONT1_a251_clampHighSideCheckResult";
BA_ "Confidence" SG_ 1335 VCFRONT1_a251_clampHighSideFailu 1;
BA_ "SystemSignalLongSymbol" SG_ 1335 VCFRONT1_a251_clampHighSideFailu "VCFRONT1_a251_clampHighSideFailureReason";
BA_ "Confidence" SG_ 1335 VCFRONT1_a251_rationalityPcsShut 1;
BA_ "SystemSignalLongSymbol" SG_ 1335 VCFRONT1_a251_rationalityPcsShut "VCFRONT1_a251_rationalityPcsShutdownCheckResult";
BA_ "Confidence" SG_ 1335 VCFRONT1_a251_rationalityPc_0001 1;
BA_ "SystemSignalLongSymbol" SG_ 1335 VCFRONT1_a251_rationalityPc_0001 "VCFRONT1_a251_rationalityPcsShutdownFailureReason";
BA_ "Confidence" SG_ 1335 VCFRONT1_a252_stage 1;
BA_ "SystemSignalLongSymbol" SG_ 1335 VCFRONT1_a252_incorrectPinConfig "VCFRONT1_a252_incorrectPinConfiguration";
BA_ "SystemSignalLongSymbol" SG_ 1335 VCFRONT1_a252_incorrectClampMoni "VCFRONT1_a252_incorrectClampMonitor1Voltage";
BA_ "SystemSignalLongSymbol" SG_ 1335 VCFRONT1_a252_incorrectClam_0001 "VCFRONT1_a252_incorrectClampMonitor2Voltage";
BA_ "SystemSignalLongSymbol" SG_ 1335 VCFRONT1_a252_incorrectClam_0002 "VCFRONT1_a252_incorrectClampMonitor3Voltage";
BA_ "SystemSignalLongSymbol" SG_ 1335 VCFRONT1_a252_incorrectPcsEnable "VCFRONT1_a252_incorrectPcsEnableLineVoltage";
BA_ "SystemSignalLongSymbol" SG_ 1335 VCFRONT1_a252_incorrectPcsTripSt "VCFRONT1_a252_incorrectPcsTripState";
BA_ "SystemSignalLongSymbol" SG_ 1335 VCFRONT1_a252_incorrectPcsSuppor "VCFRONT1_a252_incorrectPcsSupportStatus";
BA_ "SystemSignalLongSymbol" SG_ 1335 VCFRONT1_a252_incorrectPcsDcdcEn "VCFRONT1_a252_incorrectPcsDcdcEnableFeedback";
BA_ "SystemSignalLongSymbol" SG_ 1335 VCFRONT1_a252_pcsOvShutdownFault "VCFRONT1_a252_pcsOvShutdownFaultPinActive";
BA_ "SystemSignalLongSymbol" SG_ 1335 VCFRONT1_a252_pcsDcdcEnableFeedb "VCFRONT1_a252_pcsDcdcEnableFeedback";
BA_ "SystemSignalLongSymbol" SG_ 1335 VCFRONT1_a252_pcsOvSelfTestEnabl "VCFRONT1_a252_pcsOvSelfTestEnabled";
BA_ "Confidence" SG_ 1335 VCFRONT1_a252_busVoltage 1;
BA_ "Confidence" SG_ 1335 VCFRONT1_a252_dcdcEnableLineVolt 1;
BA_ "SystemSignalLongSymbol" SG_ 1335 VCFRONT1_a252_dcdcEnableLineVolt "VCFRONT1_a252_dcdcEnableLineVoltage";
BA_ "SystemSignalLongSymbol" SG_ 1335 VCFRONT1_a252_ovClampMonitorChan "VCFRONT1_a252_ovClampMonitorChannel";
BA_ "Confidence" SG_ 1335 VCFRONT1_a252_ovClampMonitorVolt 1;
BA_ "SystemSignalLongSymbol" SG_ 1335 VCFRONT1_a252_ovClampMonitorVolt "VCFRONT1_a252_ovClampMonitorVoltage";
BA_ "Confidence" SG_ 1335 VCFRONT1_a262_eFuseVoltage 1;
BA_ "Confidence" SG_ 1335 VCFRONT1_a262_vbatProtVoltage 1;
BA_ "Confidence" SG_ 1335 VCFRONT1_a263_eFuseVoltage 1;
BA_ "Confidence" SG_ 1335 VCFRONT1_a263_vbatProtVoltage 1;
BA_ "Confidence" SG_ 1335 VCFRONT1_a264_eFuseVoltage 1;
BA_ "Confidence" SG_ 1335 VCFRONT1_a264_vbatProtVoltage 1;
BA_ "Confidence" SG_ 1335 VCFRONT1_a266_eFuseVoltage 1;
BA_ "Confidence" SG_ 1335 VCFRONT1_a266_vbatProtVoltage 1;
BA_ "Confidence" SG_ 1335 VCFRONT1_a414_failureReason 1;
BA_ "SystemSignalLongSymbol" SG_ 1335 VCFRONT1_a414_loadUnattemptedOnF "VCFRONT1_a414_loadUnattemptedOnFailure";
BA_ "SystemSignalLongSymbol" SG_ 1335 VCFRONT1_a414_deviceStuckOnFailu "VCFRONT1_a414_deviceStuckOnFailure";
BA_ "SystemSignalLongSymbol" SG_ 1335 VCFRONT1_a414_followerVCRightSel "VCFRONT1_a414_followerVCRightSelfTestFailure";
BA_ "SystemSignalLongSymbol" SG_ 1335 VCFRONT1_a414_uvLoadshedVsenseDi "VCFRONT1_a414_uvLoadshedVsenseDigIn";
BA_ "SystemSignalLongSymbol" SG_ 1335 VCFRONT1_a415_upstreamEFuseStuck "VCFRONT1_a415_upstreamEFuseStuckOff";
BA_ "Confidence" SG_ 1335 VCFRONT1_a475_channel 1;
BA_ "SystemSignalLongSymbol" SG_ 1335 VCFRONT1_a475_deviceOvertemperat "VCFRONT1_a475_deviceOvertemperature";
BA_ "Confidence" SG_ 1335 VCFRONT1_a480_channel 1;
BA_ "SystemSignalLongSymbol" SG_ 1335 VCFRONT1_a480_deviceOvertemperat "VCFRONT1_a480_deviceOvertemperature";
BA_ "Confidence" SG_ 1335 VCFRONT1_a482_lvBridgeEFuseCurre 1;
BA_ "SystemSignalLongSymbol" SG_ 1335 VCFRONT1_a482_lvBridgeEFuseCurre "VCFRONT1_a482_lvBridgeEFuseCurrent";
BA_ "Confidence" SG_ 1335 VCFRONT1_a482_lvBridgeEFuseVolta 1;
BA_ "SystemSignalLongSymbol" SG_ 1335 VCFRONT1_a482_lvBridgeEFuseVolta "VCFRONT1_a482_lvBridgeEFuseVoltage";
BA_ "Confidence" SG_ 1335 VCFRONT1_a482_lvBridgeEFuseTemp 1;
BA_ "SystemSignalLongSymbol" SG_ 1335 VCFRONT1_a484_upstreamEFuseStuck "VCFRONT1_a484_upstreamEFuseStuckOn";
BA_ "Confidence" SG_ 1335 VCFRONT1_a484_upstreamEFuseVolta 1;
BA_ "SystemSignalLongSymbol" SG_ 1335 VCFRONT1_a484_upstreamEFuseVolta "VCFRONT1_a484_upstreamEFuseVoltage";
BA_ "Confidence" SG_ 1335 VCFRONT1_a484_vbusVoltage 1;
BA_ "Confidence" SG_ 1335 VCFRONT1_a484_upstreamEFuseRatio 1;
BA_ "SystemSignalLongSymbol" SG_ 1335 VCFRONT1_a485_upstreamEfuseUnatt "VCFRONT1_a485_upstreamEfuseUnattemptedOn";
BA_ "SystemSignalLongSymbol" SG_ 1335 VCFRONT1_a486_bridgeFailedArming "VCFRONT1_a486_bridgeFailedArmingSetup";
BA_ "SystemSignalLongSymbol" SG_ 1335 VCFRONT1_a486_bridgeFailedSyncCh "VCFRONT1_a486_bridgeFailedSyncCheck";
BA_ "SystemSignalLongSymbol" SG_ 1335 VCFRONT1_a486_localBridgeOutputO "VCFRONT1_a486_localBridgeOutputOn";
BA_ "SystemSignalLongSymbol" SG_ 1335 VCFRONT1_a486_localBridgeSyncArm "VCFRONT1_a486_localBridgeSyncArmed";
BA_ "SystemSignalLongSymbol" SG_ 1335 VCFRONT1_a486_localBridgeDinStat "VCFRONT1_a486_localBridgeDinState";
BA_ "SystemSignalLongSymbol" SG_ 1335 VCFRONT1_a486_remoteBridgeOutput "VCFRONT1_a486_remoteBridgeOutputOn";
BA_ "SystemSignalLongSymbol" SG_ 1335 VCFRONT1_a486_remoteBridgeO_0001 "VCFRONT1_a486_remoteBridgeOutputOnValid";
BA_ "SystemSignalLongSymbol" SG_ 1335 VCFRONT1_a486_remoteBridgeSyncAr "VCFRONT1_a486_remoteBridgeSyncArmed";
BA_ "SystemSignalLongSymbol" SG_ 1335 VCFRONT1_a486_remoteBridgeS_0001 "VCFRONT1_a486_remoteBridgeSyncArmedValid";
BA_ "SystemSignalLongSymbol" SG_ 1335 VCFRONT1_a486_remoteBridgeDinSta "VCFRONT1_a486_remoteBridgeDinState";
BA_ "SystemSignalLongSymbol" SG_ 1335 VCFRONT1_a486_remoteBridgeD_0001 "VCFRONT1_a486_remoteBridgeDinStateValid";
BA_ "SystemSignalLongSymbol" SG_ 1335 VCFRONT1_a496_NotEnoughPowerForS "VCFRONT1_a496_NotEnoughPowerForSupport";
BA_ "Confidence" SG_ 1335 VCFRONT1_a496_bmsState 1;
BA_ "GenSigSNA" SG_ 1335 VCFRONT1_a496_bmsState "9";
BA_ "Confidence" SG_ 1335 VCFRONT1_a500_mismatchedState 1;
BA_ "Confidence" SG_ 1335 VCFRONT1_a509_channel 1;
BA_ "Confidence" SG_ 1335 VCFRONT1_a509_state 1;
BA_ "Confidence" SG_ 1335 VCFRONT1_a509_expectedState 1;
BA_ "Confidence" SG_ 1335 VCFRONT1_a574_frontDriveInverter 1;
BA_ "SystemSignalLongSymbol" SG_ 1335 VCFRONT1_a574_frontDriveInverter "VCFRONT1_a574_frontDriveInverterCurrent";
BA_ "SystemSignalLongSymbol" SG_ 1335 VCFRONT1_a574_frontDriveInv_0001 "VCFRONT1_a574_frontDriveInverterRemainingRetries";
BA_ "Confidence" SG_ 1335 VCFRONT1_a596_vcrightCutoffEFuse 1;
BA_ "SystemSignalLongSymbol" SG_ 1335 VCFRONT1_a596_vcrightCutoffEFuse "VCFRONT1_a596_vcrightCutoffEFuseCurveType";
BA_ "SystemSignalLongSymbol" SG_ 1335 VCFRONT1_a596_vcrightCutoffCurve "VCFRONT1_a596_vcrightCutoffCurveOffsetChannel";
BA_ "Confidence" SG_ 1335 VCFRONT1_a596_vcrightCutoffATerm 1;
BA_ "GenSigSNA" SG_ 1335 VCFRONT1_a596_vcrightCutoffATerm "65535";
BA_ "Confidence" SG_ 1335 VCFRONT1_a596_vcrightCutoffBTerm 1;
BA_ "GenSigSNA" SG_ 1335 VCFRONT1_a596_vcrightCutoffBTerm "128";
BA_ "Confidence" SG_ 1335 VCFRONT1_a596_vcrightCutoffCTerm 1;
BA_ "GenSigSNA" SG_ 1335 VCFRONT1_a596_vcrightCutoffCTerm "32768";
BA_ "Confidence" SG_ 1335 VCFRONT1_a597_vcrightCutoffEFuse 1;
BA_ "SystemSignalLongSymbol" SG_ 1335 VCFRONT1_a597_vcrightCutoffEFuse "VCFRONT1_a597_vcrightCutoffEFuseFastBlowType";
BA_ "Confidence" SG_ 1335 VCFRONT1_a597_vcrightCutoffCurre 1;
BA_ "SystemSignalLongSymbol" SG_ 1335 VCFRONT1_a597_vcrightCutoffCurre "VCFRONT1_a597_vcrightCutoffCurrentThreshold";
BA_ "SystemSignalLongSymbol" SG_ 1335 VCFRONT1_a597_vcrightCutoffTimin "VCFRONT1_a597_vcrightCutoffTimingThresholdMs";
BA_ "SystemSignalLongSymbol" SG_ 1335 VCFRONT1_a597_vcrightCutoffMaxCo "VCFRONT1_a597_vcrightCutoffMaxCount";
BA_ "Confidence" SG_ 833 VCFRONT1_matrixIndex 1;
BA_ "SystemSignalLongSymbol" SG_ 833 VCFRONT1_a030_ECULogUploadReques "VCFRONT1_a030_ECULogUploadRequest";
BA_ "SystemSignalLongSymbol" SG_ 833 VCFRONT1_a058_inputRHighSyncDebu "VCFRONT1_a058_inputRHighSyncDebug";
BA_ "SystemSignalLongSymbol" SG_ 833 VCFRONT1_a059_inputResistanceHig "VCFRONT1_a059_inputResistanceHigh";
BA_ "SystemSignalLongSymbol" SG_ 833 VCFRONT1_a130_autopilot2EFuseTri "VCFRONT1_a130_autopilot2EFuseTrip";
BA_ "SystemSignalLongSymbol" SG_ 833 VCFRONT1_a134_hvContactorsEFuseT "VCFRONT1_a134_hvContactorsEFuseTrip";
BA_ "SystemSignalLongSymbol" SG_ 833 VCFRONT1_a135_leftHeadlightEFuse "VCFRONT1_a135_leftHeadlightEFuseTrip";
BA_ "SystemSignalLongSymbol" SG_ 833 VCFRONT1_a191_exitDriveDomainDow "VCFRONT1_a191_exitDriveDomainDown";
BA_ "SystemSignalLongSymbol" SG_ 833 VCFRONT1_a204_undervoltageLoadsh "VCFRONT1_a204_undervoltageLoadshedTriggered";
BA_ "SystemSignalLongSymbol" SG_ 833 VCFRONT1_a205_overvoltageProtect "VCFRONT1_a205_overvoltageProtectionTriggered";
BA_ "SystemSignalLongSymbol" SG_ 833 VCFRONT1_a214_openCircuitDetecte "VCFRONT1_a214_openCircuitDetected";
BA_ "SystemSignalLongSymbol" SG_ 833 VCFRONT1_a216_powerCutoffImminen "VCFRONT1_a216_powerCutoffImminent";
BA_ "SystemSignalLongSymbol" SG_ 833 VCFRONT1_a223_bridgeOvervoltageS "VCFRONT1_a223_bridgeOvervoltageSelfTestFailure";
BA_ "SystemSignalLongSymbol" SG_ 833 VCFRONT1_a229_LVHealthCompromise "VCFRONT1_a229_LVHealthCompromised";
BA_ "SystemSignalLongSymbol" SG_ 833 VCFRONT1_a230_autopilot2EFuseTri "VCFRONT1_a230_autopilot2EFuseTripDuringOTA";
BA_ "SystemSignalLongSymbol" SG_ 833 VCFRONT1_a250_pcsOvShutdownTripp "VCFRONT1_a250_pcsOvShutdownTripped";
BA_ "SystemSignalLongSymbol" SG_ 833 VCFRONT1_a251_pcsOvShutdownSelfT "VCFRONT1_a251_pcsOvShutdownSelfTestFailure";
BA_ "SystemSignalLongSymbol" SG_ 833 VCFRONT1_a252_pcsOvShutdownSelfT "VCFRONT1_a252_pcsOvShutdownSelfTestStageFailure";
BA_ "SystemSignalLongSymbol" SG_ 833 VCFRONT1_a253_pcsOvShutdownHighS "VCFRONT1_a253_pcsOvShutdownHighSideSelfTestDebug";
BA_ "SystemSignalLongSymbol" SG_ 833 VCFRONT1_a262_vcrightVoltageMism "VCFRONT1_a262_vcrightVoltageMismatch";
BA_ "SystemSignalLongSymbol" SG_ 833 VCFRONT1_a264_iBoosterVoltageMis "VCFRONT1_a264_iBoosterVoltageMismatch";
BA_ "SystemSignalLongSymbol" SG_ 833 VCFRONT1_a266_EPAS2VoltageMismat "VCFRONT1_a266_EPAS2VoltageMismatch";
BA_ "SystemSignalLongSymbol" SG_ 833 VCFRONT1_a414_undervoltageSelfTe "VCFRONT1_a414_undervoltageSelfTestFailure";
BA_ "SystemSignalLongSymbol" SG_ 833 VCFRONT1_a415_undervoltageSelfTe "VCFRONT1_a415_undervoltageSelfTestStuckOff";
BA_ "SystemSignalLongSymbol" SG_ 833 VCFRONT1_a483_vnf1048SelfTestFai "VCFRONT1_a483_vnf1048SelfTestFailure";
BA_ "SystemSignalLongSymbol" SG_ 833 VCFRONT1_a484_undervoltageSelfTe "VCFRONT1_a484_undervoltageSelfTestStuckOn";
BA_ "SystemSignalLongSymbol" SG_ 833 VCFRONT1_a485_uvSelfTestLoadUnat "VCFRONT1_a485_uvSelfTestLoadUnattemptedOnDbg";
BA_ "SystemSignalLongSymbol" SG_ 833 VCFRONT1_a486_undervoltageSelfTe "VCFRONT1_a486_undervoltageSelfTestBridgeSyncFailure";
BA_ "SystemSignalLongSymbol" SG_ 833 VCFRONT1_a489_vnf1248SelfTestDeb "VCFRONT1_a489_vnf1248SelfTestDebug";
BA_ "SystemSignalLongSymbol" SG_ 833 VCFRONT1_a490_vnf1248SelfTestFai "VCFRONT1_a490_vnf1248SelfTestFailure";
BA_ "SystemSignalLongSymbol" SG_ 833 VCFRONT1_a491_vnf1248Configurati "VCFRONT1_a491_vnf1248ConfigurationMismatch";
BA_ "SystemSignalLongSymbol" SG_ 833 VCFRONT1_a496_exitDriveWarningDo "VCFRONT1_a496_exitDriveWarningDomainDown";
BA_ "SystemSignalLongSymbol" SG_ 833 VCFRONT1_a500_eFuseASICStateMism "VCFRONT1_a500_eFuseASICStateMismatch";
BA_ "SystemSignalLongSymbol" SG_ 833 VCFRONT1_a501_vnf1048Configurati "VCFRONT1_a501_vnf1048ConfigurationMismatch";
BA_ "SystemSignalLongSymbol" SG_ 833 VCFRONT1_a509_eFuseASICManagerSt "VCFRONT1_a509_eFuseASICManagerStateMismatch";
BA_ "SystemSignalLongSymbol" SG_ 833 VCFRONT1_a523_eFuseThresholdsInc "VCFRONT1_a523_eFuseThresholdsIncorrect";
BA_ "SystemSignalLongSymbol" SG_ 833 VCFRONT1_a574_frontDriveInverter "VCFRONT1_a574_frontDriveInverterEFuseTrip";
BA_ "SystemSignalLongSymbol" SG_ 833 VCFRONT1_a575_frontDriveInverter "VCFRONT1_a575_frontDriveInverterEFuseTripDBG";
BA_ "SystemSignalLongSymbol" SG_ 833 VCFRONT1_a578_vbusFusedLoadShedE "VCFRONT1_a578_vbusFusedLoadShedEFuseTrip";
BA_ "SystemSignalLongSymbol" SG_ 833 VCFRONT1_a581_harnessResistanceI "VCFRONT1_a581_harnessResistanceInfo";
BA_ "SystemSignalLongSymbol" SG_ 833 VCFRONT1_a590_vcrightPwrRational "VCFRONT1_a590_vcrightPwrRationalityCurve";
BA_ "SystemSignalLongSymbol" SG_ 833 VCFRONT1_a591_vcrightFastBlowDet "VCFRONT1_a591_vcrightFastBlowDetection";
BA_ "SystemSignalLongSymbol" SG_ 833 VCFRONT1_a596_vcrightCurvePowerC "VCFRONT1_a596_vcrightCurvePowerCutoff";
BA_ "SystemSignalLongSymbol" SG_ 833 VCFRONT1_a597_vcrightFastBlowPow "VCFRONT1_a597_vcrightFastBlowPowerCutoff";
BA_ "Confidence" SG_ 1027 VCFRONT1_eFuseDebugStatusIndex 1;
BA_ "Confidence" SG_ 1027 VCFRONT1_EPAS2EFuseState 0;
BA_ "Confidence" SG_ 1027 VCFRONT1_EPAS2EFuseCurrent 0;
BA_ "Confidence" SG_ 1027 VCFRONT1_EPAS2EFuseOutput 0;
BA_ "Confidence" SG_ 1027 VCFRONT1_EPAS2EFuseOutputDesired 0;
BA_ "Confidence" SG_ 1027 VCFRONT1_EPAS2EFuseBypass 0;
BA_ "Confidence" SG_ 1027 VCFRONT1_EPAS2EFuseBypassDesired 0;
BA_ "Confidence" SG_ 1027 VCFRONT1_EPAS2EFuseVoltage 0;
BA_ "Confidence" SG_ 1027 VCFRONT1_EPAS2EFuseTemperature 0;
BA_ "Confidence" SG_ 1027 VCFRONT1_EPAS2EFuseManagerState 0;
BA_ "Confidence" SG_ 1027 VCFRONT1_EPAS2EFuseHardShortThre 0;
BA_ "SystemSignalLongSymbol" SG_ 1027 VCFRONT1_EPAS2EFuseHardShortThre "VCFRONT1_EPAS2EFuseHardShortThreshold";
BA_ "Confidence" SG_ 1027 VCFRONT1_EPAS2EFuseOCThreshold 0;
BA_ "Confidence" SG_ 1027 VCFRONT1_EPAS2EFuseType 0;
BA_ "Confidence" SG_ 1027 VCFRONT1_rightControllerEFuseSta 0;
BA_ "SystemSignalLongSymbol" SG_ 1027 VCFRONT1_rightControllerEFuseSta "VCFRONT1_rightControllerEFuseState";
BA_ "Confidence" SG_ 1027 VCFRONT1_rightControllerEFuseCur 0;
BA_ "SystemSignalLongSymbol" SG_ 1027 VCFRONT1_rightControllerEFuseCur "VCFRONT1_rightControllerEFuseCurrent";
BA_ "Confidence" SG_ 1027 VCFRONT1_rightControllerEFuseOut 0;
BA_ "SystemSignalLongSymbol" SG_ 1027 VCFRONT1_rightControllerEFuseOut "VCFRONT1_rightControllerEFuseOutput";
BA_ "Confidence" SG_ 1027 VCFRONT1_rightControllerEFu_0002 0;
BA_ "SystemSignalLongSymbol" SG_ 1027 VCFRONT1_rightControllerEFu_0002 "VCFRONT1_rightControllerEFuseOutputDesired";
BA_ "Confidence" SG_ 1027 VCFRONT1_rightControllerEFuseByp 0;
BA_ "SystemSignalLongSymbol" SG_ 1027 VCFRONT1_rightControllerEFuseByp "VCFRONT1_rightControllerEFuseBypass";
BA_ "Confidence" SG_ 1027 VCFRONT1_rightControllerEFu_0001 0;
BA_ "SystemSignalLongSymbol" SG_ 1027 VCFRONT1_rightControllerEFu_0001 "VCFRONT1_rightControllerEFuseBypassDesired";
BA_ "Confidence" SG_ 1027 VCFRONT1_rightControllerEFuseVol 0;
BA_ "SystemSignalLongSymbol" SG_ 1027 VCFRONT1_rightControllerEFuseVol "VCFRONT1_rightControllerEFuseVoltage";
BA_ "Confidence" SG_ 1027 VCFRONT1_rightControllerEFuseTem 0;
BA_ "SystemSignalLongSymbol" SG_ 1027 VCFRONT1_rightControllerEFuseTem "VCFRONT1_rightControllerEFuseTemperature";
BA_ "Confidence" SG_ 1027 VCFRONT1_rightControllerEFuseMan 0;
BA_ "SystemSignalLongSymbol" SG_ 1027 VCFRONT1_rightControllerEFuseMan "VCFRONT1_rightControllerEFuseManagerState";
BA_ "Confidence" SG_ 1027 VCFRONT1_rightControllerEFuseHar 0;
BA_ "SystemSignalLongSymbol" SG_ 1027 VCFRONT1_rightControllerEFuseHar "VCFRONT1_rightControllerEFuseHardShortThreshold";
BA_ "Confidence" SG_ 1027 VCFRONT1_rightControllerEFuseOCT 0;
BA_ "SystemSignalLongSymbol" SG_ 1027 VCFRONT1_rightControllerEFuseOCT "VCFRONT1_rightControllerEFuseOCThreshold";
BA_ "Confidence" SG_ 1027 VCFRONT1_rightControllerEFuseTyp 0;
BA_ "SystemSignalLongSymbol" SG_ 1027 VCFRONT1_rightControllerEFuseTyp "VCFRONT1_rightControllerEFuseType";
BA_ "Confidence" SG_ 1027 VCFRONT1_autopilot2EFuseState 0;
BA_ "Confidence" SG_ 1027 VCFRONT1_autopilot2EFuseCurrent 0;
BA_ "Confidence" SG_ 1027 VCFRONT1_autopilot2EFuseOutput 0;
BA_ "Confidence" SG_ 1027 VCFRONT1_autopilot2EFuseOutputDe 0;
BA_ "SystemSignalLongSymbol" SG_ 1027 VCFRONT1_autopilot2EFuseOutputDe "VCFRONT1_autopilot2EFuseOutputDesired";
BA_ "Confidence" SG_ 1027 VCFRONT1_autopilot2EFuseBypass 0;
BA_ "Confidence" SG_ 1027 VCFRONT1_autopilot2EFuseBypassDe 0;
BA_ "SystemSignalLongSymbol" SG_ 1027 VCFRONT1_autopilot2EFuseBypassDe "VCFRONT1_autopilot2EFuseBypassDesired";
BA_ "Confidence" SG_ 1027 VCFRONT1_autopilot2EFuseVoltage 0;
BA_ "Confidence" SG_ 1027 VCFRONT1_autopilot2EFuseTemperat 0;
BA_ "SystemSignalLongSymbol" SG_ 1027 VCFRONT1_autopilot2EFuseTemperat "VCFRONT1_autopilot2EFuseTemperature";
BA_ "Confidence" SG_ 1027 VCFRONT1_autopilot2EFuseManagerS 0;
BA_ "SystemSignalLongSymbol" SG_ 1027 VCFRONT1_autopilot2EFuseManagerS "VCFRONT1_autopilot2EFuseManagerState";
BA_ "Confidence" SG_ 1027 VCFRONT1_autopilot2EFuseHardShor 0;
BA_ "SystemSignalLongSymbol" SG_ 1027 VCFRONT1_autopilot2EFuseHardShor "VCFRONT1_autopilot2EFuseHardShortThreshold";
BA_ "Confidence" SG_ 1027 VCFRONT1_autopilot2EFuseOCThresh 0;
BA_ "SystemSignalLongSymbol" SG_ 1027 VCFRONT1_autopilot2EFuseOCThresh "VCFRONT1_autopilot2EFuseOCThreshold";
BA_ "Confidence" SG_ 1027 VCFRONT1_autopilot2EFuseType 0;
BA_ "Confidence" SG_ 1581 VCFRONT1_udsResponseData 1;
VAL_ 1335 VCFRONT1_alertID 617 "a617_APP_MIA" 597 "a597_vcrightFastBlowPowerCutoff" 596 "a596_vcrightCurvePowerCutoff" 591 "a591_vcrightFastBlowDetection" 590 "a590_vcrightPwrRationalityCurve" 581 "a581_harnessResistanceInfo" 578 "a578_vbusFusedLoadShedEFuseTrip" 575 "a575_frontDriveInverterEFuseTripDBG" 574 "a574_frontDriveInverterEFuseTrip" 523 "a523_eFuseThresholdsIncorrect" 509 "a509_eFuseASICManagerStateMismatch" 501 "a501_vnf1048ConfigurationMismatch" 500 "a500_eFuseASICStateMismatch" 496 "a496_exitDriveWarningDomainDown" 491 "a491_vnf1248ConfigurationMismatch" 490 "a490_vnf1248SelfTestFailure" 489 "a489_vnf1248SelfTestDebug" 486 "a486_undervoltageSelfTestBridgeSyncFailure" 485 "a485_uvSelfTestLoadUnattemptedOnDbg" 484 "a484_undervoltageSelfTestStuckOn" 483 "a483_vnf1048SelfTestFailure" 482 "a482_lvBridgeEFuseTrip" 480 "a480_vnf1048Fault" 475 "a475_vnf1248Fault" 450 "a450_doorWakeToOpenDBG" 423 "a423_rtosSleepFailed" 415 "a415_undervoltageSelfTestStuckOff" 414 "a414_undervoltageSelfTestFailure" 266 "a266_EPAS2VoltageMismatch" 264 "a264_iBoosterVoltageMismatch" 263 "a263_pcsVoltageMismatch" 262 "a262_vcrightVoltageMismatch" 256 "a256_nxppca9539Fault" 253 "a253_pcsOvShutdownHighSideSelfTestDebug" 252 "a252_pcsOvShutdownSelfTestStageFailure" 251 "a251_pcsOvShutdownSelfTestFailure" 250 "a250_pcsOvShutdownTripped" 249 "a249_pcsOvClampTripped" 230 "a230_autopilot2EFuseTripDuringOTA" 229 "a229_LVHealthCompromised" 223 "a223_bridgeOvervoltageSelfTestFailure" 220 "a220_LVUnhealthy" 216 "a216_powerCutoffImminent" 214 "a214_openCircuitDetected" 205 "a205_overvoltageProtectionTriggered" 204 "a204_undervoltageLoadshedTriggered" 191 "a191_exitDriveDomainDown" 188 "a188_sleepFailed" 177 "a177_mcuAudioEFuseTrip" 165 "a165_unxpctdEFuseLckout" 164 "a164_eFuseLckoutMissing" 144 "a144_EPAS3S_MIA" 135 "a135_leftHeadlightEFuseTrip" 134 "a134_hvContactorsEFuseTrip" 133 "a133_BRAKE_MIA" 132 "a132_epas2EFuseTrip" 131 "a131_PCSCOMMON_MIA" 130 "a130_autopilot2EFuseTrip" 129 "a129_pcsEFuseTrip" 128 "a128_vcrightEFuseTrip" 127 "a127_iBoosterEFuseTrip" 126 "a126_EPAS3P_MIA" 125 "a125_SCCM_MIA" 124 "a124_BB_MIA" 122 "a122_ICR_MIA" 120 "a120_DI_DRIVE_MIA" 119 "a119_SCCM_MIA" 118 "a118_VCFRONT_MIA" 117 "a117_VCLEFT_MIA" 116 "a116_VCRIGHT_MIA" 115 "a115_VCSEC_MIA" 114 "a114_ESP_MIA" 113 "a113_UI_MIA" 112 "a112_EPBL_MIA" 111 "a111_EPBR_MIA" 110 "a110_GTW_MIA" 109 "a109_RCM_MIA" 108 "a108_DIF_MIA" 107 "a107_BMS_MIA" 106 "a106_PCS_MIA" 105 "a105_TAS_MIA" 104 "a104_DAS_MIA" 103 "a103_CP_MIA" 100 "a100_CANbus_MIA" 98 "a098_DIR_MIA" 96 "a096_OCS1P_MIA" 91 "a091_CMPD_MIA" 90 "a090_APS_MIA" 86 "a086_VCBATT_MIA" 82 "a082_VCFRONT2_MIA" 81 "a081_VCFRONT1_MIA" 80 "a080_VCFRONT0_MIA" 79 "a079_VCBATT2_MIA" 78 "a078_VCBATT1_MIA" 77 "a077_VCBATT0_MIA" 64 "a064_busSleepReqTimeout" 63 "a063_SwitchFault" 62 "a062_XCPWasConnected" 61 "a061_XCPConnected" 60 "a060_engineeringBuild" 59 "a059_inputResistanceHigh" 58 "a058_inputRHighSyncDebug" 46 "a046_Task1000msError" 45 "a045_Task100msError" 44 "a044_Task10msError" 43 "a043_Task1msError" 42 "a042_HighStackUsage" 41 "a041_HighCPULoad" 40 "a040_Backtrace" 39 "a039_ProtFaultAddress" 38 "a038_ProtFaultInfo" 37 "a037_MemManageFault" 36 "a036_UnknownIrq" 31 "a031_UDSActive" 30 "a030_ECULogUploadRequest" 29 "a029_CoreDump" 28 "a028_UsageFault" 22 "a022_TaskInitError" 21 "a021_TaskSchedulerError" 19 "a019_BusFault" 18 "a018_HardFault" 17 "a017_NVMMStatusDbg" 16 "a016_NVMMRecordError" 15 "a015_NVMMError" 13 "a013_AlertManagerFault" 12 "a012_CPUReset" 6 "a006_CANTX_cyclicError" 5 "a005_CANTXError" 3 "a003_SWAssertion" 2 "a002_PowerLossReset" 1 "a001_WatchdogReset" 0 "ALERT_DO_NOT_USE_ZERO" ;
VAL_ 1335 VCFRONT1_alertState 1 "SET" 0 "CLEARED" ;
VAL_ 1335 VCFRONT1_a191_vehiclePowerState 3 "DRIVE" 2 "ACCESSORY" 1 "CONDITIONING" 0 "OFF" ;
VAL_ 1335 VCFRONT1_a191_hvState 6 "UP" 5 "UP_FOR_DC_CHARGE" 4 "UP_FOR_CHARGE" 3 "UP_FOR_DRIVE" 2 "GOING_DOWN" 1 "COMING_UP" 0 "DOWN" ;
VAL_ 1335 VCFRONT1_a191_bmsState 10 "DIAG" 9 "SNA" 8 "TEST" 7 "WELD" 6 "FAULT" 5 "CLEAR_FAULT" 4 "FEIM" 3 "CHARGE" 2 "SUPPORT" 1 "DRIVE" 0 "STANDBY" ;
VAL_ 1335 VCFRONT1_a216_hvState 6 "UP" 5 "UP_FOR_DC_CHARGE" 4 "UP_FOR_CHARGE" 3 "UP_FOR_DRIVE" 2 "GOING_DOWN" 1 "COMING_UP" 0 "DOWN" ;
VAL_ 1335 VCFRONT1_a220_DI_gear 7 "SNA" 4 "D" 3 "N" 2 "R" 1 "P" 0 "INVALID" ;
VAL_ 1335 VCFRONT1_a220_lvHealthStatus 6 "POWER_SUPPLY_COMPROMISED" 5 "ENERGY_RESERVE_CRITICAL" 4 "ENERGY_RESERVE_COMPROMISED" 3 "BACKUP_COMPROMISED" 2 "LATENT_FAULT" 1 "HEALTHY_LIMITED" 0 "DOMAIN_HEALTHY" ;
VAL_ 1335 VCFRONT1_a220_unhealthyReason 25 "PROTECTIONS_ARM_STATE" 24 "PCS_CRITICAL_HARNESS_RESISTANCE" 23 "HVC_EFUSE_STATE" 22 "PCS_OVERVOLTAGE_CLAMP_ARM_STATE" 21 "PCS_OVERVOLTAGE_CLAMP_TRIP_STATE" 20 "PCS_OVERVOLTAGE_CLAMP_BUS_RATIONALITY" 19 "PCS_OVERVOLTAGE_CLAMP_REFERENCE_RATIONALITY" 18 "PCS_SUPPORT_STATUS" 17 "PCS_POWER_CAPABILITY" 16 "PCS_COMMS" 15 "PCS_ELECTRICAL_CONNECTION_CONFIDENCE" 14 "PCS_ELECTRICAL_CONNECTION" 13 "PCS_EFUSE_STATE" 12 "EFUSE_CONFIGURATION" 11 "PCS_SHUTDOWN_ARM_STATE" 10 "PCS_SHUTDOWN_SELF_TEST" 9 "PCS_SHUTDOWN_TRIP_STATE" 8 "PROTECTIONS_LOCKOUT_STATE" 7 "OVERVOLTAGE_SELF_TEST" 6 "OVERVOLTAGE_TRIP_STATE" 5 "UNDERVOLTAGE_SELF_TEST" 4 "UNDERVOLTAGE_TRIP_STATE" 3 "VCBATT_COMMS" 2 "BRIDGE_EFUSE_SELF_TEST" 1 "BRIDGE_STATE" 0 "UNKNOWN" ;
VAL_ 1335 VCFRONT1_a251_rationalitySetupCh 2 "PASSED" 1 "FAILED" 0 "INVALID" ;
VAL_ 1335 VCFRONT1_a251_rationalitySetupFa 7 "MULTIPLE" 6 "INCORRECT_PCS_DCDC_ENABLE_FEEDBACK" 5 "INCORRECT_PCS_SUPPORT_STATUS" 4 "INCORRECT_PCS_TRIP_STATE" 3 "INCORRECT_PCS_ENABLE_LINE_VOLTAGE" 2 "INCORRECT_CLAMP_MONITOR_VOLTAGE" 1 "INCORRECT_PIN_CONFIGURATION" 0 "NONE" ;
VAL_ 1335 VCFRONT1_a251_clampLowSideCheckR 2 "PASSED" 1 "FAILED" 0 "INVALID" ;
VAL_ 1335 VCFRONT1_a251_clampLowSideFailur 7 "MULTIPLE" 6 "INCORRECT_PCS_DCDC_ENABLE_FEEDBACK" 5 "INCORRECT_PCS_SUPPORT_STATUS" 4 "INCORRECT_PCS_TRIP_STATE" 3 "INCORRECT_PCS_ENABLE_LINE_VOLTAGE" 2 "INCORRECT_CLAMP_MONITOR_VOLTAGE" 1 "INCORRECT_PIN_CONFIGURATION" 0 "NONE" ;
VAL_ 1335 VCFRONT1_a251_rationalityShutdow 2 "PASSED" 1 "FAILED" 0 "INVALID" ;
VAL_ 1335 VCFRONT1_a251_rationalitySh_0001 7 "MULTIPLE" 6 "INCORRECT_PCS_DCDC_ENABLE_FEEDBACK" 5 "INCORRECT_PCS_SUPPORT_STATUS" 4 "INCORRECT_PCS_TRIP_STATE" 3 "INCORRECT_PCS_ENABLE_LINE_VOLTAGE" 2 "INCORRECT_CLAMP_MONITOR_VOLTAGE" 1 "INCORRECT_PIN_CONFIGURATION" 0 "NONE" ;
VAL_ 1335 VCFRONT1_a251_clampHighSideCheck 2 "PASSED" 1 "FAILED" 0 "INVALID" ;
VAL_ 1335 VCFRONT1_a251_clampHighSideFailu 7 "MULTIPLE" 6 "INCORRECT_PCS_DCDC_ENABLE_FEEDBACK" 5 "INCORRECT_PCS_SUPPORT_STATUS" 4 "INCORRECT_PCS_TRIP_STATE" 3 "INCORRECT_PCS_ENABLE_LINE_VOLTAGE" 2 "INCORRECT_CLAMP_MONITOR_VOLTAGE" 1 "INCORRECT_PIN_CONFIGURATION" 0 "NONE" ;
VAL_ 1335 VCFRONT1_a251_rationalityPcsShut 2 "PASSED" 1 "FAILED" 0 "INVALID" ;
VAL_ 1335 VCFRONT1_a251_rationalityPc_0001 7 "MULTIPLE" 6 "INCORRECT_PCS_DCDC_ENABLE_FEEDBACK" 5 "INCORRECT_PCS_SUPPORT_STATUS" 4 "INCORRECT_PCS_TRIP_STATE" 3 "INCORRECT_PCS_ENABLE_LINE_VOLTAGE" 2 "INCORRECT_CLAMP_MONITOR_VOLTAGE" 1 "INCORRECT_PIN_CONFIGURATION" 0 "NONE" ;
VAL_ 1335 VCFRONT1_a252_stage 5 "RATIONALITY_PCS_SHUTDOWN_CHECK" 4 "CLAMP_HIGH_SIDE_CHECK" 3 "RATIONALITY_SHUTDOWN_ARMED_CHECK" 2 "CLAMP_LOW_SIDE_CHECK" 1 "RATIONALITY_SETUP_CHECK" 0 "UNDEFINED" ;
VAL_ 1335 VCFRONT1_a414_failureReason 32 "BRIDGE_SYNC" 16 "TIMEOUT" 8 "FOLLOWER" 4 "LOAD_UNATTEMPTED_ON" 3 "BRIDGE_AND_DEVICE_STUCK_ON" 2 "BRIDGE" 1 "DEVICE_STUCK_ON" 0 "NONE" ;
VAL_ 1335 VCFRONT1_a475_channel 6 "BRIDGE" 5 "BRAKE_MOTOR_ECU_2" 4 "AUTOPILOT_2" 3 "PCS" 2 "RIGHT_CONTROLLER" 1 "EPAS2" 0 "INVALID" ;
VAL_ 1335 VCFRONT1_a480_channel 3 "RIGHT_CONTROLLER" 2 "EPAS2" 1 "AUTOPILOT_2" 0 "INVALID" ;
VAL_ 1335 VCFRONT1_a496_bmsState 10 "DIAG" 9 "SNA" 8 "TEST" 7 "WELD" 6 "FAULT" 5 "CLEAR_FAULT" 4 "FEIM" 3 "CHARGE" 2 "SUPPORT" 1 "DRIVE" 0 "STANDBY" ;
VAL_ 1335 VCFRONT1_a500_mismatchedState 7 "SELF_TEST" 6 "SELF_TEST_PREP" 5 "LOCKED" 4 "UNLOCKED" 3 "CONFIGURATION" 2 "WAKEUP" 1 "STANDBY" 0 "UNKNOWN" ;
VAL_ 1335 VCFRONT1_a509_channel 6 "BRIDGE" 5 "BRAKE_MOTOR_ECU_2" 4 "AUTOPILOT_2" 3 "PCS" 2 "RIGHT_CONTROLLER" 1 "EPAS2" 0 "INVALID" ;
VAL_ 1335 VCFRONT1_a509_state 7 "SELF_TEST" 6 "SELF_TEST_PREP" 5 "LOCKED" 4 "UNLOCKED" 3 "CONFIGURATION" 2 "WAKEUP" 1 "STANDBY" 0 "UNKNOWN" ;
VAL_ 1335 VCFRONT1_a509_expectedState 7 "SELF_TEST" 6 "SELF_TEST_PREP" 5 "LOCKED" 4 "UNLOCKED" 3 "CONFIGURATION" 2 "WAKEUP" 1 "STANDBY" 0 "UNKNOWN" ;
VAL_ 1335 VCFRONT1_a596_vcrightCutoffEFuse 1 "DYNAMIC_EFUSE_CURVE" 0 "STATIC_EFUSE_CURVE" ;
VAL_ 1335 VCFRONT1_a596_vcrightCutoffATerm 65535 "SNA" ;
VAL_ 1335 VCFRONT1_a596_vcrightCutoffBTerm -128 "SNA" ;
VAL_ 1335 VCFRONT1_a596_vcrightCutoffCTerm -32768 "SNA" ;
VAL_ 1335 VCFRONT1_a597_vcrightCutoffEFuse 1 "DEBOUNCE" 0 "TIMING" ;
VAL_ 833 VCFRONT1_matrixIndex 10 "AlertMatrix10" 9 "AlertMatrix9" 8 "AlertMatrix8" 7 "AlertMatrix7" 6 "AlertMatrix6" 4 "AlertMatrix4" 3 "AlertMatrix3" 2 "AlertMatrix2" 1 "AlertMatrix1" 0 "AlertMatrix0" ;
VAL_ 1027 VCFRONT1_eFuseDebugStatusIndex 5 "BRIDGE" 4 "BRAKE_MOTOR_ECU_2" 3 "AUTOPILOT_2" 2 "PCS" 1 "RIGHT_CONTROLLER" 0 "EPAS2" ;
VAL_ 1027 VCFRONT1_EPAS2EFuseState 7 "SELF_TEST" 6 "SELF_TEST_PREP" 5 "FAILSAFE" 4 "LOCKED" 3 "UNLOCKED" 2 "CONFIGURATION" 1 "WAKEUP" 0 "STANDBY" ;
VAL_ 1027 VCFRONT1_EPAS2EFuseManagerState 8 "LOCKOUT" 7 "IDLE" 6 "UNLOCKING" 5 "LOCKED_ON_BOOT" 4 "LOCKING" 3 "STANDBY" 2 "WAKEUP" 1 "OFF" 0 "RESETTING" ;
VAL_ 1027 VCFRONT1_EPAS2EFuseHardShortThre 15 "160_MV" 14 "139_3_MV" 13 "121_3_MV" 12 "105_6_MV" 11 "91_9_MV" 10 "80_MV" 9 "69_6_MV" 8 "60_6_MV" 7 "52_8_MV" 6 "45_9_MV" 5 "40_MV" 4 "34_8_MV" 3 "30_3_MV" 2 "26_4_MV" 1 "23_MV" 0 "20_MV" ;
VAL_ 1027 VCFRONT1_EPAS2EFuseOCThreshold 31 "89_3_MV" 30 "78_8_MV" 29 "69_5_MV" 28 "61_3_MV" 27 "54_MV" 26 "50_6_MV" 25 "47_5_MV" 24 "44_5_MV" 23 "41_7_MV" 22 "39_1_MV" 21 "36_6_MV" 20 "34_3_MV" 19 "32_2_MV" 18 "30_1_MV" 17 "28_2_MV" 16 "26_5_MV" 15 "24_8_MV" 14 "23_3_MV" 13 "21_8_MV" 12 "20_4_MV" 11 "19_1_MV" 10 "17_9_MV" 9 "16_8_MV" 8 "15_8_MV" 7 "14_8_MV" 6 "13_8_MV" 5 "13_MV" 4 "11_8_MV" 3 "10_4_MV" 2 "8_7_MV" 1 "7_2_MV" 0 "6_MV" ;
VAL_ 1027 VCFRONT1_EPAS2EFuseType 2 "VNF1248" 1 "VNF1048" 0 "UNKNOWN" ;
VAL_ 1027 VCFRONT1_rightControllerEFuseSta 7 "SELF_TEST" 6 "SELF_TEST_PREP" 5 "FAILSAFE" 4 "LOCKED" 3 "UNLOCKED" 2 "CONFIGURATION" 1 "WAKEUP" 0 "STANDBY" ;
VAL_ 1027 VCFRONT1_rightControllerEFuseMan 8 "LOCKOUT" 7 "IDLE" 6 "UNLOCKING" 5 "LOCKED_ON_BOOT" 4 "LOCKING" 3 "STANDBY" 2 "WAKEUP" 1 "OFF" 0 "RESETTING" ;
VAL_ 1027 VCFRONT1_rightControllerEFuseHar 15 "160_MV" 14 "139_3_MV" 13 "121_3_MV" 12 "105_6_MV" 11 "91_9_MV" 10 "80_MV" 9 "69_6_MV" 8 "60_6_MV" 7 "52_8_MV" 6 "45_9_MV" 5 "40_MV" 4 "34_8_MV" 3 "30_3_MV" 2 "26_4_MV" 1 "23_MV" 0 "20_MV" ;
VAL_ 1027 VCFRONT1_rightControllerEFuseOCT 31 "89_3_MV" 30 "78_8_MV" 29 "69_5_MV" 28 "61_3_MV" 27 "54_MV" 26 "50_6_MV" 25 "47_5_MV" 24 "44_5_MV" 23 "41_7_MV" 22 "39_1_MV" 21 "36_6_MV" 20 "34_3_MV" 19 "32_2_MV" 18 "30_1_MV" 17 "28_2_MV" 16 "26_5_MV" 15 "24_8_MV" 14 "23_3_MV" 13 "21_8_MV" 12 "20_4_MV" 11 "19_1_MV" 10 "17_9_MV" 9 "16_8_MV" 8 "15_8_MV" 7 "14_8_MV" 6 "13_8_MV" 5 "13_MV" 4 "11_8_MV" 3 "10_4_MV" 2 "8_7_MV" 1 "7_2_MV" 0 "6_MV" ;
VAL_ 1027 VCFRONT1_rightControllerEFuseTyp 2 "VNF1248" 1 "VNF1048" 0 "UNKNOWN" ;
VAL_ 1027 VCFRONT1_autopilot2EFuseState 7 "SELF_TEST" 6 "SELF_TEST_PREP" 5 "FAILSAFE" 4 "LOCKED" 3 "UNLOCKED" 2 "CONFIGURATION" 1 "WAKEUP" 0 "STANDBY" ;
VAL_ 1027 VCFRONT1_autopilot2EFuseManagerS 8 "LOCKOUT" 7 "IDLE" 6 "UNLOCKING" 5 "LOCKED_ON_BOOT" 4 "LOCKING" 3 "STANDBY" 2 "WAKEUP" 1 "OFF" 0 "RESETTING" ;
VAL_ 1027 VCFRONT1_autopilot2EFuseHardShor 15 "160_MV" 14 "139_3_MV" 13 "121_3_MV" 12 "105_6_MV" 11 "91_9_MV" 10 "80_MV" 9 "69_6_MV" 8 "60_6_MV" 7 "52_8_MV" 6 "45_9_MV" 5 "40_MV" 4 "34_8_MV" 3 "30_3_MV" 2 "26_4_MV" 1 "23_MV" 0 "20_MV" ;
VAL_ 1027 VCFRONT1_autopilot2EFuseOCThresh 31 "89_3_MV" 30 "78_8_MV" 29 "69_5_MV" 28 "61_3_MV" 27 "54_MV" 26 "50_6_MV" 25 "47_5_MV" 24 "44_5_MV" 23 "41_7_MV" 22 "39_1_MV" 21 "36_6_MV" 20 "34_3_MV" 19 "32_2_MV" 18 "30_1_MV" 17 "28_2_MV" 16 "26_5_MV" 15 "24_8_MV" 14 "23_3_MV" 13 "21_8_MV" 12 "20_4_MV" 11 "19_1_MV" 10 "17_9_MV" 9 "16_8_MV" 8 "15_8_MV" 7 "14_8_MV" 6 "13_8_MV" 5 "13_MV" 4 "11_8_MV" 3 "10_4_MV" 2 "8_7_MV" 1 "7_2_MV" 0 "6_MV" ;
VAL_ 1027 VCFRONT1_autopilot2EFuseType 2 "VNF1248" 1 "VNF1048" 0 "UNKNOWN" ;
