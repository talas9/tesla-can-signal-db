VERSION "dbc-export 1 2025.20.8"

NS_ :

BS_:

BU_: ADSP APSB BB BMS CMP CP DAS DI DIF DIR DPB EPASTP EPASTS GTW ICR IDB OCS1P PM PMF PMR PTC RCM RCU TCU UI UIS VCLEFT VCSEC

BO_ 1297 RCM_alertLog: 8 RCM
 SG_ RCM_alertID M : 0|10@1+ (1,0) [0|1023] "" Vector__XXX
 SG_ RCM_a045_eventFrontRightSeatbelt m45 : 27|1@1+ (1,0) [0|1] "" Vector__XXX
 SG_ RCM_a045_eventVehicleSpeed m45 : 28|12@1+ (0.08,-40) [-40|287.6] "kph" Vector__XXX
 SG_ RCM_a045_eventSteeringAngle m45 : 45|14@0+ (0.1,-819.2) [-819.2|819.1] "deg" Vector__XXX
 SG_ RCM_a045_eventDriverBrakeApply m45 : 46|2@1+ (1,0) [0|2] "" Vector__XXX
 SG_ RCM_a045_eventAccelPedalPos m45 : 56|8@1+ (0.4,0) [0|101.6] "%" Vector__XXX
 SG_ RCM_a046_eventArmStatus m46 : 11|1@1+ (1,0) [0|1] "" Vector__XXX
 SG_ RCM_a046_eventFactoryMode m46 : 12|1@1+ (1,0) [0|1] "" Vector__XXX
 SG_ RCM_a046_eventDiagEnabled m46 : 13|1@1+ (1,0) [0|1] "" Vector__XXX
 SG_ RCM_a046_eventDriveOrientation m46 : 14|1@1+ (1,0) [0|1] "" Vector__XXX
 SG_ RCM_a046_sideAccelBPilLSht2Gnd m46 : 16|1@1+ (1,0) [0|1] "" Vector__XXX
 SG_ RCM_a046_sideAccelBPilLSht2Bat m46 : 17|1@1+ (1,0) [0|1] "" Vector__XXX
 SG_ RCM_a046_sideAccelBPilLCLosCoup m46 : 18|1@1+ (1,0) [0|1] "" Vector__XXX
 SG_ RCM_a046_sideAccelBPilLComm m46 : 19|1@1+ (1,0) [0|1] "" Vector__XXX
 SG_ RCM_a046_sideAccelBPilLInitTyp m46 : 20|1@1+ (1,0) [0|1] "" Vector__XXX
 SG_ RCM_a046_sideAccelBPilLOption m46 : 21|1@1+ (1,0) [0|1] "" Vector__XXX
 SG_ RCM_a046_sideAccelBPilLplaus m46 : 22|1@1+ (1,0) [0|1] "" Vector__XXX
 SG_ RCM_a046_sideAccelBPilLDefect m46 : 23|1@1+ (1,0) [0|1] "" Vector__XXX
 SG_ RCM_a046_eventIDFsignal m46 : 25|1@1+ (1,0) [0|1] "" Vector__XXX
 SG_ RCM_a046_eventFrontLeftSeatbelt m46 : 26|1@1+ (1,0) [0|1] "" Vector__XXX
 SG_ RCM_a046_eventFrontRightSeatbelt m46 : 27|1@1+ (1,0) [0|1] "" Vector__XXX
 SG_ RCM_a046_eventVehicleSpeed m46 : 28|12@1+ (0.08,-40) [-40|287.6] "kph" Vector__XXX
 SG_ RCM_a046_eventSteeringAngle m46 : 45|14@0+ (0.1,-819.2) [-819.2|819.1] "deg" Vector__XXX
 SG_ RCM_a046_eventDriverBrakeApply m46 : 46|2@1+ (1,0) [0|2] "" Vector__XXX
 SG_ RCM_a046_eventAccelPedalPos m46 : 56|8@1+ (0.4,0) [0|101.6] "%" Vector__XXX
 SG_ RCM_a047_eventArmStatus m47 : 11|1@1+ (1,0) [0|1] "" Vector__XXX
 SG_ RCM_a047_eventFactoryMode m47 : 12|1@1+ (1,0) [0|1] "" Vector__XXX
 SG_ RCM_a047_eventDiagEnabled m47 : 13|1@1+ (1,0) [0|1] "" Vector__XXX
 SG_ RCM_a047_eventDriveOrientation m47 : 14|1@1+ (1,0) [0|1] "" Vector__XXX
 SG_ RCM_a047_sideAccelBPilRSht2Gnd m47 : 16|1@1+ (1,0) [0|1] "" Vector__XXX
 SG_ RCM_a047_sideAccelBPilRSht2Bat m47 : 17|1@1+ (1,0) [0|1] "" Vector__XXX
 SG_ RCM_a047_sideAccelBPilRCrossCoup m47 : 18|1@1+ (1,0) [0|1] "" Vector__XXX
 SG_ RCM_a047_sideAccelBPilRComm m47 : 19|1@1+ (1,0) [0|1] "" Vector__XXX
 SG_ RCM_a047_sideAccelBPilRInitTyp m47 : 20|1@1+ (1,0) [0|1] "" Vector__XXX
 SG_ RCM_a047_sideAccelBPilROption m47 : 21|1@1+ (1,0) [0|1] "" Vector__XXX
 SG_ RCM_a047_sideAccelBPilRplaus m47 : 22|1@1+ (1,0) [0|1] "" Vector__XXX
 SG_ RCM_a047_sideAccelBPilRDefect m47 : 23|1@1+ (1,0) [0|1] "" Vector__XXX
 SG_ RCM_a047_eventIDFsignal m47 : 25|1@1+ (1,0) [0|1] "" Vector__XXX
 SG_ RCM_a047_eventFrontLeftSeatbelt m47 : 26|1@1+ (1,0) [0|1] "" Vector__XXX
 SG_ RCM_a047_eventFrontRightSeatbelt m47 : 27|1@1+ (1,0) [0|1] "" Vector__XXX
 SG_ RCM_a047_eventVehicleSpeed m47 : 28|12@1+ (0.08,-40) [-40|287.6] "kph" Vector__XXX
 SG_ RCM_a047_eventSteeringAngle m47 : 45|14@0+ (0.1,-819.2) [-819.2|819.1] "deg" Vector__XXX
 SG_ RCM_a047_eventDriverBrakeApply m47 : 46|2@1+ (1,0) [0|2] "" Vector__XXX
 SG_ RCM_a047_eventAccelPedalPos m47 : 56|8@1+ (0.4,0) [0|101.6] "%" Vector__XXX
 SG_ RCM_a048_eventArmStatus m48 : 11|1@1+ (1,0) [0|1] "" Vector__XXX
 SG_ RCM_a048_eventFactoryMode m48 : 12|1@1+ (1,0) [0|1] "" Vector__XXX
 SG_ RCM_a048_eventDiagEnabled m48 : 13|1@1+ (1,0) [0|1] "" Vector__XXX
 SG_ RCM_a048_eventDriveOrientation m48 : 14|1@1+ (1,0) [0|1] "" Vector__XXX
 SG_ RCM_a048_sideAccelCPilLSht2Gnd m48 : 16|1@1+ (1,0) [0|1] "" Vector__XXX
 SG_ RCM_a048_sideAccelCPilLSht2Bat m48 : 17|1@1+ (1,0) [0|1] "" Vector__XXX
 SG_ RCM_a048_sideAccelCPilLCrossCoup m48 : 18|1@1+ (1,0) [0|1] "" Vector__XXX
 SG_ RCM_a048_sideAccelCPilLComm m48 : 19|1@1+ (1,0) [0|1] "" Vector__XXX
 SG_ RCM_a048_sideAccelCPilLInitTyp m48 : 20|1@1+ (1,0) [0|1] "" Vector__XXX
 SG_ RCM_a048_sideAccelCPilLOption m48 : 21|1@1+ (1,0) [0|1] "" Vector__XXX
 SG_ RCM_a048_sideAccelCPilLplaus m48 : 22|1@1+ (1,0) [0|1] "" Vector__XXX
 SG_ RCM_a048_sideAccelCPilLDefect m48 : 23|1@1+ (1,0) [0|1] "" Vector__XXX
 SG_ RCM_a048_eventIDFsignal m48 : 25|1@1+ (1,0) [0|1] "" Vector__XXX
 SG_ RCM_a048_eventFrontLeftSeatbelt m48 : 26|1@1+ (1,0) [0|1] "" Vector__XXX
 SG_ RCM_a048_eventFrontRightSeatbelt m48 : 27|1@1+ (1,0) [0|1] "" Vector__XXX
 SG_ RCM_a048_eventVehicleSpeed m48 : 28|12@1+ (0.08,-40) [-40|287.6] "kph" Vector__XXX
 SG_ RCM_a048_eventSteeringAngle m48 : 45|14@0+ (0.1,-819.2) [-819.2|819.1] "deg" Vector__XXX
 SG_ RCM_a048_eventDriverBrakeApply m48 : 46|2@1+ (1,0) [0|2] "" Vector__XXX
 SG_ RCM_a048_eventAccelPedalPos m48 : 56|8@1+ (0.4,0) [0|101.6] "%" Vector__XXX
 SG_ RCM_a049_eventArmStatus m49 : 11|1@1+ (1,0) [0|1] "" Vector__XXX
 SG_ RCM_a049_eventFactoryMode m49 : 12|1@1+ (1,0) [0|1] "" Vector__XXX
 SG_ RCM_a049_eventDiagEnabled m49 : 13|1@1+ (1,0) [0|1] "" Vector__XXX
 SG_ RCM_a049_eventDriveOrientation m49 : 14|1@1+ (1,0) [0|1] "" Vector__XXX
 SG_ RCM_a049_sideAccelCPilRSht2Gnd m49 : 16|1@1+ (1,0) [0|1] "" Vector__XXX
 SG_ RCM_a049_sideAccelCPilRSht2Bat m49 : 17|1@1+ (1,0) [0|1] "" Vector__XXX
 SG_ RCM_a049_sideAccelCPilRCrossCoup m49 : 18|1@1+ (1,0) [0|1] "" Vector__XXX
 SG_ RCM_a049_sideAccelCPilRComm m49 : 19|1@1+ (1,0) [0|1] "" Vector__XXX
 SG_ RCM_a049_sideAccelCPilRInitTyp m49 : 20|1@1+ (1,0) [0|1] "" Vector__XXX
 SG_ RCM_a049_sideAccelCPilROption m49 : 21|1@1+ (1,0) [0|1] "" Vector__XXX
 SG_ RCM_a049_sideAccelCPilRplaus m49 : 22|1@1+ (1,0) [0|1] "" Vector__XXX
 SG_ RCM_a049_sideAccelCPilRDefect m49 : 23|1@1+ (1,0) [0|1] "" Vector__XXX
 SG_ RCM_a049_eventIDFsignal m49 : 25|1@1+ (1,0) [0|1] "" Vector__XXX
 SG_ RCM_a049_eventFrontLeftSeatbelt m49 : 26|1@1+ (1,0) [0|1] "" Vector__XXX
 SG_ RCM_a049_eventFrontRightSeatbelt m49 : 27|1@1+ (1,0) [0|1] "" Vector__XXX
 SG_ RCM_a049_eventVehicleSpeed m49 : 28|12@1+ (0.08,-40) [-40|287.6] "kph" Vector__XXX
 SG_ RCM_a049_eventSteeringAngle m49 : 45|14@0+ (0.1,-819.2) [-819.2|819.1] "deg" Vector__XXX
 SG_ RCM_a049_eventDriverBrakeApply m49 : 46|2@1+ (1,0) [0|2] "" Vector__XXX
 SG_ RCM_a049_eventAccelPedalPos m49 : 56|8@1+ (0.4,0) [0|101.6] "%" Vector__XXX
 SG_ RCM_a050_eventArmStatus m50 : 11|1@1+ (1,0) [0|1] "" Vector__XXX
 SG_ RCM_a050_eventFactoryMode m50 : 12|1@1+ (1,0) [0|1] "" Vector__XXX
 SG_ RCM_a050_eventDiagEnabled m50 : 13|1@1+ (1,0) [0|1] "" Vector__XXX
 SG_ RCM_a050_eventDriveOrientation m50 : 14|1@1+ (1,0) [0|1] "" Vector__XXX
 SG_ RCM_a050_upFrontSensorCSht2Gnd m50 : 16|1@1+ (1,0) [0|1] "" Vector__XXX
 SG_ RCM_a050_upFrontSensorCSht2Bat m50 : 17|1@1+ (1,0) [0|1] "" Vector__XXX
 SG_ RCM_a050_upFrontSensorCCrossCoup m50 : 18|1@1+ (1,0) [0|1] "" Vector__XXX
 SG_ RCM_a050_upFrontSensorCComm m50 : 19|1@1+ (1,0) [0|1] "" Vector__XXX
 SG_ RCM_a050_upFrontSensorCInitTyp m50 : 20|1@1+ (1,0) [0|1] "" Vector__XXX
 SG_ RCM_a050_upFrontSensorCOption m50 : 21|1@1+ (1,0) [0|1] "" Vector__XXX
 SG_ RCM_a050_upFrontSensorCplaus m50 : 22|1@1+ (1,0) [0|1] "" Vector__XXX
 SG_ RCM_a050_upFrontSensorCDefect m50 : 23|1@1+ (1,0) [0|1] "" Vector__XXX
 SG_ RCM_a050_eventIDFsignal m50 : 25|1@1+ (1,0) [0|1] "" Vector__XXX
 SG_ RCM_a050_eventFrontLeftSeatbelt m50 : 26|1@1+ (1,0) [0|1] "" Vector__XXX
 SG_ RCM_a050_eventFrontRightSeatbelt m50 : 27|1@1+ (1,0) [0|1] "" Vector__XXX
 SG_ RCM_a050_eventVehicleSpeed m50 : 28|12@1+ (0.08,-40) [-40|287.6] "kph" Vector__XXX
 SG_ RCM_a050_eventSteeringAngle m50 : 45|14@0+ (0.1,-819.2) [-819.2|819.1] "deg" Vector__XXX
 SG_ RCM_a050_eventDriverBrakeApply m50 : 46|2@1+ (1,0) [0|2] "" Vector__XXX
 SG_ RCM_a050_eventAccelPedalPos m50 : 56|8@1+ (0.4,0) [0|101.6] "%" Vector__XXX
 SG_ RCM_a051_eventArmStatus m51 : 11|1@1+ (1,0) [0|1] "" Vector__XXX
 SG_ RCM_a051_eventFactoryMode m51 : 12|1@1+ (1,0) [0|1] "" Vector__XXX
 SG_ RCM_a051_eventDiagEnabled m51 : 13|1@1+ (1,0) [0|1] "" Vector__XXX
 SG_ RCM_a051_eventDriveOrientation m51 : 14|1@1+ (1,0) [0|1] "" Vector__XXX
 SG_ RCM_a051_presFrntLDoorComm m51 : 16|1@1+ (1,0) [0|1] "" Vector__XXX
 SG_ RCM_a051_presFrntLDoorInitTyp m51 : 17|1@1+ (1,0) [0|1] "" Vector__XXX
 SG_ RCM_a051_presFrntLDoorOption m51 : 18|1@1+ (1,0) [0|1] "" Vector__XXX
 SG_ RCM_a051_presFrntLDoorPlaus m51 : 19|1@1+ (1,0) [0|1] "" Vector__XXX
 SG_ RCM_a051_presFrntLDoorAbsPre m51 : 20|1@1+ (1,0) [0|1] "" Vector__XXX
 SG_ RCM_a051_presFrntLDoorDefect m51 : 21|1@1+ (1,0) [0|1] "" Vector__XXX
 SG_ RCM_a051_presFrntLDoorSht2Gnd m51 : 22|1@1+ (1,0) [0|1] "" Vector__XXX
 SG_ RCM_a051_presFrntLDoorSht2Bat m51 : 23|1@1+ (1,0) [0|1] "" Vector__XXX
 SG_ RCM_a051_presFrntLDoorCrossCoup m51 : 24|1@1+ (1,0) [0|1] "" Vector__XXX
 SG_ RCM_a051_eventIDFsignal m51 : 25|1@1+ (1,0) [0|1] "" Vector__XXX
 SG_ RCM_a051_eventFrontLeftSeatbelt m51 : 26|1@1+ (1,0) [0|1] "" Vector__XXX
 SG_ RCM_a051_eventFrontRightSeatbelt m51 : 27|1@1+ (1,0) [0|1] "" Vector__XXX
 SG_ RCM_a051_eventVehicleSpeed m51 : 28|12@1+ (0.08,-40) [-40|287.6] "kph" Vector__XXX
 SG_ RCM_a051_eventSteeringAngle m51 : 45|14@0+ (0.1,-819.2) [-819.2|819.1] "deg" Vector__XXX
 SG_ RCM_a051_eventDriverBrakeApply m51 : 46|2@1+ (1,0) [0|2] "" Vector__XXX
 SG_ RCM_a051_eventAccelPedalPos m51 : 56|8@1+ (0.4,0) [0|101.6] "%" Vector__XXX
 SG_ RCM_a052_eventArmStatus m52 : 11|1@1+ (1,0) [0|1] "" Vector__XXX
 SG_ RCM_a052_eventFactoryMode m52 : 12|1@1+ (1,0) [0|1] "" Vector__XXX
 SG_ RCM_a052_eventDiagEnabled m52 : 13|1@1+ (1,0) [0|1] "" Vector__XXX
 SG_ RCM_a052_eventDriveOrientation m52 : 14|1@1+ (1,0) [0|1] "" Vector__XXX
 SG_ RCM_a052_presFrntRDoorComm m52 : 16|1@1+ (1,0) [0|1] "" Vector__XXX
 SG_ RCM_a052_presFrntRDoorInitTyp m52 : 17|1@1+ (1,0) [0|1] "" Vector__XXX
 SG_ RCM_a052_presFrntRDoorOption m52 : 18|1@1+ (1,0) [0|1] "" Vector__XXX
 SG_ RCM_a052_presFrntRDoorPlaus m52 : 19|1@1+ (1,0) [0|1] "" Vector__XXX
 SG_ RCM_a052_presFrntRDoorAbsPre m52 : 20|1@1+ (1,0) [0|1] "" Vector__XXX
 SG_ RCM_a052_presFrntRDoorDefect m52 : 21|1@1+ (1,0) [0|1] "" Vector__XXX
 SG_ RCM_a052_presFrntRDoorSht2Gnd m52 : 22|1@1+ (1,0) [0|1] "" Vector__XXX
 SG_ RCM_a052_presFrntRDoorSht2Bat m52 : 23|1@1+ (1,0) [0|1] "" Vector__XXX
 SG_ RCM_a052_presFrntRDoorCrossCoup m52 : 24|1@1+ (1,0) [0|1] "" Vector__XXX
 SG_ RCM_a052_eventIDFsignal m52 : 25|1@1+ (1,0) [0|1] "" Vector__XXX
 SG_ RCM_a052_eventFrontLeftSeatbelt m52 : 26|1@1+ (1,0) [0|1] "" Vector__XXX
 SG_ RCM_a052_eventFrontRightSeatbelt m52 : 27|1@1+ (1,0) [0|1] "" Vector__XXX
 SG_ RCM_a052_eventVehicleSpeed m52 : 28|12@1+ (0.08,-40) [-40|287.6] "kph" Vector__XXX
 SG_ RCM_a052_eventSteeringAngle m52 : 45|14@0+ (0.1,-819.2) [-819.2|819.1] "deg" Vector__XXX
 SG_ RCM_a052_eventDriverBrakeApply m52 : 46|2@1+ (1,0) [0|2] "" Vector__XXX
 SG_ RCM_a052_eventAccelPedalPos m52 : 56|8@1+ (0.4,0) [0|101.6] "%" Vector__XXX
 SG_ RCM_a053_eventArmStatus m53 : 11|1@1+ (1,0) [0|1] "" Vector__XXX
 SG_ RCM_a053_eventFactoryMode m53 : 12|1@1+ (1,0) [0|1] "" Vector__XXX
 SG_ RCM_a053_eventDiagEnabled m53 : 13|1@1+ (1,0) [0|1] "" Vector__XXX
 SG_ RCM_a053_eventDriveOrientation m53 : 14|1@1+ (1,0) [0|1] "" Vector__XXX
 SG_ RCM_a053_presPedProLComm m53 : 16|1@1+ (1,0) [0|1] "" Vector__XXX
 SG_ RCM_a053_presPedProLInitTyp m53 : 17|1@1+ (1,0) [0|1] "" Vector__XXX
 SG_ RCM_a053_presPedProLOption m53 : 18|1@1+ (1,0) [0|1] "" Vector__XXX
 SG_ RCM_a053_presPedProLPlaus m53 : 19|1@1+ (1,0) [0|1] "" Vector__XXX
 SG_ RCM_a053_presPedProLAbsPre m53 : 20|1@1+ (1,0) [0|1] "" Vector__XXX
 SG_ RCM_a053_presPedProLDefect m53 : 21|1@1+ (1,0) [0|1] "" Vector__XXX
 SG_ RCM_a053_presPedProLSht2Gnd m53 : 22|1@1+ (1,0) [0|1] "" Vector__XXX
 SG_ RCM_a053_presPedProLSht2Bat m53 : 23|1@1+ (1,0) [0|1] "" Vector__XXX
 SG_ RCM_a053_presPedProLCrossCoup m53 : 24|1@1+ (1,0) [0|1] "" Vector__XXX
 SG_ RCM_a053_eventIDFsignal m53 : 25|1@1+ (1,0) [0|1] "" Vector__XXX
 SG_ RCM_a053_eventFrontLeftSeatbelt m53 : 26|1@1+ (1,0) [0|1] "" Vector__XXX
 SG_ RCM_a053_eventFrontRightSeatbelt m53 : 27|1@1+ (1,0) [0|1] "" Vector__XXX
 SG_ RCM_a053_eventVehicleSpeed m53 : 28|12@1+ (0.08,-40) [-40|287.6] "kph" Vector__XXX
 SG_ RCM_a053_eventSteeringAngle m53 : 45|14@0+ (0.1,-819.2) [-819.2|819.1] "deg" Vector__XXX
 SG_ RCM_a053_eventDriverBrakeApply m53 : 46|2@1+ (1,0) [0|2] "" Vector__XXX
 SG_ RCM_a053_eventAccelPedalPos m53 : 56|8@1+ (0.4,0) [0|101.6] "%" Vector__XXX
 SG_ RCM_a054_eventArmStatus m54 : 11|1@1+ (1,0) [0|1] "" Vector__XXX
 SG_ RCM_a054_eventFactoryMode m54 : 12|1@1+ (1,0) [0|1] "" Vector__XXX
 SG_ RCM_a054_eventDiagEnabled m54 : 13|1@1+ (1,0) [0|1] "" Vector__XXX
 SG_ RCM_a054_eventDriveOrientation m54 : 14|1@1+ (1,0) [0|1] "" Vector__XXX
 SG_ RCM_a054_presPedProRComm m54 : 16|1@1+ (1,0) [0|1] "" Vector__XXX
 SG_ RCM_a054_presPedProRInitTyp m54 : 17|1@1+ (1,0) [0|1] "" Vector__XXX
 SG_ RCM_a054_presPedProROption m54 : 18|1@1+ (1,0) [0|1] "" Vector__XXX
 SG_ RCM_a054_presPedProRPlaus m54 : 19|1@1+ (1,0) [0|1] "" Vector__XXX
 SG_ RCM_a054_presPedProRAbsPre m54 : 20|1@1+ (1,0) [0|1] "" Vector__XXX
 SG_ RCM_a054_presPedProRDefect m54 : 21|1@1+ (1,0) [0|1] "" Vector__XXX
 SG_ RCM_a054_presPedProRSht2Gnd m54 : 22|1@1+ (1,0) [0|1] "" Vector__XXX
 SG_ RCM_a054_presPedProRSht2Bat m54 : 23|1@1+ (1,0) [0|1] "" Vector__XXX
 SG_ RCM_a054_presPedProRCrossCoup m54 : 24|1@1+ (1,0) [0|1] "" Vector__XXX
 SG_ RCM_a054_eventIDFsignal m54 : 25|1@1+ (1,0) [0|1] "" Vector__XXX
 SG_ RCM_a054_eventFrontLeftSeatbelt m54 : 26|1@1+ (1,0) [0|1] "" Vector__XXX
 SG_ RCM_a054_eventFrontRightSeatbelt m54 : 27|1@1+ (1,0) [0|1] "" Vector__XXX
 SG_ RCM_a054_eventVehicleSpeed m54 : 28|12@1+ (0.08,-40) [-40|287.6] "kph" Vector__XXX
 SG_ RCM_a054_eventSteeringAngle m54 : 45|14@0+ (0.1,-819.2) [-819.2|819.1] "deg" Vector__XXX
 SG_ RCM_a054_eventDriverBrakeApply m54 : 46|2@1+ (1,0) [0|2] "" Vector__XXX
 SG_ RCM_a054_eventAccelPedalPos m54 : 56|8@1+ (0.4,0) [0|101.6] "%" Vector__XXX
 SG_ RCM_a055_eventArmStatus m55 : 11|1@1+ (1,0) [0|1] "" Vector__XXX
 SG_ RCM_a055_eventFactoryMode m55 : 12|1@1+ (1,0) [0|1] "" Vector__XXX
 SG_ RCM_a055_eventDiagEnabled m55 : 13|1@1+ (1,0) [0|1] "" Vector__XXX
 SG_ RCM_a055_eventDriveOrientation m55 : 14|1@1+ (1,0) [0|1] "" Vector__XXX
 SG_ RCM_a055_imuCalibrationNotDone m55 : 16|1@1+ (1,0) [0|1] "" Vector__XXX
 SG_ RCM_a055_imuCalibrationFailed m55 : 17|1@1+ (1,0) [0|1] "" Vector__XXX
 SG_ RCM_a055_eventIDFsignal m55 : 25|1@1+ (1,0) [0|1] "" Vector__XXX
 SG_ RCM_a055_eventFrontLeftSeatbelt m55 : 26|1@1+ (1,0) [0|1] "" Vector__XXX
 SG_ RCM_a055_eventFrontRightSeatbelt m55 : 27|1@1+ (1,0) [0|1] "" Vector__XXX
 SG_ RCM_a055_eventVehicleSpeed m55 : 28|12@1+ (0.08,-40) [-40|287.6] "kph" Vector__XXX
 SG_ RCM_a055_eventSteeringAngle m55 : 45|14@0+ (0.1,-819.2) [-819.2|819.1] "deg" Vector__XXX
 SG_ RCM_a055_eventDriverBrakeApply m55 : 46|2@1+ (1,0) [0|2] "" Vector__XXX
 SG_ RCM_a055_eventAccelPedalPos m55 : 56|8@1+ (0.4,0) [0|101.6] "%" Vector__XXX
 SG_ RCM_a056_eventArmStatus m56 : 11|1@1+ (1,0) [0|1] "" Vector__XXX
 SG_ RCM_a056_eventFactoryMode m56 : 12|1@1+ (1,0) [0|1] "" Vector__XXX
 SG_ RCM_a056_eventDiagEnabled m56 : 13|1@1+ (1,0) [0|1] "" Vector__XXX
 SG_ RCM_a056_eventDriveOrientation m56 : 14|1@1+ (1,0) [0|1] "" Vector__XXX
 SG_ RCM_a056_ocs1pFaulted m56 : 16|1@1+ (1,0) [0|1] "" Vector__XXX
 SG_ RCM_a056_ocs1pWrongCalD m56 : 17|1@1+ (1,0) [0|1] "" Vector__XXX
 SG_ RCM_a056_eventIDFsignal m56 : 25|1@1+ (1,0) [0|1] "" Vector__XXX
 SG_ RCM_a056_eventFrontLeftSeatbelt m56 : 26|1@1+ (1,0) [0|1] "" Vector__XXX
 SG_ RCM_a056_eventFrontRightSeatbelt m56 : 27|1@1+ (1,0) [0|1] "" Vector__XXX
 SG_ RCM_a056_eventVehicleSpeed m56 : 28|12@1+ (0.08,-40) [-40|287.6] "kph" Vector__XXX
 SG_ RCM_a056_eventSteeringAngle m56 : 45|14@0+ (0.1,-819.2) [-819.2|819.1] "deg" Vector__XXX
 SG_ RCM_a056_eventDriverBrakeApply m56 : 46|2@1+ (1,0) [0|2] "" Vector__XXX
 SG_ RCM_a056_eventAccelPedalPos m56 : 56|8@1+ (0.4,0) [0|101.6] "%" Vector__XXX
 SG_ RCM_a057_eventArmStatus m57 : 11|1@1+ (1,0) [0|1] "" Vector__XXX
 SG_ RCM_a057_eventFactoryMode m57 : 12|1@1+ (1,0) [0|1] "" Vector__XXX
 SG_ RCM_a057_eventDiagEnabled m57 : 13|1@1+ (1,0) [0|1] "" Vector__XXX
 SG_ RCM_a057_eventDriveOrientation m57 : 14|1@1+ (1,0) [0|1] "" Vector__XXX
 SG_ RCM_a057_ocs1dFaulted m57 : 16|1@1+ (1,0) [0|1] "" Vector__XXX
 SG_ RCM_a057_ocs1dWrongCalD m57 : 17|1@1+ (1,0) [0|1] "" Vector__XXX
 SG_ RCM_a057_eventIDFsignal m57 : 25|1@1+ (1,0) [0|1] "" Vector__XXX
 SG_ RCM_a057_eventFrontLeftSeatbelt m57 : 26|1@1+ (1,0) [0|1] "" Vector__XXX
 SG_ RCM_a057_eventFrontRightSeatbelt m57 : 27|1@1+ (1,0) [0|1] "" Vector__XXX
 SG_ RCM_a057_eventVehicleSpeed m57 : 28|12@1+ (0.08,-40) [-40|287.6] "kph" Vector__XXX
 SG_ RCM_a057_eventSteeringAngle m57 : 45|14@0+ (0.1,-819.2) [-819.2|819.1] "deg" Vector__XXX
 SG_ RCM_a057_eventDriverBrakeApply m57 : 46|2@1+ (1,0) [0|2] "" Vector__XXX
 SG_ RCM_a057_eventAccelPedalPos m57 : 56|8@1+ (0.4,0) [0|101.6] "%" Vector__XXX
 SG_ RCM_a058_eventArmStatus m58 : 11|1@1+ (1,0) [0|1] "" Vector__XXX
 SG_ RCM_a058_eventFactoryMode m58 : 12|1@1+ (1,0) [0|1] "" Vector__XXX
 SG_ RCM_a058_eventDiagEnabled m58 : 13|1@1+ (1,0) [0|1] "" Vector__XXX
 SG_ RCM_a058_eventDriveOrientation m58 : 14|1@1+ (1,0) [0|1] "" Vector__XXX
 SG_ RCM_a058_bucklHallLeftShort m58 : 16|1@1+ (1,0) [0|1] "" Vector__XXX
 SG_ RCM_a058_bucklHallLeftSht2Bat m58 : 17|1@1+ (1,0) [0|1] "" Vector__XXX
 SG_ RCM_a058_bucklHallLeftOpen m58 : 18|1@1+ (1,0) [0|1] "" Vector__XXX
 SG_ RCM_a058_bucklHallLeftUndef m58 : 19|1@1+ (1,0) [0|1] "" Vector__XXX
 SG_ RCM_a058_bucklHallLeftCrossCoup m58 : 20|1@1+ (1,0) [0|1] "" Vector__XXX
 SG_ RCM_a058_bucklHallLeftConfig m58 : 21|1@1+ (1,0) [0|1] "" Vector__XXX
 SG_ RCM_a058_eventIDFsignal m58 : 25|1@1+ (1,0) [0|1] "" Vector__XXX
 SG_ RCM_a058_eventFrontLeftSeatbelt m58 : 26|1@1+ (1,0) [0|1] "" Vector__XXX
 SG_ RCM_a058_eventFrontRightSeatbelt m58 : 27|1@1+ (1,0) [0|1] "" Vector__XXX
 SG_ RCM_a058_eventVehicleSpeed m58 : 28|12@1+ (0.08,-40) [-40|287.6] "kph" Vector__XXX
 SG_ RCM_a058_eventSteeringAngle m58 : 45|14@0+ (0.1,-819.2) [-819.2|819.1] "deg" Vector__XXX
 SG_ RCM_a058_eventDriverBrakeApply m58 : 46|2@1+ (1,0) [0|2] "" Vector__XXX
 SG_ RCM_a058_eventAccelPedalPos m58 : 56|8@1+ (0.4,0) [0|101.6] "%" Vector__XXX
 SG_ RCM_a059_eventArmStatus m59 : 11|1@1+ (1,0) [0|1] "" Vector__XXX
 SG_ RCM_a059_eventFactoryMode m59 : 12|1@1+ (1,0) [0|1] "" Vector__XXX
 SG_ RCM_a059_eventDiagEnabled m59 : 13|1@1+ (1,0) [0|1] "" Vector__XXX
 SG_ RCM_a059_eventDriveOrientation m59 : 14|1@1+ (1,0) [0|1] "" Vector__XXX
 SG_ RCM_a059_bucklHallRightShort m59 : 16|1@1+ (1,0) [0|1] "" Vector__XXX
 SG_ RCM_a059_bucklHallRightSht2Bat m59 : 17|1@1+ (1,0) [0|1] "" Vector__XXX
 SG_ RCM_a059_bucklHallRightOpen m59 : 18|1@1+ (1,0) [0|1] "" Vector__XXX
 SG_ RCM_a059_bucklHallRightUndef m59 : 19|1@1+ (1,0) [0|1] "" Vector__XXX
 SG_ RCM_a059_bucklHallRightCrossCoup m59 : 20|1@1+ (1,0) [0|1] "" Vector__XXX
 SG_ RCM_a059_bucklSwRightConfig m59 : 21|1@1+ (1,0) [0|1] "" Vector__XXX
 SG_ RCM_a059_eventIDFsignal m59 : 25|1@1+ (1,0) [0|1] "" Vector__XXX
 SG_ RCM_a059_eventFrontLeftSeatbelt m59 : 26|1@1+ (1,0) [0|1] "" Vector__XXX
 SG_ RCM_a059_eventFrontRightSeatbelt m59 : 27|1@1+ (1,0) [0|1] "" Vector__XXX
 SG_ RCM_a059_eventVehicleSpeed m59 : 28|12@1+ (0.08,-40) [-40|287.6] "kph" Vector__XXX
 SG_ RCM_a059_eventSteeringAngle m59 : 45|14@0+ (0.1,-819.2) [-819.2|819.1] "deg" Vector__XXX
 SG_ RCM_a059_eventDriverBrakeApply m59 : 46|2@1+ (1,0) [0|2] "" Vector__XXX
 SG_ RCM_a059_eventAccelPedalPos m59 : 56|8@1+ (0.4,0) [0|101.6] "%" Vector__XXX
 SG_ RCM_a060_eventArmStatus m60 : 11|1@1+ (1,0) [0|1] "" Vector__XXX
 SG_ RCM_a060_eventFactoryMode m60 : 12|1@1+ (1,0) [0|1] "" Vector__XXX
 SG_ RCM_a060_eventDiagEnabled m60 : 13|1@1+ (1,0) [0|1] "" Vector__XXX
 SG_ RCM_a060_eventDriveOrientation m60 : 14|1@1+ (1,0) [0|1] "" Vector__XXX
 SG_ RCM_a060_seaTrkPosLeftShort m60 : 16|1@1+ (1,0) [0|1] "" Vector__XXX
 SG_ RCM_a060_seaTrkPosLeftShort2Bat m60 : 17|1@1+ (1,0) [0|1] "" Vector__XXX
 SG_ RCM_a060_seaTrkPosLeftOpen m60 : 18|1@1+ (1,0) [0|1] "" Vector__XXX
 SG_ RCM_a060_seaTrkPosLeftUndefined m60 : 19|1@1+ (1,0) [0|1] "" Vector__XXX
 SG_ RCM_a060_seaTrkPosLeftCrossCoup m60 : 20|1@1+ (1,0) [0|1] "" Vector__XXX
 SG_ RCM_a060_seaTrkPosLeftConfig m60 : 21|1@1+ (1,0) [0|1] "" Vector__XXX
 SG_ RCM_a060_eventIDFsignal m60 : 25|1@1+ (1,0) [0|1] "" Vector__XXX
 SG_ RCM_a060_eventFrontLeftSeatbelt m60 : 26|1@1+ (1,0) [0|1] "" Vector__XXX
 SG_ RCM_a060_eventFrontRightSeatbelt m60 : 27|1@1+ (1,0) [0|1] "" Vector__XXX
 SG_ RCM_a060_eventVehicleSpeed m60 : 28|12@1+ (0.08,-40) [-40|287.6] "kph" Vector__XXX
 SG_ RCM_a060_eventSteeringAngle m60 : 45|14@0+ (0.1,-819.2) [-819.2|819.1] "deg" Vector__XXX
 SG_ RCM_a060_eventDriverBrakeApply m60 : 46|2@1+ (1,0) [0|2] "" Vector__XXX
 SG_ RCM_a060_eventAccelPedalPos m60 : 56|8@1+ (0.4,0) [0|101.6] "%" Vector__XXX
 SG_ RCM_a061_eventArmStatus m61 : 11|1@1+ (1,0) [0|1] "" Vector__XXX
 SG_ RCM_a061_eventFactoryMode m61 : 12|1@1+ (1,0) [0|1] "" Vector__XXX
 SG_ RCM_a061_eventDiagEnabled m61 : 13|1@1+ (1,0) [0|1] "" Vector__XXX
 SG_ RCM_a061_eventDriveOrientation m61 : 14|1@1+ (1,0) [0|1] "" Vector__XXX
 SG_ RCM_a061_seaTrkPosRightShort m61 : 16|1@1+ (1,0) [0|1] "" Vector__XXX
 SG_ RCM_a061_seaTrkPosRightSht2Bat m61 : 17|1@1+ (1,0) [0|1] "" Vector__XXX
 SG_ RCM_a061_seaTrkPosRightOpen m61 : 18|1@1+ (1,0) [0|1] "" Vector__XXX
 SG_ RCM_a061_seaTrkPosRightUndefined m61 : 19|1@1+ (1,0) [0|1] "" Vector__XXX
 SG_ RCM_a061_seaTrkPosRightCrossCoup m61 : 20|1@1+ (1,0) [0|1] "" Vector__XXX
 SG_ RCM_a061_seaTrkPosRightConfig m61 : 21|1@1+ (1,0) [0|1] "" Vector__XXX
 SG_ RCM_a061_eventIDFsignal m61 : 25|1@1+ (1,0) [0|1] "" Vector__XXX
 SG_ RCM_a061_eventFrontLeftSeatbelt m61 : 26|1@1+ (1,0) [0|1] "" Vector__XXX
 SG_ RCM_a061_eventFrontRightSeatbelt m61 : 27|1@1+ (1,0) [0|1] "" Vector__XXX
 SG_ RCM_a061_eventVehicleSpeed m61 : 28|12@1+ (0.08,-40) [-40|287.6] "kph" Vector__XXX
 SG_ RCM_a061_eventSteeringAngle m61 : 45|14@0+ (0.1,-819.2) [-819.2|819.1] "deg" Vector__XXX
 SG_ RCM_a061_eventDriverBrakeApply m61 : 46|2@1+ (1,0) [0|2] "" Vector__XXX
 SG_ RCM_a061_eventAccelPedalPos m61 : 56|8@1+ (0.4,0) [0|101.6] "%" Vector__XXX
 SG_ RCM_a062_eventArmStatus m62 : 11|1@1+ (1,0) [0|1] "" Vector__XXX
 SG_ RCM_a062_eventFactoryMode m62 : 12|1@1+ (1,0) [0|1] "" Vector__XXX
 SG_ RCM_a062_eventDiagEnabled m62 : 13|1@1+ (1,0) [0|1] "" Vector__XXX
 SG_ RCM_a062_eventDriveOrientation m62 : 14|1@1+ (1,0) [0|1] "" Vector__XXX
 SG_ RCM_a062_alrShort m62 : 16|1@1+ (1,0) [0|1] "" Vector__XXX
 SG_ RCM_a062_alrSht2Bat m62 : 17|1@1+ (1,0) [0|1] "" Vector__XXX
 SG_ RCM_a062_alrOpen m62 : 18|1@1+ (1,0) [0|1] "" Vector__XXX
 SG_ RCM_a062_alrUndefined m62 : 19|1@1+ (1,0) [0|1] "" Vector__XXX
 SG_ RCM_a062_alrCrossCoup m62 : 20|1@1+ (1,0) [0|1] "" Vector__XXX
 SG_ RCM_a062_alrConfig m62 : 21|1@1+ (1,0) [0|1] "" Vector__XXX
 SG_ RCM_a062_eventIDFsignal m62 : 25|1@1+ (1,0) [0|1] "" Vector__XXX
 SG_ RCM_a062_eventFrontLeftSeatbelt m62 : 26|1@1+ (1,0) [0|1] "" Vector__XXX
 SG_ RCM_a062_eventFrontRightSeatbelt m62 : 27|1@1+ (1,0) [0|1] "" Vector__XXX
 SG_ RCM_a062_eventVehicleSpeed m62 : 28|12@1+ (0.08,-40) [-40|287.6] "kph" Vector__XXX
 SG_ RCM_a062_eventSteeringAngle m62 : 45|14@0+ (0.1,-819.2) [-819.2|819.1] "deg" Vector__XXX
 SG_ RCM_a062_eventDriverBrakeApply m62 : 46|2@1+ (1,0) [0|2] "" Vector__XXX
 SG_ RCM_a062_eventAccelPedalPos m62 : 56|8@1+ (0.4,0) [0|101.6] "%" Vector__XXX
 SG_ RCM_a063_eventArmStatus m63 : 11|1@1+ (1,0) [0|1] "" Vector__XXX
 SG_ RCM_a063_eventFactoryMode m63 : 12|1@1+ (1,0) [0|1] "" Vector__XXX
 SG_ RCM_a063_eventDiagEnabled m63 : 13|1@1+ (1,0) [0|1] "" Vector__XXX
 SG_ RCM_a063_eventDriveOrientation m63 : 14|1@1+ (1,0) [0|1] "" Vector__XXX
 SG_ RCM_a063_sbsw2ndRowRSht2Gnd m63 : 16|1@1+ (1,0) [0|1] "" Vector__XXX
 SG_ RCM_a063_sbsw2ndRowRSht2Bat m63 : 17|1@1+ (1,0) [0|1] "" Vector__XXX
 SG_ RCM_a063_sbsw2ndRowROpen m63 : 18|1@1+ (1,0) [0|1] "" Vector__XXX
 SG_ RCM_a063_sbsw2ndRowRUndefined m63 : 19|1@1+ (1,0) [0|1] "" Vector__XXX
 SG_ RCM_a063_sbsw2ndRowRCrossCoup m63 : 20|1@1+ (1,0) [0|1] "" Vector__XXX
 SG_ RCM_a063_sbsw2ndRowRConfig m63 : 21|1@1+ (1,0) [0|1] "" Vector__XXX
 SG_ RCM_a063_eventIDFsignal m63 : 25|1@1+ (1,0) [0|1] "" Vector__XXX
 SG_ RCM_a063_eventFrontLeftSeatbelt m63 : 26|1@1+ (1,0) [0|1] "" Vector__XXX
 SG_ RCM_a063_eventFrontRightSeatbelt m63 : 27|1@1+ (1,0) [0|1] "" Vector__XXX
 SG_ RCM_a063_eventVehicleSpeed m63 : 28|12@1+ (0.08,-40) [-40|287.6] "kph" Vector__XXX
 SG_ RCM_a063_eventSteeringAngle m63 : 45|14@0+ (0.1,-819.2) [-819.2|819.1] "deg" Vector__XXX
 SG_ RCM_a063_eventDriverBrakeApply m63 : 46|2@1+ (1,0) [0|2] "" Vector__XXX
 SG_ RCM_a063_eventAccelPedalPos m63 : 56|8@1+ (0.4,0) [0|101.6] "%" Vector__XXX
 SG_ RCM_a064_eventArmStatus m64 : 11|1@1+ (1,0) [0|1] "" Vector__XXX
 SG_ RCM_a064_eventFactoryMode m64 : 12|1@1+ (1,0) [0|1] "" Vector__XXX
 SG_ RCM_a064_eventDiagEnabled m64 : 13|1@1+ (1,0) [0|1] "" Vector__XXX
 SG_ RCM_a064_eventDriveOrientation m64 : 14|1@1+ (1,0) [0|1] "" Vector__XXX
 SG_ RCM_a064_hwcp1CheckFail m64 : 16|1@1+ (1,0) [0|1] "" Vector__XXX
 SG_ RCM_a064_hwcp1Sht2Bat m64 : 17|1@1+ (1,0) [0|1] "" Vector__XXX
 SG_ RCM_a064_hwcp1CrossCoup m64 : 18|1@1+ (1,0) [0|1] "" Vector__XXX
 SG_ RCM_a064_hwcp1Config m64 : 19|1@1+ (1,0) [0|1] "" Vector__XXX
 SG_ RCM_a064_eventIDFsignal m64 : 25|1@1+ (1,0) [0|1] "" Vector__XXX
 SG_ RCM_a064_eventFrontLeftSeatbelt m64 : 26|1@1+ (1,0) [0|1] "" Vector__XXX
 SG_ RCM_a064_eventFrontRightSeatbelt m64 : 27|1@1+ (1,0) [0|1] "" Vector__XXX
 SG_ RCM_a064_eventVehicleSpeed m64 : 28|12@1+ (0.08,-40) [-40|287.6] "kph" Vector__XXX
 SG_ RCM_a064_eventSteeringAngle m64 : 45|14@0+ (0.1,-819.2) [-819.2|819.1] "deg" Vector__XXX
 SG_ RCM_a064_eventDriverBrakeApply m64 : 46|2@1+ (1,0) [0|2] "" Vector__XXX
 SG_ RCM_a064_eventAccelPedalPos m64 : 56|8@1+ (0.4,0) [0|101.6] "%" Vector__XXX
 SG_ RCM_a065_eventArmStatus m65 : 11|1@1+ (1,0) [0|1] "" Vector__XXX
 SG_ RCM_a065_eventFactoryMode m65 : 12|1@1+ (1,0) [0|1] "" Vector__XXX
 SG_ RCM_a065_eventDiagEnabled m65 : 13|1@1+ (1,0) [0|1] "" Vector__XXX
 SG_ RCM_a065_eventDriveOrientation m65 : 14|1@1+ (1,0) [0|1] "" Vector__XXX
 SG_ RCM_a065_swDrvrOrientCheck m65 : 16|1@1+ (1,0) [0|1] "" Vector__XXX
 SG_ RCM_a065_swDrvrOrientSht2Bat m65 : 17|1@1+ (1,0) [0|1] "" Vector__XXX
 SG_ RCM_a065_swDrvrOrientCrossCoup m65 : 18|1@1+ (1,0) [0|1] "" Vector__XXX
 SG_ RCM_a065_swDrvrOrientConfig m65 : 19|1@1+ (1,0) [0|1] "" Vector__XXX
 SG_ RCM_a065_eventIDFsignal m65 : 25|1@1+ (1,0) [0|1] "" Vector__XXX
 SG_ RCM_a065_eventFrontLeftSeatbelt m65 : 26|1@1+ (1,0) [0|1] "" Vector__XXX
 SG_ RCM_a065_eventFrontRightSeatbelt m65 : 27|1@1+ (1,0) [0|1] "" Vector__XXX
 SG_ RCM_a065_eventVehicleSpeed m65 : 28|12@1+ (0.08,-40) [-40|287.6] "kph" Vector__XXX
 SG_ RCM_a065_eventSteeringAngle m65 : 45|14@0+ (0.1,-819.2) [-819.2|819.1] "deg" Vector__XXX
 SG_ RCM_a065_eventDriverBrakeApply m65 : 46|2@1+ (1,0) [0|2] "" Vector__XXX
 SG_ RCM_a065_eventAccelPedalPos m65 : 56|8@1+ (0.4,0) [0|101.6] "%" Vector__XXX
 SG_ RCM_a066_eventArmStatus m66 : 11|1@1+ (1,0) [0|1] "" Vector__XXX
 SG_ RCM_a066_eventFactoryMode m66 : 12|1@1+ (1,0) [0|1] "" Vector__XXX
 SG_ RCM_a066_eventDiagEnabled m66 : 13|1@1+ (1,0) [0|1] "" Vector__XXX
 SG_ RCM_a066_eventDriveOrientation m66 : 14|1@1+ (1,0) [0|1] "" Vector__XXX
 SG_ RCM_a066_sbsw2ndRowLShort m66 : 16|1@1+ (1,0) [0|1] "" Vector__XXX
 SG_ RCM_a066_sbsw2ndRowLSht2Bat m66 : 17|1@1+ (1,0) [0|1] "" Vector__XXX
 SG_ RCM_a066_sbsw2ndRowLCrossCoup m66 : 18|1@1+ (1,0) [0|1] "" Vector__XXX
 SG_ RCM_a066_sbsw2ndRowLConfig m66 : 19|1@1+ (1,0) [0|1] "" Vector__XXX
 SG_ RCM_a066_eventIDFsignal m66 : 25|1@1+ (1,0) [0|1] "" Vector__XXX
 SG_ RCM_a066_eventFrontLeftSeatbelt m66 : 26|1@1+ (1,0) [0|1] "" Vector__XXX
 SG_ RCM_a066_eventFrontRightSeatbelt m66 : 27|1@1+ (1,0) [0|1] "" Vector__XXX
 SG_ RCM_a066_eventVehicleSpeed m66 : 28|12@1+ (0.08,-40) [-40|287.6] "kph" Vector__XXX
 SG_ RCM_a066_eventSteeringAngle m66 : 45|14@0+ (0.1,-819.2) [-819.2|819.1] "deg" Vector__XXX
 SG_ RCM_a066_eventDriverBrakeApply m66 : 46|2@1+ (1,0) [0|2] "" Vector__XXX
 SG_ RCM_a066_eventAccelPedalPos m66 : 56|8@1+ (0.4,0) [0|101.6] "%" Vector__XXX
 SG_ RCM_a067_eventArmStatus m67 : 11|1@1+ (1,0) [0|1] "" Vector__XXX
 SG_ RCM_a067_eventFactoryMode m67 : 12|1@1+ (1,0) [0|1] "" Vector__XXX
 SG_ RCM_a067_eventDiagEnabled m67 : 13|1@1+ (1,0) [0|1] "" Vector__XXX
 SG_ RCM_a067_eventDriveOrientation m67 : 14|1@1+ (1,0) [0|1] "" Vector__XXX
 SG_ RCM_a067_comCANInitialization m67 : 16|1@1+ (1,0) [0|1] "" Vector__XXX
 SG_ RCM_a067_eventIDFsignal m67 : 25|1@1+ (1,0) [0|1] "" Vector__XXX
 SG_ RCM_a067_eventFrontLeftSeatbelt m67 : 26|1@1+ (1,0) [0|1] "" Vector__XXX
 SG_ RCM_a067_eventFrontRightSeatbelt m67 : 27|1@1+ (1,0) [0|1] "" Vector__XXX
 SG_ RCM_a067_eventVehicleSpeed m67 : 28|12@1+ (0.08,-40) [-40|287.6] "kph" Vector__XXX
 SG_ RCM_a067_eventSteeringAngle m67 : 45|14@0+ (0.1,-819.2) [-819.2|819.1] "deg" Vector__XXX
 SG_ RCM_a067_eventDriverBrakeApply m67 : 46|2@1+ (1,0) [0|2] "" Vector__XXX
 SG_ RCM_a067_eventAccelPedalPos m67 : 56|8@1+ (0.4,0) [0|101.6] "%" Vector__XXX
 SG_ RCM_a068_eventArmStatus m68 : 11|1@1+ (1,0) [0|1] "" Vector__XXX
 SG_ RCM_a068_eventFactoryMode m68 : 12|1@1+ (1,0) [0|1] "" Vector__XXX
 SG_ RCM_a068_eventDiagEnabled m68 : 13|1@1+ (1,0) [0|1] "" Vector__XXX
 SG_ RCM_a068_eventDriveOrientation m68 : 14|1@1+ (1,0) [0|1] "" Vector__XXX
 SG_ RCM_a068_comChassisCANBusOff m68 : 16|1@1+ (1,0) [0|1] "" Vector__XXX
 SG_ RCM_a068_eventIDFsignal m68 : 25|1@1+ (1,0) [0|1] "" Vector__XXX
 SG_ RCM_a068_eventFrontLeftSeatbelt m68 : 26|1@1+ (1,0) [0|1] "" Vector__XXX
 SG_ RCM_a068_eventFrontRightSeatbelt m68 : 27|1@1+ (1,0) [0|1] "" Vector__XXX
 SG_ RCM_a068_eventVehicleSpeed m68 : 28|12@1+ (0.08,-40) [-40|287.6] "kph" Vector__XXX
 SG_ RCM_a068_eventSteeringAngle m68 : 45|14@0+ (0.1,-819.2) [-819.2|819.1] "deg" Vector__XXX
 SG_ RCM_a068_eventDriverBrakeApply m68 : 46|2@1+ (1,0) [0|2] "" Vector__XXX
 SG_ RCM_a068_eventAccelPedalPos m68 : 56|8@1+ (0.4,0) [0|101.6] "%" Vector__XXX
 SG_ RCM_a069_eventArmStatus m69 : 11|1@1+ (1,0) [0|1] "" Vector__XXX
 SG_ RCM_a069_eventFactoryMode m69 : 12|1@1+ (1,0) [0|1] "" Vector__XXX
 SG_ RCM_a069_eventDiagEnabled m69 : 13|1@1+ (1,0) [0|1] "" Vector__XXX
 SG_ RCM_a069_eventDriveOrientation m69 : 14|1@1+ (1,0) [0|1] "" Vector__XXX
 SG_ RCM_a069_comChassisCANPH7MIA m69 : 16|1@1+ (1,0) [0|1] "" Vector__XXX
 SG_ RCM_a069_comChassisCANPH7ChkSm m69 : 17|1@1+ (1,0) [0|1] "" Vector__XXX
 SG_ RCM_a069_comChassisCANPH7Cntr m69 : 18|1@1+ (1,0) [0|1] "" Vector__XXX
 SG_ RCM_a069_eventIDFsignal m69 : 25|1@1+ (1,0) [0|1] "" Vector__XXX
 SG_ RCM_a069_eventFrontLeftSeatbelt m69 : 26|1@1+ (1,0) [0|1] "" Vector__XXX
 SG_ RCM_a069_eventFrontRightSeatbelt m69 : 27|1@1+ (1,0) [0|1] "" Vector__XXX
 SG_ RCM_a069_eventVehicleSpeed m69 : 28|12@1+ (0.08,-40) [-40|287.6] "kph" Vector__XXX
 SG_ RCM_a069_eventSteeringAngle m69 : 45|14@0+ (0.1,-819.2) [-819.2|819.1] "deg" Vector__XXX
 SG_ RCM_a069_eventDriverBrakeApply m69 : 46|2@1+ (1,0) [0|2] "" Vector__XXX
 SG_ RCM_a069_eventAccelPedalPos m69 : 56|8@1+ (0.4,0) [0|101.6] "%" Vector__XXX
 SG_ RCM_a070_eventArmStatus m70 : 11|1@1+ (1,0) [0|1] "" Vector__XXX
 SG_ RCM_a070_eventFactoryMode m70 : 12|1@1+ (1,0) [0|1] "" Vector__XXX
 SG_ RCM_a070_eventDiagEnabled m70 : 13|1@1+ (1,0) [0|1] "" Vector__XXX
 SG_ RCM_a070_eventDriveOrientation m70 : 14|1@1+ (1,0) [0|1] "" Vector__XXX
 SG_ RCM_a070_comChassisCANPH8MIA m70 : 16|1@1+ (1,0) [0|1] "" Vector__XXX
 SG_ RCM_a070_comChassisCANPH8ChkSm m70 : 17|1@1+ (1,0) [0|1] "" Vector__XXX
 SG_ RCM_a070_comChassisCANPH8Cntr m70 : 18|1@1+ (1,0) [0|1] "" Vector__XXX
 SG_ RCM_a070_eventIDFsignal m70 : 25|1@1+ (1,0) [0|1] "" Vector__XXX
 SG_ RCM_a070_eventFrontLeftSeatbelt m70 : 26|1@1+ (1,0) [0|1] "" Vector__XXX
 SG_ RCM_a070_eventFrontRightSeatbelt m70 : 27|1@1+ (1,0) [0|1] "" Vector__XXX
 SG_ RCM_a070_eventVehicleSpeed m70 : 28|12@1+ (0.08,-40) [-40|287.6] "kph" Vector__XXX
 SG_ RCM_a070_eventSteeringAngle m70 : 45|14@0+ (0.1,-819.2) [-819.2|819.1] "deg" Vector__XXX
 SG_ RCM_a070_eventDriverBrakeApply m70 : 46|2@1+ (1,0) [0|2] "" Vector__XXX
 SG_ RCM_a070_eventAccelPedalPos m70 : 56|8@1+ (0.4,0) [0|101.6] "%" Vector__XXX
 SG_ RCM_a071_eventArmStatus m71 : 11|1@1+ (1,0) [0|1] "" Vector__XXX
 SG_ RCM_a071_eventFactoryMode m71 : 12|1@1+ (1,0) [0|1] "" Vector__XXX
 SG_ RCM_a071_eventDiagEnabled m71 : 13|1@1+ (1,0) [0|1] "" Vector__XXX
 SG_ RCM_a071_eventDriveOrientation m71 : 14|1@1+ (1,0) [0|1] "" Vector__XXX
 SG_ RCM_a071_comChassisCANPH9MIA m71 : 16|1@1+ (1,0) [0|1] "" Vector__XXX
 SG_ RCM_a071_comChassisCANPH9ChkSm m71 : 17|1@1+ (1,0) [0|1] "" Vector__XXX
 SG_ RCM_a071_comChassisCANPH9Cntr m71 : 18|1@1+ (1,0) [0|1] "" Vector__XXX
 SG_ RCM_a071_eventIDFsignal m71 : 25|1@1+ (1,0) [0|1] "" Vector__XXX
 SG_ RCM_a071_eventFrontLeftSeatbelt m71 : 26|1@1+ (1,0) [0|1] "" Vector__XXX
 SG_ RCM_a071_eventFrontRightSeatbelt m71 : 27|1@1+ (1,0) [0|1] "" Vector__XXX
 SG_ RCM_a071_eventVehicleSpeed m71 : 28|12@1+ (0.08,-40) [-40|287.6] "kph" Vector__XXX
 SG_ RCM_a071_eventSteeringAngle m71 : 45|14@0+ (0.1,-819.2) [-819.2|819.1] "deg" Vector__XXX
 SG_ RCM_a071_eventDriverBrakeApply m71 : 46|2@1+ (1,0) [0|2] "" Vector__XXX
 SG_ RCM_a071_eventAccelPedalPos m71 : 56|8@1+ (0.4,0) [0|101.6] "%" Vector__XXX
 SG_ RCM_a072_eventArmStatus m72 : 11|1@1+ (1,0) [0|1] "" Vector__XXX
 SG_ RCM_a072_eventFactoryMode m72 : 12|1@1+ (1,0) [0|1] "" Vector__XXX
 SG_ RCM_a072_eventDiagEnabled m72 : 13|1@1+ (1,0) [0|1] "" Vector__XXX
 SG_ RCM_a072_eventDriveOrientation m72 : 14|1@1+ (1,0) [0|1] "" Vector__XXX
 SG_ RCM_a072_comUnusedMIA m72 : 16|1@1+ (1,0) [0|1] "" Vector__XXX
 SG_ RCM_a072_comUnusedChkSm m72 : 17|1@1+ (1,0) [0|1] "" Vector__XXX
 SG_ RCM_a072_comUnusedCntr m72 : 18|1@1+ (1,0) [0|1] "" Vector__XXX
 SG_ RCM_a072_eventIDFsignal m72 : 25|1@1+ (1,0) [0|1] "" Vector__XXX
 SG_ RCM_a072_eventFrontLeftSeatbelt m72 : 26|1@1+ (1,0) [0|1] "" Vector__XXX
 SG_ RCM_a072_eventFrontRightSeatbelt m72 : 27|1@1+ (1,0) [0|1] "" Vector__XXX
 SG_ RCM_a072_eventVehicleSpeed m72 : 28|12@1+ (0.08,-40) [-40|287.6] "kph" Vector__XXX
 SG_ RCM_a072_eventSteeringAngle m72 : 45|14@0+ (0.1,-819.2) [-819.2|819.1] "deg" Vector__XXX
 SG_ RCM_a072_eventDriverBrakeApply m72 : 46|2@1+ (1,0) [0|2] "" Vector__XXX
 SG_ RCM_a072_eventAccelPedalPos m72 : 56|8@1+ (0.4,0) [0|101.6] "%" Vector__XXX
 SG_ RCM_a073_eventArmStatus m73 : 11|1@1+ (1,0) [0|1] "" Vector__XXX
 SG_ RCM_a073_eventFactoryMode m73 : 12|1@1+ (1,0) [0|1] "" Vector__XXX
 SG_ RCM_a073_eventDiagEnabled m73 : 13|1@1+ (1,0) [0|1] "" Vector__XXX
 SG_ RCM_a073_eventDriveOrientation m73 : 14|1@1+ (1,0) [0|1] "" Vector__XXX
 SG_ RCM_a073_comChassisCANPH4MIA m73 : 16|1@1+ (1,0) [0|1] "" Vector__XXX
 SG_ RCM_a073_comChassisCANPH4ChkSm m73 : 17|1@1+ (1,0) [0|1] "" Vector__XXX
 SG_ RCM_a073_comChassisCANPH4Cntr m73 : 18|1@1+ (1,0) [0|1] "" Vector__XXX
 SG_ RCM_a073_eventIDFsignal m73 : 25|1@1+ (1,0) [0|1] "" Vector__XXX
 SG_ RCM_a073_eventFrontLeftSeatbelt m73 : 26|1@1+ (1,0) [0|1] "" Vector__XXX
 SG_ RCM_a073_eventFrontRightSeatbelt m73 : 27|1@1+ (1,0) [0|1] "" Vector__XXX
 SG_ RCM_a073_eventVehicleSpeed m73 : 28|12@1+ (0.08,-40) [-40|287.6] "kph" Vector__XXX
 SG_ RCM_a073_eventSteeringAngle m73 : 45|14@0+ (0.1,-819.2) [-819.2|819.1] "deg" Vector__XXX
 SG_ RCM_a073_eventDriverBrakeApply m73 : 46|2@1+ (1,0) [0|2] "" Vector__XXX
 SG_ RCM_a073_eventAccelPedalPos m73 : 56|8@1+ (0.4,0) [0|101.6] "%" Vector__XXX
 SG_ RCM_a074_eventArmStatus m74 : 11|1@1+ (1,0) [0|1] "" Vector__XXX
 SG_ RCM_a074_eventFactoryMode m74 : 12|1@1+ (1,0) [0|1] "" Vector__XXX
 SG_ RCM_a074_eventDiagEnabled m74 : 13|1@1+ (1,0) [0|1] "" Vector__XXX
 SG_ RCM_a074_eventDriveOrientation m74 : 14|1@1+ (1,0) [0|1] "" Vector__XXX
 SG_ RCM_a074_comChassisCANPH5MIA m74 : 16|1@1+ (1,0) [0|1] "" Vector__XXX
 SG_ RCM_a074_comChassisCANPH5ChkSm m74 : 17|1@1+ (1,0) [0|1] "" Vector__XXX
 SG_ RCM_a074_comChassisCANPH5Cntr m74 : 18|1@1+ (1,0) [0|1] "" Vector__XXX
 SG_ RCM_a074_eventIDFsignal m74 : 25|1@1+ (1,0) [0|1] "" Vector__XXX
 SG_ RCM_a074_eventFrontLeftSeatbelt m74 : 26|1@1+ (1,0) [0|1] "" Vector__XXX
 SG_ RCM_a074_eventFrontRightSeatbelt m74 : 27|1@1+ (1,0) [0|1] "" Vector__XXX
 SG_ RCM_a074_eventVehicleSpeed m74 : 28|12@1+ (0.08,-40) [-40|287.6] "kph" Vector__XXX
 SG_ RCM_a074_eventSteeringAngle m74 : 45|14@0+ (0.1,-819.2) [-819.2|819.1] "deg" Vector__XXX
 SG_ RCM_a074_eventDriverBrakeApply m74 : 46|2@1+ (1,0) [0|2] "" Vector__XXX
 SG_ RCM_a074_eventAccelPedalPos m74 : 56|8@1+ (0.4,0) [0|101.6] "%" Vector__XXX
 SG_ RCM_a075_eventArmStatus m75 : 11|1@1+ (1,0) [0|1] "" Vector__XXX
 SG_ RCM_a075_eventFactoryMode m75 : 12|1@1+ (1,0) [0|1] "" Vector__XXX
 SG_ RCM_a075_eventDiagEnabled m75 : 13|1@1+ (1,0) [0|1] "" Vector__XXX
 SG_ RCM_a075_eventDriveOrientation m75 : 14|1@1+ (1,0) [0|1] "" Vector__XXX
 SG_ RCM_a075_comChassisCANPH6MIA m75 : 16|1@1+ (1,0) [0|1] "" Vector__XXX
 SG_ RCM_a075_comChassisCANPH6ChkSm m75 : 17|1@1+ (1,0) [0|1] "" Vector__XXX
 SG_ RCM_a075_comChassisCANPH6Cntr m75 : 18|1@1+ (1,0) [0|1] "" Vector__XXX
 SG_ RCM_a075_eventIDFsignal m75 : 25|1@1+ (1,0) [0|1] "" Vector__XXX
 SG_ RCM_a075_eventFrontLeftSeatbelt m75 : 26|1@1+ (1,0) [0|1] "" Vector__XXX
 SG_ RCM_a075_eventFrontRightSeatbelt m75 : 27|1@1+ (1,0) [0|1] "" Vector__XXX
 SG_ RCM_a075_eventVehicleSpeed m75 : 28|12@1+ (0.08,-40) [-40|287.6] "kph" Vector__XXX
 SG_ RCM_a075_eventSteeringAngle m75 : 45|14@0+ (0.1,-819.2) [-819.2|819.1] "deg" Vector__XXX
 SG_ RCM_a075_eventDriverBrakeApply m75 : 46|2@1+ (1,0) [0|2] "" Vector__XXX
 SG_ RCM_a075_eventAccelPedalPos m75 : 56|8@1+ (0.4,0) [0|101.6] "%" Vector__XXX
 SG_ RCM_a078_eventArmStatus m78 : 11|1@1+ (1,0) [0|1] "" Vector__XXX
 SG_ RCM_a078_eventFactoryMode m78 : 12|1@1+ (1,0) [0|1] "" Vector__XXX
 SG_ RCM_a078_eventDiagEnabled m78 : 13|1@1+ (1,0) [0|1] "" Vector__XXX
 SG_ RCM_a078_eventDriveOrientation m78 : 14|1@1+ (1,0) [0|1] "" Vector__XXX
 SG_ RCM_a078_comOCS1PMIA m78 : 16|1@1+ (1,0) [0|1] "" Vector__XXX
 SG_ RCM_a078_comOCS1PChkSm m78 : 17|1@1+ (1,0) [0|1] "" Vector__XXX
 SG_ RCM_a078_comOCS1PCntr m78 : 18|1@1+ (1,0) [0|1] "" Vector__XXX
 SG_ RCM_a078_eventIDFsignal m78 : 25|1@1+ (1,0) [0|1] "" Vector__XXX
 SG_ RCM_a078_eventFrontLeftSeatbelt m78 : 26|1@1+ (1,0) [0|1] "" Vector__XXX
 SG_ RCM_a078_eventFrontRightSeatbelt m78 : 27|1@1+ (1,0) [0|1] "" Vector__XXX
 SG_ RCM_a078_eventVehicleSpeed m78 : 28|12@1+ (0.08,-40) [-40|287.6] "kph" Vector__XXX
 SG_ RCM_a078_eventSteeringAngle m78 : 45|14@0+ (0.1,-819.2) [-819.2|819.1] "deg" Vector__XXX
 SG_ RCM_a078_eventDriverBrakeApply m78 : 46|2@1+ (1,0) [0|2] "" Vector__XXX
 SG_ RCM_a078_eventAccelPedalPos m78 : 56|8@1+ (0.4,0) [0|101.6] "%" Vector__XXX
 SG_ RCM_a079_eventArmStatus m79 : 11|1@1+ (1,0) [0|1] "" Vector__XXX
 SG_ RCM_a079_eventFactoryMode m79 : 12|1@1+ (1,0) [0|1] "" Vector__XXX
 SG_ RCM_a079_eventDiagEnabled m79 : 13|1@1+ (1,0) [0|1] "" Vector__XXX
 SG_ RCM_a079_eventDriveOrientation m79 : 14|1@1+ (1,0) [0|1] "" Vector__XXX
 SG_ RCM_a079_comOCS1DMIA m79 : 16|1@1+ (1,0) [0|1] "" Vector__XXX
 SG_ RCM_a079_comOCS1DChkSm m79 : 17|1@1+ (1,0) [0|1] "" Vector__XXX
 SG_ RCM_a079_comOCS1DCntr m79 : 18|1@1+ (1,0) [0|1] "" Vector__XXX
 SG_ RCM_a079_eventIDFsignal m79 : 25|1@1+ (1,0) [0|1] "" Vector__XXX
 SG_ RCM_a079_eventFrontLeftSeatbelt m79 : 26|1@1+ (1,0) [0|1] "" Vector__XXX
 SG_ RCM_a079_eventFrontRightSeatbelt m79 : 27|1@1+ (1,0) [0|1] "" Vector__XXX
 SG_ RCM_a079_eventVehicleSpeed m79 : 28|12@1+ (0.08,-40) [-40|287.6] "kph" Vector__XXX
 SG_ RCM_a079_eventSteeringAngle m79 : 45|14@0+ (0.1,-819.2) [-819.2|819.1] "deg" Vector__XXX
 SG_ RCM_a079_eventDriverBrakeApply m79 : 46|2@1+ (1,0) [0|2] "" Vector__XXX
 SG_ RCM_a079_eventAccelPedalPos m79 : 56|8@1+ (0.4,0) [0|101.6] "%" Vector__XXX
 SG_ RCM_a080_eventArmStatus m80 : 11|1@1+ (1,0) [0|1] "" Vector__XXX
 SG_ RCM_a080_eventFactoryMode m80 : 12|1@1+ (1,0) [0|1] "" Vector__XXX
 SG_ RCM_a080_eventDiagEnabled m80 : 13|1@1+ (1,0) [0|1] "" Vector__XXX
 SG_ RCM_a080_eventDriveOrientation m80 : 14|1@1+ (1,0) [0|1] "" Vector__XXX
 SG_ RCM_a080_comGTWACSMIA m80 : 16|1@1+ (1,0) [0|1] "" Vector__XXX
 SG_ RCM_a080_comGTWACSChkSm m80 : 17|1@1+ (1,0) [0|1] "" Vector__XXX
 SG_ RCM_a080_comGTWACSCntr m80 : 18|1@1+ (1,0) [0|1] "" Vector__XXX
 SG_ RCM_a080_eventIDFsignal m80 : 25|1@1+ (1,0) [0|1] "" Vector__XXX
 SG_ RCM_a080_eventFrontLeftSeatbelt m80 : 26|1@1+ (1,0) [0|1] "" Vector__XXX
 SG_ RCM_a080_eventFrontRightSeatbelt m80 : 27|1@1+ (1,0) [0|1] "" Vector__XXX
 SG_ RCM_a080_eventVehicleSpeed m80 : 28|12@1+ (0.08,-40) [-40|287.6] "kph" Vector__XXX
 SG_ RCM_a080_eventSteeringAngle m80 : 45|14@0+ (0.1,-819.2) [-819.2|819.1] "deg" Vector__XXX
 SG_ RCM_a080_eventDriverBrakeApply m80 : 46|2@1+ (1,0) [0|2] "" Vector__XXX
 SG_ RCM_a080_eventAccelPedalPos m80 : 56|8@1+ (0.4,0) [0|101.6] "%" Vector__XXX
 SG_ RCM_a083_eventArmStatus m83 : 11|1@1+ (1,0) [0|1] "" Vector__XXX
 SG_ RCM_a083_eventFactoryMode m83 : 12|1@1+ (1,0) [0|1] "" Vector__XXX
 SG_ RCM_a083_eventDiagEnabled m83 : 13|1@1+ (1,0) [0|1] "" Vector__XXX
 SG_ RCM_a083_eventDriveOrientation m83 : 14|1@1+ (1,0) [0|1] "" Vector__XXX
 SG_ RCM_a083_comGTWCarStateMIA m83 : 16|1@1+ (1,0) [0|1] "" Vector__XXX
 SG_ RCM_a083_eventIDFsignal m83 : 25|1@1+ (1,0) [0|1] "" Vector__XXX
 SG_ RCM_a083_eventFrontLeftSeatbelt m83 : 26|1@1+ (1,0) [0|1] "" Vector__XXX
 SG_ RCM_a083_eventFrontRightSeatbelt m83 : 27|1@1+ (1,0) [0|1] "" Vector__XXX
 SG_ RCM_a083_eventVehicleSpeed m83 : 28|12@1+ (0.08,-40) [-40|287.6] "kph" Vector__XXX
 SG_ RCM_a083_eventSteeringAngle m83 : 45|14@0+ (0.1,-819.2) [-819.2|819.1] "deg" Vector__XXX
 SG_ RCM_a083_eventDriverBrakeApply m83 : 46|2@1+ (1,0) [0|2] "" Vector__XXX
 SG_ RCM_a083_eventAccelPedalPos m83 : 56|8@1+ (0.4,0) [0|101.6] "%" Vector__XXX
 SG_ RCM_a087_eventArmStatus m87 : 11|1@1+ (1,0) [0|1] "" Vector__XXX
 SG_ RCM_a087_eventFactoryMode m87 : 12|1@1+ (1,0) [0|1] "" Vector__XXX
 SG_ RCM_a087_eventDiagEnabled m87 : 13|1@1+ (1,0) [0|1] "" Vector__XXX
 SG_ RCM_a087_eventDriveOrientation m87 : 14|1@1+ (1,0) [0|1] "" Vector__XXX
 SG_ RCM_a087_comChassisCANSilent m87 : 16|1@1+ (1,0) [0|1] "" Vector__XXX
 SG_ RCM_a087_comPARTYCANSilent m87 : 17|1@1+ (1,0) [0|1] "" Vector__XXX
 SG_ RCM_a087_comUnusedCANSilent m87 : 18|1@1+ (1,0) [0|1] "" Vector__XXX
 SG_ RCM_a087_eventIDFsignal m87 : 25|1@1+ (1,0) [0|1] "" Vector__XXX
 SG_ RCM_a087_eventFrontLeftSeatbelt m87 : 26|1@1+ (1,0) [0|1] "" Vector__XXX
 SG_ RCM_a087_eventFrontRightSeatbelt m87 : 27|1@1+ (1,0) [0|1] "" Vector__XXX
 SG_ RCM_a087_eventVehicleSpeed m87 : 28|12@1+ (0.08,-40) [-40|287.6] "kph" Vector__XXX
 SG_ RCM_a087_eventSteeringAngle m87 : 45|14@0+ (0.1,-819.2) [-819.2|819.1] "deg" Vector__XXX
 SG_ RCM_a087_eventDriverBrakeApply m87 : 46|2@1+ (1,0) [0|2] "" Vector__XXX
 SG_ RCM_a087_eventAccelPedalPos m87 : 56|8@1+ (0.4,0) [0|101.6] "%" Vector__XXX
 SG_ RCM_a088_eventArmStatus m88 : 11|1@1+ (1,0) [0|1] "" Vector__XXX
 SG_ RCM_a088_eventFactoryMode m88 : 12|1@1+ (1,0) [0|1] "" Vector__XXX
 SG_ RCM_a088_eventDiagEnabled m88 : 13|1@1+ (1,0) [0|1] "" Vector__XXX
 SG_ RCM_a088_eventDriveOrientation m88 : 14|1@1+ (1,0) [0|1] "" Vector__XXX
 SG_ RCM_a088_comChassisCANPH2MIA m88 : 16|1@1+ (1,0) [0|1] "" Vector__XXX
 SG_ RCM_a088_comChassisCANPH2ChkSm m88 : 17|1@1+ (1,0) [0|1] "" Vector__XXX
 SG_ RCM_a088_comChassisCANPH2Cntr m88 : 18|1@1+ (1,0) [0|1] "" Vector__XXX
 SG_ RCM_a088_eventIDFsignal m88 : 25|1@1+ (1,0) [0|1] "" Vector__XXX
 SG_ RCM_a088_eventFrontLeftSeatbelt m88 : 26|1@1+ (1,0) [0|1] "" Vector__XXX
 SG_ RCM_a088_eventFrontRightSeatbelt m88 : 27|1@1+ (1,0) [0|1] "" Vector__XXX
 SG_ RCM_a088_eventVehicleSpeed m88 : 28|12@1+ (0.08,-40) [-40|287.6] "kph" Vector__XXX
 SG_ RCM_a088_eventSteeringAngle m88 : 45|14@0+ (0.1,-819.2) [-819.2|819.1] "deg" Vector__XXX
 SG_ RCM_a088_eventDriverBrakeApply m88 : 46|2@1+ (1,0) [0|2] "" Vector__XXX
 SG_ RCM_a088_eventAccelPedalPos m88 : 56|8@1+ (0.4,0) [0|101.6] "%" Vector__XXX
 SG_ RCM_a089_eventArmStatus m89 : 11|1@1+ (1,0) [0|1] "" Vector__XXX
 SG_ RCM_a089_eventFactoryMode m89 : 12|1@1+ (1,0) [0|1] "" Vector__XXX
 SG_ RCM_a089_eventDiagEnabled m89 : 13|1@1+ (1,0) [0|1] "" Vector__XXX
 SG_ RCM_a089_eventDriveOrientation m89 : 14|1@1+ (1,0) [0|1] "" Vector__XXX
 SG_ RCM_a089_comChassisCANPH3MIA m89 : 16|1@1+ (1,0) [0|1] "" Vector__XXX
 SG_ RCM_a089_comChassisCANPH3ChkSm m89 : 17|1@1+ (1,0) [0|1] "" Vector__XXX
 SG_ RCM_a089_comChassisCANPH3Cntr m89 : 18|1@1+ (1,0) [0|1] "" Vector__XXX
 SG_ RCM_a089_eventIDFsignal m89 : 25|1@1+ (1,0) [0|1] "" Vector__XXX
 SG_ RCM_a089_eventFrontLeftSeatbelt m89 : 26|1@1+ (1,0) [0|1] "" Vector__XXX
 SG_ RCM_a089_eventFrontRightSeatbelt m89 : 27|1@1+ (1,0) [0|1] "" Vector__XXX
 SG_ RCM_a089_eventVehicleSpeed m89 : 28|12@1+ (0.08,-40) [-40|287.6] "kph" Vector__XXX
 SG_ RCM_a089_eventSteeringAngle m89 : 45|14@0+ (0.1,-819.2) [-819.2|819.1] "deg" Vector__XXX
 SG_ RCM_a089_eventDriverBrakeApply m89 : 46|2@1+ (1,0) [0|2] "" Vector__XXX
 SG_ RCM_a089_eventAccelPedalPos m89 : 56|8@1+ (0.4,0) [0|101.6] "%" Vector__XXX
 SG_ RCM_a090_eventArmStatus m90 : 11|1@1+ (1,0) [0|1] "" Vector__XXX
 SG_ RCM_a090_eventFactoryMode m90 : 12|1@1+ (1,0) [0|1] "" Vector__XXX
 SG_ RCM_a090_eventDiagEnabled m90 : 13|1@1+ (1,0) [0|1] "" Vector__XXX
 SG_ RCM_a090_eventDriveOrientation m90 : 14|1@1+ (1,0) [0|1] "" Vector__XXX
 SG_ RCM_a090_comPartyCANBusOff m90 : 16|1@1+ (1,0) [0|1] "" Vector__XXX
 SG_ RCM_a090_eventIDFsignal m90 : 25|1@1+ (1,0) [0|1] "" Vector__XXX
 SG_ RCM_a090_eventFrontLeftSeatbelt m90 : 26|1@1+ (1,0) [0|1] "" Vector__XXX
 SG_ RCM_a090_eventFrontRightSeatbelt m90 : 27|1@1+ (1,0) [0|1] "" Vector__XXX
 SG_ RCM_a090_eventVehicleSpeed m90 : 28|12@1+ (0.08,-40) [-40|287.6] "kph" Vector__XXX
 SG_ RCM_a090_eventSteeringAngle m90 : 45|14@0+ (0.1,-819.2) [-819.2|819.1] "deg" Vector__XXX
 SG_ RCM_a090_eventDriverBrakeApply m90 : 46|2@1+ (1,0) [0|2] "" Vector__XXX
 SG_ RCM_a090_eventAccelPedalPos m90 : 56|8@1+ (0.4,0) [0|101.6] "%" Vector__XXX
 SG_ RCM_a091_eventArmStatus m91 : 11|1@1+ (1,0) [0|1] "" Vector__XXX
 SG_ RCM_a091_eventFactoryMode m91 : 12|1@1+ (1,0) [0|1] "" Vector__XXX
 SG_ RCM_a091_eventDiagEnabled m91 : 13|1@1+ (1,0) [0|1] "" Vector__XXX
 SG_ RCM_a091_eventDriveOrientation m91 : 14|1@1+ (1,0) [0|1] "" Vector__XXX
 SG_ RCM_a091_comEPAS3PStAnglInvlidQF m91 : 16|1@1+ (1,0) [0|1] "" Vector__XXX
 SG_ RCM_a091_comEPAS3PsysStatusMIA m91 : 17|1@1+ (1,0) [0|1] "" Vector__XXX
 SG_ RCM_a091_comEPAS3PsysStatusChkSm m91 : 18|1@1+ (1,0) [0|1] "" Vector__XXX
 SG_ RCM_a091_comEPAS3PsysStatusCntr m91 : 19|1@1+ (1,0) [0|1] "" Vector__XXX
 SG_ RCM_a091_eventIDFsignal m91 : 25|1@1+ (1,0) [0|1] "" Vector__XXX
 SG_ RCM_a091_eventFrontLeftSeatbelt m91 : 26|1@1+ (1,0) [0|1] "" Vector__XXX
 SG_ RCM_a091_eventFrontRightSeatbelt m91 : 27|1@1+ (1,0) [0|1] "" Vector__XXX
 SG_ RCM_a091_eventVehicleSpeed m91 : 28|12@1+ (0.08,-40) [-40|287.6] "kph" Vector__XXX
 SG_ RCM_a091_eventSteeringAngle m91 : 45|14@0+ (0.1,-819.2) [-819.2|819.1] "deg" Vector__XXX
 SG_ RCM_a091_eventDriverBrakeApply m91 : 46|2@1+ (1,0) [0|2] "" Vector__XXX
 SG_ RCM_a091_eventAccelPedalPos m91 : 56|8@1+ (0.4,0) [0|101.6] "%" Vector__XXX
 SG_ RCM_a092_eventArmStatus m92 : 11|1@1+ (1,0) [0|1] "" Vector__XXX
 SG_ RCM_a092_eventFactoryMode m92 : 12|1@1+ (1,0) [0|1] "" Vector__XXX
 SG_ RCM_a092_eventDiagEnabled m92 : 13|1@1+ (1,0) [0|1] "" Vector__XXX
 SG_ RCM_a092_eventDriveOrientation m92 : 14|1@1+ (1,0) [0|1] "" Vector__XXX
 SG_ RCM_a092_comDASSafetyFrontMIA m92 : 16|1@1+ (1,0) [0|1] "" Vector__XXX
 SG_ RCM_a092_comDASSafetyFrontChkSm m92 : 17|1@1+ (1,0) [0|1] "" Vector__XXX
 SG_ RCM_a092_comDASSafetyFrontCntr m92 : 18|1@1+ (1,0) [0|1] "" Vector__XXX
 SG_ RCM_a092_eventIDFsignal m92 : 25|1@1+ (1,0) [0|1] "" Vector__XXX
 SG_ RCM_a092_eventFrontLeftSeatbelt m92 : 26|1@1+ (1,0) [0|1] "" Vector__XXX
 SG_ RCM_a092_eventFrontRightSeatbelt m92 : 27|1@1+ (1,0) [0|1] "" Vector__XXX
 SG_ RCM_a092_eventVehicleSpeed m92 : 28|12@1+ (0.08,-40) [-40|287.6] "kph" Vector__XXX
 SG_ RCM_a092_eventSteeringAngle m92 : 45|14@0+ (0.1,-819.2) [-819.2|819.1] "deg" Vector__XXX
 SG_ RCM_a092_eventDriverBrakeApply m92 : 46|2@1+ (1,0) [0|2] "" Vector__XXX
 SG_ RCM_a092_eventAccelPedalPos m92 : 56|8@1+ (0.4,0) [0|101.6] "%" Vector__XXX
 SG_ RCM_a093_eventArmStatus m93 : 11|1@1+ (1,0) [0|1] "" Vector__XXX
 SG_ RCM_a093_eventFactoryMode m93 : 12|1@1+ (1,0) [0|1] "" Vector__XXX
 SG_ RCM_a093_eventDiagEnabled m93 : 13|1@1+ (1,0) [0|1] "" Vector__XXX
 SG_ RCM_a093_eventDriveOrientation m93 : 14|1@1+ (1,0) [0|1] "" Vector__XXX
 SG_ RCM_a093_comVCLEFTStatusMIA m93 : 16|1@1+ (1,0) [0|1] "" Vector__XXX
 SG_ RCM_a093_comVCLEFTStatusChkSm m93 : 17|1@1+ (1,0) [0|1] "" Vector__XXX
 SG_ RCM_a093_comVCLEFTStatusCntr m93 : 18|1@1+ (1,0) [0|1] "" Vector__XXX
 SG_ RCM_a093_bucklSwVCFrontLeftFault m93 : 19|1@1+ (1,0) [0|1] "" Vector__XXX
 SG_ RCM_a093_bucklSwVCRearLeftFault m93 : 20|1@1+ (1,0) [0|1] "" Vector__XXX
 SG_ RCM_a093_eventIDFsignal m93 : 25|1@1+ (1,0) [0|1] "" Vector__XXX
 SG_ RCM_a093_eventFrontLeftSeatbelt m93 : 26|1@1+ (1,0) [0|1] "" Vector__XXX
 SG_ RCM_a093_eventFrontRightSeatbelt m93 : 27|1@1+ (1,0) [0|1] "" Vector__XXX
 SG_ RCM_a093_eventVehicleSpeed m93 : 28|12@1+ (0.08,-40) [-40|287.6] "kph" Vector__XXX
 SG_ RCM_a093_eventSteeringAngle m93 : 45|14@0+ (0.1,-819.2) [-819.2|819.1] "deg" Vector__XXX
 SG_ RCM_a093_eventDriverBrakeApply m93 : 46|2@1+ (1,0) [0|2] "" Vector__XXX
 SG_ RCM_a093_eventAccelPedalPos m93 : 56|8@1+ (0.4,0) [0|101.6] "%" Vector__XXX
 SG_ RCM_a094_eventArmStatus m94 : 11|1@1+ (1,0) [0|1] "" Vector__XXX
 SG_ RCM_a094_eventFactoryMode m94 : 12|1@1+ (1,0) [0|1] "" Vector__XXX
 SG_ RCM_a094_eventDiagEnabled m94 : 13|1@1+ (1,0) [0|1] "" Vector__XXX
 SG_ RCM_a094_eventDriveOrientation m94 : 14|1@1+ (1,0) [0|1] "" Vector__XXX
 SG_ RCM_a094_comVCRIGHTStatusMIA m94 : 16|1@1+ (1,0) [0|1] "" Vector__XXX
 SG_ RCM_a094_comVCRIGHTStatusChkSm m94 : 17|1@1+ (1,0) [0|1] "" Vector__XXX
 SG_ RCM_a094_comVCRIGHTStatusCntr m94 : 18|1@1+ (1,0) [0|1] "" Vector__XXX
 SG_ RCM_a094_bucklSwVCFrontRghtFault m94 : 19|1@1+ (1,0) [0|1] "" Vector__XXX
 SG_ RCM_a094_bucklSwVCRearRghtFault m94 : 20|1@1+ (1,0) [0|1] "" Vector__XXX
 SG_ RCM_a094_bucklSwVCRearCnterFault m94 : 21|1@1+ (1,0) [0|1] "" Vector__XXX
 SG_ RCM_a094_eventIDFsignal m94 : 25|1@1+ (1,0) [0|1] "" Vector__XXX
 SG_ RCM_a094_eventFrontLeftSeatbelt m94 : 26|1@1+ (1,0) [0|1] "" Vector__XXX
 SG_ RCM_a094_eventFrontRightSeatbelt m94 : 27|1@1+ (1,0) [0|1] "" Vector__XXX
 SG_ RCM_a094_eventVehicleSpeed m94 : 28|12@1+ (0.08,-40) [-40|287.6] "kph" Vector__XXX
 SG_ RCM_a094_eventSteeringAngle m94 : 45|14@0+ (0.1,-819.2) [-819.2|819.1] "deg" Vector__XXX
 SG_ RCM_a094_eventDriverBrakeApply m94 : 46|2@1+ (1,0) [0|2] "" Vector__XXX
 SG_ RCM_a094_eventAccelPedalPos m94 : 56|8@1+ (0.4,0) [0|101.6] "%" Vector__XXX
 SG_ RCM_a101_eventArmStatus m101 : 11|1@1+ (1,0) [0|1] "" Vector__XXX
 SG_ RCM_a101_eventFactoryMode m101 : 12|1@1+ (1,0) [0|1] "" Vector__XXX
 SG_ RCM_a101_eventDiagEnabled m101 : 13|1@1+ (1,0) [0|1] "" Vector__XXX
 SG_ RCM_a101_eventDriveOrientation m101 : 14|1@1+ (1,0) [0|1] "" Vector__XXX
 SG_ RCM_a101_idfMisuseMonitoringErr m101 : 16|1@1+ (1,0) [0|1] "" Vector__XXX
 SG_ RCM_a101_idfEnviMonitoringError m101 : 17|1@1+ (1,0) [0|1] "" Vector__XXX
 SG_ RCM_a101_idfEnviMonitoringEvent m101 : 18|1@1+ (1,0) [0|1] "" Vector__XXX
 SG_ RCM_a101_eventIDFsignal m101 : 25|1@1+ (1,0) [0|1] "" Vector__XXX
 SG_ RCM_a101_eventFrontLeftSeatbelt m101 : 26|1@1+ (1,0) [0|1] "" Vector__XXX
 SG_ RCM_a101_eventFrontRightSeatbelt m101 : 27|1@1+ (1,0) [0|1] "" Vector__XXX
 SG_ RCM_a101_eventVehicleSpeed m101 : 28|12@1+ (0.08,-40) [-40|287.6] "kph" Vector__XXX
 SG_ RCM_a101_eventSteeringAngle m101 : 45|14@0+ (0.1,-819.2) [-819.2|819.1] "deg" Vector__XXX
 SG_ RCM_a101_eventDriverBrakeApply m101 : 46|2@1+ (1,0) [0|2] "" Vector__XXX
 SG_ RCM_a101_eventAccelPedalPos m101 : 56|8@1+ (0.4,0) [0|101.6] "%" Vector__XXX
 SG_ RCM_a102_eventArmStatus m102 : 11|1@1+ (1,0) [0|1] "" Vector__XXX
 SG_ RCM_a102_eventFactoryMode m102 : 12|1@1+ (1,0) [0|1] "" Vector__XXX
 SG_ RCM_a102_eventDiagEnabled m102 : 13|1@1+ (1,0) [0|1] "" Vector__XXX
 SG_ RCM_a102_eventDriveOrientation m102 : 14|1@1+ (1,0) [0|1] "" Vector__XXX
 SG_ RCM_a102_imuYawR8OffCompPosLife m102 : 16|1@1+ (1,0) [0|1] "" Vector__XXX
 SG_ RCM_a102_imuYawR8OffCompNegLife m102 : 17|1@1+ (1,0) [0|1] "" Vector__XXX
 SG_ RCM_a102_imuYawR8OffCompPosFLDC m102 : 18|1@1+ (1,0) [0|1] "" Vector__XXX
 SG_ RCM_a102_imuYawR8OffCompNegFLDC m102 : 19|1@1+ (1,0) [0|1] "" Vector__XXX
 SG_ RCM_a102_imuYawR8OffCompPosSLDC m102 : 20|1@1+ (1,0) [0|1] "" Vector__XXX
 SG_ RCM_a102_imuYawR8OffCompNegSLDC m102 : 21|1@1+ (1,0) [0|1] "" Vector__XXX
 SG_ RCM_a102_eventIDFsignal m102 : 25|1@1+ (1,0) [0|1] "" Vector__XXX
 SG_ RCM_a102_eventFrontLeftSeatbelt m102 : 26|1@1+ (1,0) [0|1] "" Vector__XXX
 SG_ RCM_a102_eventFrontRightSeatbelt m102 : 27|1@1+ (1,0) [0|1] "" Vector__XXX
 SG_ RCM_a102_eventVehicleSpeed m102 : 28|12@1+ (0.08,-40) [-40|287.6] "kph" Vector__XXX
 SG_ RCM_a102_eventSteeringAngle m102 : 45|14@0+ (0.1,-819.2) [-819.2|819.1] "deg" Vector__XXX
 SG_ RCM_a102_eventDriverBrakeApply m102 : 46|2@1+ (1,0) [0|2] "" Vector__XXX
 SG_ RCM_a102_eventAccelPedalPos m102 : 56|8@1+ (0.4,0) [0|101.6] "%" Vector__XXX
 SG_ RCM_a103_eventArmStatus m103 : 11|1@1+ (1,0) [0|1] "" Vector__XXX
 SG_ RCM_a103_eventFactoryMode m103 : 12|1@1+ (1,0) [0|1] "" Vector__XXX
 SG_ RCM_a103_eventDiagEnabled m103 : 13|1@1+ (1,0) [0|1] "" Vector__XXX
 SG_ RCM_a103_eventDriveOrientation m103 : 14|1@1+ (1,0) [0|1] "" Vector__XXX
 SG_ RCM_a103_imuPtchR8OffCompPosLife m103 : 16|1@1+ (1,0) [0|1] "" Vector__XXX
 SG_ RCM_a103_imuPtchR8OffCompNegLife m103 : 17|1@1+ (1,0) [0|1] "" Vector__XXX
 SG_ RCM_a103_imuPtchR8OffCompPosFLDC m103 : 18|1@1+ (1,0) [0|1] "" Vector__XXX
 SG_ RCM_a103_imuPtchR8OffCompNegFLDC m103 : 19|1@1+ (1,0) [0|1] "" Vector__XXX
 SG_ RCM_a103_imuPtchR8OffCompPosSLDC m103 : 20|1@1+ (1,0) [0|1] "" Vector__XXX
 SG_ RCM_a103_imuPtchR8OffCompNegSLDC m103 : 21|1@1+ (1,0) [0|1] "" Vector__XXX
 SG_ RCM_a103_eventIDFsignal m103 : 25|1@1+ (1,0) [0|1] "" Vector__XXX
 SG_ RCM_a103_eventFrontLeftSeatbelt m103 : 26|1@1+ (1,0) [0|1] "" Vector__XXX
 SG_ RCM_a103_eventFrontRightSeatbelt m103 : 27|1@1+ (1,0) [0|1] "" Vector__XXX
 SG_ RCM_a103_eventVehicleSpeed m103 : 28|12@1+ (0.08,-40) [-40|287.6] "kph" Vector__XXX
 SG_ RCM_a103_eventSteeringAngle m103 : 45|14@0+ (0.1,-819.2) [-819.2|819.1] "deg" Vector__XXX
 SG_ RCM_a103_eventDriverBrakeApply m103 : 46|2@1+ (1,0) [0|2] "" Vector__XXX
 SG_ RCM_a103_eventAccelPedalPos m103 : 56|8@1+ (0.4,0) [0|101.6] "%" Vector__XXX
 SG_ RCM_a104_eventArmStatus m104 : 11|1@1+ (1,0) [0|1] "" Vector__XXX
 SG_ RCM_a104_eventFactoryMode m104 : 12|1@1+ (1,0) [0|1] "" Vector__XXX
 SG_ RCM_a104_eventDiagEnabled m104 : 13|1@1+ (1,0) [0|1] "" Vector__XXX
 SG_ RCM_a104_eventDriveOrientation m104 : 14|1@1+ (1,0) [0|1] "" Vector__XXX
 SG_ RCM_a104_imuRollR8OffCompPosLife m104 : 16|1@1+ (1,0) [0|1] "" Vector__XXX
 SG_ RCM_a104_imuRollR8OffCompNegLife m104 : 17|1@1+ (1,0) [0|1] "" Vector__XXX
 SG_ RCM_a104_imuRollR8OffCompPosFLDC m104 : 18|1@1+ (1,0) [0|1] "" Vector__XXX
 SG_ RCM_a104_imuRollR8OffCompNegFLDC m104 : 19|1@1+ (1,0) [0|1] "" Vector__XXX
 SG_ RCM_a104_imuRollR8OffCompPosSLDC m104 : 20|1@1+ (1,0) [0|1] "" Vector__XXX
 SG_ RCM_a104_imuRollR8OffCompNegSLDC m104 : 21|1@1+ (1,0) [0|1] "" Vector__XXX
 SG_ RCM_a104_eventIDFsignal m104 : 25|1@1+ (1,0) [0|1] "" Vector__XXX
 SG_ RCM_a104_eventFrontLeftSeatbelt m104 : 26|1@1+ (1,0) [0|1] "" Vector__XXX
 SG_ RCM_a104_eventFrontRightSeatbelt m104 : 27|1@1+ (1,0) [0|1] "" Vector__XXX
 SG_ RCM_a104_eventVehicleSpeed m104 : 28|12@1+ (0.08,-40) [-40|287.6] "kph" Vector__XXX
 SG_ RCM_a104_eventSteeringAngle m104 : 45|14@0+ (0.1,-819.2) [-819.2|819.1] "deg" Vector__XXX

CM_ SG_ 1297 RCM_a045_eventFrontRightSeatbelt "Restraint control module: a045 event front right seatbelt";
CM_ SG_ 1297 RCM_a045_eventVehicleSpeed "Restraint control module: a045 event vehicle speed";
CM_ SG_ 1297 RCM_a045_eventSteeringAngle "Restraint control module: a045 event steering angle";
CM_ SG_ 1297 RCM_a045_eventDriverBrakeApply "Restraint control module: a045 event driver brake apply; raw 3 = signal not available (SNA)";
CM_ SG_ 1297 RCM_a045_eventAccelPedalPos "Restraint control module: a045 event accel pedal pos; raw 255 = signal not available (SNA)";
CM_ SG_ 1297 RCM_a046_eventArmStatus "Restraint control module: a046 event arm status";
CM_ SG_ 1297 RCM_a046_eventFactoryMode "Restraint control module: a046 event factory mode";
CM_ SG_ 1297 RCM_a046_eventDiagEnabled "Restraint control module: a046 event diag enabled";
CM_ SG_ 1297 RCM_a046_eventDriveOrientation "Restraint control module: a046 event drive orientation";
CM_ SG_ 1297 RCM_a046_sideAccelBPilLSht2Gnd "Restraint control module: a046 side accel b pil l sht2 gnd";
CM_ SG_ 1297 RCM_a046_sideAccelBPilLSht2Bat "Restraint control module: a046 side accel b pil l sht2 bat";
CM_ SG_ 1297 RCM_a046_sideAccelBPilLCLosCoup "Restraint control module: a046 side accel b pil LC los coup";
CM_ SG_ 1297 RCM_a046_sideAccelBPilLComm "Restraint control module: a046 side accel b pil l comm";
CM_ SG_ 1297 RCM_a046_sideAccelBPilLInitTyp "Restraint control module: a046 side accel b pil l init typ";
CM_ SG_ 1297 RCM_a046_sideAccelBPilLOption "Restraint control module: a046 side accel b pil l option";
CM_ SG_ 1297 RCM_a046_sideAccelBPilLplaus "Restraint control module: a046 side accel b pil lplaus";
CM_ SG_ 1297 RCM_a046_sideAccelBPilLDefect "Restraint control module: a046 side accel b pil l defect";
CM_ SG_ 1297 RCM_a046_eventIDFsignal "Restraint control module: a046 event ID fsignal";
CM_ SG_ 1297 RCM_a046_eventFrontLeftSeatbelt "Restraint control module: a046 event front left seatbelt";
CM_ SG_ 1297 RCM_a046_eventFrontRightSeatbelt "Restraint control module: a046 event front right seatbelt";
CM_ SG_ 1297 RCM_a046_eventVehicleSpeed "Restraint control module: a046 event vehicle speed";
CM_ SG_ 1297 RCM_a046_eventSteeringAngle "Restraint control module: a046 event steering angle";
CM_ SG_ 1297 RCM_a046_eventDriverBrakeApply "Restraint control module: a046 event driver brake apply; raw 3 = signal not available (SNA)";
CM_ SG_ 1297 RCM_a046_eventAccelPedalPos "Restraint control module: a046 event accel pedal pos; raw 255 = signal not available (SNA)";
CM_ SG_ 1297 RCM_a047_eventArmStatus "Restraint control module: a047 event arm status";
CM_ SG_ 1297 RCM_a047_eventFactoryMode "Restraint control module: a047 event factory mode";
CM_ SG_ 1297 RCM_a047_eventDiagEnabled "Restraint control module: a047 event diag enabled";
CM_ SG_ 1297 RCM_a047_eventDriveOrientation "Restraint control module: a047 event drive orientation";
CM_ SG_ 1297 RCM_a047_sideAccelBPilRSht2Gnd "Restraint control module: a047 side accel b pil r sht2 gnd";
CM_ SG_ 1297 RCM_a047_sideAccelBPilRSht2Bat "Restraint control module: a047 side accel b pil r sht2 bat";
CM_ SG_ 1297 RCM_a047_sideAccelBPilRCrossCoup "Restraint control module: a047 side accel b pil r cross coup";
CM_ SG_ 1297 RCM_a047_sideAccelBPilRComm "Restraint control module: a047 side accel b pil r comm";
CM_ SG_ 1297 RCM_a047_sideAccelBPilRInitTyp "Restraint control module: a047 side accel b pil r init typ";
CM_ SG_ 1297 RCM_a047_sideAccelBPilROption "Restraint control module: a047 side accel b pil r option";
CM_ SG_ 1297 RCM_a047_sideAccelBPilRplaus "Restraint control module: a047 side accel b pil rplaus";
CM_ SG_ 1297 RCM_a047_sideAccelBPilRDefect "Restraint control module: a047 side accel b pil r defect";
CM_ SG_ 1297 RCM_a047_eventIDFsignal "Restraint control module: a047 event ID fsignal";
CM_ SG_ 1297 RCM_a047_eventFrontLeftSeatbelt "Restraint control module: a047 event front left seatbelt";
CM_ SG_ 1297 RCM_a047_eventFrontRightSeatbelt "Restraint control module: a047 event front right seatbelt";
CM_ SG_ 1297 RCM_a047_eventVehicleSpeed "Restraint control module: a047 event vehicle speed";
CM_ SG_ 1297 RCM_a047_eventSteeringAngle "Restraint control module: a047 event steering angle";
CM_ SG_ 1297 RCM_a047_eventDriverBrakeApply "Restraint control module: a047 event driver brake apply; raw 3 = signal not available (SNA)";
CM_ SG_ 1297 RCM_a047_eventAccelPedalPos "Restraint control module: a047 event accel pedal pos; raw 255 = signal not available (SNA)";
CM_ SG_ 1297 RCM_a048_eventArmStatus "Restraint control module: a048 event arm status";
CM_ SG_ 1297 RCM_a048_eventFactoryMode "Restraint control module: a048 event factory mode";
CM_ SG_ 1297 RCM_a048_eventDiagEnabled "Restraint control module: a048 event diag enabled";
CM_ SG_ 1297 RCM_a048_eventDriveOrientation "Restraint control module: a048 event drive orientation";
CM_ SG_ 1297 RCM_a048_sideAccelCPilLSht2Gnd "Restraint control module: a048 side accel c pil l sht2 gnd";
CM_ SG_ 1297 RCM_a048_sideAccelCPilLSht2Bat "Restraint control module: a048 side accel c pil l sht2 bat";
CM_ SG_ 1297 RCM_a048_sideAccelCPilLCrossCoup "Restraint control module: a048 side accel c pil l cross coup";
CM_ SG_ 1297 RCM_a048_sideAccelCPilLComm "Restraint control module: a048 side accel c pil l comm";
CM_ SG_ 1297 RCM_a048_sideAccelCPilLInitTyp "Restraint control module: a048 side accel c pil l init typ";
CM_ SG_ 1297 RCM_a048_sideAccelCPilLOption "Restraint control module: a048 side accel c pil l option";
CM_ SG_ 1297 RCM_a048_sideAccelCPilLplaus "Restraint control module: a048 side accel c pil lplaus";
CM_ SG_ 1297 RCM_a048_sideAccelCPilLDefect "Restraint control module: a048 side accel c pil l defect";
CM_ SG_ 1297 RCM_a048_eventIDFsignal "Restraint control module: a048 event ID fsignal";
CM_ SG_ 1297 RCM_a048_eventFrontLeftSeatbelt "Restraint control module: a048 event front left seatbelt";
CM_ SG_ 1297 RCM_a048_eventFrontRightSeatbelt "Restraint control module: a048 event front right seatbelt";
CM_ SG_ 1297 RCM_a048_eventVehicleSpeed "Restraint control module: a048 event vehicle speed";
CM_ SG_ 1297 RCM_a048_eventSteeringAngle "Restraint control module: a048 event steering angle";
CM_ SG_ 1297 RCM_a048_eventDriverBrakeApply "Restraint control module: a048 event driver brake apply; raw 3 = signal not available (SNA)";
CM_ SG_ 1297 RCM_a048_eventAccelPedalPos "Restraint control module: a048 event accel pedal pos; raw 255 = signal not available (SNA)";
CM_ SG_ 1297 RCM_a049_eventArmStatus "Restraint control module: a049 event arm status";
CM_ SG_ 1297 RCM_a049_eventFactoryMode "Restraint control module: a049 event factory mode";
CM_ SG_ 1297 RCM_a049_eventDiagEnabled "Restraint control module: a049 event diag enabled";
CM_ SG_ 1297 RCM_a049_eventDriveOrientation "Restraint control module: a049 event drive orientation";
CM_ SG_ 1297 RCM_a049_sideAccelCPilRSht2Gnd "Restraint control module: a049 side accel c pil r sht2 gnd";
CM_ SG_ 1297 RCM_a049_sideAccelCPilRSht2Bat "Restraint control module: a049 side accel c pil r sht2 bat";
CM_ SG_ 1297 RCM_a049_sideAccelCPilRCrossCoup "Restraint control module: a049 side accel c pil r cross coup";
CM_ SG_ 1297 RCM_a049_sideAccelCPilRComm "Restraint control module: a049 side accel c pil r comm";
CM_ SG_ 1297 RCM_a049_sideAccelCPilRInitTyp "Restraint control module: a049 side accel c pil r init typ";
CM_ SG_ 1297 RCM_a049_sideAccelCPilROption "Restraint control module: a049 side accel c pil r option";
CM_ SG_ 1297 RCM_a049_sideAccelCPilRplaus "Restraint control module: a049 side accel c pil rplaus";
CM_ SG_ 1297 RCM_a049_sideAccelCPilRDefect "Restraint control module: a049 side accel c pil r defect";
CM_ SG_ 1297 RCM_a049_eventIDFsignal "Restraint control module: a049 event ID fsignal";
CM_ SG_ 1297 RCM_a049_eventFrontLeftSeatbelt "Restraint control module: a049 event front left seatbelt";
CM_ SG_ 1297 RCM_a049_eventFrontRightSeatbelt "Restraint control module: a049 event front right seatbelt";
CM_ SG_ 1297 RCM_a049_eventVehicleSpeed "Restraint control module: a049 event vehicle speed";
CM_ SG_ 1297 RCM_a049_eventSteeringAngle "Restraint control module: a049 event steering angle";
CM_ SG_ 1297 RCM_a049_eventDriverBrakeApply "Restraint control module: a049 event driver brake apply; raw 3 = signal not available (SNA)";
CM_ SG_ 1297 RCM_a049_eventAccelPedalPos "Restraint control module: a049 event accel pedal pos; raw 255 = signal not available (SNA)";
CM_ SG_ 1297 RCM_a050_eventArmStatus "Restraint control module: a050 event arm status";
CM_ SG_ 1297 RCM_a050_eventFactoryMode "Restraint control module: a050 event factory mode";
CM_ SG_ 1297 RCM_a050_eventDiagEnabled "Restraint control module: a050 event diag enabled";
CM_ SG_ 1297 RCM_a050_eventDriveOrientation "Restraint control module: a050 event drive orientation";
CM_ SG_ 1297 RCM_a050_upFrontSensorCSht2Gnd "Restraint control module: a050 up front sensor c sht2 gnd";
CM_ SG_ 1297 RCM_a050_upFrontSensorCSht2Bat "Restraint control module: a050 up front sensor c sht2 bat";
CM_ SG_ 1297 RCM_a050_upFrontSensorCCrossCoup "Restraint control module: a050 up front sensor c cross coup";
CM_ SG_ 1297 RCM_a050_upFrontSensorCComm "Restraint control module: a050 up front sensor c comm";
CM_ SG_ 1297 RCM_a050_upFrontSensorCInitTyp "Restraint control module: a050 up front sensor c init typ";
CM_ SG_ 1297 RCM_a050_upFrontSensorCOption "Restraint control module: a050 up front sensor c option";
CM_ SG_ 1297 RCM_a050_upFrontSensorCplaus "Restraint control module: a050 up front sensor cplaus";
CM_ SG_ 1297 RCM_a050_upFrontSensorCDefect "Restraint control module: a050 up front sensor c defect";
CM_ SG_ 1297 RCM_a050_eventIDFsignal "Restraint control module: a050 event ID fsignal";
CM_ SG_ 1297 RCM_a050_eventFrontLeftSeatbelt "Restraint control module: a050 event front left seatbelt";
CM_ SG_ 1297 RCM_a050_eventFrontRightSeatbelt "Restraint control module: a050 event front right seatbelt";
CM_ SG_ 1297 RCM_a050_eventVehicleSpeed "Restraint control module: a050 event vehicle speed";
CM_ SG_ 1297 RCM_a050_eventSteeringAngle "Restraint control module: a050 event steering angle";
CM_ SG_ 1297 RCM_a050_eventDriverBrakeApply "Restraint control module: a050 event driver brake apply; raw 3 = signal not available (SNA)";
CM_ SG_ 1297 RCM_a050_eventAccelPedalPos "Restraint control module: a050 event accel pedal pos; raw 255 = signal not available (SNA)";
CM_ SG_ 1297 RCM_a051_eventArmStatus "Restraint control module: a051 event arm status";
CM_ SG_ 1297 RCM_a051_eventFactoryMode "Restraint control module: a051 event factory mode";
CM_ SG_ 1297 RCM_a051_eventDiagEnabled "Restraint control module: a051 event diag enabled";
CM_ SG_ 1297 RCM_a051_eventDriveOrientation "Restraint control module: a051 event drive orientation";
CM_ SG_ 1297 RCM_a051_presFrntLDoorComm "Restraint control module: a051 pres frnt l door comm";
CM_ SG_ 1297 RCM_a051_presFrntLDoorInitTyp "Restraint control module: a051 pres frnt l door init typ";
CM_ SG_ 1297 RCM_a051_presFrntLDoorOption "Restraint control module: a051 pres frnt l door option";
CM_ SG_ 1297 RCM_a051_presFrntLDoorPlaus "Restraint control module: a051 pres frnt l door plaus";
CM_ SG_ 1297 RCM_a051_presFrntLDoorAbsPre "Restraint control module: a051 pres frnt l door abs pre";
CM_ SG_ 1297 RCM_a051_presFrntLDoorDefect "Restraint control module: a051 pres frnt l door defect";
CM_ SG_ 1297 RCM_a051_presFrntLDoorSht2Gnd "Restraint control module: a051 pres frnt l door sht2 gnd";
CM_ SG_ 1297 RCM_a051_presFrntLDoorSht2Bat "Restraint control module: a051 pres frnt l door sht2 bat";
CM_ SG_ 1297 RCM_a051_presFrntLDoorCrossCoup "Restraint control module: a051 pres frnt l door cross coup";
CM_ SG_ 1297 RCM_a051_eventIDFsignal "Restraint control module: a051 event ID fsignal";
CM_ SG_ 1297 RCM_a051_eventFrontLeftSeatbelt "Restraint control module: a051 event front left seatbelt";
CM_ SG_ 1297 RCM_a051_eventFrontRightSeatbelt "Restraint control module: a051 event front right seatbelt";
CM_ SG_ 1297 RCM_a051_eventVehicleSpeed "Restraint control module: a051 event vehicle speed";
CM_ SG_ 1297 RCM_a051_eventSteeringAngle "Restraint control module: a051 event steering angle";
CM_ SG_ 1297 RCM_a051_eventDriverBrakeApply "Restraint control module: a051 event driver brake apply; raw 3 = signal not available (SNA)";
CM_ SG_ 1297 RCM_a051_eventAccelPedalPos "Restraint control module: a051 event accel pedal pos; raw 255 = signal not available (SNA)";
CM_ SG_ 1297 RCM_a052_eventArmStatus "Restraint control module: a052 event arm status";
CM_ SG_ 1297 RCM_a052_eventFactoryMode "Restraint control module: a052 event factory mode";
CM_ SG_ 1297 RCM_a052_eventDiagEnabled "Restraint control module: a052 event diag enabled";
CM_ SG_ 1297 RCM_a052_eventDriveOrientation "Restraint control module: a052 event drive orientation";
CM_ SG_ 1297 RCM_a052_presFrntRDoorComm "Restraint control module: a052 pres frnt r door comm";
CM_ SG_ 1297 RCM_a052_presFrntRDoorInitTyp "Restraint control module: a052 pres frnt r door init typ";
CM_ SG_ 1297 RCM_a052_presFrntRDoorOption "Restraint control module: a052 pres frnt r door option";
CM_ SG_ 1297 RCM_a052_presFrntRDoorPlaus "Restraint control module: a052 pres frnt r door plaus";
CM_ SG_ 1297 RCM_a052_presFrntRDoorAbsPre "Restraint control module: a052 pres frnt r door abs pre";
CM_ SG_ 1297 RCM_a052_presFrntRDoorDefect "Restraint control module: a052 pres frnt r door defect";
CM_ SG_ 1297 RCM_a052_presFrntRDoorSht2Gnd "Restraint control module: a052 pres frnt r door sht2 gnd";
CM_ SG_ 1297 RCM_a052_presFrntRDoorSht2Bat "Restraint control module: a052 pres frnt r door sht2 bat";
CM_ SG_ 1297 RCM_a052_presFrntRDoorCrossCoup "Restraint control module: a052 pres frnt r door cross coup";
CM_ SG_ 1297 RCM_a052_eventIDFsignal "Restraint control module: a052 event ID fsignal";
CM_ SG_ 1297 RCM_a052_eventFrontLeftSeatbelt "Restraint control module: a052 event front left seatbelt";
CM_ SG_ 1297 RCM_a052_eventFrontRightSeatbelt "Restraint control module: a052 event front right seatbelt";
CM_ SG_ 1297 RCM_a052_eventVehicleSpeed "Restraint control module: a052 event vehicle speed";
CM_ SG_ 1297 RCM_a052_eventSteeringAngle "Restraint control module: a052 event steering angle";
CM_ SG_ 1297 RCM_a052_eventDriverBrakeApply "Restraint control module: a052 event driver brake apply; raw 3 = signal not available (SNA)";
CM_ SG_ 1297 RCM_a052_eventAccelPedalPos "Restraint control module: a052 event accel pedal pos; raw 255 = signal not available (SNA)";
CM_ SG_ 1297 RCM_a053_eventArmStatus "Restraint control module: a053 event arm status";
CM_ SG_ 1297 RCM_a053_eventFactoryMode "Restraint control module: a053 event factory mode";
CM_ SG_ 1297 RCM_a053_eventDiagEnabled "Restraint control module: a053 event diag enabled";
CM_ SG_ 1297 RCM_a053_eventDriveOrientation "Restraint control module: a053 event drive orientation";
CM_ SG_ 1297 RCM_a053_presPedProLComm "Restraint control module: a053 pres ped pro l comm";
CM_ SG_ 1297 RCM_a053_presPedProLInitTyp "Restraint control module: a053 pres ped pro l init typ";
CM_ SG_ 1297 RCM_a053_presPedProLOption "Restraint control module: a053 pres ped pro l option";
CM_ SG_ 1297 RCM_a053_presPedProLPlaus "Restraint control module: a053 pres ped pro l plaus";
CM_ SG_ 1297 RCM_a053_presPedProLAbsPre "Restraint control module: a053 pres ped pro l abs pre";
CM_ SG_ 1297 RCM_a053_presPedProLDefect "Restraint control module: a053 pres ped pro l defect";
CM_ SG_ 1297 RCM_a053_presPedProLSht2Gnd "Restraint control module: a053 pres ped pro l sht2 gnd";
CM_ SG_ 1297 RCM_a053_presPedProLSht2Bat "Restraint control module: a053 pres ped pro l sht2 bat";
CM_ SG_ 1297 RCM_a053_presPedProLCrossCoup "Restraint control module: a053 pres ped pro l cross coup";
CM_ SG_ 1297 RCM_a053_eventIDFsignal "Restraint control module: a053 event ID fsignal";
CM_ SG_ 1297 RCM_a053_eventFrontLeftSeatbelt "Restraint control module: a053 event front left seatbelt";
CM_ SG_ 1297 RCM_a053_eventFrontRightSeatbelt "Restraint control module: a053 event front right seatbelt";
CM_ SG_ 1297 RCM_a053_eventVehicleSpeed "Restraint control module: a053 event vehicle speed";
CM_ SG_ 1297 RCM_a053_eventSteeringAngle "Restraint control module: a053 event steering angle";
CM_ SG_ 1297 RCM_a053_eventDriverBrakeApply "Restraint control module: a053 event driver brake apply; raw 3 = signal not available (SNA)";
CM_ SG_ 1297 RCM_a053_eventAccelPedalPos "Restraint control module: a053 event accel pedal pos; raw 255 = signal not available (SNA)";
CM_ SG_ 1297 RCM_a054_eventArmStatus "Restraint control module: a054 event arm status";
CM_ SG_ 1297 RCM_a054_eventFactoryMode "Restraint control module: a054 event factory mode";
CM_ SG_ 1297 RCM_a054_eventDiagEnabled "Restraint control module: a054 event diag enabled";
CM_ SG_ 1297 RCM_a054_eventDriveOrientation "Restraint control module: a054 event drive orientation";
CM_ SG_ 1297 RCM_a054_presPedProRComm "Restraint control module: a054 pres ped pro r comm";
CM_ SG_ 1297 RCM_a054_presPedProRInitTyp "Restraint control module: a054 pres ped pro r init typ";
CM_ SG_ 1297 RCM_a054_presPedProROption "Restraint control module: a054 pres ped pro r option";
CM_ SG_ 1297 RCM_a054_presPedProRPlaus "Restraint control module: a054 pres ped pro r plaus";
CM_ SG_ 1297 RCM_a054_presPedProRAbsPre "Restraint control module: a054 pres ped pro r abs pre";
CM_ SG_ 1297 RCM_a054_presPedProRDefect "Restraint control module: a054 pres ped pro r defect";
CM_ SG_ 1297 RCM_a054_presPedProRSht2Gnd "Restraint control module: a054 pres ped pro r sht2 gnd";
CM_ SG_ 1297 RCM_a054_presPedProRSht2Bat "Restraint control module: a054 pres ped pro r sht2 bat";
CM_ SG_ 1297 RCM_a054_presPedProRCrossCoup "Restraint control module: a054 pres ped pro r cross coup";
CM_ SG_ 1297 RCM_a054_eventIDFsignal "Restraint control module: a054 event ID fsignal";
CM_ SG_ 1297 RCM_a054_eventFrontLeftSeatbelt "Restraint control module: a054 event front left seatbelt";
CM_ SG_ 1297 RCM_a054_eventFrontRightSeatbelt "Restraint control module: a054 event front right seatbelt";
CM_ SG_ 1297 RCM_a054_eventVehicleSpeed "Restraint control module: a054 event vehicle speed";
CM_ SG_ 1297 RCM_a054_eventSteeringAngle "Restraint control module: a054 event steering angle";
CM_ SG_ 1297 RCM_a054_eventDriverBrakeApply "Restraint control module: a054 event driver brake apply; raw 3 = signal not available (SNA)";
CM_ SG_ 1297 RCM_a054_eventAccelPedalPos "Restraint control module: a054 event accel pedal pos; raw 255 = signal not available (SNA)";
CM_ SG_ 1297 RCM_a055_eventArmStatus "Restraint control module: a055 event arm status";
CM_ SG_ 1297 RCM_a055_eventFactoryMode "Restraint control module: a055 event factory mode";
CM_ SG_ 1297 RCM_a055_eventDiagEnabled "Restraint control module: a055 event diag enabled";
CM_ SG_ 1297 RCM_a055_eventDriveOrientation "Restraint control module: a055 event drive orientation";
CM_ SG_ 1297 RCM_a055_imuCalibrationNotDone "Restraint control module: a055 imu calibration not done";
CM_ SG_ 1297 RCM_a055_imuCalibrationFailed "Restraint control module: a055 imu calibration failed";
CM_ SG_ 1297 RCM_a055_eventIDFsignal "Restraint control module: a055 event ID fsignal";
CM_ SG_ 1297 RCM_a055_eventFrontLeftSeatbelt "Restraint control module: a055 event front left seatbelt";
CM_ SG_ 1297 RCM_a055_eventFrontRightSeatbelt "Restraint control module: a055 event front right seatbelt";
CM_ SG_ 1297 RCM_a055_eventVehicleSpeed "Restraint control module: a055 event vehicle speed";
CM_ SG_ 1297 RCM_a055_eventSteeringAngle "Restraint control module: a055 event steering angle";
CM_ SG_ 1297 RCM_a055_eventDriverBrakeApply "Restraint control module: a055 event driver brake apply; raw 3 = signal not available (SNA)";
CM_ SG_ 1297 RCM_a055_eventAccelPedalPos "Restraint control module: a055 event accel pedal pos; raw 255 = signal not available (SNA)";
CM_ SG_ 1297 RCM_a056_eventArmStatus "Restraint control module: a056 event arm status";
CM_ SG_ 1297 RCM_a056_eventFactoryMode "Restraint control module: a056 event factory mode";
CM_ SG_ 1297 RCM_a056_eventDiagEnabled "Restraint control module: a056 event diag enabled";
CM_ SG_ 1297 RCM_a056_eventDriveOrientation "Restraint control module: a056 event drive orientation";
CM_ SG_ 1297 RCM_a056_ocs1pFaulted "Restraint control module: a056 ocs1p faulted";
CM_ SG_ 1297 RCM_a056_ocs1pWrongCalD "Restraint control module: a056 ocs1p wrong cal d";
CM_ SG_ 1297 RCM_a056_eventIDFsignal "Restraint control module: a056 event ID fsignal";
CM_ SG_ 1297 RCM_a056_eventFrontLeftSeatbelt "Restraint control module: a056 event front left seatbelt";
CM_ SG_ 1297 RCM_a056_eventFrontRightSeatbelt "Restraint control module: a056 event front right seatbelt";
CM_ SG_ 1297 RCM_a056_eventVehicleSpeed "Restraint control module: a056 event vehicle speed";
CM_ SG_ 1297 RCM_a056_eventSteeringAngle "Restraint control module: a056 event steering angle";
CM_ SG_ 1297 RCM_a056_eventDriverBrakeApply "Restraint control module: a056 event driver brake apply; raw 3 = signal not available (SNA)";
CM_ SG_ 1297 RCM_a056_eventAccelPedalPos "Restraint control module: a056 event accel pedal pos; raw 255 = signal not available (SNA)";
CM_ SG_ 1297 RCM_a057_eventArmStatus "Restraint control module: a057 event arm status";
CM_ SG_ 1297 RCM_a057_eventFactoryMode "Restraint control module: a057 event factory mode";
CM_ SG_ 1297 RCM_a057_eventDiagEnabled "Restraint control module: a057 event diag enabled";
CM_ SG_ 1297 RCM_a057_eventDriveOrientation "Restraint control module: a057 event drive orientation";
CM_ SG_ 1297 RCM_a057_ocs1dFaulted "Restraint control module: a057 ocs1d faulted";
CM_ SG_ 1297 RCM_a057_ocs1dWrongCalD "Restraint control module: a057 ocs1d wrong cal d";
CM_ SG_ 1297 RCM_a057_eventIDFsignal "Restraint control module: a057 event ID fsignal";
CM_ SG_ 1297 RCM_a057_eventFrontLeftSeatbelt "Restraint control module: a057 event front left seatbelt";
CM_ SG_ 1297 RCM_a057_eventFrontRightSeatbelt "Restraint control module: a057 event front right seatbelt";
CM_ SG_ 1297 RCM_a057_eventVehicleSpeed "Restraint control module: a057 event vehicle speed";
CM_ SG_ 1297 RCM_a057_eventSteeringAngle "Restraint control module: a057 event steering angle";
CM_ SG_ 1297 RCM_a057_eventDriverBrakeApply "Restraint control module: a057 event driver brake apply; raw 3 = signal not available (SNA)";
CM_ SG_ 1297 RCM_a057_eventAccelPedalPos "Restraint control module: a057 event accel pedal pos; raw 255 = signal not available (SNA)";
CM_ SG_ 1297 RCM_a058_eventArmStatus "Restraint control module: a058 event arm status";
CM_ SG_ 1297 RCM_a058_eventFactoryMode "Restraint control module: a058 event factory mode";
CM_ SG_ 1297 RCM_a058_eventDiagEnabled "Restraint control module: a058 event diag enabled";
CM_ SG_ 1297 RCM_a058_eventDriveOrientation "Restraint control module: a058 event drive orientation";
CM_ SG_ 1297 RCM_a058_bucklHallLeftShort "Restraint control module: a058 buckl hall left short";
CM_ SG_ 1297 RCM_a058_bucklHallLeftSht2Bat "Restraint control module: a058 buckl hall left sht2 bat";
CM_ SG_ 1297 RCM_a058_bucklHallLeftOpen "Restraint control module: a058 buckl hall left open";
CM_ SG_ 1297 RCM_a058_bucklHallLeftUndef "Restraint control module: a058 buckl hall left undef";
CM_ SG_ 1297 RCM_a058_bucklHallLeftCrossCoup "Restraint control module: a058 buckl hall left cross coup";
CM_ SG_ 1297 RCM_a058_bucklHallLeftConfig "Restraint control module: a058 buckl hall left config";
CM_ SG_ 1297 RCM_a058_eventIDFsignal "Restraint control module: a058 event ID fsignal";
CM_ SG_ 1297 RCM_a058_eventFrontLeftSeatbelt "Restraint control module: a058 event front left seatbelt";
CM_ SG_ 1297 RCM_a058_eventFrontRightSeatbelt "Restraint control module: a058 event front right seatbelt";
CM_ SG_ 1297 RCM_a058_eventVehicleSpeed "Restraint control module: a058 event vehicle speed";
CM_ SG_ 1297 RCM_a058_eventSteeringAngle "Restraint control module: a058 event steering angle";
CM_ SG_ 1297 RCM_a058_eventDriverBrakeApply "Restraint control module: a058 event driver brake apply; raw 3 = signal not available (SNA)";
CM_ SG_ 1297 RCM_a058_eventAccelPedalPos "Restraint control module: a058 event accel pedal pos; raw 255 = signal not available (SNA)";
CM_ SG_ 1297 RCM_a059_eventArmStatus "Restraint control module: a059 event arm status";
CM_ SG_ 1297 RCM_a059_eventFactoryMode "Restraint control module: a059 event factory mode";
CM_ SG_ 1297 RCM_a059_eventDiagEnabled "Restraint control module: a059 event diag enabled";
CM_ SG_ 1297 RCM_a059_eventDriveOrientation "Restraint control module: a059 event drive orientation";
CM_ SG_ 1297 RCM_a059_bucklHallRightShort "Restraint control module: a059 buckl hall right short";
CM_ SG_ 1297 RCM_a059_bucklHallRightSht2Bat "Restraint control module: a059 buckl hall right sht2 bat";
CM_ SG_ 1297 RCM_a059_bucklHallRightOpen "Restraint control module: a059 buckl hall right open";
CM_ SG_ 1297 RCM_a059_bucklHallRightUndef "Restraint control module: a059 buckl hall right undef";
CM_ SG_ 1297 RCM_a059_bucklHallRightCrossCoup "Restraint control module: a059 buckl hall right cross coup";
CM_ SG_ 1297 RCM_a059_bucklSwRightConfig "Restraint control module: a059 buckl sw right config";
CM_ SG_ 1297 RCM_a059_eventIDFsignal "Restraint control module: a059 event ID fsignal";
CM_ SG_ 1297 RCM_a059_eventFrontLeftSeatbelt "Restraint control module: a059 event front left seatbelt";
CM_ SG_ 1297 RCM_a059_eventFrontRightSeatbelt "Restraint control module: a059 event front right seatbelt";
CM_ SG_ 1297 RCM_a059_eventVehicleSpeed "Restraint control module: a059 event vehicle speed";
CM_ SG_ 1297 RCM_a059_eventSteeringAngle "Restraint control module: a059 event steering angle";
CM_ SG_ 1297 RCM_a059_eventDriverBrakeApply "Restraint control module: a059 event driver brake apply; raw 3 = signal not available (SNA)";
CM_ SG_ 1297 RCM_a059_eventAccelPedalPos "Restraint control module: a059 event accel pedal pos; raw 255 = signal not available (SNA)";
CM_ SG_ 1297 RCM_a060_eventArmStatus "Restraint control module: a060 event arm status";
CM_ SG_ 1297 RCM_a060_eventFactoryMode "Restraint control module: a060 event factory mode";
CM_ SG_ 1297 RCM_a060_eventDiagEnabled "Restraint control module: a060 event diag enabled";
CM_ SG_ 1297 RCM_a060_eventDriveOrientation "Restraint control module: a060 event drive orientation";
CM_ SG_ 1297 RCM_a060_seaTrkPosLeftShort "Restraint control module: a060 sea trk pos left short";
CM_ SG_ 1297 RCM_a060_seaTrkPosLeftShort2Bat "Restraint control module: a060 sea trk pos left short2 bat";
CM_ SG_ 1297 RCM_a060_seaTrkPosLeftOpen "Restraint control module: a060 sea trk pos left open";
CM_ SG_ 1297 RCM_a060_seaTrkPosLeftUndefined "Restraint control module: a060 sea trk pos left undefined";
CM_ SG_ 1297 RCM_a060_seaTrkPosLeftCrossCoup "Restraint control module: a060 sea trk pos left cross coup";
CM_ SG_ 1297 RCM_a060_seaTrkPosLeftConfig "Restraint control module: a060 sea trk pos left config";
CM_ SG_ 1297 RCM_a060_eventIDFsignal "Restraint control module: a060 event ID fsignal";
CM_ SG_ 1297 RCM_a060_eventFrontLeftSeatbelt "Restraint control module: a060 event front left seatbelt";
CM_ SG_ 1297 RCM_a060_eventFrontRightSeatbelt "Restraint control module: a060 event front right seatbelt";
CM_ SG_ 1297 RCM_a060_eventVehicleSpeed "Restraint control module: a060 event vehicle speed";
CM_ SG_ 1297 RCM_a060_eventSteeringAngle "Restraint control module: a060 event steering angle";
CM_ SG_ 1297 RCM_a060_eventDriverBrakeApply "Restraint control module: a060 event driver brake apply; raw 3 = signal not available (SNA)";
CM_ SG_ 1297 RCM_a060_eventAccelPedalPos "Restraint control module: a060 event accel pedal pos; raw 255 = signal not available (SNA)";
CM_ SG_ 1297 RCM_a061_eventArmStatus "Restraint control module: a061 event arm status";
CM_ SG_ 1297 RCM_a061_eventFactoryMode "Restraint control module: a061 event factory mode";
CM_ SG_ 1297 RCM_a061_eventDiagEnabled "Restraint control module: a061 event diag enabled";
CM_ SG_ 1297 RCM_a061_eventDriveOrientation "Restraint control module: a061 event drive orientation";
CM_ SG_ 1297 RCM_a061_seaTrkPosRightShort "Restraint control module: a061 sea trk pos right short";
CM_ SG_ 1297 RCM_a061_seaTrkPosRightSht2Bat "Restraint control module: a061 sea trk pos right sht2 bat";
CM_ SG_ 1297 RCM_a061_seaTrkPosRightOpen "Restraint control module: a061 sea trk pos right open";
CM_ SG_ 1297 RCM_a061_seaTrkPosRightUndefined "Restraint control module: a061 sea trk pos right undefined";
CM_ SG_ 1297 RCM_a061_seaTrkPosRightCrossCoup "Restraint control module: a061 sea trk pos right cross coup";
CM_ SG_ 1297 RCM_a061_seaTrkPosRightConfig "Restraint control module: a061 sea trk pos right config";
CM_ SG_ 1297 RCM_a061_eventIDFsignal "Restraint control module: a061 event ID fsignal";
CM_ SG_ 1297 RCM_a061_eventFrontLeftSeatbelt "Restraint control module: a061 event front left seatbelt";
CM_ SG_ 1297 RCM_a061_eventFrontRightSeatbelt "Restraint control module: a061 event front right seatbelt";
CM_ SG_ 1297 RCM_a061_eventVehicleSpeed "Restraint control module: a061 event vehicle speed";
CM_ SG_ 1297 RCM_a061_eventSteeringAngle "Restraint control module: a061 event steering angle";
CM_ SG_ 1297 RCM_a061_eventDriverBrakeApply "Restraint control module: a061 event driver brake apply; raw 3 = signal not available (SNA)";
CM_ SG_ 1297 RCM_a061_eventAccelPedalPos "Restraint control module: a061 event accel pedal pos; raw 255 = signal not available (SNA)";
CM_ SG_ 1297 RCM_a062_eventArmStatus "Restraint control module: a062 event arm status";
CM_ SG_ 1297 RCM_a062_eventFactoryMode "Restraint control module: a062 event factory mode";
CM_ SG_ 1297 RCM_a062_eventDiagEnabled "Restraint control module: a062 event diag enabled";
CM_ SG_ 1297 RCM_a062_eventDriveOrientation "Restraint control module: a062 event drive orientation";
CM_ SG_ 1297 RCM_a062_alrShort "Restraint control module: a062 alr short";
CM_ SG_ 1297 RCM_a062_alrSht2Bat "Restraint control module: a062 alr sht2 bat";
CM_ SG_ 1297 RCM_a062_alrOpen "Restraint control module: a062 alr open";
CM_ SG_ 1297 RCM_a062_alrUndefined "Restraint control module: a062 alr undefined";
CM_ SG_ 1297 RCM_a062_alrCrossCoup "Restraint control module: a062 alr cross coup";
CM_ SG_ 1297 RCM_a062_alrConfig "Restraint control module: a062 alr config";
CM_ SG_ 1297 RCM_a062_eventIDFsignal "Restraint control module: a062 event ID fsignal";
CM_ SG_ 1297 RCM_a062_eventFrontLeftSeatbelt "Restraint control module: a062 event front left seatbelt";
CM_ SG_ 1297 RCM_a062_eventFrontRightSeatbelt "Restraint control module: a062 event front right seatbelt";
CM_ SG_ 1297 RCM_a062_eventVehicleSpeed "Restraint control module: a062 event vehicle speed";
CM_ SG_ 1297 RCM_a062_eventSteeringAngle "Restraint control module: a062 event steering angle";
CM_ SG_ 1297 RCM_a062_eventDriverBrakeApply "Restraint control module: a062 event driver brake apply; raw 3 = signal not available (SNA)";
CM_ SG_ 1297 RCM_a062_eventAccelPedalPos "Restraint control module: a062 event accel pedal pos; raw 255 = signal not available (SNA)";
CM_ SG_ 1297 RCM_a063_eventArmStatus "Restraint control module: a063 event arm status";
CM_ SG_ 1297 RCM_a063_eventFactoryMode "Restraint control module: a063 event factory mode";
CM_ SG_ 1297 RCM_a063_eventDiagEnabled "Restraint control module: a063 event diag enabled";
CM_ SG_ 1297 RCM_a063_eventDriveOrientation "Restraint control module: a063 event drive orientation";
CM_ SG_ 1297 RCM_a063_sbsw2ndRowRSht2Gnd "Restraint control module: a063 sbsw2nd row r sht2 gnd";
CM_ SG_ 1297 RCM_a063_sbsw2ndRowRSht2Bat "Restraint control module: a063 sbsw2nd row r sht2 bat";
CM_ SG_ 1297 RCM_a063_sbsw2ndRowROpen "Restraint control module: a063 sbsw2nd row r open";
CM_ SG_ 1297 RCM_a063_sbsw2ndRowRUndefined "Restraint control module: a063 sbsw2nd row r undefined";
CM_ SG_ 1297 RCM_a063_sbsw2ndRowRCrossCoup "Restraint control module: a063 sbsw2nd row r cross coup";
CM_ SG_ 1297 RCM_a063_sbsw2ndRowRConfig "Restraint control module: a063 sbsw2nd row r config";
CM_ SG_ 1297 RCM_a063_eventIDFsignal "Restraint control module: a063 event ID fsignal";
CM_ SG_ 1297 RCM_a063_eventFrontLeftSeatbelt "Restraint control module: a063 event front left seatbelt";
CM_ SG_ 1297 RCM_a063_eventFrontRightSeatbelt "Restraint control module: a063 event front right seatbelt";
CM_ SG_ 1297 RCM_a063_eventVehicleSpeed "Restraint control module: a063 event vehicle speed";
CM_ SG_ 1297 RCM_a063_eventSteeringAngle "Restraint control module: a063 event steering angle";
CM_ SG_ 1297 RCM_a063_eventDriverBrakeApply "Restraint control module: a063 event driver brake apply; raw 3 = signal not available (SNA)";
CM_ SG_ 1297 RCM_a063_eventAccelPedalPos "Restraint control module: a063 event accel pedal pos; raw 255 = signal not available (SNA)";
CM_ SG_ 1297 RCM_a064_eventArmStatus "Restraint control module: a064 event arm status";
CM_ SG_ 1297 RCM_a064_eventFactoryMode "Restraint control module: a064 event factory mode";
CM_ SG_ 1297 RCM_a064_eventDiagEnabled "Restraint control module: a064 event diag enabled";
CM_ SG_ 1297 RCM_a064_eventDriveOrientation "Restraint control module: a064 event drive orientation";
CM_ SG_ 1297 RCM_a064_hwcp1CheckFail "Restraint control module: a064 hwcp1 check fail";
CM_ SG_ 1297 RCM_a064_hwcp1Sht2Bat "Restraint control module: a064 hwcp1 sht2 bat";
CM_ SG_ 1297 RCM_a064_hwcp1CrossCoup "Restraint control module: a064 hwcp1 cross coup";
CM_ SG_ 1297 RCM_a064_hwcp1Config "Restraint control module: a064 hwcp1 config";
CM_ SG_ 1297 RCM_a064_eventIDFsignal "Restraint control module: a064 event ID fsignal";
CM_ SG_ 1297 RCM_a064_eventFrontLeftSeatbelt "Restraint control module: a064 event front left seatbelt";
CM_ SG_ 1297 RCM_a064_eventFrontRightSeatbelt "Restraint control module: a064 event front right seatbelt";
CM_ SG_ 1297 RCM_a064_eventVehicleSpeed "Restraint control module: a064 event vehicle speed";
CM_ SG_ 1297 RCM_a064_eventSteeringAngle "Restraint control module: a064 event steering angle";
CM_ SG_ 1297 RCM_a064_eventDriverBrakeApply "Restraint control module: a064 event driver brake apply; raw 3 = signal not available (SNA)";
CM_ SG_ 1297 RCM_a064_eventAccelPedalPos "Restraint control module: a064 event accel pedal pos; raw 255 = signal not available (SNA)";
CM_ SG_ 1297 RCM_a065_eventArmStatus "Restraint control module: a065 event arm status";
CM_ SG_ 1297 RCM_a065_eventFactoryMode "Restraint control module: a065 event factory mode";
CM_ SG_ 1297 RCM_a065_eventDiagEnabled "Restraint control module: a065 event diag enabled";
CM_ SG_ 1297 RCM_a065_eventDriveOrientation "Restraint control module: a065 event drive orientation";
CM_ SG_ 1297 RCM_a065_swDrvrOrientCheck "Restraint control module: a065 sw drvr orient check";
CM_ SG_ 1297 RCM_a065_swDrvrOrientSht2Bat "Restraint control module: a065 sw drvr orient sht2 bat";
CM_ SG_ 1297 RCM_a065_swDrvrOrientCrossCoup "Restraint control module: a065 sw drvr orient cross coup";
CM_ SG_ 1297 RCM_a065_swDrvrOrientConfig "Restraint control module: a065 sw drvr orient config";
CM_ SG_ 1297 RCM_a065_eventIDFsignal "Restraint control module: a065 event ID fsignal";
CM_ SG_ 1297 RCM_a065_eventFrontLeftSeatbelt "Restraint control module: a065 event front left seatbelt";
CM_ SG_ 1297 RCM_a065_eventFrontRightSeatbelt "Restraint control module: a065 event front right seatbelt";
CM_ SG_ 1297 RCM_a065_eventVehicleSpeed "Restraint control module: a065 event vehicle speed";
CM_ SG_ 1297 RCM_a065_eventSteeringAngle "Restraint control module: a065 event steering angle";
CM_ SG_ 1297 RCM_a065_eventDriverBrakeApply "Restraint control module: a065 event driver brake apply; raw 3 = signal not available (SNA)";
CM_ SG_ 1297 RCM_a065_eventAccelPedalPos "Restraint control module: a065 event accel pedal pos; raw 255 = signal not available (SNA)";
CM_ SG_ 1297 RCM_a066_eventArmStatus "Restraint control module: a066 event arm status";
CM_ SG_ 1297 RCM_a066_eventFactoryMode "Restraint control module: a066 event factory mode";
CM_ SG_ 1297 RCM_a066_eventDiagEnabled "Restraint control module: a066 event diag enabled";
CM_ SG_ 1297 RCM_a066_eventDriveOrientation "Restraint control module: a066 event drive orientation";
CM_ SG_ 1297 RCM_a066_sbsw2ndRowLShort "Restraint control module: a066 sbsw2nd row l short";
CM_ SG_ 1297 RCM_a066_sbsw2ndRowLSht2Bat "Restraint control module: a066 sbsw2nd row l sht2 bat";
CM_ SG_ 1297 RCM_a066_sbsw2ndRowLCrossCoup "Restraint control module: a066 sbsw2nd row l cross coup";
CM_ SG_ 1297 RCM_a066_sbsw2ndRowLConfig "Restraint control module: a066 sbsw2nd row l config";
CM_ SG_ 1297 RCM_a066_eventIDFsignal "Restraint control module: a066 event ID fsignal";
CM_ SG_ 1297 RCM_a066_eventFrontLeftSeatbelt "Restraint control module: a066 event front left seatbelt";
CM_ SG_ 1297 RCM_a066_eventFrontRightSeatbelt "Restraint control module: a066 event front right seatbelt";
CM_ SG_ 1297 RCM_a066_eventVehicleSpeed "Restraint control module: a066 event vehicle speed";
CM_ SG_ 1297 RCM_a066_eventSteeringAngle "Restraint control module: a066 event steering angle";
CM_ SG_ 1297 RCM_a066_eventDriverBrakeApply "Restraint control module: a066 event driver brake apply; raw 3 = signal not available (SNA)";
CM_ SG_ 1297 RCM_a066_eventAccelPedalPos "Restraint control module: a066 event accel pedal pos; raw 255 = signal not available (SNA)";
CM_ SG_ 1297 RCM_a067_eventArmStatus "Restraint control module: a067 event arm status";
CM_ SG_ 1297 RCM_a067_eventFactoryMode "Restraint control module: a067 event factory mode";
CM_ SG_ 1297 RCM_a067_eventDiagEnabled "Restraint control module: a067 event diag enabled";
CM_ SG_ 1297 RCM_a067_eventDriveOrientation "Restraint control module: a067 event drive orientation";
CM_ SG_ 1297 RCM_a067_comCANInitialization "Restraint control module: a067 com CAN initialization";
CM_ SG_ 1297 RCM_a067_eventIDFsignal "Restraint control module: a067 event ID fsignal";
CM_ SG_ 1297 RCM_a067_eventFrontLeftSeatbelt "Restraint control module: a067 event front left seatbelt";
CM_ SG_ 1297 RCM_a067_eventFrontRightSeatbelt "Restraint control module: a067 event front right seatbelt";
CM_ SG_ 1297 RCM_a067_eventVehicleSpeed "Restraint control module: a067 event vehicle speed";
CM_ SG_ 1297 RCM_a067_eventSteeringAngle "Restraint control module: a067 event steering angle";
CM_ SG_ 1297 RCM_a067_eventDriverBrakeApply "Restraint control module: a067 event driver brake apply; raw 3 = signal not available (SNA)";
CM_ SG_ 1297 RCM_a067_eventAccelPedalPos "Restraint control module: a067 event accel pedal pos; raw 255 = signal not available (SNA)";
CM_ SG_ 1297 RCM_a068_eventArmStatus "Restraint control module: a068 event arm status";
CM_ SG_ 1297 RCM_a068_eventFactoryMode "Restraint control module: a068 event factory mode";
CM_ SG_ 1297 RCM_a068_eventDiagEnabled "Restraint control module: a068 event diag enabled";
CM_ SG_ 1297 RCM_a068_eventDriveOrientation "Restraint control module: a068 event drive orientation";
CM_ SG_ 1297 RCM_a068_comChassisCANBusOff "Restraint control module: a068 com chassis CAN bus off";
CM_ SG_ 1297 RCM_a068_eventIDFsignal "Restraint control module: a068 event ID fsignal";
CM_ SG_ 1297 RCM_a068_eventFrontLeftSeatbelt "Restraint control module: a068 event front left seatbelt";
CM_ SG_ 1297 RCM_a068_eventFrontRightSeatbelt "Restraint control module: a068 event front right seatbelt";
CM_ SG_ 1297 RCM_a068_eventVehicleSpeed "Restraint control module: a068 event vehicle speed";
CM_ SG_ 1297 RCM_a068_eventSteeringAngle "Restraint control module: a068 event steering angle";
CM_ SG_ 1297 RCM_a068_eventDriverBrakeApply "Restraint control module: a068 event driver brake apply; raw 3 = signal not available (SNA)";
CM_ SG_ 1297 RCM_a068_eventAccelPedalPos "Restraint control module: a068 event accel pedal pos; raw 255 = signal not available (SNA)";
CM_ SG_ 1297 RCM_a069_eventArmStatus "Restraint control module: a069 event arm status";
CM_ SG_ 1297 RCM_a069_eventFactoryMode "Restraint control module: a069 event factory mode";
CM_ SG_ 1297 RCM_a069_eventDiagEnabled "Restraint control module: a069 event diag enabled";
CM_ SG_ 1297 RCM_a069_eventDriveOrientation "Restraint control module: a069 event drive orientation";
CM_ SG_ 1297 RCM_a069_comChassisCANPH7MIA "Restraint control module: a069 com chassis CANPH7 MIA";
CM_ SG_ 1297 RCM_a069_comChassisCANPH7ChkSm "Restraint control module: a069 com chassis CANPH7 chk sm";
CM_ SG_ 1297 RCM_a069_comChassisCANPH7Cntr "Restraint control module: a069 com chassis CANPH7 cntr";
CM_ SG_ 1297 RCM_a069_eventIDFsignal "Restraint control module: a069 event ID fsignal";
CM_ SG_ 1297 RCM_a069_eventFrontLeftSeatbelt "Restraint control module: a069 event front left seatbelt";
CM_ SG_ 1297 RCM_a069_eventFrontRightSeatbelt "Restraint control module: a069 event front right seatbelt";
CM_ SG_ 1297 RCM_a069_eventVehicleSpeed "Restraint control module: a069 event vehicle speed";
CM_ SG_ 1297 RCM_a069_eventSteeringAngle "Restraint control module: a069 event steering angle";
CM_ SG_ 1297 RCM_a069_eventDriverBrakeApply "Restraint control module: a069 event driver brake apply; raw 3 = signal not available (SNA)";
CM_ SG_ 1297 RCM_a069_eventAccelPedalPos "Restraint control module: a069 event accel pedal pos; raw 255 = signal not available (SNA)";
CM_ SG_ 1297 RCM_a070_eventArmStatus "Restraint control module: a070 event arm status";
CM_ SG_ 1297 RCM_a070_eventFactoryMode "Restraint control module: a070 event factory mode";
CM_ SG_ 1297 RCM_a070_eventDiagEnabled "Restraint control module: a070 event diag enabled";
CM_ SG_ 1297 RCM_a070_eventDriveOrientation "Restraint control module: a070 event drive orientation";
CM_ SG_ 1297 RCM_a070_comChassisCANPH8MIA "Restraint control module: a070 com chassis CANPH8 MIA";
CM_ SG_ 1297 RCM_a070_comChassisCANPH8ChkSm "Restraint control module: a070 com chassis CANPH8 chk sm";
CM_ SG_ 1297 RCM_a070_comChassisCANPH8Cntr "Restraint control module: a070 com chassis CANPH8 cntr";
CM_ SG_ 1297 RCM_a070_eventIDFsignal "Restraint control module: a070 event ID fsignal";
CM_ SG_ 1297 RCM_a070_eventFrontLeftSeatbelt "Restraint control module: a070 event front left seatbelt";
CM_ SG_ 1297 RCM_a070_eventFrontRightSeatbelt "Restraint control module: a070 event front right seatbelt";
CM_ SG_ 1297 RCM_a070_eventVehicleSpeed "Restraint control module: a070 event vehicle speed";
CM_ SG_ 1297 RCM_a070_eventSteeringAngle "Restraint control module: a070 event steering angle";
CM_ SG_ 1297 RCM_a070_eventDriverBrakeApply "Restraint control module: a070 event driver brake apply; raw 3 = signal not available (SNA)";
CM_ SG_ 1297 RCM_a070_eventAccelPedalPos "Restraint control module: a070 event accel pedal pos; raw 255 = signal not available (SNA)";
CM_ SG_ 1297 RCM_a071_eventArmStatus "Restraint control module: a071 event arm status";
CM_ SG_ 1297 RCM_a071_eventFactoryMode "Restraint control module: a071 event factory mode";
CM_ SG_ 1297 RCM_a071_eventDiagEnabled "Restraint control module: a071 event diag enabled";
CM_ SG_ 1297 RCM_a071_eventDriveOrientation "Restraint control module: a071 event drive orientation";
CM_ SG_ 1297 RCM_a071_comChassisCANPH9MIA "Restraint control module: a071 com chassis CANPH9 MIA";
CM_ SG_ 1297 RCM_a071_comChassisCANPH9ChkSm "Restraint control module: a071 com chassis CANPH9 chk sm";
CM_ SG_ 1297 RCM_a071_comChassisCANPH9Cntr "Restraint control module: a071 com chassis CANPH9 cntr";
CM_ SG_ 1297 RCM_a071_eventIDFsignal "Restraint control module: a071 event ID fsignal";
CM_ SG_ 1297 RCM_a071_eventFrontLeftSeatbelt "Restraint control module: a071 event front left seatbelt";
CM_ SG_ 1297 RCM_a071_eventFrontRightSeatbelt "Restraint control module: a071 event front right seatbelt";
CM_ SG_ 1297 RCM_a071_eventVehicleSpeed "Restraint control module: a071 event vehicle speed";
CM_ SG_ 1297 RCM_a071_eventSteeringAngle "Restraint control module: a071 event steering angle";
CM_ SG_ 1297 RCM_a071_eventDriverBrakeApply "Restraint control module: a071 event driver brake apply; raw 3 = signal not available (SNA)";
CM_ SG_ 1297 RCM_a071_eventAccelPedalPos "Restraint control module: a071 event accel pedal pos; raw 255 = signal not available (SNA)";
CM_ SG_ 1297 RCM_a072_eventArmStatus "Restraint control module: a072 event arm status";
CM_ SG_ 1297 RCM_a072_eventFactoryMode "Restraint control module: a072 event factory mode";
CM_ SG_ 1297 RCM_a072_eventDiagEnabled "Restraint control module: a072 event diag enabled";
CM_ SG_ 1297 RCM_a072_eventDriveOrientation "Restraint control module: a072 event drive orientation";
CM_ SG_ 1297 RCM_a072_comUnusedMIA "Restraint control module: a072 com unused MIA";
CM_ SG_ 1297 RCM_a072_comUnusedChkSm "Restraint control module: a072 com unused chk sm";
CM_ SG_ 1297 RCM_a072_comUnusedCntr "Restraint control module: a072 com unused cntr";
CM_ SG_ 1297 RCM_a072_eventIDFsignal "Restraint control module: a072 event ID fsignal";
CM_ SG_ 1297 RCM_a072_eventFrontLeftSeatbelt "Restraint control module: a072 event front left seatbelt";
CM_ SG_ 1297 RCM_a072_eventFrontRightSeatbelt "Restraint control module: a072 event front right seatbelt";
CM_ SG_ 1297 RCM_a072_eventVehicleSpeed "Restraint control module: a072 event vehicle speed";
CM_ SG_ 1297 RCM_a072_eventSteeringAngle "Restraint control module: a072 event steering angle";
CM_ SG_ 1297 RCM_a072_eventDriverBrakeApply "Restraint control module: a072 event driver brake apply; raw 3 = signal not available (SNA)";
CM_ SG_ 1297 RCM_a072_eventAccelPedalPos "Restraint control module: a072 event accel pedal pos; raw 255 = signal not available (SNA)";
CM_ SG_ 1297 RCM_a073_eventArmStatus "Restraint control module: a073 event arm status";
CM_ SG_ 1297 RCM_a073_eventFactoryMode "Restraint control module: a073 event factory mode";
CM_ SG_ 1297 RCM_a073_eventDiagEnabled "Restraint control module: a073 event diag enabled";
CM_ SG_ 1297 RCM_a073_eventDriveOrientation "Restraint control module: a073 event drive orientation";
CM_ SG_ 1297 RCM_a073_comChassisCANPH4MIA "Restraint control module: a073 com chassis CANPH4 MIA";
CM_ SG_ 1297 RCM_a073_comChassisCANPH4ChkSm "Restraint control module: a073 com chassis CANPH4 chk sm";
CM_ SG_ 1297 RCM_a073_comChassisCANPH4Cntr "Restraint control module: a073 com chassis CANPH4 cntr";
CM_ SG_ 1297 RCM_a073_eventIDFsignal "Restraint control module: a073 event ID fsignal";
CM_ SG_ 1297 RCM_a073_eventFrontLeftSeatbelt "Restraint control module: a073 event front left seatbelt";
CM_ SG_ 1297 RCM_a073_eventFrontRightSeatbelt "Restraint control module: a073 event front right seatbelt";
CM_ SG_ 1297 RCM_a073_eventVehicleSpeed "Restraint control module: a073 event vehicle speed";
CM_ SG_ 1297 RCM_a073_eventSteeringAngle "Restraint control module: a073 event steering angle";
CM_ SG_ 1297 RCM_a073_eventDriverBrakeApply "Restraint control module: a073 event driver brake apply; raw 3 = signal not available (SNA)";
CM_ SG_ 1297 RCM_a073_eventAccelPedalPos "Restraint control module: a073 event accel pedal pos; raw 255 = signal not available (SNA)";
CM_ SG_ 1297 RCM_a074_eventArmStatus "Restraint control module: a074 event arm status";
CM_ SG_ 1297 RCM_a074_eventFactoryMode "Restraint control module: a074 event factory mode";
CM_ SG_ 1297 RCM_a074_eventDiagEnabled "Restraint control module: a074 event diag enabled";
CM_ SG_ 1297 RCM_a074_eventDriveOrientation "Restraint control module: a074 event drive orientation";
CM_ SG_ 1297 RCM_a074_comChassisCANPH5MIA "Restraint control module: a074 com chassis CANPH5 MIA";
CM_ SG_ 1297 RCM_a074_comChassisCANPH5ChkSm "Restraint control module: a074 com chassis CANPH5 chk sm";
CM_ SG_ 1297 RCM_a074_comChassisCANPH5Cntr "Restraint control module: a074 com chassis CANPH5 cntr";
CM_ SG_ 1297 RCM_a074_eventIDFsignal "Restraint control module: a074 event ID fsignal";
CM_ SG_ 1297 RCM_a074_eventFrontLeftSeatbelt "Restraint control module: a074 event front left seatbelt";
CM_ SG_ 1297 RCM_a074_eventFrontRightSeatbelt "Restraint control module: a074 event front right seatbelt";
CM_ SG_ 1297 RCM_a074_eventVehicleSpeed "Restraint control module: a074 event vehicle speed";
CM_ SG_ 1297 RCM_a074_eventSteeringAngle "Restraint control module: a074 event steering angle";
CM_ SG_ 1297 RCM_a074_eventDriverBrakeApply "Restraint control module: a074 event driver brake apply; raw 3 = signal not available (SNA)";
CM_ SG_ 1297 RCM_a074_eventAccelPedalPos "Restraint control module: a074 event accel pedal pos; raw 255 = signal not available (SNA)";
CM_ SG_ 1297 RCM_a075_eventArmStatus "Restraint control module: a075 event arm status";
CM_ SG_ 1297 RCM_a075_eventFactoryMode "Restraint control module: a075 event factory mode";
CM_ SG_ 1297 RCM_a075_eventDiagEnabled "Restraint control module: a075 event diag enabled";
CM_ SG_ 1297 RCM_a075_eventDriveOrientation "Restraint control module: a075 event drive orientation";
CM_ SG_ 1297 RCM_a075_comChassisCANPH6MIA "Restraint control module: a075 com chassis CANPH6 MIA";
CM_ SG_ 1297 RCM_a075_comChassisCANPH6ChkSm "Restraint control module: a075 com chassis CANPH6 chk sm";
CM_ SG_ 1297 RCM_a075_comChassisCANPH6Cntr "Restraint control module: a075 com chassis CANPH6 cntr";
CM_ SG_ 1297 RCM_a075_eventIDFsignal "Restraint control module: a075 event ID fsignal";
CM_ SG_ 1297 RCM_a075_eventFrontLeftSeatbelt "Restraint control module: a075 event front left seatbelt";
CM_ SG_ 1297 RCM_a075_eventFrontRightSeatbelt "Restraint control module: a075 event front right seatbelt";
CM_ SG_ 1297 RCM_a075_eventVehicleSpeed "Restraint control module: a075 event vehicle speed";
CM_ SG_ 1297 RCM_a075_eventSteeringAngle "Restraint control module: a075 event steering angle";
CM_ SG_ 1297 RCM_a075_eventDriverBrakeApply "Restraint control module: a075 event driver brake apply; raw 3 = signal not available (SNA)";
CM_ SG_ 1297 RCM_a075_eventAccelPedalPos "Restraint control module: a075 event accel pedal pos; raw 255 = signal not available (SNA)";
CM_ SG_ 1297 RCM_a078_eventArmStatus "Restraint control module: a078 event arm status";
CM_ SG_ 1297 RCM_a078_eventFactoryMode "Restraint control module: a078 event factory mode";
CM_ SG_ 1297 RCM_a078_eventDiagEnabled "Restraint control module: a078 event diag enabled";
CM_ SG_ 1297 RCM_a078_eventDriveOrientation "Restraint control module: a078 event drive orientation";
CM_ SG_ 1297 RCM_a078_comOCS1PMIA "Restraint control module: a078 com OCS1 PMIA";
CM_ SG_ 1297 RCM_a078_comOCS1PChkSm "Restraint control module: a078 com OCS1 p chk sm";
CM_ SG_ 1297 RCM_a078_comOCS1PCntr "Restraint control module: a078 com OCS1 p cntr";
CM_ SG_ 1297 RCM_a078_eventIDFsignal "Restraint control module: a078 event ID fsignal";
CM_ SG_ 1297 RCM_a078_eventFrontLeftSeatbelt "Restraint control module: a078 event front left seatbelt";
CM_ SG_ 1297 RCM_a078_eventFrontRightSeatbelt "Restraint control module: a078 event front right seatbelt";
CM_ SG_ 1297 RCM_a078_eventVehicleSpeed "Restraint control module: a078 event vehicle speed";
CM_ SG_ 1297 RCM_a078_eventSteeringAngle "Restraint control module: a078 event steering angle";
CM_ SG_ 1297 RCM_a078_eventDriverBrakeApply "Restraint control module: a078 event driver brake apply; raw 3 = signal not available (SNA)";
CM_ SG_ 1297 RCM_a078_eventAccelPedalPos "Restraint control module: a078 event accel pedal pos; raw 255 = signal not available (SNA)";
CM_ SG_ 1297 RCM_a079_eventArmStatus "Restraint control module: a079 event arm status";
CM_ SG_ 1297 RCM_a079_eventFactoryMode "Restraint control module: a079 event factory mode";
CM_ SG_ 1297 RCM_a079_eventDiagEnabled "Restraint control module: a079 event diag enabled";
CM_ SG_ 1297 RCM_a079_eventDriveOrientation "Restraint control module: a079 event drive orientation";
CM_ SG_ 1297 RCM_a079_comOCS1DMIA "Restraint control module: a079 com OCS1 DMIA";
CM_ SG_ 1297 RCM_a079_comOCS1DChkSm "Restraint control module: a079 com OCS1 d chk sm";
CM_ SG_ 1297 RCM_a079_comOCS1DCntr "Restraint control module: a079 com OCS1 d cntr";
CM_ SG_ 1297 RCM_a079_eventIDFsignal "Restraint control module: a079 event ID fsignal";
CM_ SG_ 1297 RCM_a079_eventFrontLeftSeatbelt "Restraint control module: a079 event front left seatbelt";
CM_ SG_ 1297 RCM_a079_eventFrontRightSeatbelt "Restraint control module: a079 event front right seatbelt";
CM_ SG_ 1297 RCM_a079_eventVehicleSpeed "Restraint control module: a079 event vehicle speed";
CM_ SG_ 1297 RCM_a079_eventSteeringAngle "Restraint control module: a079 event steering angle";
CM_ SG_ 1297 RCM_a079_eventDriverBrakeApply "Restraint control module: a079 event driver brake apply; raw 3 = signal not available (SNA)";
CM_ SG_ 1297 RCM_a079_eventAccelPedalPos "Restraint control module: a079 event accel pedal pos; raw 255 = signal not available (SNA)";
CM_ SG_ 1297 RCM_a080_eventArmStatus "Restraint control module: a080 event arm status";
CM_ SG_ 1297 RCM_a080_eventFactoryMode "Restraint control module: a080 event factory mode";
CM_ SG_ 1297 RCM_a080_eventDiagEnabled "Restraint control module: a080 event diag enabled";
CM_ SG_ 1297 RCM_a080_eventDriveOrientation "Restraint control module: a080 event drive orientation";
CM_ SG_ 1297 RCM_a080_comGTWACSMIA "Restraint control module: a080 com GTWACSMIA";
CM_ SG_ 1297 RCM_a080_comGTWACSChkSm "Restraint control module: a080 com GTWACS chk sm";
CM_ SG_ 1297 RCM_a080_comGTWACSCntr "Restraint control module: a080 com GTWACS cntr";
CM_ SG_ 1297 RCM_a080_eventIDFsignal "Restraint control module: a080 event ID fsignal";
CM_ SG_ 1297 RCM_a080_eventFrontLeftSeatbelt "Restraint control module: a080 event front left seatbelt";
CM_ SG_ 1297 RCM_a080_eventFrontRightSeatbelt "Restraint control module: a080 event front right seatbelt";
CM_ SG_ 1297 RCM_a080_eventVehicleSpeed "Restraint control module: a080 event vehicle speed";
CM_ SG_ 1297 RCM_a080_eventSteeringAngle "Restraint control module: a080 event steering angle";
CM_ SG_ 1297 RCM_a080_eventDriverBrakeApply "Restraint control module: a080 event driver brake apply; raw 3 = signal not available (SNA)";
CM_ SG_ 1297 RCM_a080_eventAccelPedalPos "Restraint control module: a080 event accel pedal pos; raw 255 = signal not available (SNA)";
CM_ SG_ 1297 RCM_a083_eventArmStatus "Restraint control module: a083 event arm status";
CM_ SG_ 1297 RCM_a083_eventFactoryMode "Restraint control module: a083 event factory mode";
CM_ SG_ 1297 RCM_a083_eventDiagEnabled "Restraint control module: a083 event diag enabled";
CM_ SG_ 1297 RCM_a083_eventDriveOrientation "Restraint control module: a083 event drive orientation";
CM_ SG_ 1297 RCM_a083_comGTWCarStateMIA "Restraint control module: a083 com GTW car state MIA";
CM_ SG_ 1297 RCM_a083_eventIDFsignal "Restraint control module: a083 event ID fsignal";
CM_ SG_ 1297 RCM_a083_eventFrontLeftSeatbelt "Restraint control module: a083 event front left seatbelt";
CM_ SG_ 1297 RCM_a083_eventFrontRightSeatbelt "Restraint control module: a083 event front right seatbelt";
CM_ SG_ 1297 RCM_a083_eventVehicleSpeed "Restraint control module: a083 event vehicle speed";
CM_ SG_ 1297 RCM_a083_eventSteeringAngle "Restraint control module: a083 event steering angle";
CM_ SG_ 1297 RCM_a083_eventDriverBrakeApply "Restraint control module: a083 event driver brake apply; raw 3 = signal not available (SNA)";
CM_ SG_ 1297 RCM_a083_eventAccelPedalPos "Restraint control module: a083 event accel pedal pos; raw 255 = signal not available (SNA)";
CM_ SG_ 1297 RCM_a087_eventArmStatus "Restraint control module: a087 event arm status";
CM_ SG_ 1297 RCM_a087_eventFactoryMode "Restraint control module: a087 event factory mode";
CM_ SG_ 1297 RCM_a087_eventDiagEnabled "Restraint control module: a087 event diag enabled";
CM_ SG_ 1297 RCM_a087_eventDriveOrientation "Restraint control module: a087 event drive orientation";
CM_ SG_ 1297 RCM_a087_comChassisCANSilent "Restraint control module: a087 com chassis CAN silent";
CM_ SG_ 1297 RCM_a087_comPARTYCANSilent "Restraint control module: a087 com PARTYCAN silent";
CM_ SG_ 1297 RCM_a087_comUnusedCANSilent "Restraint control module: a087 com unused CAN silent";
CM_ SG_ 1297 RCM_a087_eventIDFsignal "Restraint control module: a087 event ID fsignal";
CM_ SG_ 1297 RCM_a087_eventFrontLeftSeatbelt "Restraint control module: a087 event front left seatbelt";
CM_ SG_ 1297 RCM_a087_eventFrontRightSeatbelt "Restraint control module: a087 event front right seatbelt";
CM_ SG_ 1297 RCM_a087_eventVehicleSpeed "Restraint control module: a087 event vehicle speed";
CM_ SG_ 1297 RCM_a087_eventSteeringAngle "Restraint control module: a087 event steering angle";
CM_ SG_ 1297 RCM_a087_eventDriverBrakeApply "Restraint control module: a087 event driver brake apply; raw 3 = signal not available (SNA)";
CM_ SG_ 1297 RCM_a087_eventAccelPedalPos "Restraint control module: a087 event accel pedal pos; raw 255 = signal not available (SNA)";
CM_ SG_ 1297 RCM_a088_eventArmStatus "Restraint control module: a088 event arm status";
CM_ SG_ 1297 RCM_a088_eventFactoryMode "Restraint control module: a088 event factory mode";
CM_ SG_ 1297 RCM_a088_eventDiagEnabled "Restraint control module: a088 event diag enabled";
CM_ SG_ 1297 RCM_a088_eventDriveOrientation "Restraint control module: a088 event drive orientation";
CM_ SG_ 1297 RCM_a088_comChassisCANPH2MIA "Restraint control module: a088 com chassis CANPH2 MIA";
CM_ SG_ 1297 RCM_a088_comChassisCANPH2ChkSm "Restraint control module: a088 com chassis CANPH2 chk sm";
CM_ SG_ 1297 RCM_a088_comChassisCANPH2Cntr "Restraint control module: a088 com chassis CANPH2 cntr";
CM_ SG_ 1297 RCM_a088_eventIDFsignal "Restraint control module: a088 event ID fsignal";
CM_ SG_ 1297 RCM_a088_eventFrontLeftSeatbelt "Restraint control module: a088 event front left seatbelt";
CM_ SG_ 1297 RCM_a088_eventFrontRightSeatbelt "Restraint control module: a088 event front right seatbelt";
CM_ SG_ 1297 RCM_a088_eventVehicleSpeed "Restraint control module: a088 event vehicle speed";
CM_ SG_ 1297 RCM_a088_eventSteeringAngle "Restraint control module: a088 event steering angle";
CM_ SG_ 1297 RCM_a088_eventDriverBrakeApply "Restraint control module: a088 event driver brake apply; raw 3 = signal not available (SNA)";
CM_ SG_ 1297 RCM_a088_eventAccelPedalPos "Restraint control module: a088 event accel pedal pos; raw 255 = signal not available (SNA)";
CM_ SG_ 1297 RCM_a089_eventArmStatus "Restraint control module: a089 event arm status";
CM_ SG_ 1297 RCM_a089_eventFactoryMode "Restraint control module: a089 event factory mode";
CM_ SG_ 1297 RCM_a089_eventDiagEnabled "Restraint control module: a089 event diag enabled";
CM_ SG_ 1297 RCM_a089_eventDriveOrientation "Restraint control module: a089 event drive orientation";
CM_ SG_ 1297 RCM_a089_comChassisCANPH3MIA "Restraint control module: a089 com chassis CANPH3 MIA";
CM_ SG_ 1297 RCM_a089_comChassisCANPH3ChkSm "Restraint control module: a089 com chassis CANPH3 chk sm";
CM_ SG_ 1297 RCM_a089_comChassisCANPH3Cntr "Restraint control module: a089 com chassis CANPH3 cntr";
CM_ SG_ 1297 RCM_a089_eventIDFsignal "Restraint control module: a089 event ID fsignal";
CM_ SG_ 1297 RCM_a089_eventFrontLeftSeatbelt "Restraint control module: a089 event front left seatbelt";
CM_ SG_ 1297 RCM_a089_eventFrontRightSeatbelt "Restraint control module: a089 event front right seatbelt";
CM_ SG_ 1297 RCM_a089_eventVehicleSpeed "Restraint control module: a089 event vehicle speed";
CM_ SG_ 1297 RCM_a089_eventSteeringAngle "Restraint control module: a089 event steering angle";
CM_ SG_ 1297 RCM_a089_eventDriverBrakeApply "Restraint control module: a089 event driver brake apply; raw 3 = signal not available (SNA)";
CM_ SG_ 1297 RCM_a089_eventAccelPedalPos "Restraint control module: a089 event accel pedal pos; raw 255 = signal not available (SNA)";
CM_ SG_ 1297 RCM_a090_eventArmStatus "Restraint control module: a090 event arm status";
CM_ SG_ 1297 RCM_a090_eventFactoryMode "Restraint control module: a090 event factory mode";
CM_ SG_ 1297 RCM_a090_eventDiagEnabled "Restraint control module: a090 event diag enabled";
CM_ SG_ 1297 RCM_a090_eventDriveOrientation "Restraint control module: a090 event drive orientation";
CM_ SG_ 1297 RCM_a090_comPartyCANBusOff "Restraint control module: a090 com party CAN bus off";
CM_ SG_ 1297 RCM_a090_eventIDFsignal "Restraint control module: a090 event ID fsignal";
CM_ SG_ 1297 RCM_a090_eventFrontLeftSeatbelt "Restraint control module: a090 event front left seatbelt";
CM_ SG_ 1297 RCM_a090_eventFrontRightSeatbelt "Restraint control module: a090 event front right seatbelt";
CM_ SG_ 1297 RCM_a090_eventVehicleSpeed "Restraint control module: a090 event vehicle speed";
CM_ SG_ 1297 RCM_a090_eventSteeringAngle "Restraint control module: a090 event steering angle";
CM_ SG_ 1297 RCM_a090_eventDriverBrakeApply "Restraint control module: a090 event driver brake apply; raw 3 = signal not available (SNA)";
CM_ SG_ 1297 RCM_a090_eventAccelPedalPos "Restraint control module: a090 event accel pedal pos; raw 255 = signal not available (SNA)";
CM_ SG_ 1297 RCM_a091_eventArmStatus "Restraint control module: a091 event arm status";
CM_ SG_ 1297 RCM_a091_eventFactoryMode "Restraint control module: a091 event factory mode";
CM_ SG_ 1297 RCM_a091_eventDiagEnabled "Restraint control module: a091 event diag enabled";
CM_ SG_ 1297 RCM_a091_eventDriveOrientation "Restraint control module: a091 event drive orientation";
CM_ SG_ 1297 RCM_a091_comEPAS3PStAnglInvlidQF "Restraint control module: a091 com EPAS3 p st angl invlid QF";
CM_ SG_ 1297 RCM_a091_comEPAS3PsysStatusMIA "Restraint control module: a091 com EPAS3 psys status MIA";
CM_ SG_ 1297 RCM_a091_comEPAS3PsysStatusChkSm "Restraint control module: a091 com EPAS3 psys status chk sm";
CM_ SG_ 1297 RCM_a091_comEPAS3PsysStatusCntr "Restraint control module: a091 com EPAS3 psys status cntr";
CM_ SG_ 1297 RCM_a091_eventIDFsignal "Restraint control module: a091 event ID fsignal";
CM_ SG_ 1297 RCM_a091_eventFrontLeftSeatbelt "Restraint control module: a091 event front left seatbelt";
CM_ SG_ 1297 RCM_a091_eventFrontRightSeatbelt "Restraint control module: a091 event front right seatbelt";
CM_ SG_ 1297 RCM_a091_eventVehicleSpeed "Restraint control module: a091 event vehicle speed";
CM_ SG_ 1297 RCM_a091_eventSteeringAngle "Restraint control module: a091 event steering angle";
CM_ SG_ 1297 RCM_a091_eventDriverBrakeApply "Restraint control module: a091 event driver brake apply; raw 3 = signal not available (SNA)";
CM_ SG_ 1297 RCM_a091_eventAccelPedalPos "Restraint control module: a091 event accel pedal pos; raw 255 = signal not available (SNA)";
CM_ SG_ 1297 RCM_a092_eventArmStatus "Restraint control module: a092 event arm status";
CM_ SG_ 1297 RCM_a092_eventFactoryMode "Restraint control module: a092 event factory mode";
CM_ SG_ 1297 RCM_a092_eventDiagEnabled "Restraint control module: a092 event diag enabled";
CM_ SG_ 1297 RCM_a092_eventDriveOrientation "Restraint control module: a092 event drive orientation";
CM_ SG_ 1297 RCM_a092_comDASSafetyFrontMIA "Restraint control module: a092 com DAS safety front MIA";
CM_ SG_ 1297 RCM_a092_comDASSafetyFrontChkSm "Restraint control module: a092 com DAS safety front chk sm";
CM_ SG_ 1297 RCM_a092_comDASSafetyFrontCntr "Restraint control module: a092 com DAS safety front cntr";
CM_ SG_ 1297 RCM_a092_eventIDFsignal "Restraint control module: a092 event ID fsignal";
CM_ SG_ 1297 RCM_a092_eventFrontLeftSeatbelt "Restraint control module: a092 event front left seatbelt";
CM_ SG_ 1297 RCM_a092_eventFrontRightSeatbelt "Restraint control module: a092 event front right seatbelt";
CM_ SG_ 1297 RCM_a092_eventVehicleSpeed "Restraint control module: a092 event vehicle speed";
CM_ SG_ 1297 RCM_a092_eventSteeringAngle "Restraint control module: a092 event steering angle";
CM_ SG_ 1297 RCM_a092_eventDriverBrakeApply "Restraint control module: a092 event driver brake apply; raw 3 = signal not available (SNA)";
CM_ SG_ 1297 RCM_a092_eventAccelPedalPos "Restraint control module: a092 event accel pedal pos; raw 255 = signal not available (SNA)";
CM_ SG_ 1297 RCM_a093_eventArmStatus "Restraint control module: a093 event arm status";
CM_ SG_ 1297 RCM_a093_eventFactoryMode "Restraint control module: a093 event factory mode";
CM_ SG_ 1297 RCM_a093_eventDiagEnabled "Restraint control module: a093 event diag enabled";
CM_ SG_ 1297 RCM_a093_eventDriveOrientation "Restraint control module: a093 event drive orientation";
CM_ SG_ 1297 RCM_a093_comVCLEFTStatusMIA "Restraint control module: a093 com VCLEFT status MIA";
CM_ SG_ 1297 RCM_a093_comVCLEFTStatusChkSm "Restraint control module: a093 com VCLEFT status chk sm";
CM_ SG_ 1297 RCM_a093_comVCLEFTStatusCntr "Restraint control module: a093 com VCLEFT status cntr";
CM_ SG_ 1297 RCM_a093_bucklSwVCFrontLeftFault "Restraint control module: a093 buckl sw VC front left fault";
CM_ SG_ 1297 RCM_a093_bucklSwVCRearLeftFault "Restraint control module: a093 buckl sw VC rear left fault";
CM_ SG_ 1297 RCM_a093_eventIDFsignal "Restraint control module: a093 event ID fsignal";
CM_ SG_ 1297 RCM_a093_eventFrontLeftSeatbelt "Restraint control module: a093 event front left seatbelt";
CM_ SG_ 1297 RCM_a093_eventFrontRightSeatbelt "Restraint control module: a093 event front right seatbelt";
CM_ SG_ 1297 RCM_a093_eventVehicleSpeed "Restraint control module: a093 event vehicle speed";
CM_ SG_ 1297 RCM_a093_eventSteeringAngle "Restraint control module: a093 event steering angle";
CM_ SG_ 1297 RCM_a093_eventDriverBrakeApply "Restraint control module: a093 event driver brake apply; raw 3 = signal not available (SNA)";
CM_ SG_ 1297 RCM_a093_eventAccelPedalPos "Restraint control module: a093 event accel pedal pos; raw 255 = signal not available (SNA)";
CM_ SG_ 1297 RCM_a094_eventArmStatus "Restraint control module: a094 event arm status";
CM_ SG_ 1297 RCM_a094_eventFactoryMode "Restraint control module: a094 event factory mode";
CM_ SG_ 1297 RCM_a094_eventDiagEnabled "Restraint control module: a094 event diag enabled";
CM_ SG_ 1297 RCM_a094_eventDriveOrientation "Restraint control module: a094 event drive orientation";
CM_ SG_ 1297 RCM_a094_comVCRIGHTStatusMIA "Restraint control module: a094 com VCRIGHT status MIA";
CM_ SG_ 1297 RCM_a094_comVCRIGHTStatusChkSm "Restraint control module: a094 com VCRIGHT status chk sm";
CM_ SG_ 1297 RCM_a094_comVCRIGHTStatusCntr "Restraint control module: a094 com VCRIGHT status cntr";
CM_ SG_ 1297 RCM_a094_bucklSwVCFrontRghtFault "Restraint control module: a094 buckl sw VC front rght fault";
CM_ SG_ 1297 RCM_a094_bucklSwVCRearRghtFault "Restraint control module: a094 buckl sw VC rear rght fault";
CM_ SG_ 1297 RCM_a094_bucklSwVCRearCnterFault "Restraint control module: a094 buckl sw VC rear cnter fault";
CM_ SG_ 1297 RCM_a094_eventIDFsignal "Restraint control module: a094 event ID fsignal";
CM_ SG_ 1297 RCM_a094_eventFrontLeftSeatbelt "Restraint control module: a094 event front left seatbelt";
CM_ SG_ 1297 RCM_a094_eventFrontRightSeatbelt "Restraint control module: a094 event front right seatbelt";
CM_ SG_ 1297 RCM_a094_eventVehicleSpeed "Restraint control module: a094 event vehicle speed";
CM_ SG_ 1297 RCM_a094_eventSteeringAngle "Restraint control module: a094 event steering angle";
CM_ SG_ 1297 RCM_a094_eventDriverBrakeApply "Restraint control module: a094 event driver brake apply; raw 3 = signal not available (SNA)";
CM_ SG_ 1297 RCM_a094_eventAccelPedalPos "Restraint control module: a094 event accel pedal pos; raw 255 = signal not available (SNA)";
CM_ SG_ 1297 RCM_a101_eventArmStatus "Restraint control module: a101 event arm status";
CM_ SG_ 1297 RCM_a101_eventFactoryMode "Restraint control module: a101 event factory mode";
CM_ SG_ 1297 RCM_a101_eventDiagEnabled "Restraint control module: a101 event diag enabled";
CM_ SG_ 1297 RCM_a101_eventDriveOrientation "Restraint control module: a101 event drive orientation";
CM_ SG_ 1297 RCM_a101_idfMisuseMonitoringErr "Restraint control module: a101 idf misuse monitoring err";
CM_ SG_ 1297 RCM_a101_idfEnviMonitoringError "Restraint control module: a101 idf envi monitoring error";
CM_ SG_ 1297 RCM_a101_idfEnviMonitoringEvent "Restraint control module: a101 idf envi monitoring event";
CM_ SG_ 1297 RCM_a101_eventIDFsignal "Restraint control module: a101 event ID fsignal";
CM_ SG_ 1297 RCM_a101_eventFrontLeftSeatbelt "Restraint control module: a101 event front left seatbelt";
CM_ SG_ 1297 RCM_a101_eventFrontRightSeatbelt "Restraint control module: a101 event front right seatbelt";
CM_ SG_ 1297 RCM_a101_eventVehicleSpeed "Restraint control module: a101 event vehicle speed";
CM_ SG_ 1297 RCM_a101_eventSteeringAngle "Restraint control module: a101 event steering angle";
CM_ SG_ 1297 RCM_a101_eventDriverBrakeApply "Restraint control module: a101 event driver brake apply; raw 3 = signal not available (SNA)";
CM_ SG_ 1297 RCM_a101_eventAccelPedalPos "Restraint control module: a101 event accel pedal pos; raw 255 = signal not available (SNA)";
CM_ SG_ 1297 RCM_a102_eventArmStatus "Restraint control module: a102 event arm status";
CM_ SG_ 1297 RCM_a102_eventFactoryMode "Restraint control module: a102 event factory mode";
CM_ SG_ 1297 RCM_a102_eventDiagEnabled "Restraint control module: a102 event diag enabled";
CM_ SG_ 1297 RCM_a102_eventDriveOrientation "Restraint control module: a102 event drive orientation";
CM_ SG_ 1297 RCM_a102_imuYawR8OffCompPosLife "Restraint control module: a102 imu yaw R8 off comp pos life";
CM_ SG_ 1297 RCM_a102_imuYawR8OffCompNegLife "Restraint control module: a102 imu yaw R8 off comp neg life";
CM_ SG_ 1297 RCM_a102_imuYawR8OffCompPosFLDC "Restraint control module: a102 imu yaw R8 off comp pos FLDC";
CM_ SG_ 1297 RCM_a102_imuYawR8OffCompNegFLDC "Restraint control module: a102 imu yaw R8 off comp neg FLDC";
CM_ SG_ 1297 RCM_a102_imuYawR8OffCompPosSLDC "Restraint control module: a102 imu yaw R8 off comp pos SLDC";
CM_ SG_ 1297 RCM_a102_imuYawR8OffCompNegSLDC "Restraint control module: a102 imu yaw R8 off comp neg SLDC";
CM_ SG_ 1297 RCM_a102_eventIDFsignal "Restraint control module: a102 event ID fsignal";
CM_ SG_ 1297 RCM_a102_eventFrontLeftSeatbelt "Restraint control module: a102 event front left seatbelt";
CM_ SG_ 1297 RCM_a102_eventFrontRightSeatbelt "Restraint control module: a102 event front right seatbelt";
CM_ SG_ 1297 RCM_a102_eventVehicleSpeed "Restraint control module: a102 event vehicle speed";
CM_ SG_ 1297 RCM_a102_eventSteeringAngle "Restraint control module: a102 event steering angle";
CM_ SG_ 1297 RCM_a102_eventDriverBrakeApply "Restraint control module: a102 event driver brake apply; raw 3 = signal not available (SNA)";
CM_ SG_ 1297 RCM_a102_eventAccelPedalPos "Restraint control module: a102 event accel pedal pos; raw 255 = signal not available (SNA)";
CM_ SG_ 1297 RCM_a103_eventArmStatus "Restraint control module: a103 event arm status";
CM_ SG_ 1297 RCM_a103_eventFactoryMode "Restraint control module: a103 event factory mode";
CM_ SG_ 1297 RCM_a103_eventDiagEnabled "Restraint control module: a103 event diag enabled";
CM_ SG_ 1297 RCM_a103_eventDriveOrientation "Restraint control module: a103 event drive orientation";
CM_ SG_ 1297 RCM_a103_imuPtchR8OffCompPosLife "Restraint control module: a103 imu ptch R8 off comp pos life";
CM_ SG_ 1297 RCM_a103_imuPtchR8OffCompNegLife "Restraint control module: a103 imu ptch R8 off comp neg life";
CM_ SG_ 1297 RCM_a103_imuPtchR8OffCompPosFLDC "Restraint control module: a103 imu ptch R8 off comp pos FLDC";
CM_ SG_ 1297 RCM_a103_imuPtchR8OffCompNegFLDC "Restraint control module: a103 imu ptch R8 off comp neg FLDC";
CM_ SG_ 1297 RCM_a103_imuPtchR8OffCompPosSLDC "Restraint control module: a103 imu ptch R8 off comp pos SLDC";
CM_ SG_ 1297 RCM_a103_imuPtchR8OffCompNegSLDC "Restraint control module: a103 imu ptch R8 off comp neg SLDC";
CM_ SG_ 1297 RCM_a103_eventIDFsignal "Restraint control module: a103 event ID fsignal";
CM_ SG_ 1297 RCM_a103_eventFrontLeftSeatbelt "Restraint control module: a103 event front left seatbelt";
CM_ SG_ 1297 RCM_a103_eventFrontRightSeatbelt "Restraint control module: a103 event front right seatbelt";
CM_ SG_ 1297 RCM_a103_eventVehicleSpeed "Restraint control module: a103 event vehicle speed";
CM_ SG_ 1297 RCM_a103_eventSteeringAngle "Restraint control module: a103 event steering angle";
CM_ SG_ 1297 RCM_a103_eventDriverBrakeApply "Restraint control module: a103 event driver brake apply; raw 3 = signal not available (SNA)";
CM_ SG_ 1297 RCM_a103_eventAccelPedalPos "Restraint control module: a103 event accel pedal pos; raw 255 = signal not available (SNA)";
CM_ SG_ 1297 RCM_a104_eventArmStatus "Restraint control module: a104 event arm status";
CM_ SG_ 1297 RCM_a104_eventFactoryMode "Restraint control module: a104 event factory mode";
CM_ SG_ 1297 RCM_a104_eventDiagEnabled "Restraint control module: a104 event diag enabled";
CM_ SG_ 1297 RCM_a104_eventDriveOrientation "Restraint control module: a104 event drive orientation";
CM_ SG_ 1297 RCM_a104_imuRollR8OffCompPosLife "Restraint control module: a104 imu roll R8 off comp pos life";
CM_ SG_ 1297 RCM_a104_imuRollR8OffCompNegLife "Restraint control module: a104 imu roll R8 off comp neg life";
CM_ SG_ 1297 RCM_a104_imuRollR8OffCompPosFLDC "Restraint control module: a104 imu roll R8 off comp pos FLDC";
CM_ SG_ 1297 RCM_a104_imuRollR8OffCompNegFLDC "Restraint control module: a104 imu roll R8 off comp neg FLDC";
CM_ SG_ 1297 RCM_a104_imuRollR8OffCompPosSLDC "Restraint control module: a104 imu roll R8 off comp pos SLDC";
CM_ SG_ 1297 RCM_a104_imuRollR8OffCompNegSLDC "Restraint control module: a104 imu roll R8 off comp neg SLDC";
CM_ SG_ 1297 RCM_a104_eventIDFsignal "Restraint control module: a104 event ID fsignal";
CM_ SG_ 1297 RCM_a104_eventFrontLeftSeatbelt "Restraint control module: a104 event front left seatbelt";
CM_ SG_ 1297 RCM_a104_eventFrontRightSeatbelt "Restraint control module: a104 event front right seatbelt";
CM_ SG_ 1297 RCM_a104_eventVehicleSpeed "Restraint control module: a104 event vehicle speed";
CM_ SG_ 1297 RCM_a104_eventSteeringAngle "Restraint control module: a104 event steering angle";
BA_DEF_ BO_ "GenMsgCycleTime" INT 0 3600000;
BA_DEF_ BO_ "GenMsgSendType" ENUM "Cyclic","NotUsed","NotUsed","NotUsed","NotUsed","NotUsed","NotUsed","IfActive","NoMsgSendType","NotUsed";
BA_DEF_ BO_ "VFrameFormat" ENUM "StandardCAN","ExtendedCAN","reserved","J1939PG","reserved","reserved","reserved","reserved","reserved","reserved","reserved","reserved","reserved","reserved","StandardCAN_FD","ExtendedCAN_FD";
BA_DEF_ BO_ "CANFD_BRS" ENUM "0","1";
BA_DEF_ SG_ "GenSigSNA" STRING;
BA_DEF_ SG_ "SystemSignalLongSymbol" STRING;
BA_DEF_ SG_ "Confidence" ENUM "validated","plausible","layout-only","contradicted";
BA_DEF_DEF_ "GenMsgCycleTime" 0;
BA_DEF_DEF_ "GenMsgSendType" "NoMsgSendType";
BA_DEF_DEF_ "VFrameFormat" "StandardCAN";
BA_DEF_DEF_ "CANFD_BRS" "1";
BA_DEF_DEF_ "GenSigSNA" "";
BA_DEF_DEF_ "SystemSignalLongSymbol" "";
BA_DEF_DEF_ "Confidence" "layout-only";
BA_ "Confidence" SG_ 1297 RCM_a045_eventFrontRightSeatbelt 1;
BA_ "Confidence" SG_ 1297 RCM_a045_eventVehicleSpeed 1;
BA_ "Confidence" SG_ 1297 RCM_a045_eventSteeringAngle 1;
BA_ "Confidence" SG_ 1297 RCM_a045_eventDriverBrakeApply 1;
BA_ "GenSigSNA" SG_ 1297 RCM_a045_eventDriverBrakeApply "3";
BA_ "Confidence" SG_ 1297 RCM_a045_eventAccelPedalPos 1;
BA_ "GenSigSNA" SG_ 1297 RCM_a045_eventAccelPedalPos "255";
BA_ "Confidence" SG_ 1297 RCM_a046_eventArmStatus 1;
BA_ "Confidence" SG_ 1297 RCM_a046_eventFactoryMode 1;
BA_ "Confidence" SG_ 1297 RCM_a046_eventDiagEnabled 1;
BA_ "Confidence" SG_ 1297 RCM_a046_eventDriveOrientation 1;
BA_ "Confidence" SG_ 1297 RCM_a046_eventIDFsignal 1;
BA_ "Confidence" SG_ 1297 RCM_a046_eventFrontLeftSeatbelt 1;
BA_ "Confidence" SG_ 1297 RCM_a046_eventFrontRightSeatbelt 1;
BA_ "Confidence" SG_ 1297 RCM_a046_eventVehicleSpeed 1;
BA_ "Confidence" SG_ 1297 RCM_a046_eventSteeringAngle 1;
BA_ "Confidence" SG_ 1297 RCM_a046_eventDriverBrakeApply 1;
BA_ "GenSigSNA" SG_ 1297 RCM_a046_eventDriverBrakeApply "3";
BA_ "Confidence" SG_ 1297 RCM_a046_eventAccelPedalPos 1;
BA_ "GenSigSNA" SG_ 1297 RCM_a046_eventAccelPedalPos "255";
BA_ "Confidence" SG_ 1297 RCM_a047_eventArmStatus 1;
BA_ "Confidence" SG_ 1297 RCM_a047_eventFactoryMode 1;
BA_ "Confidence" SG_ 1297 RCM_a047_eventDiagEnabled 1;
BA_ "Confidence" SG_ 1297 RCM_a047_eventDriveOrientation 1;
BA_ "Confidence" SG_ 1297 RCM_a047_eventIDFsignal 1;
BA_ "Confidence" SG_ 1297 RCM_a047_eventFrontLeftSeatbelt 1;
BA_ "Confidence" SG_ 1297 RCM_a047_eventFrontRightSeatbelt 1;
BA_ "Confidence" SG_ 1297 RCM_a047_eventVehicleSpeed 1;
BA_ "Confidence" SG_ 1297 RCM_a047_eventSteeringAngle 1;
BA_ "Confidence" SG_ 1297 RCM_a047_eventDriverBrakeApply 1;
BA_ "GenSigSNA" SG_ 1297 RCM_a047_eventDriverBrakeApply "3";
BA_ "Confidence" SG_ 1297 RCM_a047_eventAccelPedalPos 1;
BA_ "GenSigSNA" SG_ 1297 RCM_a047_eventAccelPedalPos "255";
BA_ "Confidence" SG_ 1297 RCM_a048_eventArmStatus 1;
BA_ "Confidence" SG_ 1297 RCM_a048_eventFactoryMode 1;
BA_ "Confidence" SG_ 1297 RCM_a048_eventDiagEnabled 1;
BA_ "Confidence" SG_ 1297 RCM_a048_eventDriveOrientation 1;
BA_ "Confidence" SG_ 1297 RCM_a048_eventIDFsignal 1;
BA_ "Confidence" SG_ 1297 RCM_a048_eventFrontLeftSeatbelt 1;
BA_ "Confidence" SG_ 1297 RCM_a048_eventFrontRightSeatbelt 1;
BA_ "Confidence" SG_ 1297 RCM_a048_eventVehicleSpeed 1;
BA_ "Confidence" SG_ 1297 RCM_a048_eventSteeringAngle 1;
BA_ "Confidence" SG_ 1297 RCM_a048_eventDriverBrakeApply 1;
BA_ "GenSigSNA" SG_ 1297 RCM_a048_eventDriverBrakeApply "3";
BA_ "Confidence" SG_ 1297 RCM_a048_eventAccelPedalPos 1;
BA_ "GenSigSNA" SG_ 1297 RCM_a048_eventAccelPedalPos "255";
BA_ "Confidence" SG_ 1297 RCM_a049_eventArmStatus 1;
BA_ "Confidence" SG_ 1297 RCM_a049_eventFactoryMode 1;
BA_ "Confidence" SG_ 1297 RCM_a049_eventDiagEnabled 1;
BA_ "Confidence" SG_ 1297 RCM_a049_eventDriveOrientation 1;
BA_ "Confidence" SG_ 1297 RCM_a049_eventIDFsignal 1;
BA_ "Confidence" SG_ 1297 RCM_a049_eventFrontLeftSeatbelt 1;
BA_ "Confidence" SG_ 1297 RCM_a049_eventFrontRightSeatbelt 1;
BA_ "Confidence" SG_ 1297 RCM_a049_eventVehicleSpeed 1;
BA_ "Confidence" SG_ 1297 RCM_a049_eventSteeringAngle 1;
BA_ "Confidence" SG_ 1297 RCM_a049_eventDriverBrakeApply 1;
BA_ "GenSigSNA" SG_ 1297 RCM_a049_eventDriverBrakeApply "3";
BA_ "Confidence" SG_ 1297 RCM_a049_eventAccelPedalPos 1;
BA_ "GenSigSNA" SG_ 1297 RCM_a049_eventAccelPedalPos "255";
BA_ "Confidence" SG_ 1297 RCM_a050_eventArmStatus 1;
BA_ "Confidence" SG_ 1297 RCM_a050_eventFactoryMode 1;
BA_ "Confidence" SG_ 1297 RCM_a050_eventDiagEnabled 1;
BA_ "Confidence" SG_ 1297 RCM_a050_eventDriveOrientation 1;
BA_ "Confidence" SG_ 1297 RCM_a050_eventIDFsignal 1;
BA_ "Confidence" SG_ 1297 RCM_a050_eventFrontLeftSeatbelt 1;
BA_ "Confidence" SG_ 1297 RCM_a050_eventFrontRightSeatbelt 1;
BA_ "Confidence" SG_ 1297 RCM_a050_eventVehicleSpeed 1;
BA_ "Confidence" SG_ 1297 RCM_a050_eventSteeringAngle 1;
BA_ "Confidence" SG_ 1297 RCM_a050_eventDriverBrakeApply 1;
BA_ "GenSigSNA" SG_ 1297 RCM_a050_eventDriverBrakeApply "3";
BA_ "Confidence" SG_ 1297 RCM_a050_eventAccelPedalPos 1;
BA_ "GenSigSNA" SG_ 1297 RCM_a050_eventAccelPedalPos "255";
BA_ "Confidence" SG_ 1297 RCM_a051_eventArmStatus 1;
BA_ "Confidence" SG_ 1297 RCM_a051_eventFactoryMode 1;
BA_ "Confidence" SG_ 1297 RCM_a051_eventDiagEnabled 1;
BA_ "Confidence" SG_ 1297 RCM_a051_eventDriveOrientation 1;
BA_ "Confidence" SG_ 1297 RCM_a051_eventIDFsignal 1;
BA_ "Confidence" SG_ 1297 RCM_a051_eventFrontLeftSeatbelt 1;
BA_ "Confidence" SG_ 1297 RCM_a051_eventFrontRightSeatbelt 1;
BA_ "Confidence" SG_ 1297 RCM_a051_eventVehicleSpeed 1;
BA_ "Confidence" SG_ 1297 RCM_a051_eventSteeringAngle 1;
BA_ "Confidence" SG_ 1297 RCM_a051_eventDriverBrakeApply 1;
BA_ "GenSigSNA" SG_ 1297 RCM_a051_eventDriverBrakeApply "3";
BA_ "Confidence" SG_ 1297 RCM_a051_eventAccelPedalPos 1;
BA_ "GenSigSNA" SG_ 1297 RCM_a051_eventAccelPedalPos "255";
BA_ "Confidence" SG_ 1297 RCM_a052_eventArmStatus 1;
BA_ "Confidence" SG_ 1297 RCM_a052_eventFactoryMode 1;
BA_ "Confidence" SG_ 1297 RCM_a052_eventDiagEnabled 1;
BA_ "Confidence" SG_ 1297 RCM_a052_eventDriveOrientation 1;
BA_ "Confidence" SG_ 1297 RCM_a052_eventIDFsignal 1;
BA_ "Confidence" SG_ 1297 RCM_a052_eventFrontLeftSeatbelt 1;
BA_ "Confidence" SG_ 1297 RCM_a052_eventFrontRightSeatbelt 1;
BA_ "Confidence" SG_ 1297 RCM_a052_eventVehicleSpeed 1;
BA_ "Confidence" SG_ 1297 RCM_a052_eventSteeringAngle 1;
BA_ "Confidence" SG_ 1297 RCM_a052_eventDriverBrakeApply 1;
BA_ "GenSigSNA" SG_ 1297 RCM_a052_eventDriverBrakeApply "3";
BA_ "Confidence" SG_ 1297 RCM_a052_eventAccelPedalPos 1;
BA_ "GenSigSNA" SG_ 1297 RCM_a052_eventAccelPedalPos "255";
BA_ "Confidence" SG_ 1297 RCM_a053_eventArmStatus 1;
BA_ "Confidence" SG_ 1297 RCM_a053_eventFactoryMode 1;
BA_ "Confidence" SG_ 1297 RCM_a053_eventDiagEnabled 1;
BA_ "Confidence" SG_ 1297 RCM_a053_eventDriveOrientation 1;
BA_ "Confidence" SG_ 1297 RCM_a053_eventIDFsignal 1;
BA_ "Confidence" SG_ 1297 RCM_a053_eventFrontLeftSeatbelt 1;
BA_ "Confidence" SG_ 1297 RCM_a053_eventFrontRightSeatbelt 1;
BA_ "Confidence" SG_ 1297 RCM_a053_eventVehicleSpeed 1;
BA_ "Confidence" SG_ 1297 RCM_a053_eventSteeringAngle 1;
BA_ "Confidence" SG_ 1297 RCM_a053_eventDriverBrakeApply 1;
BA_ "GenSigSNA" SG_ 1297 RCM_a053_eventDriverBrakeApply "3";
BA_ "Confidence" SG_ 1297 RCM_a053_eventAccelPedalPos 1;
BA_ "GenSigSNA" SG_ 1297 RCM_a053_eventAccelPedalPos "255";
BA_ "Confidence" SG_ 1297 RCM_a054_eventArmStatus 1;
BA_ "Confidence" SG_ 1297 RCM_a054_eventFactoryMode 1;
BA_ "Confidence" SG_ 1297 RCM_a054_eventDiagEnabled 1;
BA_ "Confidence" SG_ 1297 RCM_a054_eventDriveOrientation 1;
BA_ "Confidence" SG_ 1297 RCM_a054_eventIDFsignal 1;
BA_ "Confidence" SG_ 1297 RCM_a054_eventFrontLeftSeatbelt 1;
BA_ "Confidence" SG_ 1297 RCM_a054_eventFrontRightSeatbelt 1;
BA_ "Confidence" SG_ 1297 RCM_a054_eventVehicleSpeed 1;
BA_ "Confidence" SG_ 1297 RCM_a054_eventSteeringAngle 1;
BA_ "Confidence" SG_ 1297 RCM_a054_eventDriverBrakeApply 1;
BA_ "GenSigSNA" SG_ 1297 RCM_a054_eventDriverBrakeApply "3";
BA_ "Confidence" SG_ 1297 RCM_a054_eventAccelPedalPos 1;
BA_ "GenSigSNA" SG_ 1297 RCM_a054_eventAccelPedalPos "255";
BA_ "Confidence" SG_ 1297 RCM_a055_eventArmStatus 1;
BA_ "Confidence" SG_ 1297 RCM_a055_eventFactoryMode 1;
BA_ "Confidence" SG_ 1297 RCM_a055_eventDiagEnabled 1;
BA_ "Confidence" SG_ 1297 RCM_a055_eventDriveOrientation 1;
BA_ "Confidence" SG_ 1297 RCM_a055_eventIDFsignal 1;
BA_ "Confidence" SG_ 1297 RCM_a055_eventFrontLeftSeatbelt 1;
BA_ "Confidence" SG_ 1297 RCM_a055_eventFrontRightSeatbelt 1;
BA_ "Confidence" SG_ 1297 RCM_a055_eventVehicleSpeed 1;
BA_ "Confidence" SG_ 1297 RCM_a055_eventSteeringAngle 1;
BA_ "Confidence" SG_ 1297 RCM_a055_eventDriverBrakeApply 1;
BA_ "GenSigSNA" SG_ 1297 RCM_a055_eventDriverBrakeApply "3";
BA_ "Confidence" SG_ 1297 RCM_a055_eventAccelPedalPos 1;
BA_ "GenSigSNA" SG_ 1297 RCM_a055_eventAccelPedalPos "255";
BA_ "Confidence" SG_ 1297 RCM_a056_eventArmStatus 1;
BA_ "Confidence" SG_ 1297 RCM_a056_eventFactoryMode 1;
BA_ "Confidence" SG_ 1297 RCM_a056_eventDiagEnabled 1;
BA_ "Confidence" SG_ 1297 RCM_a056_eventDriveOrientation 1;
BA_ "Confidence" SG_ 1297 RCM_a056_eventIDFsignal 1;
BA_ "Confidence" SG_ 1297 RCM_a056_eventFrontLeftSeatbelt 1;
BA_ "Confidence" SG_ 1297 RCM_a056_eventFrontRightSeatbelt 1;
BA_ "Confidence" SG_ 1297 RCM_a056_eventVehicleSpeed 1;
BA_ "Confidence" SG_ 1297 RCM_a056_eventSteeringAngle 1;
BA_ "Confidence" SG_ 1297 RCM_a056_eventDriverBrakeApply 1;
BA_ "GenSigSNA" SG_ 1297 RCM_a056_eventDriverBrakeApply "3";
BA_ "Confidence" SG_ 1297 RCM_a056_eventAccelPedalPos 1;
BA_ "GenSigSNA" SG_ 1297 RCM_a056_eventAccelPedalPos "255";
BA_ "Confidence" SG_ 1297 RCM_a057_eventArmStatus 1;
BA_ "Confidence" SG_ 1297 RCM_a057_eventFactoryMode 1;
BA_ "Confidence" SG_ 1297 RCM_a057_eventDiagEnabled 1;
BA_ "Confidence" SG_ 1297 RCM_a057_eventDriveOrientation 1;
BA_ "Confidence" SG_ 1297 RCM_a057_eventIDFsignal 1;
BA_ "Confidence" SG_ 1297 RCM_a057_eventFrontLeftSeatbelt 1;
BA_ "Confidence" SG_ 1297 RCM_a057_eventFrontRightSeatbelt 1;
BA_ "Confidence" SG_ 1297 RCM_a057_eventVehicleSpeed 1;
BA_ "Confidence" SG_ 1297 RCM_a057_eventSteeringAngle 1;
BA_ "Confidence" SG_ 1297 RCM_a057_eventDriverBrakeApply 1;
BA_ "GenSigSNA" SG_ 1297 RCM_a057_eventDriverBrakeApply "3";
BA_ "Confidence" SG_ 1297 RCM_a057_eventAccelPedalPos 1;
BA_ "GenSigSNA" SG_ 1297 RCM_a057_eventAccelPedalPos "255";
BA_ "Confidence" SG_ 1297 RCM_a058_eventArmStatus 1;
BA_ "Confidence" SG_ 1297 RCM_a058_eventFactoryMode 1;
BA_ "Confidence" SG_ 1297 RCM_a058_eventDiagEnabled 1;
BA_ "Confidence" SG_ 1297 RCM_a058_eventDriveOrientation 1;
BA_ "Confidence" SG_ 1297 RCM_a058_eventIDFsignal 1;
BA_ "Confidence" SG_ 1297 RCM_a058_eventFrontLeftSeatbelt 1;
BA_ "Confidence" SG_ 1297 RCM_a058_eventFrontRightSeatbelt 1;
BA_ "Confidence" SG_ 1297 RCM_a058_eventVehicleSpeed 1;
BA_ "Confidence" SG_ 1297 RCM_a058_eventSteeringAngle 1;
BA_ "Confidence" SG_ 1297 RCM_a058_eventDriverBrakeApply 1;
BA_ "GenSigSNA" SG_ 1297 RCM_a058_eventDriverBrakeApply "3";
BA_ "Confidence" SG_ 1297 RCM_a058_eventAccelPedalPos 1;
BA_ "GenSigSNA" SG_ 1297 RCM_a058_eventAccelPedalPos "255";
BA_ "Confidence" SG_ 1297 RCM_a059_eventArmStatus 1;
BA_ "Confidence" SG_ 1297 RCM_a059_eventFactoryMode 1;
BA_ "Confidence" SG_ 1297 RCM_a059_eventDiagEnabled 1;
BA_ "Confidence" SG_ 1297 RCM_a059_eventDriveOrientation 1;
BA_ "Confidence" SG_ 1297 RCM_a059_eventIDFsignal 1;
BA_ "Confidence" SG_ 1297 RCM_a059_eventFrontLeftSeatbelt 1;
BA_ "Confidence" SG_ 1297 RCM_a059_eventFrontRightSeatbelt 1;
BA_ "Confidence" SG_ 1297 RCM_a059_eventVehicleSpeed 1;
BA_ "Confidence" SG_ 1297 RCM_a059_eventSteeringAngle 1;
BA_ "Confidence" SG_ 1297 RCM_a059_eventDriverBrakeApply 1;
BA_ "GenSigSNA" SG_ 1297 RCM_a059_eventDriverBrakeApply "3";
BA_ "Confidence" SG_ 1297 RCM_a059_eventAccelPedalPos 1;
BA_ "GenSigSNA" SG_ 1297 RCM_a059_eventAccelPedalPos "255";
BA_ "Confidence" SG_ 1297 RCM_a060_eventArmStatus 1;
BA_ "Confidence" SG_ 1297 RCM_a060_eventFactoryMode 1;
BA_ "Confidence" SG_ 1297 RCM_a060_eventDiagEnabled 1;
BA_ "Confidence" SG_ 1297 RCM_a060_eventDriveOrientation 1;
BA_ "Confidence" SG_ 1297 RCM_a060_eventIDFsignal 1;
BA_ "Confidence" SG_ 1297 RCM_a060_eventFrontLeftSeatbelt 1;
BA_ "Confidence" SG_ 1297 RCM_a060_eventFrontRightSeatbelt 1;
BA_ "Confidence" SG_ 1297 RCM_a060_eventVehicleSpeed 1;
BA_ "Confidence" SG_ 1297 RCM_a060_eventSteeringAngle 1;
BA_ "Confidence" SG_ 1297 RCM_a060_eventDriverBrakeApply 1;
BA_ "GenSigSNA" SG_ 1297 RCM_a060_eventDriverBrakeApply "3";
BA_ "Confidence" SG_ 1297 RCM_a060_eventAccelPedalPos 1;
BA_ "GenSigSNA" SG_ 1297 RCM_a060_eventAccelPedalPos "255";
BA_ "Confidence" SG_ 1297 RCM_a061_eventArmStatus 1;
BA_ "Confidence" SG_ 1297 RCM_a061_eventFactoryMode 1;
BA_ "Confidence" SG_ 1297 RCM_a061_eventDiagEnabled 1;
BA_ "Confidence" SG_ 1297 RCM_a061_eventDriveOrientation 1;
BA_ "Confidence" SG_ 1297 RCM_a061_eventIDFsignal 1;
BA_ "Confidence" SG_ 1297 RCM_a061_eventFrontLeftSeatbelt 1;
BA_ "Confidence" SG_ 1297 RCM_a061_eventFrontRightSeatbelt 1;
BA_ "Confidence" SG_ 1297 RCM_a061_eventVehicleSpeed 1;
BA_ "Confidence" SG_ 1297 RCM_a061_eventSteeringAngle 1;
BA_ "Confidence" SG_ 1297 RCM_a061_eventDriverBrakeApply 1;
BA_ "GenSigSNA" SG_ 1297 RCM_a061_eventDriverBrakeApply "3";
BA_ "Confidence" SG_ 1297 RCM_a061_eventAccelPedalPos 1;
BA_ "GenSigSNA" SG_ 1297 RCM_a061_eventAccelPedalPos "255";
BA_ "Confidence" SG_ 1297 RCM_a062_eventArmStatus 1;
BA_ "Confidence" SG_ 1297 RCM_a062_eventFactoryMode 1;
BA_ "Confidence" SG_ 1297 RCM_a062_eventDiagEnabled 1;
BA_ "Confidence" SG_ 1297 RCM_a062_eventDriveOrientation 1;
BA_ "Confidence" SG_ 1297 RCM_a062_eventIDFsignal 1;
BA_ "Confidence" SG_ 1297 RCM_a062_eventFrontLeftSeatbelt 1;
BA_ "Confidence" SG_ 1297 RCM_a062_eventFrontRightSeatbelt 1;
BA_ "Confidence" SG_ 1297 RCM_a062_eventVehicleSpeed 1;
BA_ "Confidence" SG_ 1297 RCM_a062_eventSteeringAngle 1;
BA_ "Confidence" SG_ 1297 RCM_a062_eventDriverBrakeApply 1;
BA_ "GenSigSNA" SG_ 1297 RCM_a062_eventDriverBrakeApply "3";
BA_ "Confidence" SG_ 1297 RCM_a062_eventAccelPedalPos 1;
BA_ "GenSigSNA" SG_ 1297 RCM_a062_eventAccelPedalPos "255";
BA_ "Confidence" SG_ 1297 RCM_a063_eventArmStatus 1;
BA_ "Confidence" SG_ 1297 RCM_a063_eventFactoryMode 1;
BA_ "Confidence" SG_ 1297 RCM_a063_eventDiagEnabled 1;
BA_ "Confidence" SG_ 1297 RCM_a063_eventDriveOrientation 1;
BA_ "Confidence" SG_ 1297 RCM_a063_eventIDFsignal 1;
BA_ "Confidence" SG_ 1297 RCM_a063_eventFrontLeftSeatbelt 1;
BA_ "Confidence" SG_ 1297 RCM_a063_eventFrontRightSeatbelt 1;
BA_ "Confidence" SG_ 1297 RCM_a063_eventVehicleSpeed 1;
BA_ "Confidence" SG_ 1297 RCM_a063_eventSteeringAngle 1;
BA_ "Confidence" SG_ 1297 RCM_a063_eventDriverBrakeApply 1;
BA_ "GenSigSNA" SG_ 1297 RCM_a063_eventDriverBrakeApply "3";
BA_ "Confidence" SG_ 1297 RCM_a063_eventAccelPedalPos 1;
BA_ "GenSigSNA" SG_ 1297 RCM_a063_eventAccelPedalPos "255";
BA_ "Confidence" SG_ 1297 RCM_a064_eventArmStatus 1;
BA_ "Confidence" SG_ 1297 RCM_a064_eventFactoryMode 1;
BA_ "Confidence" SG_ 1297 RCM_a064_eventDiagEnabled 1;
BA_ "Confidence" SG_ 1297 RCM_a064_eventDriveOrientation 1;
BA_ "Confidence" SG_ 1297 RCM_a064_eventIDFsignal 1;
BA_ "Confidence" SG_ 1297 RCM_a064_eventFrontLeftSeatbelt 1;
BA_ "Confidence" SG_ 1297 RCM_a064_eventFrontRightSeatbelt 1;
BA_ "Confidence" SG_ 1297 RCM_a064_eventVehicleSpeed 1;
BA_ "Confidence" SG_ 1297 RCM_a064_eventSteeringAngle 1;
BA_ "Confidence" SG_ 1297 RCM_a064_eventDriverBrakeApply 1;
BA_ "GenSigSNA" SG_ 1297 RCM_a064_eventDriverBrakeApply "3";
BA_ "Confidence" SG_ 1297 RCM_a064_eventAccelPedalPos 1;
BA_ "GenSigSNA" SG_ 1297 RCM_a064_eventAccelPedalPos "255";
BA_ "Confidence" SG_ 1297 RCM_a065_eventArmStatus 1;
BA_ "Confidence" SG_ 1297 RCM_a065_eventFactoryMode 1;
BA_ "Confidence" SG_ 1297 RCM_a065_eventDiagEnabled 1;
BA_ "Confidence" SG_ 1297 RCM_a065_eventDriveOrientation 1;
BA_ "Confidence" SG_ 1297 RCM_a065_eventIDFsignal 1;
BA_ "Confidence" SG_ 1297 RCM_a065_eventFrontLeftSeatbelt 1;
BA_ "Confidence" SG_ 1297 RCM_a065_eventFrontRightSeatbelt 1;
BA_ "Confidence" SG_ 1297 RCM_a065_eventVehicleSpeed 1;
BA_ "Confidence" SG_ 1297 RCM_a065_eventSteeringAngle 1;
BA_ "Confidence" SG_ 1297 RCM_a065_eventDriverBrakeApply 1;
BA_ "GenSigSNA" SG_ 1297 RCM_a065_eventDriverBrakeApply "3";
BA_ "Confidence" SG_ 1297 RCM_a065_eventAccelPedalPos 1;
BA_ "GenSigSNA" SG_ 1297 RCM_a065_eventAccelPedalPos "255";
BA_ "Confidence" SG_ 1297 RCM_a066_eventArmStatus 1;
BA_ "Confidence" SG_ 1297 RCM_a066_eventFactoryMode 1;
BA_ "Confidence" SG_ 1297 RCM_a066_eventDiagEnabled 1;
BA_ "Confidence" SG_ 1297 RCM_a066_eventDriveOrientation 1;
BA_ "Confidence" SG_ 1297 RCM_a066_eventIDFsignal 1;
BA_ "Confidence" SG_ 1297 RCM_a066_eventFrontLeftSeatbelt 1;
BA_ "Confidence" SG_ 1297 RCM_a066_eventFrontRightSeatbelt 1;
BA_ "Confidence" SG_ 1297 RCM_a066_eventVehicleSpeed 1;
BA_ "Confidence" SG_ 1297 RCM_a066_eventSteeringAngle 1;
BA_ "Confidence" SG_ 1297 RCM_a066_eventDriverBrakeApply 1;
BA_ "GenSigSNA" SG_ 1297 RCM_a066_eventDriverBrakeApply "3";
BA_ "Confidence" SG_ 1297 RCM_a066_eventAccelPedalPos 1;
BA_ "GenSigSNA" SG_ 1297 RCM_a066_eventAccelPedalPos "255";
BA_ "Confidence" SG_ 1297 RCM_a067_eventArmStatus 1;
BA_ "Confidence" SG_ 1297 RCM_a067_eventFactoryMode 1;
BA_ "Confidence" SG_ 1297 RCM_a067_eventDiagEnabled 1;
BA_ "Confidence" SG_ 1297 RCM_a067_eventDriveOrientation 1;
BA_ "Confidence" SG_ 1297 RCM_a067_eventIDFsignal 1;
BA_ "Confidence" SG_ 1297 RCM_a067_eventFrontLeftSeatbelt 1;
BA_ "Confidence" SG_ 1297 RCM_a067_eventFrontRightSeatbelt 1;
BA_ "Confidence" SG_ 1297 RCM_a067_eventVehicleSpeed 1;
BA_ "Confidence" SG_ 1297 RCM_a067_eventSteeringAngle 1;
BA_ "Confidence" SG_ 1297 RCM_a067_eventDriverBrakeApply 1;
BA_ "GenSigSNA" SG_ 1297 RCM_a067_eventDriverBrakeApply "3";
BA_ "Confidence" SG_ 1297 RCM_a067_eventAccelPedalPos 1;
BA_ "GenSigSNA" SG_ 1297 RCM_a067_eventAccelPedalPos "255";
BA_ "Confidence" SG_ 1297 RCM_a068_eventArmStatus 1;
BA_ "Confidence" SG_ 1297 RCM_a068_eventFactoryMode 1;
BA_ "Confidence" SG_ 1297 RCM_a068_eventDiagEnabled 1;
BA_ "Confidence" SG_ 1297 RCM_a068_eventDriveOrientation 1;
BA_ "Confidence" SG_ 1297 RCM_a068_eventIDFsignal 1;
BA_ "Confidence" SG_ 1297 RCM_a068_eventFrontLeftSeatbelt 1;
BA_ "Confidence" SG_ 1297 RCM_a068_eventFrontRightSeatbelt 1;
BA_ "Confidence" SG_ 1297 RCM_a068_eventVehicleSpeed 1;
BA_ "Confidence" SG_ 1297 RCM_a068_eventSteeringAngle 1;
BA_ "Confidence" SG_ 1297 RCM_a068_eventDriverBrakeApply 1;
BA_ "GenSigSNA" SG_ 1297 RCM_a068_eventDriverBrakeApply "3";
BA_ "Confidence" SG_ 1297 RCM_a068_eventAccelPedalPos 1;
BA_ "GenSigSNA" SG_ 1297 RCM_a068_eventAccelPedalPos "255";
BA_ "Confidence" SG_ 1297 RCM_a069_eventArmStatus 1;
BA_ "Confidence" SG_ 1297 RCM_a069_eventFactoryMode 1;
BA_ "Confidence" SG_ 1297 RCM_a069_eventDiagEnabled 1;
BA_ "Confidence" SG_ 1297 RCM_a069_eventDriveOrientation 1;
BA_ "Confidence" SG_ 1297 RCM_a069_eventIDFsignal 1;
BA_ "Confidence" SG_ 1297 RCM_a069_eventFrontLeftSeatbelt 1;
BA_ "Confidence" SG_ 1297 RCM_a069_eventFrontRightSeatbelt 1;
BA_ "Confidence" SG_ 1297 RCM_a069_eventVehicleSpeed 1;
BA_ "Confidence" SG_ 1297 RCM_a069_eventSteeringAngle 1;
BA_ "Confidence" SG_ 1297 RCM_a069_eventDriverBrakeApply 1;
BA_ "GenSigSNA" SG_ 1297 RCM_a069_eventDriverBrakeApply "3";
BA_ "Confidence" SG_ 1297 RCM_a069_eventAccelPedalPos 1;
BA_ "GenSigSNA" SG_ 1297 RCM_a069_eventAccelPedalPos "255";
BA_ "Confidence" SG_ 1297 RCM_a070_eventArmStatus 1;
BA_ "Confidence" SG_ 1297 RCM_a070_eventFactoryMode 1;
BA_ "Confidence" SG_ 1297 RCM_a070_eventDiagEnabled 1;
BA_ "Confidence" SG_ 1297 RCM_a070_eventDriveOrientation 1;
BA_ "Confidence" SG_ 1297 RCM_a070_eventIDFsignal 1;
BA_ "Confidence" SG_ 1297 RCM_a070_eventFrontLeftSeatbelt 1;
BA_ "Confidence" SG_ 1297 RCM_a070_eventFrontRightSeatbelt 1;
BA_ "Confidence" SG_ 1297 RCM_a070_eventVehicleSpeed 1;
BA_ "Confidence" SG_ 1297 RCM_a070_eventSteeringAngle 1;
BA_ "Confidence" SG_ 1297 RCM_a070_eventDriverBrakeApply 1;
BA_ "GenSigSNA" SG_ 1297 RCM_a070_eventDriverBrakeApply "3";
BA_ "Confidence" SG_ 1297 RCM_a070_eventAccelPedalPos 1;
BA_ "GenSigSNA" SG_ 1297 RCM_a070_eventAccelPedalPos "255";
BA_ "Confidence" SG_ 1297 RCM_a071_eventArmStatus 1;
BA_ "Confidence" SG_ 1297 RCM_a071_eventFactoryMode 1;
BA_ "Confidence" SG_ 1297 RCM_a071_eventDiagEnabled 1;
BA_ "Confidence" SG_ 1297 RCM_a071_eventDriveOrientation 1;
BA_ "Confidence" SG_ 1297 RCM_a071_eventIDFsignal 1;
BA_ "Confidence" SG_ 1297 RCM_a071_eventFrontLeftSeatbelt 1;
BA_ "Confidence" SG_ 1297 RCM_a071_eventFrontRightSeatbelt 1;
BA_ "Confidence" SG_ 1297 RCM_a071_eventVehicleSpeed 1;
BA_ "Confidence" SG_ 1297 RCM_a071_eventSteeringAngle 1;
BA_ "Confidence" SG_ 1297 RCM_a071_eventDriverBrakeApply 1;
BA_ "GenSigSNA" SG_ 1297 RCM_a071_eventDriverBrakeApply "3";
BA_ "Confidence" SG_ 1297 RCM_a071_eventAccelPedalPos 1;
BA_ "GenSigSNA" SG_ 1297 RCM_a071_eventAccelPedalPos "255";
BA_ "Confidence" SG_ 1297 RCM_a072_eventArmStatus 1;
BA_ "Confidence" SG_ 1297 RCM_a072_eventFactoryMode 1;
BA_ "Confidence" SG_ 1297 RCM_a072_eventDiagEnabled 1;
BA_ "Confidence" SG_ 1297 RCM_a072_eventDriveOrientation 1;
BA_ "Confidence" SG_ 1297 RCM_a072_eventIDFsignal 1;
BA_ "Confidence" SG_ 1297 RCM_a072_eventFrontLeftSeatbelt 1;
BA_ "Confidence" SG_ 1297 RCM_a072_eventFrontRightSeatbelt 1;
BA_ "Confidence" SG_ 1297 RCM_a072_eventVehicleSpeed 1;
BA_ "Confidence" SG_ 1297 RCM_a072_eventSteeringAngle 1;
BA_ "Confidence" SG_ 1297 RCM_a072_eventDriverBrakeApply 1;
BA_ "GenSigSNA" SG_ 1297 RCM_a072_eventDriverBrakeApply "3";
BA_ "Confidence" SG_ 1297 RCM_a072_eventAccelPedalPos 1;
BA_ "GenSigSNA" SG_ 1297 RCM_a072_eventAccelPedalPos "255";
BA_ "Confidence" SG_ 1297 RCM_a073_eventArmStatus 1;
BA_ "Confidence" SG_ 1297 RCM_a073_eventFactoryMode 1;
BA_ "Confidence" SG_ 1297 RCM_a073_eventDiagEnabled 1;
BA_ "Confidence" SG_ 1297 RCM_a073_eventDriveOrientation 1;
BA_ "Confidence" SG_ 1297 RCM_a073_eventIDFsignal 1;
BA_ "Confidence" SG_ 1297 RCM_a073_eventFrontLeftSeatbelt 1;
BA_ "Confidence" SG_ 1297 RCM_a073_eventFrontRightSeatbelt 1;
BA_ "Confidence" SG_ 1297 RCM_a073_eventVehicleSpeed 1;
BA_ "Confidence" SG_ 1297 RCM_a073_eventSteeringAngle 1;
BA_ "Confidence" SG_ 1297 RCM_a073_eventDriverBrakeApply 1;
BA_ "GenSigSNA" SG_ 1297 RCM_a073_eventDriverBrakeApply "3";
BA_ "Confidence" SG_ 1297 RCM_a073_eventAccelPedalPos 1;
BA_ "GenSigSNA" SG_ 1297 RCM_a073_eventAccelPedalPos "255";
BA_ "Confidence" SG_ 1297 RCM_a074_eventArmStatus 1;
BA_ "Confidence" SG_ 1297 RCM_a074_eventFactoryMode 1;
BA_ "Confidence" SG_ 1297 RCM_a074_eventDiagEnabled 1;
BA_ "Confidence" SG_ 1297 RCM_a074_eventDriveOrientation 1;
BA_ "Confidence" SG_ 1297 RCM_a074_eventIDFsignal 1;
BA_ "Confidence" SG_ 1297 RCM_a074_eventFrontLeftSeatbelt 1;
BA_ "Confidence" SG_ 1297 RCM_a074_eventFrontRightSeatbelt 1;
BA_ "Confidence" SG_ 1297 RCM_a074_eventVehicleSpeed 1;
BA_ "Confidence" SG_ 1297 RCM_a074_eventSteeringAngle 1;
BA_ "Confidence" SG_ 1297 RCM_a074_eventDriverBrakeApply 1;
BA_ "GenSigSNA" SG_ 1297 RCM_a074_eventDriverBrakeApply "3";
BA_ "Confidence" SG_ 1297 RCM_a074_eventAccelPedalPos 1;
BA_ "GenSigSNA" SG_ 1297 RCM_a074_eventAccelPedalPos "255";
BA_ "Confidence" SG_ 1297 RCM_a075_eventArmStatus 1;
BA_ "Confidence" SG_ 1297 RCM_a075_eventFactoryMode 1;
BA_ "Confidence" SG_ 1297 RCM_a075_eventDiagEnabled 1;
BA_ "Confidence" SG_ 1297 RCM_a075_eventDriveOrientation 1;
BA_ "Confidence" SG_ 1297 RCM_a075_eventIDFsignal 1;
BA_ "Confidence" SG_ 1297 RCM_a075_eventFrontLeftSeatbelt 1;
BA_ "Confidence" SG_ 1297 RCM_a075_eventFrontRightSeatbelt 1;
BA_ "Confidence" SG_ 1297 RCM_a075_eventVehicleSpeed 1;
BA_ "Confidence" SG_ 1297 RCM_a075_eventSteeringAngle 1;
BA_ "Confidence" SG_ 1297 RCM_a075_eventDriverBrakeApply 1;
BA_ "GenSigSNA" SG_ 1297 RCM_a075_eventDriverBrakeApply "3";
BA_ "Confidence" SG_ 1297 RCM_a075_eventAccelPedalPos 1;
BA_ "GenSigSNA" SG_ 1297 RCM_a075_eventAccelPedalPos "255";
BA_ "Confidence" SG_ 1297 RCM_a078_eventArmStatus 1;
BA_ "Confidence" SG_ 1297 RCM_a078_eventFactoryMode 1;
BA_ "Confidence" SG_ 1297 RCM_a078_eventDiagEnabled 1;
BA_ "Confidence" SG_ 1297 RCM_a078_eventDriveOrientation 1;
BA_ "Confidence" SG_ 1297 RCM_a078_eventIDFsignal 1;
BA_ "Confidence" SG_ 1297 RCM_a078_eventFrontLeftSeatbelt 1;
BA_ "Confidence" SG_ 1297 RCM_a078_eventFrontRightSeatbelt 1;
BA_ "Confidence" SG_ 1297 RCM_a078_eventVehicleSpeed 1;
BA_ "Confidence" SG_ 1297 RCM_a078_eventSteeringAngle 1;
BA_ "Confidence" SG_ 1297 RCM_a078_eventDriverBrakeApply 1;
BA_ "GenSigSNA" SG_ 1297 RCM_a078_eventDriverBrakeApply "3";
BA_ "Confidence" SG_ 1297 RCM_a078_eventAccelPedalPos 1;
BA_ "GenSigSNA" SG_ 1297 RCM_a078_eventAccelPedalPos "255";
BA_ "Confidence" SG_ 1297 RCM_a079_eventArmStatus 1;
BA_ "Confidence" SG_ 1297 RCM_a079_eventFactoryMode 1;
BA_ "Confidence" SG_ 1297 RCM_a079_eventDiagEnabled 1;
BA_ "Confidence" SG_ 1297 RCM_a079_eventDriveOrientation 1;
BA_ "Confidence" SG_ 1297 RCM_a079_eventIDFsignal 1;
BA_ "Confidence" SG_ 1297 RCM_a079_eventFrontLeftSeatbelt 1;
BA_ "Confidence" SG_ 1297 RCM_a079_eventFrontRightSeatbelt 1;
BA_ "Confidence" SG_ 1297 RCM_a079_eventVehicleSpeed 1;
BA_ "Confidence" SG_ 1297 RCM_a079_eventSteeringAngle 1;
BA_ "Confidence" SG_ 1297 RCM_a079_eventDriverBrakeApply 1;
BA_ "GenSigSNA" SG_ 1297 RCM_a079_eventDriverBrakeApply "3";
BA_ "Confidence" SG_ 1297 RCM_a079_eventAccelPedalPos 1;
BA_ "GenSigSNA" SG_ 1297 RCM_a079_eventAccelPedalPos "255";
BA_ "Confidence" SG_ 1297 RCM_a080_eventArmStatus 1;
BA_ "Confidence" SG_ 1297 RCM_a080_eventFactoryMode 1;
BA_ "Confidence" SG_ 1297 RCM_a080_eventDiagEnabled 1;
BA_ "Confidence" SG_ 1297 RCM_a080_eventDriveOrientation 1;
BA_ "Confidence" SG_ 1297 RCM_a080_eventIDFsignal 1;
BA_ "Confidence" SG_ 1297 RCM_a080_eventFrontLeftSeatbelt 1;
BA_ "Confidence" SG_ 1297 RCM_a080_eventFrontRightSeatbelt 1;
BA_ "Confidence" SG_ 1297 RCM_a080_eventVehicleSpeed 1;
BA_ "Confidence" SG_ 1297 RCM_a080_eventSteeringAngle 1;
BA_ "Confidence" SG_ 1297 RCM_a080_eventDriverBrakeApply 1;
BA_ "GenSigSNA" SG_ 1297 RCM_a080_eventDriverBrakeApply "3";
BA_ "Confidence" SG_ 1297 RCM_a080_eventAccelPedalPos 1;
BA_ "GenSigSNA" SG_ 1297 RCM_a080_eventAccelPedalPos "255";
BA_ "Confidence" SG_ 1297 RCM_a083_eventArmStatus 1;
BA_ "Confidence" SG_ 1297 RCM_a083_eventFactoryMode 1;
BA_ "Confidence" SG_ 1297 RCM_a083_eventDiagEnabled 1;
BA_ "Confidence" SG_ 1297 RCM_a083_eventDriveOrientation 1;
BA_ "Confidence" SG_ 1297 RCM_a083_eventIDFsignal 1;
BA_ "Confidence" SG_ 1297 RCM_a083_eventFrontLeftSeatbelt 1;
BA_ "Confidence" SG_ 1297 RCM_a083_eventFrontRightSeatbelt 1;
BA_ "Confidence" SG_ 1297 RCM_a083_eventVehicleSpeed 1;
BA_ "Confidence" SG_ 1297 RCM_a083_eventSteeringAngle 1;
BA_ "Confidence" SG_ 1297 RCM_a083_eventDriverBrakeApply 1;
BA_ "GenSigSNA" SG_ 1297 RCM_a083_eventDriverBrakeApply "3";
BA_ "Confidence" SG_ 1297 RCM_a083_eventAccelPedalPos 1;
BA_ "GenSigSNA" SG_ 1297 RCM_a083_eventAccelPedalPos "255";
BA_ "Confidence" SG_ 1297 RCM_a087_eventArmStatus 1;
BA_ "Confidence" SG_ 1297 RCM_a087_eventFactoryMode 1;
BA_ "Confidence" SG_ 1297 RCM_a087_eventDiagEnabled 1;
BA_ "Confidence" SG_ 1297 RCM_a087_eventDriveOrientation 1;
BA_ "Confidence" SG_ 1297 RCM_a087_eventIDFsignal 1;
BA_ "Confidence" SG_ 1297 RCM_a087_eventFrontLeftSeatbelt 1;
BA_ "Confidence" SG_ 1297 RCM_a087_eventFrontRightSeatbelt 1;
BA_ "Confidence" SG_ 1297 RCM_a087_eventVehicleSpeed 1;
BA_ "Confidence" SG_ 1297 RCM_a087_eventSteeringAngle 1;
BA_ "Confidence" SG_ 1297 RCM_a087_eventDriverBrakeApply 1;
BA_ "GenSigSNA" SG_ 1297 RCM_a087_eventDriverBrakeApply "3";
BA_ "Confidence" SG_ 1297 RCM_a087_eventAccelPedalPos 1;
BA_ "GenSigSNA" SG_ 1297 RCM_a087_eventAccelPedalPos "255";
BA_ "Confidence" SG_ 1297 RCM_a088_eventArmStatus 1;
BA_ "Confidence" SG_ 1297 RCM_a088_eventFactoryMode 1;
BA_ "Confidence" SG_ 1297 RCM_a088_eventDiagEnabled 1;
BA_ "Confidence" SG_ 1297 RCM_a088_eventDriveOrientation 1;
BA_ "Confidence" SG_ 1297 RCM_a088_eventIDFsignal 1;
BA_ "Confidence" SG_ 1297 RCM_a088_eventFrontLeftSeatbelt 1;
BA_ "Confidence" SG_ 1297 RCM_a088_eventFrontRightSeatbelt 1;
BA_ "Confidence" SG_ 1297 RCM_a088_eventVehicleSpeed 1;
BA_ "Confidence" SG_ 1297 RCM_a088_eventSteeringAngle 1;
BA_ "Confidence" SG_ 1297 RCM_a088_eventDriverBrakeApply 1;
BA_ "GenSigSNA" SG_ 1297 RCM_a088_eventDriverBrakeApply "3";
BA_ "Confidence" SG_ 1297 RCM_a088_eventAccelPedalPos 1;
BA_ "GenSigSNA" SG_ 1297 RCM_a088_eventAccelPedalPos "255";
BA_ "Confidence" SG_ 1297 RCM_a089_eventArmStatus 1;
BA_ "Confidence" SG_ 1297 RCM_a089_eventFactoryMode 1;
BA_ "Confidence" SG_ 1297 RCM_a089_eventDiagEnabled 1;
BA_ "Confidence" SG_ 1297 RCM_a089_eventDriveOrientation 1;
BA_ "Confidence" SG_ 1297 RCM_a089_eventIDFsignal 1;
BA_ "Confidence" SG_ 1297 RCM_a089_eventFrontLeftSeatbelt 1;
BA_ "Confidence" SG_ 1297 RCM_a089_eventFrontRightSeatbelt 1;
BA_ "Confidence" SG_ 1297 RCM_a089_eventVehicleSpeed 1;
BA_ "Confidence" SG_ 1297 RCM_a089_eventSteeringAngle 1;
BA_ "Confidence" SG_ 1297 RCM_a089_eventDriverBrakeApply 1;
BA_ "GenSigSNA" SG_ 1297 RCM_a089_eventDriverBrakeApply "3";
BA_ "Confidence" SG_ 1297 RCM_a089_eventAccelPedalPos 1;
BA_ "GenSigSNA" SG_ 1297 RCM_a089_eventAccelPedalPos "255";
BA_ "Confidence" SG_ 1297 RCM_a090_eventArmStatus 1;
BA_ "Confidence" SG_ 1297 RCM_a090_eventFactoryMode 1;
BA_ "Confidence" SG_ 1297 RCM_a090_eventDiagEnabled 1;
BA_ "Confidence" SG_ 1297 RCM_a090_eventDriveOrientation 1;
BA_ "Confidence" SG_ 1297 RCM_a090_eventIDFsignal 1;
BA_ "Confidence" SG_ 1297 RCM_a090_eventFrontLeftSeatbelt 1;
BA_ "Confidence" SG_ 1297 RCM_a090_eventFrontRightSeatbelt 1;
BA_ "Confidence" SG_ 1297 RCM_a090_eventVehicleSpeed 1;
BA_ "Confidence" SG_ 1297 RCM_a090_eventSteeringAngle 1;
BA_ "Confidence" SG_ 1297 RCM_a090_eventDriverBrakeApply 1;
BA_ "GenSigSNA" SG_ 1297 RCM_a090_eventDriverBrakeApply "3";
BA_ "Confidence" SG_ 1297 RCM_a090_eventAccelPedalPos 1;
BA_ "GenSigSNA" SG_ 1297 RCM_a090_eventAccelPedalPos "255";
BA_ "Confidence" SG_ 1297 RCM_a091_eventArmStatus 1;
BA_ "Confidence" SG_ 1297 RCM_a091_eventFactoryMode 1;
BA_ "Confidence" SG_ 1297 RCM_a091_eventDiagEnabled 1;
BA_ "Confidence" SG_ 1297 RCM_a091_eventDriveOrientation 1;
BA_ "Confidence" SG_ 1297 RCM_a091_eventIDFsignal 1;
BA_ "Confidence" SG_ 1297 RCM_a091_eventFrontLeftSeatbelt 1;
BA_ "Confidence" SG_ 1297 RCM_a091_eventFrontRightSeatbelt 1;
BA_ "Confidence" SG_ 1297 RCM_a091_eventVehicleSpeed 1;
BA_ "Confidence" SG_ 1297 RCM_a091_eventSteeringAngle 1;
BA_ "Confidence" SG_ 1297 RCM_a091_eventDriverBrakeApply 1;
BA_ "GenSigSNA" SG_ 1297 RCM_a091_eventDriverBrakeApply "3";
BA_ "Confidence" SG_ 1297 RCM_a091_eventAccelPedalPos 1;
BA_ "GenSigSNA" SG_ 1297 RCM_a091_eventAccelPedalPos "255";
BA_ "Confidence" SG_ 1297 RCM_a092_eventArmStatus 1;
BA_ "Confidence" SG_ 1297 RCM_a092_eventFactoryMode 1;
BA_ "Confidence" SG_ 1297 RCM_a092_eventDiagEnabled 1;
BA_ "Confidence" SG_ 1297 RCM_a092_eventDriveOrientation 1;
BA_ "Confidence" SG_ 1297 RCM_a092_eventIDFsignal 1;
BA_ "Confidence" SG_ 1297 RCM_a092_eventFrontLeftSeatbelt 1;
BA_ "Confidence" SG_ 1297 RCM_a092_eventFrontRightSeatbelt 1;
BA_ "Confidence" SG_ 1297 RCM_a092_eventVehicleSpeed 1;
BA_ "Confidence" SG_ 1297 RCM_a092_eventSteeringAngle 1;
BA_ "Confidence" SG_ 1297 RCM_a092_eventDriverBrakeApply 1;
BA_ "GenSigSNA" SG_ 1297 RCM_a092_eventDriverBrakeApply "3";
BA_ "Confidence" SG_ 1297 RCM_a092_eventAccelPedalPos 1;
BA_ "GenSigSNA" SG_ 1297 RCM_a092_eventAccelPedalPos "255";
BA_ "Confidence" SG_ 1297 RCM_a093_eventArmStatus 1;
BA_ "Confidence" SG_ 1297 RCM_a093_eventFactoryMode 1;
BA_ "Confidence" SG_ 1297 RCM_a093_eventDiagEnabled 1;
BA_ "Confidence" SG_ 1297 RCM_a093_eventDriveOrientation 1;
BA_ "Confidence" SG_ 1297 RCM_a093_eventIDFsignal 1;
BA_ "Confidence" SG_ 1297 RCM_a093_eventFrontLeftSeatbelt 1;
BA_ "Confidence" SG_ 1297 RCM_a093_eventFrontRightSeatbelt 1;
BA_ "Confidence" SG_ 1297 RCM_a093_eventVehicleSpeed 1;
BA_ "Confidence" SG_ 1297 RCM_a093_eventSteeringAngle 1;
BA_ "Confidence" SG_ 1297 RCM_a093_eventDriverBrakeApply 1;
BA_ "GenSigSNA" SG_ 1297 RCM_a093_eventDriverBrakeApply "3";
BA_ "Confidence" SG_ 1297 RCM_a093_eventAccelPedalPos 1;
BA_ "GenSigSNA" SG_ 1297 RCM_a093_eventAccelPedalPos "255";
BA_ "Confidence" SG_ 1297 RCM_a094_eventArmStatus 1;
BA_ "Confidence" SG_ 1297 RCM_a094_eventFactoryMode 1;
BA_ "Confidence" SG_ 1297 RCM_a094_eventDiagEnabled 1;
BA_ "Confidence" SG_ 1297 RCM_a094_eventDriveOrientation 1;
BA_ "Confidence" SG_ 1297 RCM_a094_eventIDFsignal 1;
BA_ "Confidence" SG_ 1297 RCM_a094_eventFrontLeftSeatbelt 1;
BA_ "Confidence" SG_ 1297 RCM_a094_eventFrontRightSeatbelt 1;
BA_ "Confidence" SG_ 1297 RCM_a094_eventVehicleSpeed 1;
BA_ "Confidence" SG_ 1297 RCM_a094_eventSteeringAngle 1;
BA_ "Confidence" SG_ 1297 RCM_a094_eventDriverBrakeApply 1;
BA_ "GenSigSNA" SG_ 1297 RCM_a094_eventDriverBrakeApply "3";
BA_ "Confidence" SG_ 1297 RCM_a094_eventAccelPedalPos 1;
BA_ "GenSigSNA" SG_ 1297 RCM_a094_eventAccelPedalPos "255";
BA_ "Confidence" SG_ 1297 RCM_a101_eventArmStatus 1;
BA_ "Confidence" SG_ 1297 RCM_a101_eventFactoryMode 1;
BA_ "Confidence" SG_ 1297 RCM_a101_eventDiagEnabled 1;
BA_ "Confidence" SG_ 1297 RCM_a101_eventDriveOrientation 1;
BA_ "Confidence" SG_ 1297 RCM_a101_eventIDFsignal 1;
BA_ "Confidence" SG_ 1297 RCM_a101_eventFrontLeftSeatbelt 1;
BA_ "Confidence" SG_ 1297 RCM_a101_eventFrontRightSeatbelt 1;
BA_ "Confidence" SG_ 1297 RCM_a101_eventVehicleSpeed 1;
BA_ "Confidence" SG_ 1297 RCM_a101_eventSteeringAngle 1;
BA_ "Confidence" SG_ 1297 RCM_a101_eventDriverBrakeApply 1;
BA_ "GenSigSNA" SG_ 1297 RCM_a101_eventDriverBrakeApply "3";
BA_ "Confidence" SG_ 1297 RCM_a101_eventAccelPedalPos 1;
BA_ "GenSigSNA" SG_ 1297 RCM_a101_eventAccelPedalPos "255";
BA_ "Confidence" SG_ 1297 RCM_a102_eventArmStatus 1;
BA_ "Confidence" SG_ 1297 RCM_a102_eventFactoryMode 1;
BA_ "Confidence" SG_ 1297 RCM_a102_eventDiagEnabled 1;
BA_ "Confidence" SG_ 1297 RCM_a102_eventDriveOrientation 1;
BA_ "Confidence" SG_ 1297 RCM_a102_eventIDFsignal 1;
BA_ "Confidence" SG_ 1297 RCM_a102_eventFrontLeftSeatbelt 1;
BA_ "Confidence" SG_ 1297 RCM_a102_eventFrontRightSeatbelt 1;
BA_ "Confidence" SG_ 1297 RCM_a102_eventVehicleSpeed 1;
BA_ "Confidence" SG_ 1297 RCM_a102_eventSteeringAngle 1;
BA_ "Confidence" SG_ 1297 RCM_a102_eventDriverBrakeApply 1;
BA_ "GenSigSNA" SG_ 1297 RCM_a102_eventDriverBrakeApply "3";
BA_ "Confidence" SG_ 1297 RCM_a102_eventAccelPedalPos 1;
BA_ "GenSigSNA" SG_ 1297 RCM_a102_eventAccelPedalPos "255";
BA_ "Confidence" SG_ 1297 RCM_a103_eventArmStatus 1;
BA_ "Confidence" SG_ 1297 RCM_a103_eventFactoryMode 1;
BA_ "Confidence" SG_ 1297 RCM_a103_eventDiagEnabled 1;
BA_ "Confidence" SG_ 1297 RCM_a103_eventDriveOrientation 1;
BA_ "Confidence" SG_ 1297 RCM_a103_eventIDFsignal 1;
BA_ "Confidence" SG_ 1297 RCM_a103_eventFrontLeftSeatbelt 1;
BA_ "Confidence" SG_ 1297 RCM_a103_eventFrontRightSeatbelt 1;
BA_ "Confidence" SG_ 1297 RCM_a103_eventVehicleSpeed 1;
BA_ "Confidence" SG_ 1297 RCM_a103_eventSteeringAngle 1;
BA_ "Confidence" SG_ 1297 RCM_a103_eventDriverBrakeApply 1;
BA_ "GenSigSNA" SG_ 1297 RCM_a103_eventDriverBrakeApply "3";
BA_ "Confidence" SG_ 1297 RCM_a103_eventAccelPedalPos 1;
BA_ "GenSigSNA" SG_ 1297 RCM_a103_eventAccelPedalPos "255";
BA_ "Confidence" SG_ 1297 RCM_a104_eventArmStatus 1;
BA_ "Confidence" SG_ 1297 RCM_a104_eventFactoryMode 1;
BA_ "Confidence" SG_ 1297 RCM_a104_eventDiagEnabled 1;
BA_ "Confidence" SG_ 1297 RCM_a104_eventDriveOrientation 1;
BA_ "Confidence" SG_ 1297 RCM_a104_eventIDFsignal 1;
BA_ "Confidence" SG_ 1297 RCM_a104_eventFrontLeftSeatbelt 1;
BA_ "Confidence" SG_ 1297 RCM_a104_eventFrontRightSeatbelt 1;
BA_ "Confidence" SG_ 1297 RCM_a104_eventVehicleSpeed 1;
BA_ "Confidence" SG_ 1297 RCM_a104_eventSteeringAngle 1;
VAL_ 1297 RCM_a045_eventFrontRightSeatbelt 1 "LATCHED" 0 "UNLATCHED" ;
VAL_ 1297 RCM_a045_eventDriverBrakeApply 3 "Faulty_SNA" 2 "Driver_applying_brakes" 1 "Not_Applied" 0 "NotInit_orOff" ;
VAL_ 1297 RCM_a045_eventAccelPedalPos 255 "SNA" ;
VAL_ 1297 RCM_a046_eventArmStatus 1 "ARMED" 0 "UNARMED" ;
VAL_ 1297 RCM_a046_eventFactoryMode 1 "ENABLED" 0 "DISABLED" ;
VAL_ 1297 RCM_a046_eventDiagEnabled 1 "ENABLED" 0 "DISABLED" ;
VAL_ 1297 RCM_a046_eventDriveOrientation 1 "RIGHT_HAND_DRIVE" 0 "LEFT_HAND_DRIVE" ;
VAL_ 1297 RCM_a046_eventIDFsignal 1 "ACTIVE" 0 "NOT_ACTIVE" ;
VAL_ 1297 RCM_a046_eventFrontLeftSeatbelt 1 "LATCHED" 0 "UNLATCHED" ;
VAL_ 1297 RCM_a046_eventFrontRightSeatbelt 1 "LATCHED" 0 "UNLATCHED" ;
VAL_ 1297 RCM_a046_eventDriverBrakeApply 3 "Faulty_SNA" 2 "Driver_applying_brakes" 1 "Not_Applied" 0 "NotInit_orOff" ;
VAL_ 1297 RCM_a046_eventAccelPedalPos 255 "SNA" ;
VAL_ 1297 RCM_a047_eventArmStatus 1 "ARMED" 0 "UNARMED" ;
VAL_ 1297 RCM_a047_eventFactoryMode 1 "ENABLED" 0 "DISABLED" ;
VAL_ 1297 RCM_a047_eventDiagEnabled 1 "ENABLED" 0 "DISABLED" ;
VAL_ 1297 RCM_a047_eventDriveOrientation 1 "RIGHT_HAND_DRIVE" 0 "LEFT_HAND_DRIVE" ;
VAL_ 1297 RCM_a047_eventIDFsignal 1 "ACTIVE" 0 "NOT_ACTIVE" ;
VAL_ 1297 RCM_a047_eventFrontLeftSeatbelt 1 "LATCHED" 0 "UNLATCHED" ;
VAL_ 1297 RCM_a047_eventFrontRightSeatbelt 1 "LATCHED" 0 "UNLATCHED" ;
VAL_ 1297 RCM_a047_eventDriverBrakeApply 3 "Faulty_SNA" 2 "Driver_applying_brakes" 1 "Not_Applied" 0 "NotInit_orOff" ;
VAL_ 1297 RCM_a047_eventAccelPedalPos 255 "SNA" ;
VAL_ 1297 RCM_a048_eventArmStatus 1 "ARMED" 0 "UNARMED" ;
VAL_ 1297 RCM_a048_eventFactoryMode 1 "ENABLED" 0 "DISABLED" ;
VAL_ 1297 RCM_a048_eventDiagEnabled 1 "ENABLED" 0 "DISABLED" ;
VAL_ 1297 RCM_a048_eventDriveOrientation 1 "RIGHT_HAND_DRIVE" 0 "LEFT_HAND_DRIVE" ;
VAL_ 1297 RCM_a048_eventIDFsignal 1 "ACTIVE" 0 "NOT_ACTIVE" ;
VAL_ 1297 RCM_a048_eventFrontLeftSeatbelt 1 "LATCHED" 0 "UNLATCHED" ;
VAL_ 1297 RCM_a048_eventFrontRightSeatbelt 1 "LATCHED" 0 "UNLATCHED" ;
VAL_ 1297 RCM_a048_eventDriverBrakeApply 3 "Faulty_SNA" 2 "Driver_applying_brakes" 1 "Not_Applied" 0 "NotInit_orOff" ;
VAL_ 1297 RCM_a048_eventAccelPedalPos 255 "SNA" ;
VAL_ 1297 RCM_a049_eventArmStatus 1 "ARMED" 0 "UNARMED" ;
VAL_ 1297 RCM_a049_eventFactoryMode 1 "ENABLED" 0 "DISABLED" ;
VAL_ 1297 RCM_a049_eventDiagEnabled 1 "ENABLED" 0 "DISABLED" ;
VAL_ 1297 RCM_a049_eventDriveOrientation 1 "RIGHT_HAND_DRIVE" 0 "LEFT_HAND_DRIVE" ;
VAL_ 1297 RCM_a049_eventIDFsignal 1 "ACTIVE" 0 "NOT_ACTIVE" ;
VAL_ 1297 RCM_a049_eventFrontLeftSeatbelt 1 "LATCHED" 0 "UNLATCHED" ;
VAL_ 1297 RCM_a049_eventFrontRightSeatbelt 1 "LATCHED" 0 "UNLATCHED" ;
VAL_ 1297 RCM_a049_eventDriverBrakeApply 3 "Faulty_SNA" 2 "Driver_applying_brakes" 1 "Not_Applied" 0 "NotInit_orOff" ;
VAL_ 1297 RCM_a049_eventAccelPedalPos 255 "SNA" ;
VAL_ 1297 RCM_a050_eventArmStatus 1 "ARMED" 0 "UNARMED" ;
VAL_ 1297 RCM_a050_eventFactoryMode 1 "ENABLED" 0 "DISABLED" ;
VAL_ 1297 RCM_a050_eventDiagEnabled 1 "ENABLED" 0 "DISABLED" ;
VAL_ 1297 RCM_a050_eventDriveOrientation 1 "RIGHT_HAND_DRIVE" 0 "LEFT_HAND_DRIVE" ;
VAL_ 1297 RCM_a050_eventIDFsignal 1 "ACTIVE" 0 "NOT_ACTIVE" ;
VAL_ 1297 RCM_a050_eventFrontLeftSeatbelt 1 "LATCHED" 0 "UNLATCHED" ;
VAL_ 1297 RCM_a050_eventFrontRightSeatbelt 1 "LATCHED" 0 "UNLATCHED" ;
VAL_ 1297 RCM_a050_eventDriverBrakeApply 3 "Faulty_SNA" 2 "Driver_applying_brakes" 1 "Not_Applied" 0 "NotInit_orOff" ;
VAL_ 1297 RCM_a050_eventAccelPedalPos 255 "SNA" ;
VAL_ 1297 RCM_a051_eventArmStatus 1 "ARMED" 0 "UNARMED" ;
VAL_ 1297 RCM_a051_eventFactoryMode 1 "ENABLED" 0 "DISABLED" ;
VAL_ 1297 RCM_a051_eventDiagEnabled 1 "ENABLED" 0 "DISABLED" ;
VAL_ 1297 RCM_a051_eventDriveOrientation 1 "RIGHT_HAND_DRIVE" 0 "LEFT_HAND_DRIVE" ;
VAL_ 1297 RCM_a051_eventIDFsignal 1 "ACTIVE" 0 "NOT_ACTIVE" ;
VAL_ 1297 RCM_a051_eventFrontLeftSeatbelt 1 "LATCHED" 0 "UNLATCHED" ;
VAL_ 1297 RCM_a051_eventFrontRightSeatbelt 1 "LATCHED" 0 "UNLATCHED" ;
VAL_ 1297 RCM_a051_eventDriverBrakeApply 3 "Faulty_SNA" 2 "Driver_applying_brakes" 1 "Not_Applied" 0 "NotInit_orOff" ;
VAL_ 1297 RCM_a051_eventAccelPedalPos 255 "SNA" ;
VAL_ 1297 RCM_a052_eventArmStatus 1 "ARMED" 0 "UNARMED" ;
VAL_ 1297 RCM_a052_eventFactoryMode 1 "ENABLED" 0 "DISABLED" ;
VAL_ 1297 RCM_a052_eventDiagEnabled 1 "ENABLED" 0 "DISABLED" ;
VAL_ 1297 RCM_a052_eventDriveOrientation 1 "RIGHT_HAND_DRIVE" 0 "LEFT_HAND_DRIVE" ;
VAL_ 1297 RCM_a052_eventIDFsignal 1 "ACTIVE" 0 "NOT_ACTIVE" ;
VAL_ 1297 RCM_a052_eventFrontLeftSeatbelt 1 "LATCHED" 0 "UNLATCHED" ;
VAL_ 1297 RCM_a052_eventFrontRightSeatbelt 1 "LATCHED" 0 "UNLATCHED" ;
VAL_ 1297 RCM_a052_eventDriverBrakeApply 3 "Faulty_SNA" 2 "Driver_applying_brakes" 1 "Not_Applied" 0 "NotInit_orOff" ;
VAL_ 1297 RCM_a052_eventAccelPedalPos 255 "SNA" ;
VAL_ 1297 RCM_a053_eventArmStatus 1 "ARMED" 0 "UNARMED" ;
VAL_ 1297 RCM_a053_eventFactoryMode 1 "ENABLED" 0 "DISABLED" ;
VAL_ 1297 RCM_a053_eventDiagEnabled 1 "ENABLED" 0 "DISABLED" ;
VAL_ 1297 RCM_a053_eventDriveOrientation 1 "RIGHT_HAND_DRIVE" 0 "LEFT_HAND_DRIVE" ;
VAL_ 1297 RCM_a053_eventIDFsignal 1 "ACTIVE" 0 "NOT_ACTIVE" ;
VAL_ 1297 RCM_a053_eventFrontLeftSeatbelt 1 "LATCHED" 0 "UNLATCHED" ;
VAL_ 1297 RCM_a053_eventFrontRightSeatbelt 1 "LATCHED" 0 "UNLATCHED" ;
VAL_ 1297 RCM_a053_eventDriverBrakeApply 3 "Faulty_SNA" 2 "Driver_applying_brakes" 1 "Not_Applied" 0 "NotInit_orOff" ;
VAL_ 1297 RCM_a053_eventAccelPedalPos 255 "SNA" ;
VAL_ 1297 RCM_a054_eventArmStatus 1 "ARMED" 0 "UNARMED" ;
VAL_ 1297 RCM_a054_eventFactoryMode 1 "ENABLED" 0 "DISABLED" ;
VAL_ 1297 RCM_a054_eventDiagEnabled 1 "ENABLED" 0 "DISABLED" ;
VAL_ 1297 RCM_a054_eventDriveOrientation 1 "RIGHT_HAND_DRIVE" 0 "LEFT_HAND_DRIVE" ;
VAL_ 1297 RCM_a054_eventIDFsignal 1 "ACTIVE" 0 "NOT_ACTIVE" ;
VAL_ 1297 RCM_a054_eventFrontLeftSeatbelt 1 "LATCHED" 0 "UNLATCHED" ;
VAL_ 1297 RCM_a054_eventFrontRightSeatbelt 1 "LATCHED" 0 "UNLATCHED" ;
VAL_ 1297 RCM_a054_eventDriverBrakeApply 3 "Faulty_SNA" 2 "Driver_applying_brakes" 1 "Not_Applied" 0 "NotInit_orOff" ;
VAL_ 1297 RCM_a054_eventAccelPedalPos 255 "SNA" ;
VAL_ 1297 RCM_a055_eventArmStatus 1 "ARMED" 0 "UNARMED" ;
VAL_ 1297 RCM_a055_eventFactoryMode 1 "ENABLED" 0 "DISABLED" ;
VAL_ 1297 RCM_a055_eventDiagEnabled 1 "ENABLED" 0 "DISABLED" ;
VAL_ 1297 RCM_a055_eventDriveOrientation 1 "RIGHT_HAND_DRIVE" 0 "LEFT_HAND_DRIVE" ;
VAL_ 1297 RCM_a055_eventIDFsignal 1 "ACTIVE" 0 "NOT_ACTIVE" ;
VAL_ 1297 RCM_a055_eventFrontLeftSeatbelt 1 "LATCHED" 0 "UNLATCHED" ;
VAL_ 1297 RCM_a055_eventFrontRightSeatbelt 1 "LATCHED" 0 "UNLATCHED" ;
VAL_ 1297 RCM_a055_eventDriverBrakeApply 3 "Faulty_SNA" 2 "Driver_applying_brakes" 1 "Not_Applied" 0 "NotInit_orOff" ;
VAL_ 1297 RCM_a055_eventAccelPedalPos 255 "SNA" ;
VAL_ 1297 RCM_a056_eventArmStatus 1 "ARMED" 0 "UNARMED" ;
VAL_ 1297 RCM_a056_eventFactoryMode 1 "ENABLED" 0 "DISABLED" ;
VAL_ 1297 RCM_a056_eventDiagEnabled 1 "ENABLED" 0 "DISABLED" ;
VAL_ 1297 RCM_a056_eventDriveOrientation 1 "RIGHT_HAND_DRIVE" 0 "LEFT_HAND_DRIVE" ;
VAL_ 1297 RCM_a056_eventIDFsignal 1 "ACTIVE" 0 "NOT_ACTIVE" ;
VAL_ 1297 RCM_a056_eventFrontLeftSeatbelt 1 "LATCHED" 0 "UNLATCHED" ;
VAL_ 1297 RCM_a056_eventFrontRightSeatbelt 1 "LATCHED" 0 "UNLATCHED" ;
VAL_ 1297 RCM_a056_eventDriverBrakeApply 3 "Faulty_SNA" 2 "Driver_applying_brakes" 1 "Not_Applied" 0 "NotInit_orOff" ;
VAL_ 1297 RCM_a056_eventAccelPedalPos 255 "SNA" ;
VAL_ 1297 RCM_a057_eventArmStatus 1 "ARMED" 0 "UNARMED" ;
VAL_ 1297 RCM_a057_eventFactoryMode 1 "ENABLED" 0 "DISABLED" ;
VAL_ 1297 RCM_a057_eventDiagEnabled 1 "ENABLED" 0 "DISABLED" ;
VAL_ 1297 RCM_a057_eventDriveOrientation 1 "RIGHT_HAND_DRIVE" 0 "LEFT_HAND_DRIVE" ;
VAL_ 1297 RCM_a057_eventIDFsignal 1 "ACTIVE" 0 "NOT_ACTIVE" ;
VAL_ 1297 RCM_a057_eventFrontLeftSeatbelt 1 "LATCHED" 0 "UNLATCHED" ;
VAL_ 1297 RCM_a057_eventFrontRightSeatbelt 1 "LATCHED" 0 "UNLATCHED" ;
VAL_ 1297 RCM_a057_eventDriverBrakeApply 3 "Faulty_SNA" 2 "Driver_applying_brakes" 1 "Not_Applied" 0 "NotInit_orOff" ;
VAL_ 1297 RCM_a057_eventAccelPedalPos 255 "SNA" ;
VAL_ 1297 RCM_a058_eventArmStatus 1 "ARMED" 0 "UNARMED" ;
VAL_ 1297 RCM_a058_eventFactoryMode 1 "ENABLED" 0 "DISABLED" ;
VAL_ 1297 RCM_a058_eventDiagEnabled 1 "ENABLED" 0 "DISABLED" ;
VAL_ 1297 RCM_a058_eventDriveOrientation 1 "RIGHT_HAND_DRIVE" 0 "LEFT_HAND_DRIVE" ;
VAL_ 1297 RCM_a058_eventIDFsignal 1 "ACTIVE" 0 "NOT_ACTIVE" ;
VAL_ 1297 RCM_a058_eventFrontLeftSeatbelt 1 "LATCHED" 0 "UNLATCHED" ;
VAL_ 1297 RCM_a058_eventFrontRightSeatbelt 1 "LATCHED" 0 "UNLATCHED" ;
VAL_ 1297 RCM_a058_eventDriverBrakeApply 3 "Faulty_SNA" 2 "Driver_applying_brakes" 1 "Not_Applied" 0 "NotInit_orOff" ;
VAL_ 1297 RCM_a058_eventAccelPedalPos 255 "SNA" ;
VAL_ 1297 RCM_a059_eventArmStatus 1 "ARMED" 0 "UNARMED" ;
VAL_ 1297 RCM_a059_eventFactoryMode 1 "ENABLED" 0 "DISABLED" ;
VAL_ 1297 RCM_a059_eventDiagEnabled 1 "ENABLED" 0 "DISABLED" ;
VAL_ 1297 RCM_a059_eventDriveOrientation 1 "RIGHT_HAND_DRIVE" 0 "LEFT_HAND_DRIVE" ;
VAL_ 1297 RCM_a059_eventIDFsignal 1 "ACTIVE" 0 "NOT_ACTIVE" ;
VAL_ 1297 RCM_a059_eventFrontLeftSeatbelt 1 "LATCHED" 0 "UNLATCHED" ;
VAL_ 1297 RCM_a059_eventFrontRightSeatbelt 1 "LATCHED" 0 "UNLATCHED" ;
VAL_ 1297 RCM_a059_eventDriverBrakeApply 3 "Faulty_SNA" 2 "Driver_applying_brakes" 1 "Not_Applied" 0 "NotInit_orOff" ;
VAL_ 1297 RCM_a059_eventAccelPedalPos 255 "SNA" ;
VAL_ 1297 RCM_a060_eventArmStatus 1 "ARMED" 0 "UNARMED" ;
VAL_ 1297 RCM_a060_eventFactoryMode 1 "ENABLED" 0 "DISABLED" ;
VAL_ 1297 RCM_a060_eventDiagEnabled 1 "ENABLED" 0 "DISABLED" ;
VAL_ 1297 RCM_a060_eventDriveOrientation 1 "RIGHT_HAND_DRIVE" 0 "LEFT_HAND_DRIVE" ;
VAL_ 1297 RCM_a060_eventIDFsignal 1 "ACTIVE" 0 "NOT_ACTIVE" ;
VAL_ 1297 RCM_a060_eventFrontLeftSeatbelt 1 "LATCHED" 0 "UNLATCHED" ;
VAL_ 1297 RCM_a060_eventFrontRightSeatbelt 1 "LATCHED" 0 "UNLATCHED" ;
VAL_ 1297 RCM_a060_eventDriverBrakeApply 3 "Faulty_SNA" 2 "Driver_applying_brakes" 1 "Not_Applied" 0 "NotInit_orOff" ;
VAL_ 1297 RCM_a060_eventAccelPedalPos 255 "SNA" ;
VAL_ 1297 RCM_a061_eventArmStatus 1 "ARMED" 0 "UNARMED" ;
VAL_ 1297 RCM_a061_eventFactoryMode 1 "ENABLED" 0 "DISABLED" ;
VAL_ 1297 RCM_a061_eventDiagEnabled 1 "ENABLED" 0 "DISABLED" ;
VAL_ 1297 RCM_a061_eventDriveOrientation 1 "RIGHT_HAND_DRIVE" 0 "LEFT_HAND_DRIVE" ;
VAL_ 1297 RCM_a061_eventIDFsignal 1 "ACTIVE" 0 "NOT_ACTIVE" ;
VAL_ 1297 RCM_a061_eventFrontLeftSeatbelt 1 "LATCHED" 0 "UNLATCHED" ;
VAL_ 1297 RCM_a061_eventFrontRightSeatbelt 1 "LATCHED" 0 "UNLATCHED" ;
VAL_ 1297 RCM_a061_eventDriverBrakeApply 3 "Faulty_SNA" 2 "Driver_applying_brakes" 1 "Not_Applied" 0 "NotInit_orOff" ;
VAL_ 1297 RCM_a061_eventAccelPedalPos 255 "SNA" ;
VAL_ 1297 RCM_a062_eventArmStatus 1 "ARMED" 0 "UNARMED" ;
VAL_ 1297 RCM_a062_eventFactoryMode 1 "ENABLED" 0 "DISABLED" ;
VAL_ 1297 RCM_a062_eventDiagEnabled 1 "ENABLED" 0 "DISABLED" ;
VAL_ 1297 RCM_a062_eventDriveOrientation 1 "RIGHT_HAND_DRIVE" 0 "LEFT_HAND_DRIVE" ;
VAL_ 1297 RCM_a062_eventIDFsignal 1 "ACTIVE" 0 "NOT_ACTIVE" ;
VAL_ 1297 RCM_a062_eventFrontLeftSeatbelt 1 "LATCHED" 0 "UNLATCHED" ;
VAL_ 1297 RCM_a062_eventFrontRightSeatbelt 1 "LATCHED" 0 "UNLATCHED" ;
VAL_ 1297 RCM_a062_eventDriverBrakeApply 3 "Faulty_SNA" 2 "Driver_applying_brakes" 1 "Not_Applied" 0 "NotInit_orOff" ;
VAL_ 1297 RCM_a062_eventAccelPedalPos 255 "SNA" ;
VAL_ 1297 RCM_a063_eventArmStatus 1 "ARMED" 0 "UNARMED" ;
VAL_ 1297 RCM_a063_eventFactoryMode 1 "ENABLED" 0 "DISABLED" ;
VAL_ 1297 RCM_a063_eventDiagEnabled 1 "ENABLED" 0 "DISABLED" ;
VAL_ 1297 RCM_a063_eventDriveOrientation 1 "RIGHT_HAND_DRIVE" 0 "LEFT_HAND_DRIVE" ;
VAL_ 1297 RCM_a063_eventIDFsignal 1 "ACTIVE" 0 "NOT_ACTIVE" ;
VAL_ 1297 RCM_a063_eventFrontLeftSeatbelt 1 "LATCHED" 0 "UNLATCHED" ;
VAL_ 1297 RCM_a063_eventFrontRightSeatbelt 1 "LATCHED" 0 "UNLATCHED" ;
VAL_ 1297 RCM_a063_eventDriverBrakeApply 3 "Faulty_SNA" 2 "Driver_applying_brakes" 1 "Not_Applied" 0 "NotInit_orOff" ;
VAL_ 1297 RCM_a063_eventAccelPedalPos 255 "SNA" ;
VAL_ 1297 RCM_a064_eventArmStatus 1 "ARMED" 0 "UNARMED" ;
VAL_ 1297 RCM_a064_eventFactoryMode 1 "ENABLED" 0 "DISABLED" ;
VAL_ 1297 RCM_a064_eventDiagEnabled 1 "ENABLED" 0 "DISABLED" ;
VAL_ 1297 RCM_a064_eventDriveOrientation 1 "RIGHT_HAND_DRIVE" 0 "LEFT_HAND_DRIVE" ;
VAL_ 1297 RCM_a064_eventIDFsignal 1 "ACTIVE" 0 "NOT_ACTIVE" ;
VAL_ 1297 RCM_a064_eventFrontLeftSeatbelt 1 "LATCHED" 0 "UNLATCHED" ;
VAL_ 1297 RCM_a064_eventFrontRightSeatbelt 1 "LATCHED" 0 "UNLATCHED" ;
VAL_ 1297 RCM_a064_eventDriverBrakeApply 3 "Faulty_SNA" 2 "Driver_applying_brakes" 1 "Not_Applied" 0 "NotInit_orOff" ;
VAL_ 1297 RCM_a064_eventAccelPedalPos 255 "SNA" ;
VAL_ 1297 RCM_a065_eventArmStatus 1 "ARMED" 0 "UNARMED" ;
VAL_ 1297 RCM_a065_eventFactoryMode 1 "ENABLED" 0 "DISABLED" ;
VAL_ 1297 RCM_a065_eventDiagEnabled 1 "ENABLED" 0 "DISABLED" ;
VAL_ 1297 RCM_a065_eventDriveOrientation 1 "RIGHT_HAND_DRIVE" 0 "LEFT_HAND_DRIVE" ;
VAL_ 1297 RCM_a065_eventIDFsignal 1 "ACTIVE" 0 "NOT_ACTIVE" ;
VAL_ 1297 RCM_a065_eventFrontLeftSeatbelt 1 "LATCHED" 0 "UNLATCHED" ;
VAL_ 1297 RCM_a065_eventFrontRightSeatbelt 1 "LATCHED" 0 "UNLATCHED" ;
VAL_ 1297 RCM_a065_eventDriverBrakeApply 3 "Faulty_SNA" 2 "Driver_applying_brakes" 1 "Not_Applied" 0 "NotInit_orOff" ;
VAL_ 1297 RCM_a065_eventAccelPedalPos 255 "SNA" ;
VAL_ 1297 RCM_a066_eventArmStatus 1 "ARMED" 0 "UNARMED" ;
VAL_ 1297 RCM_a066_eventFactoryMode 1 "ENABLED" 0 "DISABLED" ;
VAL_ 1297 RCM_a066_eventDiagEnabled 1 "ENABLED" 0 "DISABLED" ;
VAL_ 1297 RCM_a066_eventDriveOrientation 1 "RIGHT_HAND_DRIVE" 0 "LEFT_HAND_DRIVE" ;
VAL_ 1297 RCM_a066_eventIDFsignal 1 "ACTIVE" 0 "NOT_ACTIVE" ;
VAL_ 1297 RCM_a066_eventFrontLeftSeatbelt 1 "LATCHED" 0 "UNLATCHED" ;
VAL_ 1297 RCM_a066_eventFrontRightSeatbelt 1 "LATCHED" 0 "UNLATCHED" ;
VAL_ 1297 RCM_a066_eventDriverBrakeApply 3 "Faulty_SNA" 2 "Driver_applying_brakes" 1 "Not_Applied" 0 "NotInit_orOff" ;
VAL_ 1297 RCM_a066_eventAccelPedalPos 255 "SNA" ;
VAL_ 1297 RCM_a067_eventArmStatus 1 "ARMED" 0 "UNARMED" ;
VAL_ 1297 RCM_a067_eventFactoryMode 1 "ENABLED" 0 "DISABLED" ;
VAL_ 1297 RCM_a067_eventDiagEnabled 1 "ENABLED" 0 "DISABLED" ;
VAL_ 1297 RCM_a067_eventDriveOrientation 1 "RIGHT_HAND_DRIVE" 0 "LEFT_HAND_DRIVE" ;
VAL_ 1297 RCM_a067_eventIDFsignal 1 "ACTIVE" 0 "NOT_ACTIVE" ;
VAL_ 1297 RCM_a067_eventFrontLeftSeatbelt 1 "LATCHED" 0 "UNLATCHED" ;
VAL_ 1297 RCM_a067_eventFrontRightSeatbelt 1 "LATCHED" 0 "UNLATCHED" ;
VAL_ 1297 RCM_a067_eventDriverBrakeApply 3 "Faulty_SNA" 2 "Driver_applying_brakes" 1 "Not_Applied" 0 "NotInit_orOff" ;
VAL_ 1297 RCM_a067_eventAccelPedalPos 255 "SNA" ;
VAL_ 1297 RCM_a068_eventArmStatus 1 "ARMED" 0 "UNARMED" ;
VAL_ 1297 RCM_a068_eventFactoryMode 1 "ENABLED" 0 "DISABLED" ;
VAL_ 1297 RCM_a068_eventDiagEnabled 1 "ENABLED" 0 "DISABLED" ;
VAL_ 1297 RCM_a068_eventDriveOrientation 1 "RIGHT_HAND_DRIVE" 0 "LEFT_HAND_DRIVE" ;
VAL_ 1297 RCM_a068_eventIDFsignal 1 "ACTIVE" 0 "NOT_ACTIVE" ;
VAL_ 1297 RCM_a068_eventFrontLeftSeatbelt 1 "LATCHED" 0 "UNLATCHED" ;
VAL_ 1297 RCM_a068_eventFrontRightSeatbelt 1 "LATCHED" 0 "UNLATCHED" ;
VAL_ 1297 RCM_a068_eventDriverBrakeApply 3 "Faulty_SNA" 2 "Driver_applying_brakes" 1 "Not_Applied" 0 "NotInit_orOff" ;
VAL_ 1297 RCM_a068_eventAccelPedalPos 255 "SNA" ;
VAL_ 1297 RCM_a069_eventArmStatus 1 "ARMED" 0 "UNARMED" ;
VAL_ 1297 RCM_a069_eventFactoryMode 1 "ENABLED" 0 "DISABLED" ;
VAL_ 1297 RCM_a069_eventDiagEnabled 1 "ENABLED" 0 "DISABLED" ;
VAL_ 1297 RCM_a069_eventDriveOrientation 1 "RIGHT_HAND_DRIVE" 0 "LEFT_HAND_DRIVE" ;
VAL_ 1297 RCM_a069_eventIDFsignal 1 "ACTIVE" 0 "NOT_ACTIVE" ;
VAL_ 1297 RCM_a069_eventFrontLeftSeatbelt 1 "LATCHED" 0 "UNLATCHED" ;
VAL_ 1297 RCM_a069_eventFrontRightSeatbelt 1 "LATCHED" 0 "UNLATCHED" ;
VAL_ 1297 RCM_a069_eventDriverBrakeApply 3 "Faulty_SNA" 2 "Driver_applying_brakes" 1 "Not_Applied" 0 "NotInit_orOff" ;
VAL_ 1297 RCM_a069_eventAccelPedalPos 255 "SNA" ;
VAL_ 1297 RCM_a070_eventArmStatus 1 "ARMED" 0 "UNARMED" ;
VAL_ 1297 RCM_a070_eventFactoryMode 1 "ENABLED" 0 "DISABLED" ;
VAL_ 1297 RCM_a070_eventDiagEnabled 1 "ENABLED" 0 "DISABLED" ;
VAL_ 1297 RCM_a070_eventDriveOrientation 1 "RIGHT_HAND_DRIVE" 0 "LEFT_HAND_DRIVE" ;
VAL_ 1297 RCM_a070_eventIDFsignal 1 "ACTIVE" 0 "NOT_ACTIVE" ;
VAL_ 1297 RCM_a070_eventFrontLeftSeatbelt 1 "LATCHED" 0 "UNLATCHED" ;
VAL_ 1297 RCM_a070_eventFrontRightSeatbelt 1 "LATCHED" 0 "UNLATCHED" ;
VAL_ 1297 RCM_a070_eventDriverBrakeApply 3 "Faulty_SNA" 2 "Driver_applying_brakes" 1 "Not_Applied" 0 "NotInit_orOff" ;
VAL_ 1297 RCM_a070_eventAccelPedalPos 255 "SNA" ;
VAL_ 1297 RCM_a071_eventArmStatus 1 "ARMED" 0 "UNARMED" ;
VAL_ 1297 RCM_a071_eventFactoryMode 1 "ENABLED" 0 "DISABLED" ;
VAL_ 1297 RCM_a071_eventDiagEnabled 1 "ENABLED" 0 "DISABLED" ;
VAL_ 1297 RCM_a071_eventDriveOrientation 1 "RIGHT_HAND_DRIVE" 0 "LEFT_HAND_DRIVE" ;
VAL_ 1297 RCM_a071_eventIDFsignal 1 "ACTIVE" 0 "NOT_ACTIVE" ;
VAL_ 1297 RCM_a071_eventFrontLeftSeatbelt 1 "LATCHED" 0 "UNLATCHED" ;
VAL_ 1297 RCM_a071_eventFrontRightSeatbelt 1 "LATCHED" 0 "UNLATCHED" ;
VAL_ 1297 RCM_a071_eventDriverBrakeApply 3 "Faulty_SNA" 2 "Driver_applying_brakes" 1 "Not_Applied" 0 "NotInit_orOff" ;
VAL_ 1297 RCM_a071_eventAccelPedalPos 255 "SNA" ;
VAL_ 1297 RCM_a072_eventArmStatus 1 "ARMED" 0 "UNARMED" ;
VAL_ 1297 RCM_a072_eventFactoryMode 1 "ENABLED" 0 "DISABLED" ;
VAL_ 1297 RCM_a072_eventDiagEnabled 1 "ENABLED" 0 "DISABLED" ;
VAL_ 1297 RCM_a072_eventDriveOrientation 1 "RIGHT_HAND_DRIVE" 0 "LEFT_HAND_DRIVE" ;
VAL_ 1297 RCM_a072_eventIDFsignal 1 "ACTIVE" 0 "NOT_ACTIVE" ;
VAL_ 1297 RCM_a072_eventFrontLeftSeatbelt 1 "LATCHED" 0 "UNLATCHED" ;
VAL_ 1297 RCM_a072_eventFrontRightSeatbelt 1 "LATCHED" 0 "UNLATCHED" ;
VAL_ 1297 RCM_a072_eventDriverBrakeApply 3 "Faulty_SNA" 2 "Driver_applying_brakes" 1 "Not_Applied" 0 "NotInit_orOff" ;
VAL_ 1297 RCM_a072_eventAccelPedalPos 255 "SNA" ;
VAL_ 1297 RCM_a073_eventArmStatus 1 "ARMED" 0 "UNARMED" ;
VAL_ 1297 RCM_a073_eventFactoryMode 1 "ENABLED" 0 "DISABLED" ;
VAL_ 1297 RCM_a073_eventDiagEnabled 1 "ENABLED" 0 "DISABLED" ;
VAL_ 1297 RCM_a073_eventDriveOrientation 1 "RIGHT_HAND_DRIVE" 0 "LEFT_HAND_DRIVE" ;
VAL_ 1297 RCM_a073_eventIDFsignal 1 "ACTIVE" 0 "NOT_ACTIVE" ;
VAL_ 1297 RCM_a073_eventFrontLeftSeatbelt 1 "LATCHED" 0 "UNLATCHED" ;
VAL_ 1297 RCM_a073_eventFrontRightSeatbelt 1 "LATCHED" 0 "UNLATCHED" ;
VAL_ 1297 RCM_a073_eventDriverBrakeApply 3 "Faulty_SNA" 2 "Driver_applying_brakes" 1 "Not_Applied" 0 "NotInit_orOff" ;
VAL_ 1297 RCM_a073_eventAccelPedalPos 255 "SNA" ;
VAL_ 1297 RCM_a074_eventArmStatus 1 "ARMED" 0 "UNARMED" ;
VAL_ 1297 RCM_a074_eventFactoryMode 1 "ENABLED" 0 "DISABLED" ;
VAL_ 1297 RCM_a074_eventDiagEnabled 1 "ENABLED" 0 "DISABLED" ;
VAL_ 1297 RCM_a074_eventDriveOrientation 1 "RIGHT_HAND_DRIVE" 0 "LEFT_HAND_DRIVE" ;
VAL_ 1297 RCM_a074_eventIDFsignal 1 "ACTIVE" 0 "NOT_ACTIVE" ;
VAL_ 1297 RCM_a074_eventFrontLeftSeatbelt 1 "LATCHED" 0 "UNLATCHED" ;
VAL_ 1297 RCM_a074_eventFrontRightSeatbelt 1 "LATCHED" 0 "UNLATCHED" ;
VAL_ 1297 RCM_a074_eventDriverBrakeApply 3 "Faulty_SNA" 2 "Driver_applying_brakes" 1 "Not_Applied" 0 "NotInit_orOff" ;
VAL_ 1297 RCM_a074_eventAccelPedalPos 255 "SNA" ;
VAL_ 1297 RCM_a075_eventArmStatus 1 "ARMED" 0 "UNARMED" ;
VAL_ 1297 RCM_a075_eventFactoryMode 1 "ENABLED" 0 "DISABLED" ;
VAL_ 1297 RCM_a075_eventDiagEnabled 1 "ENABLED" 0 "DISABLED" ;
VAL_ 1297 RCM_a075_eventDriveOrientation 1 "RIGHT_HAND_DRIVE" 0 "LEFT_HAND_DRIVE" ;
VAL_ 1297 RCM_a075_eventIDFsignal 1 "ACTIVE" 0 "NOT_ACTIVE" ;
VAL_ 1297 RCM_a075_eventFrontLeftSeatbelt 1 "LATCHED" 0 "UNLATCHED" ;
VAL_ 1297 RCM_a075_eventFrontRightSeatbelt 1 "LATCHED" 0 "UNLATCHED" ;
VAL_ 1297 RCM_a075_eventDriverBrakeApply 3 "Faulty_SNA" 2 "Driver_applying_brakes" 1 "Not_Applied" 0 "NotInit_orOff" ;
VAL_ 1297 RCM_a075_eventAccelPedalPos 255 "SNA" ;
VAL_ 1297 RCM_a078_eventArmStatus 1 "ARMED" 0 "UNARMED" ;
VAL_ 1297 RCM_a078_eventFactoryMode 1 "ENABLED" 0 "DISABLED" ;
VAL_ 1297 RCM_a078_eventDiagEnabled 1 "ENABLED" 0 "DISABLED" ;
VAL_ 1297 RCM_a078_eventDriveOrientation 1 "RIGHT_HAND_DRIVE" 0 "LEFT_HAND_DRIVE" ;
VAL_ 1297 RCM_a078_eventIDFsignal 1 "ACTIVE" 0 "NOT_ACTIVE" ;
VAL_ 1297 RCM_a078_eventFrontLeftSeatbelt 1 "LATCHED" 0 "UNLATCHED" ;
VAL_ 1297 RCM_a078_eventFrontRightSeatbelt 1 "LATCHED" 0 "UNLATCHED" ;
VAL_ 1297 RCM_a078_eventDriverBrakeApply 3 "Faulty_SNA" 2 "Driver_applying_brakes" 1 "Not_Applied" 0 "NotInit_orOff" ;
VAL_ 1297 RCM_a078_eventAccelPedalPos 255 "SNA" ;
VAL_ 1297 RCM_a079_eventArmStatus 1 "ARMED" 0 "UNARMED" ;
VAL_ 1297 RCM_a079_eventFactoryMode 1 "ENABLED" 0 "DISABLED" ;
VAL_ 1297 RCM_a079_eventDiagEnabled 1 "ENABLED" 0 "DISABLED" ;
VAL_ 1297 RCM_a079_eventDriveOrientation 1 "RIGHT_HAND_DRIVE" 0 "LEFT_HAND_DRIVE" ;
VAL_ 1297 RCM_a079_eventIDFsignal 1 "ACTIVE" 0 "NOT_ACTIVE" ;
VAL_ 1297 RCM_a079_eventFrontLeftSeatbelt 1 "LATCHED" 0 "UNLATCHED" ;
VAL_ 1297 RCM_a079_eventFrontRightSeatbelt 1 "LATCHED" 0 "UNLATCHED" ;
VAL_ 1297 RCM_a079_eventDriverBrakeApply 3 "Faulty_SNA" 2 "Driver_applying_brakes" 1 "Not_Applied" 0 "NotInit_orOff" ;
VAL_ 1297 RCM_a079_eventAccelPedalPos 255 "SNA" ;
VAL_ 1297 RCM_a080_eventArmStatus 1 "ARMED" 0 "UNARMED" ;
VAL_ 1297 RCM_a080_eventFactoryMode 1 "ENABLED" 0 "DISABLED" ;
VAL_ 1297 RCM_a080_eventDiagEnabled 1 "ENABLED" 0 "DISABLED" ;
VAL_ 1297 RCM_a080_eventDriveOrientation 1 "RIGHT_HAND_DRIVE" 0 "LEFT_HAND_DRIVE" ;
VAL_ 1297 RCM_a080_eventIDFsignal 1 "ACTIVE" 0 "NOT_ACTIVE" ;
VAL_ 1297 RCM_a080_eventFrontLeftSeatbelt 1 "LATCHED" 0 "UNLATCHED" ;
VAL_ 1297 RCM_a080_eventFrontRightSeatbelt 1 "LATCHED" 0 "UNLATCHED" ;
VAL_ 1297 RCM_a080_eventDriverBrakeApply 3 "Faulty_SNA" 2 "Driver_applying_brakes" 1 "Not_Applied" 0 "NotInit_orOff" ;
VAL_ 1297 RCM_a080_eventAccelPedalPos 255 "SNA" ;
VAL_ 1297 RCM_a083_eventArmStatus 1 "ARMED" 0 "UNARMED" ;
VAL_ 1297 RCM_a083_eventFactoryMode 1 "ENABLED" 0 "DISABLED" ;
VAL_ 1297 RCM_a083_eventDiagEnabled 1 "ENABLED" 0 "DISABLED" ;
VAL_ 1297 RCM_a083_eventDriveOrientation 1 "RIGHT_HAND_DRIVE" 0 "LEFT_HAND_DRIVE" ;
VAL_ 1297 RCM_a083_eventIDFsignal 1 "ACTIVE" 0 "NOT_ACTIVE" ;
VAL_ 1297 RCM_a083_eventFrontLeftSeatbelt 1 "LATCHED" 0 "UNLATCHED" ;
VAL_ 1297 RCM_a083_eventFrontRightSeatbelt 1 "LATCHED" 0 "UNLATCHED" ;
VAL_ 1297 RCM_a083_eventDriverBrakeApply 3 "Faulty_SNA" 2 "Driver_applying_brakes" 1 "Not_Applied" 0 "NotInit_orOff" ;
VAL_ 1297 RCM_a083_eventAccelPedalPos 255 "SNA" ;
VAL_ 1297 RCM_a087_eventArmStatus 1 "ARMED" 0 "UNARMED" ;
VAL_ 1297 RCM_a087_eventFactoryMode 1 "ENABLED" 0 "DISABLED" ;
VAL_ 1297 RCM_a087_eventDiagEnabled 1 "ENABLED" 0 "DISABLED" ;
VAL_ 1297 RCM_a087_eventDriveOrientation 1 "RIGHT_HAND_DRIVE" 0 "LEFT_HAND_DRIVE" ;
VAL_ 1297 RCM_a087_eventIDFsignal 1 "ACTIVE" 0 "NOT_ACTIVE" ;
VAL_ 1297 RCM_a087_eventFrontLeftSeatbelt 1 "LATCHED" 0 "UNLATCHED" ;
VAL_ 1297 RCM_a087_eventFrontRightSeatbelt 1 "LATCHED" 0 "UNLATCHED" ;
VAL_ 1297 RCM_a087_eventDriverBrakeApply 3 "Faulty_SNA" 2 "Driver_applying_brakes" 1 "Not_Applied" 0 "NotInit_orOff" ;
VAL_ 1297 RCM_a087_eventAccelPedalPos 255 "SNA" ;
VAL_ 1297 RCM_a088_eventArmStatus 1 "ARMED" 0 "UNARMED" ;
VAL_ 1297 RCM_a088_eventFactoryMode 1 "ENABLED" 0 "DISABLED" ;
VAL_ 1297 RCM_a088_eventDiagEnabled 1 "ENABLED" 0 "DISABLED" ;
VAL_ 1297 RCM_a088_eventDriveOrientation 1 "RIGHT_HAND_DRIVE" 0 "LEFT_HAND_DRIVE" ;
VAL_ 1297 RCM_a088_eventIDFsignal 1 "ACTIVE" 0 "NOT_ACTIVE" ;
VAL_ 1297 RCM_a088_eventFrontLeftSeatbelt 1 "LATCHED" 0 "UNLATCHED" ;
VAL_ 1297 RCM_a088_eventFrontRightSeatbelt 1 "LATCHED" 0 "UNLATCHED" ;
VAL_ 1297 RCM_a088_eventDriverBrakeApply 3 "Faulty_SNA" 2 "Driver_applying_brakes" 1 "Not_Applied" 0 "NotInit_orOff" ;
VAL_ 1297 RCM_a088_eventAccelPedalPos 255 "SNA" ;
VAL_ 1297 RCM_a089_eventArmStatus 1 "ARMED" 0 "UNARMED" ;
VAL_ 1297 RCM_a089_eventFactoryMode 1 "ENABLED" 0 "DISABLED" ;
VAL_ 1297 RCM_a089_eventDiagEnabled 1 "ENABLED" 0 "DISABLED" ;
VAL_ 1297 RCM_a089_eventDriveOrientation 1 "RIGHT_HAND_DRIVE" 0 "LEFT_HAND_DRIVE" ;
VAL_ 1297 RCM_a089_eventIDFsignal 1 "ACTIVE" 0 "NOT_ACTIVE" ;
VAL_ 1297 RCM_a089_eventFrontLeftSeatbelt 1 "LATCHED" 0 "UNLATCHED" ;
VAL_ 1297 RCM_a089_eventFrontRightSeatbelt 1 "LATCHED" 0 "UNLATCHED" ;
VAL_ 1297 RCM_a089_eventDriverBrakeApply 3 "Faulty_SNA" 2 "Driver_applying_brakes" 1 "Not_Applied" 0 "NotInit_orOff" ;
VAL_ 1297 RCM_a089_eventAccelPedalPos 255 "SNA" ;
VAL_ 1297 RCM_a090_eventArmStatus 1 "ARMED" 0 "UNARMED" ;
VAL_ 1297 RCM_a090_eventFactoryMode 1 "ENABLED" 0 "DISABLED" ;
VAL_ 1297 RCM_a090_eventDiagEnabled 1 "ENABLED" 0 "DISABLED" ;
VAL_ 1297 RCM_a090_eventDriveOrientation 1 "RIGHT_HAND_DRIVE" 0 "LEFT_HAND_DRIVE" ;
VAL_ 1297 RCM_a090_eventIDFsignal 1 "ACTIVE" 0 "NOT_ACTIVE" ;
VAL_ 1297 RCM_a090_eventFrontLeftSeatbelt 1 "LATCHED" 0 "UNLATCHED" ;
VAL_ 1297 RCM_a090_eventFrontRightSeatbelt 1 "LATCHED" 0 "UNLATCHED" ;
VAL_ 1297 RCM_a090_eventDriverBrakeApply 3 "Faulty_SNA" 2 "Driver_applying_brakes" 1 "Not_Applied" 0 "NotInit_orOff" ;
VAL_ 1297 RCM_a090_eventAccelPedalPos 255 "SNA" ;
VAL_ 1297 RCM_a091_eventArmStatus 1 "ARMED" 0 "UNARMED" ;
VAL_ 1297 RCM_a091_eventFactoryMode 1 "ENABLED" 0 "DISABLED" ;
VAL_ 1297 RCM_a091_eventDiagEnabled 1 "ENABLED" 0 "DISABLED" ;
VAL_ 1297 RCM_a091_eventDriveOrientation 1 "RIGHT_HAND_DRIVE" 0 "LEFT_HAND_DRIVE" ;
VAL_ 1297 RCM_a091_eventIDFsignal 1 "ACTIVE" 0 "NOT_ACTIVE" ;
VAL_ 1297 RCM_a091_eventFrontLeftSeatbelt 1 "LATCHED" 0 "UNLATCHED" ;
VAL_ 1297 RCM_a091_eventFrontRightSeatbelt 1 "LATCHED" 0 "UNLATCHED" ;
VAL_ 1297 RCM_a091_eventDriverBrakeApply 3 "Faulty_SNA" 2 "Driver_applying_brakes" 1 "Not_Applied" 0 "NotInit_orOff" ;
VAL_ 1297 RCM_a091_eventAccelPedalPos 255 "SNA" ;
VAL_ 1297 RCM_a092_eventArmStatus 1 "ARMED" 0 "UNARMED" ;
VAL_ 1297 RCM_a092_eventFactoryMode 1 "ENABLED" 0 "DISABLED" ;
VAL_ 1297 RCM_a092_eventDiagEnabled 1 "ENABLED" 0 "DISABLED" ;
VAL_ 1297 RCM_a092_eventDriveOrientation 1 "RIGHT_HAND_DRIVE" 0 "LEFT_HAND_DRIVE" ;
VAL_ 1297 RCM_a092_eventIDFsignal 1 "ACTIVE" 0 "NOT_ACTIVE" ;
VAL_ 1297 RCM_a092_eventFrontLeftSeatbelt 1 "LATCHED" 0 "UNLATCHED" ;
VAL_ 1297 RCM_a092_eventFrontRightSeatbelt 1 "LATCHED" 0 "UNLATCHED" ;
VAL_ 1297 RCM_a092_eventDriverBrakeApply 3 "Faulty_SNA" 2 "Driver_applying_brakes" 1 "Not_Applied" 0 "NotInit_orOff" ;
VAL_ 1297 RCM_a092_eventAccelPedalPos 255 "SNA" ;
VAL_ 1297 RCM_a093_eventArmStatus 1 "ARMED" 0 "UNARMED" ;
VAL_ 1297 RCM_a093_eventFactoryMode 1 "ENABLED" 0 "DISABLED" ;
VAL_ 1297 RCM_a093_eventDiagEnabled 1 "ENABLED" 0 "DISABLED" ;
VAL_ 1297 RCM_a093_eventDriveOrientation 1 "RIGHT_HAND_DRIVE" 0 "LEFT_HAND_DRIVE" ;
VAL_ 1297 RCM_a093_eventIDFsignal 1 "ACTIVE" 0 "NOT_ACTIVE" ;
VAL_ 1297 RCM_a093_eventFrontLeftSeatbelt 1 "LATCHED" 0 "UNLATCHED" ;
VAL_ 1297 RCM_a093_eventFrontRightSeatbelt 1 "LATCHED" 0 "UNLATCHED" ;
VAL_ 1297 RCM_a093_eventDriverBrakeApply 3 "Faulty_SNA" 2 "Driver_applying_brakes" 1 "Not_Applied" 0 "NotInit_orOff" ;
VAL_ 1297 RCM_a093_eventAccelPedalPos 255 "SNA" ;
VAL_ 1297 RCM_a094_eventArmStatus 1 "ARMED" 0 "UNARMED" ;
VAL_ 1297 RCM_a094_eventFactoryMode 1 "ENABLED" 0 "DISABLED" ;
VAL_ 1297 RCM_a094_eventDiagEnabled 1 "ENABLED" 0 "DISABLED" ;
VAL_ 1297 RCM_a094_eventDriveOrientation 1 "RIGHT_HAND_DRIVE" 0 "LEFT_HAND_DRIVE" ;
VAL_ 1297 RCM_a094_eventIDFsignal 1 "ACTIVE" 0 "NOT_ACTIVE" ;
VAL_ 1297 RCM_a094_eventFrontLeftSeatbelt 1 "LATCHED" 0 "UNLATCHED" ;
VAL_ 1297 RCM_a094_eventFrontRightSeatbelt 1 "LATCHED" 0 "UNLATCHED" ;
VAL_ 1297 RCM_a094_eventDriverBrakeApply 3 "Faulty_SNA" 2 "Driver_applying_brakes" 1 "Not_Applied" 0 "NotInit_orOff" ;
VAL_ 1297 RCM_a094_eventAccelPedalPos 255 "SNA" ;
VAL_ 1297 RCM_a101_eventArmStatus 1 "ARMED" 0 "UNARMED" ;
VAL_ 1297 RCM_a101_eventFactoryMode 1 "ENABLED" 0 "DISABLED" ;
VAL_ 1297 RCM_a101_eventDiagEnabled 1 "ENABLED" 0 "DISABLED" ;
VAL_ 1297 RCM_a101_eventDriveOrientation 1 "RIGHT_HAND_DRIVE" 0 "LEFT_HAND_DRIVE" ;
VAL_ 1297 RCM_a101_eventIDFsignal 1 "ACTIVE" 0 "NOT_ACTIVE" ;
VAL_ 1297 RCM_a101_eventFrontLeftSeatbelt 1 "LATCHED" 0 "UNLATCHED" ;
VAL_ 1297 RCM_a101_eventFrontRightSeatbelt 1 "LATCHED" 0 "UNLATCHED" ;
VAL_ 1297 RCM_a101_eventDriverBrakeApply 3 "Faulty_SNA" 2 "Driver_applying_brakes" 1 "Not_Applied" 0 "NotInit_orOff" ;
VAL_ 1297 RCM_a101_eventAccelPedalPos 255 "SNA" ;
VAL_ 1297 RCM_a102_eventArmStatus 1 "ARMED" 0 "UNARMED" ;
VAL_ 1297 RCM_a102_eventFactoryMode 1 "ENABLED" 0 "DISABLED" ;
VAL_ 1297 RCM_a102_eventDiagEnabled 1 "ENABLED" 0 "DISABLED" ;
VAL_ 1297 RCM_a102_eventDriveOrientation 1 "RIGHT_HAND_DRIVE" 0 "LEFT_HAND_DRIVE" ;
VAL_ 1297 RCM_a102_eventIDFsignal 1 "ACTIVE" 0 "NOT_ACTIVE" ;
VAL_ 1297 RCM_a102_eventFrontLeftSeatbelt 1 "LATCHED" 0 "UNLATCHED" ;
VAL_ 1297 RCM_a102_eventFrontRightSeatbelt 1 "LATCHED" 0 "UNLATCHED" ;
VAL_ 1297 RCM_a102_eventDriverBrakeApply 3 "Faulty_SNA" 2 "Driver_applying_brakes" 1 "Not_Applied" 0 "NotInit_orOff" ;
VAL_ 1297 RCM_a102_eventAccelPedalPos 255 "SNA" ;
VAL_ 1297 RCM_a103_eventArmStatus 1 "ARMED" 0 "UNARMED" ;
VAL_ 1297 RCM_a103_eventFactoryMode 1 "ENABLED" 0 "DISABLED" ;
VAL_ 1297 RCM_a103_eventDiagEnabled 1 "ENABLED" 0 "DISABLED" ;
VAL_ 1297 RCM_a103_eventDriveOrientation 1 "RIGHT_HAND_DRIVE" 0 "LEFT_HAND_DRIVE" ;
VAL_ 1297 RCM_a103_eventIDFsignal 1 "ACTIVE" 0 "NOT_ACTIVE" ;
VAL_ 1297 RCM_a103_eventFrontLeftSeatbelt 1 "LATCHED" 0 "UNLATCHED" ;
VAL_ 1297 RCM_a103_eventFrontRightSeatbelt 1 "LATCHED" 0 "UNLATCHED" ;
VAL_ 1297 RCM_a103_eventDriverBrakeApply 3 "Faulty_SNA" 2 "Driver_applying_brakes" 1 "Not_Applied" 0 "NotInit_orOff" ;
VAL_ 1297 RCM_a103_eventAccelPedalPos 255 "SNA" ;
VAL_ 1297 RCM_a104_eventArmStatus 1 "ARMED" 0 "UNARMED" ;
VAL_ 1297 RCM_a104_eventFactoryMode 1 "ENABLED" 0 "DISABLED" ;
VAL_ 1297 RCM_a104_eventDiagEnabled 1 "ENABLED" 0 "DISABLED" ;
VAL_ 1297 RCM_a104_eventDriveOrientation 1 "RIGHT_HAND_DRIVE" 0 "LEFT_HAND_DRIVE" ;
VAL_ 1297 RCM_a104_eventIDFsignal 1 "ACTIVE" 0 "NOT_ACTIVE" ;
VAL_ 1297 RCM_a104_eventFrontLeftSeatbelt 1 "LATCHED" 0 "UNLATCHED" ;
VAL_ 1297 RCM_a104_eventFrontRightSeatbelt 1 "LATCHED" 0 "UNLATCHED" ;
