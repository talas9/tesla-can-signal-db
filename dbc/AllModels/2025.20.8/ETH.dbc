VERSION "dbc-export 1 2025.20.8"

NS_ :

BS_:

BU_: ADSP APSB BB BMS CMP CP DAS DI DIF DIR DPB EPASTP EPASTS GTW ICR IDB OCS1P PM PMF PMR PTC RCM RCU TCU UI UIS VCLEFT VCSEC

BO_ 999 DPB_alertMatrix: 8 DPB
 SG_ DPB_matrixIndex M : 0|4@1+ (1,0) [0|15] "" Vector__XXX
 SG_ DPB_a001_pPlungerSensorOffsetHig m0 : 4|1@1+ (1,0) [0|1] "" Vector__XXX
 SG_ DPB_a002_pMC2SensorOffsetHigh m0 : 5|1@1+ (1,0) [0|1] "" Vector__XXX
 SG_ DPB_a003_AswEEPROMReadFailure m0 : 6|1@1+ (1,0) [0|1] "" Vector__XXX
 SG_ DPB_a004_assertionFault m0 : 7|1@1+ (1,0) [0|1] "" Vector__XXX
 SG_ DPB_a005_hardPedalChar m0 : 8|1@1+ (1,0) [0|1] "" Vector__XXX
 SG_ DPB_a006_hardPedalCharGoodCheck m0 : 9|1@1+ (1,0) [0|1] "" Vector__XXX
 SG_ DPB_a007_PMCLeakageDetected m0 : 10|1@1+ (1,0) [0|1] "" Vector__XXX
 SG_ DPB_a008_LiPSPts1Offset m0 : 11|1@1+ (1,0) [0|1] "" Vector__XXX
 SG_ DPB_a009_LiPSPts2Offset m0 : 12|1@1+ (1,0) [0|1] "" Vector__XXX
 SG_ DPB_a010_LiPSPtsConsistency m0 : 13|1@1+ (1,0) [0|1] "" Vector__XXX
 SG_ DPB_a011_PtsNonZeroStage1 m0 : 14|1@1+ (1,0) [0|1] "" Vector__XXX
 SG_ DPB_a012_PtsNonZeroStage2 m0 : 15|1@1+ (1,0) [0|1] "" Vector__XXX
 SG_ DPB_a013_softPedalChar m0 : 16|1@1+ (1,0) [0|1] "" Vector__XXX
 SG_ DPB_a014_CANControllerHWFault m0 : 17|1@1+ (1,0) [0|1] "" Vector__XXX
 SG_ DPB_a015_CAN1BusOff m0 : 18|1@1+ (1,0) [0|1] "" Vector__XXX
 SG_ DPB_a016_CAN2BusOff m0 : 19|1@1+ (1,0) [0|1] "" Vector__XXX
 SG_ DPB_a017_largeLeakageDetected m0 : 20|1@1+ (1,0) [0|1] "" Vector__XXX
 SG_ DPB_a018_largeLeakageDetectedGoo m0 : 21|1@1+ (1,0) [0|1] "" Vector__XXX
 SG_ DPB_a019_DETReportError m0 : 22|1@1+ (1,0) [0|1] "" Vector__XXX
 SG_ DPB_a020_ecuHuMismatch m0 : 23|1@1+ (1,0) [0|1] "" Vector__XXX
 SG_ DPB_a021_brakeSystemOverheatLvl1 m0 : 24|1@1+ (1,0) [0|1] "" Vector__XXX
 SG_ DPB_a022_brakeSystemOverheatLvl2 m0 : 25|1@1+ (1,0) [0|1] "" Vector__XXX
 SG_ DPB_a023_initialPlungerCheckFail m0 : 26|1@1+ (1,0) [0|1] "" Vector__XXX
 SG_ DPB_a024_ESPLDMFailure m0 : 27|1@1+ (1,0) [0|1] "" Vector__XXX
 SG_ DPB_a025_backupCircuitLeakage m0 : 28|1@1+ (1,0) [0|1] "" Vector__XXX
 SG_ DPB_a026_LiPSIDTimeout m0 : 29|1@1+ (1,0) [0|1] "" Vector__XXX
 SG_ DPB_a027_motorTempHighLevel1 m0 : 30|1@1+ (1,0) [0|1] "" Vector__XXX
 SG_ DPB_a028_motorTempHighLevel2 m0 : 31|1@1+ (1,0) [0|1] "" Vector__XXX
 SG_ DPB_a029_motorTestFault m0 : 32|1@1+ (1,0) [0|1] "" Vector__XXX
 SG_ DPB_a030_notShutDownRight m0 : 33|1@1+ (1,0) [0|1] "" Vector__XXX
 SG_ DPB_a031_HWParamReadFailed m0 : 34|1@1+ (1,0) [0|1] "" Vector__XXX
 SG_ DPB_a032_HWParamWriteFailed m0 : 35|1@1+ (1,0) [0|1] "" Vector__XXX
 SG_ DPB_a033_motorDynamicLimited m0 : 36|1@1+ (1,0) [0|1] "" Vector__XXX
 SG_ DPB_a034_lipsMemoryEmpty m0 : 37|1@1+ (1,0) [0|1] "" Vector__XXX
 SG_ DPB_a035_PDURouterinitialization m0 : 38|1@1+ (1,0) [0|1] "" Vector__XXX
 SG_ DPB_a036_lossOfPDUInstanceDetect m0 : 39|1@1+ (1,0) [0|1] "" Vector__XXX
 SG_ DPB_a037_plungerCircuitPressHigh m0 : 40|1@1+ (1,0) [0|1] "" Vector__XXX
 SG_ DPB_a038_plungerCircuitPressHigh m0 : 41|1@1+ (1,0) [0|1] "" Vector__XXX
 SG_ DPB_a039_plungerCircuitPressLow m0 : 42|1@1+ (1,0) [0|1] "" Vector__XXX
 SG_ DPB_a040_plungerCircuitPressLowG m0 : 43|1@1+ (1,0) [0|1] "" Vector__XXX
 SG_ DPB_a041_PSCGearRatioReadFault m0 : 44|1@1+ (1,0) [0|1] "" Vector__XXX
 SG_ DPB_a042_motorLoadPressImplausib m0 : 45|1@1+ (1,0) [0|1] "" Vector__XXX
 SG_ DPB_a043_PSCMotorSizeReadFault m0 : 46|1@1+ (1,0) [0|1] "" Vector__XXX
 SG_ DPB_a044_supplyOvervoltageLvl1 m0 : 47|1@1+ (1,0) [0|1] "" Vector__XXX
 SG_ DPB_a045_supplyOvervoltageLvl2 m0 : 48|1@1+ (1,0) [0|1] "" Vector__XXX
 SG_ DPB_a046_supplyOvervoltageLvl3 m0 : 49|1@1+ (1,0) [0|1] "" Vector__XXX
 SG_ DPB_a047_pPlungerPlausCheckFailu m0 : 50|1@1+ (1,0) [0|1] "" Vector__XXX
 SG_ DPB_a048_supplyUndervoltageLvl1 m0 : 51|1@1+ (1,0) [0|1] "" Vector__XXX
 SG_ DPB_a049_supplyUndervoltageLvl2 m0 : 52|1@1+ (1,0) [0|1] "" Vector__XXX
 SG_ DPB_a050_supplyUndervoltageLvl3 m0 : 53|1@1+ (1,0) [0|1] "" Vector__XXX
 SG_ DPB_a051_PSCVoltageImplausible m0 : 54|1@1+ (1,0) [0|1] "" Vector__XXX
 SG_ DPB_a052_PSIDTimeOut m0 : 55|1@1+ (1,0) [0|1] "" Vector__XXX
 SG_ DPB_a053_hydraulicAssemblyModeAc m0 : 56|1@1+ (1,0) [0|1] "" Vector__XXX
 SG_ DPB_a054_unsupportedHW m0 : 57|1@1+ (1,0) [0|1] "" Vector__XXX
 SG_ DPB_a055_unsupportedSeriesHWDete m0 : 58|1@1+ (1,0) [0|1] "" Vector__XXX
 SG_ DPB_a056_AdcPeripheralFault m0 : 59|1@1+ (1,0) [0|1] "" Vector__XXX
 SG_ DPB_a057_AdcPinTest m0 : 60|1@1+ (1,0) [0|1] "" Vector__XXX
 SG_ DPB_a058_AdcSelftestC5P m0 : 61|1@1+ (1,0) [0|1] "" Vector__XXX
 SG_ DPB_a059_factoryModeActive m0 : 62|1@1+ (1,0) [0|1] "" Vector__XXX
 SG_ DPB_a060_motorBridgeDriverFault m0 : 63|1@1+ (1,0) [0|1] "" Vector__XXX
 SG_ DPB_a061_bridgeSwitchInitError m1 : 4|1@1+ (1,0) [0|1] "" Vector__XXX
 SG_ DPB_a062_loadDumpOnFSLTest m1 : 5|1@1+ (1,0) [0|1] "" Vector__XXX
 SG_ DPB_a063_motorConfigMismatch m1 : 6|1@1+ (1,0) [0|1] "" Vector__XXX
 SG_ DPB_a064_current1OffsetHigh m1 : 7|1@1+ (1,0) [0|1] "" Vector__XXX
 SG_ DPB_a065_current1OffsetLow m1 : 8|1@1+ (1,0) [0|1] "" Vector__XXX
 SG_ DPB_a066_current2OffsetHigh m1 : 9|1@1+ (1,0) [0|1] "" Vector__XXX
 SG_ DPB_a067_current2OffsetLow m1 : 10|1@1+ (1,0) [0|1] "" Vector__XXX
 SG_ DPB_a068_BLMMuxerTimeoutError m1 : 11|1@1+ (1,0) [0|1] "" Vector__XXX
 SG_ DPB_a069_OBDCurrent1OORHigh m1 : 12|1@1+ (1,0) [0|1] "" Vector__XXX
 SG_ DPB_a070_OBDCurrent1OORLow m1 : 13|1@1+ (1,0) [0|1] "" Vector__XXX
 SG_ DPB_a071_OBDCurrent2OORHigh m1 : 14|1@1+ (1,0) [0|1] "" Vector__XXX
 SG_ DPB_a072_OBDCurrent2OORLow m1 : 15|1@1+ (1,0) [0|1] "" Vector__XXX
 SG_ DPB_a073_rotorCosOutOfRangeHigh m1 : 16|1@1+ (1,0) [0|1] "" Vector__XXX
 SG_ DPB_a074_rotorCosOutOfRangeLow m1 : 17|1@1+ (1,0) [0|1] "" Vector__XXX
 SG_ DPB_a075_rotorSinOutOfRangeHigh m1 : 18|1@1+ (1,0) [0|1] "" Vector__XXX
 SG_ DPB_a076_rotorSinOutOfRangeLow m1 : 19|1@1+ (1,0) [0|1] "" Vector__XXX
 SG_ DPB_a077_tempSens1ShortToSupply m1 : 20|1@1+ (1,0) [0|1] "" Vector__XXX
 SG_ DPB_a078_tempSens1ShortToGround m1 : 21|1@1+ (1,0) [0|1] "" Vector__XXX
 SG_ DPB_a079_tempSens2ShortToSupply m1 : 22|1@1+ (1,0) [0|1] "" Vector__XXX
 SG_ DPB_a080_tempSens2ShortToGround m1 : 23|1@1+ (1,0) [0|1] "" Vector__XXX
 SG_ DPB_a081_tempSensImplausVoltage m1 : 24|1@1+ (1,0) [0|1] "" Vector__XXX
 SG_ DPB_a082_chargePumpFault m1 : 25|1@1+ (1,0) [0|1] "" Vector__XXX
 SG_ DPB_a083_chargePumpUndervoltage m1 : 26|1@1+ (1,0) [0|1] "" Vector__XXX
 SG_ DPB_a084_RBCPUException m1 : 27|1@1+ (1,0) [0|1] "" Vector__XXX
 SG_ DPB_a085_infoFailureWrongCUBASHa m1 : 28|1@1+ (1,0) [0|1] "" Vector__XXX
 SG_ DPB_a086_diagHydProtectionPressF m1 : 29|1@1+ (1,0) [0|1] "" Vector__XXX
 SG_ DPB_a087_diagHydProtectionVlvFau m1 : 30|1@1+ (1,0) [0|1] "" Vector__XXX
 SG_ DPB_a088_DMATransferError m1 : 31|1@1+ (1,0) [0|1] "" Vector__XXX
 SG_ DPB_a089_ecuBandgap m1 : 32|1@1+ (1,0) [0|1] "" Vector__XXX
 SG_ DPB_a090_flashFault m1 : 33|1@1+ (1,0) [0|1] "" Vector__XXX
 SG_ DPB_a091_MRGPathTestFault m1 : 34|1@1+ (1,0) [0|1] "" Vector__XXX
 SG_ DPB_a092_decoupleBitTestFault m1 : 35|1@1+ (1,0) [0|1] "" Vector__XXX
 SG_ DPB_a093_ecuBistFaultCtrFault m1 : 36|1@1+ (1,0) [0|1] "" Vector__XXX
 SG_ DPB_a094_ecuClockTestFault m1 : 37|1@1+ (1,0) [0|1] "" Vector__XXX
 SG_ DPB_a095_ecuEnableElHighFault m1 : 38|1@1+ (1,0) [0|1] "" Vector__XXX
 SG_ DPB_a096_ecuEnableElLowFault m1 : 39|1@1+ (1,0) [0|1] "" Vector__XXX
 SG_ DPB_a097_ecuEnableHyHighFault m1 : 40|1@1+ (1,0) [0|1] "" Vector__XXX
 SG_ DPB_a098_ecuEnableHyLowFault m1 : 41|1@1+ (1,0) [0|1] "" Vector__XXX
 SG_ DPB_a099_ecuEnContinuousError m1 : 42|1@1+ (1,0) [0|1] "" Vector__XXX
 SG_ DPB_a100_ecuErrpinCounterFault m1 : 43|1@1+ (1,0) [0|1] "" Vector__XXX
 SG_ DPB_a101_ecuFastWdTestFault m1 : 44|1@1+ (1,0) [0|1] "" Vector__XXX
 SG_ DPB_a102_ecuVrOnWhileWdTimeout m1 : 45|1@1+ (1,0) [0|1] "" Vector__XXX
 SG_ DPB_a103_ecuVrViaSpiFails m1 : 46|1@1+ (1,0) [0|1] "" Vector__XXX
 SG_ DPB_a104_ecuWdStartuptestFault m1 : 47|1@1+ (1,0) [0|1] "" Vector__XXX
 SG_ DPB_a105_ecuWdSContinuousError m1 : 48|1@1+ (1,0) [0|1] "" Vector__XXX
 SG_ DPB_a106_ecuBistCmdTestFault m1 : 49|1@1+ (1,0) [0|1] "" Vector__XXX
 SG_ DPB_a107_vrOnFails m1 : 50|1@1+ (1,0) [0|1] "" Vector__XXX
 SG_ DPB_a108_GTMRefFrequencyError m1 : 51|1@1+ (1,0) [0|1] "" Vector__XXX
 SG_ DPB_a109_GTMTbuMonError m1 : 52|1@1+ (1,0) [0|1] "" Vector__XXX
 SG_ DPB_a110_HWBISTError m1 : 53|1@1+ (1,0) [0|1] "" Vector__XXX
 SG_ DPB_a111_hydraulicHardUndervolta m1 : 54|1@1+ (1,0) [0|1] "" Vector__XXX
 SG_ DPB_a112_hydraulicUndervoltage m1 : 55|1@1+ (1,0) [0|1] "" Vector__XXX
 SG_ DPB_a113_LiPS1SentLineHigh m1 : 56|1@1+ (1,0) [0|1] "" Vector__XXX
 SG_ DPB_a114_LiPS1SentLineLow m1 : 57|1@1+ (1,0) [0|1] "" Vector__XXX
 SG_ DPB_a115_LiPS1SentSensor m1 : 58|1@1+ (1,0) [0|1] "" Vector__XXX
 SG_ DPB_a116_LiPS1SentTransmission m1 : 59|1@1+ (1,0) [0|1] "" Vector__XXX
 SG_ DPB_a117_LiPS2PwmLineHigh m1 : 60|1@1+ (1,0) [0|1] "" Vector__XXX
 SG_ DPB_a118_LiPS2PwmLineLow m1 : 61|1@1+ (1,0) [0|1] "" Vector__XXX
 SG_ DPB_a119_LiPS2PwmTransmission m1 : 62|1@1+ (1,0) [0|1] "" Vector__XXX
 SG_ DPB_a120_LiPSOutOfRangeHigh m1 : 63|1@1+ (1,0) [0|1] "" Vector__XXX
 SG_ DPB_a121_LiPSOutOfRangeLow m2 : 4|1@1+ (1,0) [0|1] "" Vector__XXX
 SG_ DPB_a122_micAsicClkInError m2 : 5|1@1+ (1,0) [0|1] "" Vector__XXX
 SG_ DPB_a123_micAsicInitTestError m2 : 6|1@1+ (1,0) [0|1] "" Vector__XXX
 SG_ DPB_a124_asicOscillatorError m2 : 7|1@1+ (1,0) [0|1] "" Vector__XXX
 SG_ DPB_a125_B6AsicFault m2 : 8|1@1+ (1,0) [0|1] "" Vector__XXX
 SG_ DPB_a126_MICB6TransferError m2 : 9|1@1+ (1,0) [0|1] "" Vector__XXX
 SG_ DPB_a127_hydraulicAsicShortCircu m2 : 10|1@1+ (1,0) [0|1] "" Vector__XXX
 SG_ DPB_a128_micSpiTransferError m2 : 11|1@1+ (1,0) [0|1] "" Vector__XXX
 SG_ DPB_a129_AsicTrimmingNotComplete m2 : 12|1@1+ (1,0) [0|1] "" Vector__XXX
 SG_ DPB_a130_AsicMalfunctionDetected m2 : 13|1@1+ (1,0) [0|1] "" Vector__XXX
 SG_ DPB_a131_ASICOvercurrentOnGPIO25 m2 : 14|1@1+ (1,0) [0|1] "" Vector__XXX
 SG_ DPB_a132_ASICOvercurrentOnGPIO25 m2 : 15|1@1+ (1,0) [0|1] "" Vector__XXX
 SG_ DPB_a133_ASICOvercurrentOnGPIO50 m2 : 16|1@1+ (1,0) [0|1] "" Vector__XXX
 SG_ DPB_a134_ASICOvercurrentOnGPIO50 m2 : 17|1@1+ (1,0) [0|1] "" Vector__XXX
 SG_ DPB_a135_ASICOvercurrentOnGPIO50 m2 : 18|1@1+ (1,0) [0|1] "" Vector__XXX
 SG_ DPB_a136_ASICOvercurrentOnGPIO50 m2 : 19|1@1+ (1,0) [0|1] "" Vector__XXX
 SG_ DPB_a137_ASICOvercurrentOnWRHS m2 : 20|1@1+ (1,0) [0|1] "" Vector__XXX
 SG_ DPB_a138_DIchassisControlCounter m2 : 21|1@1+ (1,0) [0|1] "" Vector__XXX
 SG_ DPB_a139_DIchassisControlChecksu m2 : 22|1@1+ (1,0) [0|1] "" Vector__XXX
 SG_ DPB_a140_DIchassisControlDLC m2 : 23|1@1+ (1,0) [0|1] "" Vector__XXX
 SG_ DPB_a141_DIchassisControlTimeout m2 : 24|1@1+ (1,0) [0|1] "" Vector__XXX
 SG_ DPB_a142_DIsystemStatusCounter m2 : 25|1@1+ (1,0) [0|1] "" Vector__XXX
 SG_ DPB_a143_DIsystemStatusChecksum m2 : 26|1@1+ (1,0) [0|1] "" Vector__XXX
 SG_ DPB_a144_DIsystemStatusDLC m2 : 27|1@1+ (1,0) [0|1] "" Vector__XXX
 SG_ DPB_a145_DIsystemStatusTimeout m2 : 28|1@1+ (1,0) [0|1] "" Vector__XXX
 SG_ DPB_a146_DIFtorqueCounter m2 : 29|1@1+ (1,0) [0|1] "" Vector__XXX
 SG_ DPB_a147_DIFtorqueChecksum m2 : 30|1@1+ (1,0) [0|1] "" Vector__XXX
 SG_ DPB_a148_DIFtorqueDLC m2 : 31|1@1+ (1,0) [0|1] "" Vector__XXX
 SG_ DPB_a149_DIFtorqueTimeout m2 : 32|1@1+ (1,0) [0|1] "" Vector__XXX
 SG_ DPB_a150_DIRtorqueCounter m2 : 33|1@1+ (1,0) [0|1] "" Vector__XXX
 SG_ DPB_a151_DIRtorqueChecksum m2 : 34|1@1+ (1,0) [0|1] "" Vector__XXX
 SG_ DPB_a152_DIRtorqueDLC m2 : 35|1@1+ (1,0) [0|1] "" Vector__XXX
 SG_ DPB_a153_DIRtorqueTimeout m2 : 36|1@1+ (1,0) [0|1] "" Vector__XXX
 SG_ DPB_a154_EPBLstatusCounter m2 : 37|1@1+ (1,0) [0|1] "" Vector__XXX
 SG_ DPB_a155_EPBLstatusChecksum m2 : 38|1@1+ (1,0) [0|1] "" Vector__XXX
 SG_ DPB_a156_EPBLstatusDLC m2 : 39|1@1+ (1,0) [0|1] "" Vector__XXX
 SG_ DPB_a157_EPBLstatusTimeout m2 : 40|1@1+ (1,0) [0|1] "" Vector__XXX
 SG_ DPB_a158_EPBRstatusCounter m2 : 41|1@1+ (1,0) [0|1] "" Vector__XXX
 SG_ DPB_a159_EPBRstatusChecksum m2 : 42|1@1+ (1,0) [0|1] "" Vector__XXX
 SG_ DPB_a160_EPBRstatusDLC m2 : 43|1@1+ (1,0) [0|1] "" Vector__XXX
 SG_ DPB_a161_EPBRstatusTimeout m2 : 44|1@1+ (1,0) [0|1] "" Vector__XXX
 SG_ DPB_a162_ESP_modulator1Counter m2 : 45|1@1+ (1,0) [0|1] "" Vector__XXX
 SG_ DPB_a163_ESP_modulator1Checksum m2 : 46|1@1+ (1,0) [0|1] "" Vector__XXX
 SG_ DPB_a164_ESP_modulator1DLC m2 : 47|1@1+ (1,0) [0|1] "" Vector__XXX
 SG_ DPB_a165_ESP_modulator1Timeout m2 : 48|1@1+ (1,0) [0|1] "" Vector__XXX
 SG_ DPB_a166_ESP_chassis3Counter m2 : 49|1@1+ (1,0) [0|1] "" Vector__XXX
 SG_ DPB_a167_ESP_chassis3Checksum m2 : 50|1@1+ (1,0) [0|1] "" Vector__XXX
 SG_ DPB_a168_ESP_chassis3DLC m2 : 51|1@1+ (1,0) [0|1] "" Vector__XXX
 SG_ DPB_a169_ESP_chassis3Timeout m2 : 52|1@1+ (1,0) [0|1] "" Vector__XXX
 SG_ DPB_a170_ESP_modulator2Counter m2 : 53|1@1+ (1,0) [0|1] "" Vector__XXX
 SG_ DPB_a171_ESP_modulator2Checksum m2 : 54|1@1+ (1,0) [0|1] "" Vector__XXX
 SG_ DPB_a172_ESP_modulator2DLC m2 : 55|1@1+ (1,0) [0|1] "" Vector__XXX
 SG_ DPB_a173_ESP_modulator2Timeout m2 : 56|1@1+ (1,0) [0|1] "" Vector__XXX
 SG_ DPB_a174_ESP_modulator3Counter m2 : 57|1@1+ (1,0) [0|1] "" Vector__XXX
 SG_ DPB_a175_ESP_modulator3Checksum m2 : 58|1@1+ (1,0) [0|1] "" Vector__XXX
 SG_ DPB_a176_ESP_modulator3DLC m2 : 59|1@1+ (1,0) [0|1] "" Vector__XXX
 SG_ DPB_a177_ESP_modulator3Timeout m2 : 60|1@1+ (1,0) [0|1] "" Vector__XXX
 SG_ DPB_a178_PMstate2Counter m2 : 61|1@1+ (1,0) [0|1] "" Vector__XXX
 SG_ DPB_a179_PMstate2Checksum m2 : 62|1@1+ (1,0) [0|1] "" Vector__XXX
 SG_ DPB_a180_PMstate2DLC m2 : 63|1@1+ (1,0) [0|1] "" Vector__XXX
 SG_ DPB_a181_PMstate2Timeout m3 : 4|1@1+ (1,0) [0|1] "" Vector__XXX
 SG_ DPB_a182_RCMInertial2Counter m3 : 5|1@1+ (1,0) [0|1] "" Vector__XXX
 SG_ DPB_a183_RCMInertial2Checksum m3 : 6|1@1+ (1,0) [0|1] "" Vector__XXX
 SG_ DPB_a184_RCMInertial2DLC m3 : 7|1@1+ (1,0) [0|1] "" Vector__XXX
 SG_ DPB_a185_RCMInertial2Timeout m3 : 8|1@1+ (1,0) [0|1] "" Vector__XXX
 SG_ DPB_a186_LVPowerStateTimeout m3 : 9|1@1+ (1,0) [0|1] "" Vector__XXX
 SG_ DPB_a187_LVPowerStateChecksum m3 : 10|1@1+ (1,0) [0|1] "" Vector__XXX
 SG_ DPB_a188_LVPowerStateDLC m3 : 11|1@1+ (1,0) [0|1] "" Vector__XXX
 SG_ DPB_a189_LVPowerStateCounter m3 : 12|1@1+ (1,0) [0|1] "" Vector__XXX
 SG_ DPB_a190_VCLEFTepbmStatusCounter m3 : 13|1@1+ (1,0) [0|1] "" Vector__XXX
 SG_ DPB_a191_VCLEFTepbmStatusChecksu m3 : 14|1@1+ (1,0) [0|1] "" Vector__XXX
 SG_ DPB_a192_VCLEFTepbmStatusDLC m3 : 15|1@1+ (1,0) [0|1] "" Vector__XXX
 SG_ DPB_a193_VCLEFTepbmStatusTimeout m3 : 16|1@1+ (1,0) [0|1] "" Vector__XXX
 SG_ DPB_a194_VCRIGHTepbmStatusCounte m3 : 17|1@1+ (1,0) [0|1] "" Vector__XXX
 SG_ DPB_a195_VCRIGHTepbmStatusChecks m3 : 18|1@1+ (1,0) [0|1] "" Vector__XXX
 SG_ DPB_a196_VCRIGHTepbmStatusDLC m3 : 19|1@1+ (1,0) [0|1] "" Vector__XXX
 SG_ DPB_a197_VCRIGHTepbmStatusTimeou m3 : 20|1@1+ (1,0) [0|1] "" Vector__XXX
 SG_ DPB_a198_CANOvervoltage m3 : 21|1@1+ (1,0) [0|1] "" Vector__XXX
 SG_ DPB_a199_pMC1QFaulty m3 : 22|1@1+ (1,0) [0|1] "" Vector__XXX
 SG_ DPB_a200_ESPRunoutSupportNotAvai m3 : 23|1@1+ (1,0) [0|1] "" Vector__XXX
 SG_ DPB_a201_vehicleSpeedQFaulty m3 : 24|1@1+ (1,0) [0|1] "" Vector__XXX
 SG_ DPB_a202_vehicleStandstillQFault m3 : 25|1@1+ (1,0) [0|1] "" Vector__XXX
 SG_ DPB_a203_ABSNotAvailable m3 : 26|1@1+ (1,0) [0|1] "" Vector__XXX
 SG_ DPB_a204_CANUndervoltage m3 : 27|1@1+ (1,0) [0|1] "" Vector__XXX
 SG_ DPB_a205_NvMWriteCycleExceed m3 : 28|1@1+ (1,0) [0|1] "" Vector__XXX
 SG_ DPB_a206_OSTaskSchemeError m3 : 29|1@1+ (1,0) [0|1] "" Vector__XXX
 SG_ DPB_a207_hydraulicOvervoltage m3 : 30|1@1+ (1,0) [0|1] "" Vector__XXX
 SG_ DPB_a208_pressureSensor1Short m3 : 31|1@1+ (1,0) [0|1] "" Vector__XXX
 SG_ DPB_a209_pressureSensor1High m3 : 32|1@1+ (1,0) [0|1] "" Vector__XXX
 SG_ DPB_a210_pressureSensor1Low m3 : 33|1@1+ (1,0) [0|1] "" Vector__XXX
 SG_ DPB_a211_pressureSensor1Fault m3 : 34|1@1+ (1,0) [0|1] "" Vector__XXX
 SG_ DPB_a212_pressureSensor1Temp m3 : 35|1@1+ (1,0) [0|1] "" Vector__XXX
 SG_ DPB_a213_pressureSensor1Fault m3 : 36|1@1+ (1,0) [0|1] "" Vector__XXX
 SG_ DPB_a214_pressureSensor2Short m3 : 37|1@1+ (1,0) [0|1] "" Vector__XXX
 SG_ DPB_a215_pressureSensor2High m3 : 38|1@1+ (1,0) [0|1] "" Vector__XXX
 SG_ DPB_a216_pressureSensor2Low m3 : 39|1@1+ (1,0) [0|1] "" Vector__XXX
 SG_ DPB_a217_pressureSensor2Fault m3 : 40|1@1+ (1,0) [0|1] "" Vector__XXX
 SG_ DPB_a218_pressureSensor2Temp m3 : 41|1@1+ (1,0) [0|1] "" Vector__XXX
 SG_ DPB_a219_pressureSensor2Fault m3 : 42|1@1+ (1,0) [0|1] "" Vector__XXX
 SG_ DPB_a220_excessiveBoostWakeupsDe m3 : 43|1@1+ (1,0) [0|1] "" Vector__XXX
 SG_ DPB_a221_notShutdownRight m3 : 44|1@1+ (1,0) [0|1] "" Vector__XXX
 SG_ DPB_a222_excessiveEcuResetsDetec m3 : 45|1@1+ (1,0) [0|1] "" Vector__XXX
 SG_ DPB_a223_RAMFault m3 : 46|1@1+ (1,0) [0|1] "" Vector__XXX
 SG_ DPB_a224_brakeBoostLost m3 : 47|1@1+ (1,0) [0|1] "" Vector__XXX
 SG_ DPB_a225_U5VOutOfRange m3 : 48|1@1+ (1,0) [0|1] "" Vector__XXX
 SG_ DPB_a226_U5VTestFault m3 : 49|1@1+ (1,0) [0|1] "" Vector__XXX
 SG_ DPB_a227_brakeFluidLoss m3 : 50|1@1+ (1,0) [0|1] "" Vector__XXX
 SG_ DPB_a228_supplyASICInitFault m3 : 51|1@1+ (1,0) [0|1] "" Vector__XXX
 SG_ DPB_a229_IREFOutOfRange m3 : 52|1@1+ (1,0) [0|1] "" Vector__XXX
 SG_ DPB_a230_OSErrorHook m3 : 53|1@1+ (1,0) [0|1] "" Vector__XXX
 SG_ DPB_a231_stackOverUnderFlow m3 : 54|1@1+ (1,0) [0|1] "" Vector__XXX
 SG_ DPB_a232_systemErrorHook m3 : 55|1@1+ (1,0) [0|1] "" Vector__XXX
 SG_ DPB_a233_systemTaskJitter m3 : 56|1@1+ (1,0) [0|1] "" Vector__XXX
 SG_ DPB_a234_systemTaskOverRun m3 : 57|1@1+ (1,0) [0|1] "" Vector__XXX
 SG_ DPB_a235_UB6PlausiMonFault m3 : 58|1@1+ (1,0) [0|1] "" Vector__XXX
 SG_ DPB_a236_UB6SupplyPathFault m3 : 59|1@1+ (1,0) [0|1] "" Vector__XXX
 SG_ DPB_a237_uCVoltageDividerDrift m3 : 60|1@1+ (1,0) [0|1] "" Vector__XXX
 SG_ DPB_a238_microRegisterFault m3 : 61|1@1+ (1,0) [0|1] "" Vector__XXX
 SG_ DPB_a239_microSafetyFault m3 : 62|1@1+ (1,0) [0|1] "" Vector__XXX
 SG_ DPB_a240_microSafetyLogicFault m3 : 63|1@1+ (1,0) [0|1] "" Vector__XXX
 SG_ DPB_a241_uCSafetyNotification m4 : 4|1@1+ (1,0) [0|1] "" Vector__XXX
 SG_ DPB_a242_uCSafetyNotificationGRA m4 : 5|1@1+ (1,0) [0|1] "" Vector__XXX
 SG_ DPB_a243_microSupplyError m4 : 6|1@1+ (1,0) [0|1] "" Vector__XXX
 SG_ DPB_a244_valvesGenericFault m4 : 7|1@1+ (1,0) [0|1] "" Vector__XXX
 SG_ DPB_a245_valveMV0Fault m4 : 8|1@1+ (1,0) [0|1] "" Vector__XXX
 SG_ DPB_a246_valveMV5Fault m4 : 9|1@1+ (1,0) [0|1] "" Vector__XXX
 SG_ DPB_a247_valveMV6Fault m4 : 10|1@1+ (1,0) [0|1] "" Vector__XXX
 SG_ DPB_a248_valveMV61Fault m4 : 11|1@1+ (1,0) [0|1] "" Vector__XXX
 SG_ DPB_a249_valveMV62Fault m4 : 12|1@1+ (1,0) [0|1] "" Vector__XXX
 SG_ DPB_a250_valveMV7Fault m4 : 13|1@1+ (1,0) [0|1] "" Vector__XXX
 SG_ DPB_a251_valveMV8Fault m4 : 14|1@1+ (1,0) [0|1] "" Vector__XXX
 SG_ DPB_a252_valveMV81Fault m4 : 15|1@1+ (1,0) [0|1] "" Vector__XXX
 SG_ DPB_a253_valveMV82Fault m4 : 16|1@1+ (1,0) [0|1] "" Vector__XXX
 SG_ DPB_a254_valveMV9Fault m4 : 17|1@1+ (1,0) [0|1] "" Vector__XXX
 SG_ DPB_a255_valveRelayShort m4 : 18|1@1+ (1,0) [0|1] "" Vector__XXX
 SG_ DPB_a256_valveRelayActuationFaul m4 : 19|1@1+ (1,0) [0|1] "" Vector__XXX
 SG_ DPB_a257_valveRelayOnContinuous m4 : 20|1@1+ (1,0) [0|1] "" Vector__XXX
 SG_ DPB_a258_valveRelayOffContinuous m4 : 21|1@1+ (1,0) [0|1] "" Vector__XXX
 SG_ DPB_a259_valveRelayTestUndervolt m4 : 22|1@1+ (1,0) [0|1] "" Vector__XXX
 SG_ DPB_a260_valveRelaySafetySwitchF m4 : 23|1@1+ (1,0) [0|1] "" Vector__XXX
 SG_ DPB_a261_WdhAsicWdCmdMissing m4 : 24|1@1+ (1,0) [0|1] "" Vector__XXX
 SG_ DPB_a262_WdhAsicWdErrorCntLimit m4 : 25|1@1+ (1,0) [0|1] "" Vector__XXX
 SG_ DPB_a263_WdhAsicWdErrorCntStuck m4 : 26|1@1+ (1,0) [0|1] "" Vector__XXX
 SG_ DPB_a264_WdhSwBistConCnt m4 : 27|1@1+ (1,0) [0|1] "" Vector__XXX
 SG_ DPB_a265_WdhTaskMonConCnt m4 : 28|1@1+ (1,0) [0|1] "" Vector__XXX
 SG_ DPB_a266_RPSNvMReadFault m4 : 29|1@1+ (1,0) [0|1] "" Vector__XXX
 SG_ DPB_a267_RpsAngleImplausible m4 : 30|1@1+ (1,0) [0|1] "" Vector__XXX
 SG_ DPB_a268_RPSVectorOscillating m4 : 31|1@1+ (1,0) [0|1] "" Vector__XXX
 SG_ DPB_a269_RPSVectorRangeHigh m4 : 32|1@1+ (1,0) [0|1] "" Vector__XXX
 SG_ DPB_a270_RPSVectorRangeLow m4 : 33|1@1+ (1,0) [0|1] "" Vector__XXX
 SG_ DPB_a271_RPSWrongCalibData m4 : 34|1@1+ (1,0) [0|1] "" Vector__XXX
 SG_ DPB_a272_runtimeAssertionFault m4 : 35|1@1+ (1,0) [0|1] "" Vector__XXX
 SG_ DPB_a273_SMMOneRequestsInit m4 : 36|1@1+ (1,0) [0|1] "" Vector__XXX
 SG_ DPB_a274_AswSystemTimeOut m4 : 37|1@1+ (1,0) [0|1] "" Vector__XXX
 SG_ DPB_a275_Ps1Ps2PlausibilityFault m4 : 38|1@1+ (1,0) [0|1] "" Vector__XXX
 SG_ DPB_a276_VCFRONTsensorsCounter m4 : 39|1@1+ (1,0) [0|1] "" Vector__XXX
 SG_ DPB_a277_VCFRONTsensorsChecksum m4 : 40|1@1+ (1,0) [0|1] "" Vector__XXX
 SG_ DPB_a278_VCFRONTsensorsDLC m4 : 41|1@1+ (1,0) [0|1] "" Vector__XXX
 SG_ DPB_a279_VCFRONTsensorsTimeout m4 : 42|1@1+ (1,0) [0|1] "" Vector__XXX
 SG_ DPB_a280_LowBrakeFluid m4 : 43|1@1+ (1,0) [0|1] "" Vector__XXX
 SG_ DPB_a281_brakeFluidOORHigh m4 : 44|1@1+ (1,0) [0|1] "" Vector__XXX
 SG_ DPB_a282_DIbrakeCommandCounter m4 : 45|1@1+ (1,0) [0|1] "" Vector__XXX
 SG_ DPB_a283_DIbrakeCommandChecksum m4 : 46|1@1+ (1,0) [0|1] "" Vector__XXX
 SG_ DPB_a284_DIbrakeCommandDLC m4 : 47|1@1+ (1,0) [0|1] "" Vector__XXX
 SG_ DPB_a285_DIbrakeCommandTimeout m4 : 48|1@1+ (1,0) [0|1] "" Vector__XXX
 SG_ DPB_a286_ebrCmdStateInvalid m4 : 49|1@1+ (1,0) [0|1] "" Vector__XXX
 SG_ DPB_a287_brakeCmdStateInvalid m4 : 50|1@1+ (1,0) [0|1] "" Vector__XXX
 SG_ DPB_a288_PlantDegradedSW m4 : 51|1@1+ (1,0) [0|1] "" Vector__XXX
 SG_ DPB_a289_evacFillNotComplete m4 : 52|1@1+ (1,0) [0|1] "" Vector__XXX
 SG_ DPB_a290_securityInfo m4 : 53|1@1+ (1,0) [0|1] "" Vector__XXX
 SG_ DPB_a291_extDBRRequestTooLow m4 : 54|1@1+ (1,0) [0|1] "" Vector__XXX
 SG_ DPB_a292_CBDS_fillBufferThreshol m4 : 55|1@1+ (1,0) [0|1] "" Vector__XXX
 SG_ DPB_a293_CBDS_fmeInternalEvent m4 : 56|1@1+ (1,0) [0|1] "" Vector__XXX
 SG_ DPB_a294_hbaNormalModeActive m4 : 57|1@1+ (1,0) [0|1] "" Vector__XXX
 SG_ DPB_a295_hbaTrackModeActive m4 : 58|1@1+ (1,0) [0|1] "" Vector__XXX
 SG_ DPB_a296_StatInvalid_DI_FullSNA m4 : 59|1@1+ (1,0) [0|1] "" Vector__XXX
 SG_ DPB_a297_undefinedAlertDetected m4 : 60|1@1+ (1,0) [0|1] "" Vector__XXX
 SG_ DPB_a298_RunningActiveSystemTest m4 : 61|1@1+ (1,0) [0|1] "" Vector__XXX
 SG_ DPB_a299_PM_locStateCounter m4 : 62|1@1+ (1,0) [0|1] "" Vector__XXX
 SG_ DPB_a300_PM_locStateChecksum m4 : 63|1@1+ (1,0) [0|1] "" Vector__XXX
 SG_ DPB_a301_PM_locStateDLC m5 : 4|1@1+ (1,0) [0|1] "" Vector__XXX
 SG_ DPB_a302_PM_locStateTimeout m5 : 5|1@1+ (1,0) [0|1] "" Vector__XXX
 SG_ DPB_a303_actuatingDIFullTorqueCm m5 : 6|1@1+ (1,0) [0|1] "" Vector__XXX
 SG_ DPB_a304_actuatingDITorqueCmd m5 : 7|1@1+ (1,0) [0|1] "" Vector__XXX
 SG_ DPB_a305_DIbrakeTorqueCommandAnd m5 : 8|1@1+ (1,0) [0|1] "" Vector__XXX
 SG_ DPB_a306_actuatorFallbackBasicMa m5 : 9|1@1+ (1,0) [0|1] "" Vector__XXX
 SG_ DPB_a307_actuatorDegradedMap m5 : 10|1@1+ (1,0) [0|1] "" Vector__XXX
 SG_ DPB_a308_hydraulicPushthroughAct m5 : 11|1@1+ (1,0) [0|1] "" Vector__XXX
 SG_ DPB_a309_DIFAxleTorqueInvalid m5 : 12|1@1+ (1,0) [0|1] "" Vector__XXX
 SG_ DPB_a310_DIRAxleTorqueInvalid m5 : 13|1@1+ (1,0) [0|1] "" Vector__XXX
 SG_ DPB_a311_postrunDurationTooLong m5 : 14|1@1+ (1,0) [0|1] "" Vector__XXX
 SG_ DPB_a312_cyclicVolumeCheckDisabl m5 : 15|1@1+ (1,0) [0|1] "" Vector__XXX
 SG_ DPB_a313_qualifiedBrakeEventDete m5 : 16|1@1+ (1,0) [0|1] "" Vector__XXX

BO_ 1427 EPASTP_alertLog: 8 EPASTP
 SG_ EPASTP_alertID M : 0|9@1+ (1,0) [0|511] "" Vector__XXX
 SG_ EPASTP_alertState : 15|1@1+ (1,0) [0|1] "" Vector__XXX
 SG_ EPASTP_a001_debugInfo m1 : 16|48@1+ (1,0) [0|281474976710655] "" Vector__XXX
 SG_ EPASTP_a002_debugInfo m2 : 16|48@1+ (1,0) [0|281474976710655] "" Vector__XXX
 SG_ EPASTP_a003_debugInfo m3 : 16|48@1+ (1,0) [0|281474976710655] "" Vector__XXX
 SG_ EPASTP_a004_debugInfo m4 : 16|48@1+ (1,0) [0|281474976710655] "" Vector__XXX
 SG_ EPASTP_a005_debugInfo m5 : 16|48@1+ (1,0) [0|281474976710655] "" Vector__XXX
 SG_ EPASTP_a006_debugInfo m6 : 16|48@1+ (1,0) [0|281474976710655] "" Vector__XXX
 SG_ EPASTP_a007_debugInfo m7 : 16|48@1+ (1,0) [0|281474976710655] "" Vector__XXX
 SG_ EPASTP_a009_debugInfo m9 : 16|48@1+ (1,0) [0|281474976710655] "" Vector__XXX
 SG_ EPASTP_a010_debugInfo m10 : 16|48@1+ (1,0) [0|281474976710655] "" Vector__XXX
 SG_ EPASTP_a011_debugInfo m11 : 16|48@1+ (1,0) [0|281474976710655] "" Vector__XXX
 SG_ EPASTP_a012_debugInfo m12 : 16|48@1+ (1,0) [0|281474976710655] "" Vector__XXX
 SG_ EPASTP_a013_debugInfo m13 : 16|48@1+ (1,0) [0|281474976710655] "" Vector__XXX
 SG_ EPASTP_a014_debugInfo m14 : 16|48@1+ (1,0) [0|281474976710655] "" Vector__XXX
 SG_ EPASTP_a015_debugInfo m15 : 16|48@1+ (1,0) [0|281474976710655] "" Vector__XXX
 SG_ EPASTP_a016_debugInfo m16 : 16|48@1+ (1,0) [0|281474976710655] "" Vector__XXX
 SG_ EPASTP_a017_debugInfo m17 : 16|48@1+ (1,0) [0|281474976710655] "" Vector__XXX
 SG_ EPASTP_a018_debugInfo m18 : 16|48@1+ (1,0) [0|281474976710655] "" Vector__XXX
 SG_ EPASTP_a019_debugInfo m19 : 16|48@1+ (1,0) [0|281474976710655] "" Vector__XXX
 SG_ EPASTP_a020_debugInfo m20 : 16|48@1+ (1,0) [0|281474976710655] "" Vector__XXX
 SG_ EPASTP_a021_debugInfo m21 : 16|48@1+ (1,0) [0|281474976710655] "" Vector__XXX
 SG_ EPASTP_a022_debugInfo m22 : 16|48@1+ (1,0) [0|281474976710655] "" Vector__XXX
 SG_ EPASTP_a023_debugInfo m23 : 16|48@1+ (1,0) [0|281474976710655] "" Vector__XXX
 SG_ EPASTP_a024_debugInfo m24 : 16|48@1+ (1,0) [0|281474976710655] "" Vector__XXX
 SG_ EPASTP_a025_debugInfo m25 : 16|48@1+ (1,0) [0|281474976710655] "" Vector__XXX
 SG_ EPASTP_a026_debugInfo m26 : 16|48@1+ (1,0) [0|281474976710655] "" Vector__XXX
 SG_ EPASTP_a027_debugInfo m27 : 16|48@1+ (1,0) [0|281474976710655] "" Vector__XXX
 SG_ EPASTP_a028_debugInfo m28 : 16|48@1+ (1,0) [0|281474976710655] "" Vector__XXX
 SG_ EPASTP_a029_debugInfo m29 : 16|48@1+ (1,0) [0|281474976710655] "" Vector__XXX
 SG_ EPASTP_a030_debugInfo m30 : 16|48@1+ (1,0) [0|281474976710655] "" Vector__XXX
 SG_ EPASTP_a031_debugInfo m31 : 16|48@1+ (1,0) [0|281474976710655] "" Vector__XXX
 SG_ EPASTP_a032_debugInfo m32 : 16|48@1+ (1,0) [0|281474976710655] "" Vector__XXX
 SG_ EPASTP_a033_debugInfo m33 : 16|48@1+ (1,0) [0|281474976710655] "" Vector__XXX
 SG_ EPASTP_a034_debugInfo m34 : 16|48@1+ (1,0) [0|281474976710655] "" Vector__XXX
 SG_ EPASTP_a035_debugInfo m35 : 16|48@1+ (1,0) [0|281474976710655] "" Vector__XXX
 SG_ EPASTP_a036_debugInfo m36 : 16|48@1+ (1,0) [0|281474976710655] "" Vector__XXX
 SG_ EPASTP_a037_debugInfo m37 : 16|48@1+ (1,0) [0|281474976710655] "" Vector__XXX
 SG_ EPASTP_a038_debugInfo m38 : 16|48@1+ (1,0) [0|281474976710655] "" Vector__XXX
 SG_ EPASTP_a039_debugInfo m39 : 16|48@1+ (1,0) [0|281474976710655] "" Vector__XXX
 SG_ EPASTP_a040_debugInfo m40 : 16|48@1+ (1,0) [0|281474976710655] "" Vector__XXX
 SG_ EPASTP_a041_debugInfo m41 : 16|48@1+ (1,0) [0|281474976710655] "" Vector__XXX
 SG_ EPASTP_a042_debugInfo m42 : 16|48@1+ (1,0) [0|281474976710655] "" Vector__XXX
 SG_ EPASTP_a043_debugInfo m43 : 16|48@1+ (1,0) [0|281474976710655] "" Vector__XXX
 SG_ EPASTP_a044_debugInfo m44 : 16|48@1+ (1,0) [0|281474976710655] "" Vector__XXX
 SG_ EPASTP_a045_debugInfo m45 : 16|48@1+ (1,0) [0|281474976710655] "" Vector__XXX
 SG_ EPASTP_a046_debugInfo m46 : 16|48@1+ (1,0) [0|281474976710655] "" Vector__XXX
 SG_ EPASTP_a047_debugInfo m47 : 16|48@1+ (1,0) [0|281474976710655] "" Vector__XXX
 SG_ EPASTP_a048_debugInfo m48 : 16|48@1+ (1,0) [0|281474976710655] "" Vector__XXX
 SG_ EPASTP_a049_debugInfo m49 : 16|48@1+ (1,0) [0|281474976710655] "" Vector__XXX
 SG_ EPASTP_a050_debugInfo m50 : 16|48@1+ (1,0) [0|281474976710655] "" Vector__XXX
 SG_ EPASTP_a051_debugInfo m51 : 16|48@1+ (1,0) [0|281474976710655] "" Vector__XXX
 SG_ EPASTP_a052_debugInfo m52 : 16|48@1+ (1,0) [0|281474976710655] "" Vector__XXX
 SG_ EPASTP_a053_debugInfo m53 : 16|48@1+ (1,0) [0|281474976710655] "" Vector__XXX
 SG_ EPASTP_a054_debugInfo m54 : 16|48@1+ (1,0) [0|281474976710655] "" Vector__XXX
 SG_ EPASTP_a055_debugInfo m55 : 16|48@1+ (1,0) [0|281474976710655] "" Vector__XXX
 SG_ EPASTP_a056_debugInfo m56 : 16|48@1+ (1,0) [0|281474976710655] "" Vector__XXX
 SG_ EPASTP_a057_debugInfo m57 : 16|48@1+ (1,0) [0|281474976710655] "" Vector__XXX
 SG_ EPASTP_a058_debugInfo m58 : 16|48@1+ (1,0) [0|281474976710655] "" Vector__XXX
 SG_ EPASTP_a059_debugInfo m59 : 16|48@1+ (1,0) [0|281474976710655] "" Vector__XXX
 SG_ EPASTP_a060_debugInfo m60 : 16|48@1+ (1,0) [0|281474976710655] "" Vector__XXX
 SG_ EPASTP_a061_debugInfo m61 : 16|48@1+ (1,0) [0|281474976710655] "" Vector__XXX
 SG_ EPASTP_a062_debugInfo m62 : 16|48@1+ (1,0) [0|281474976710655] "" Vector__XXX
 SG_ EPASTP_a063_debugInfo m63 : 16|48@1+ (1,0) [0|281474976710655] "" Vector__XXX
 SG_ EPASTP_a064_debugInfo m64 : 16|48@1+ (1,0) [0|281474976710655] "" Vector__XXX
 SG_ EPASTP_a065_debugInfo m65 : 16|48@1+ (1,0) [0|281474976710655] "" Vector__XXX
 SG_ EPASTP_a066_debugInfo m66 : 16|48@1+ (1,0) [0|281474976710655] "" Vector__XXX
 SG_ EPASTP_a067_debugInfo m67 : 16|48@1+ (1,0) [0|281474976710655] "" Vector__XXX
 SG_ EPASTP_a068_debugInfo m68 : 16|48@1+ (1,0) [0|281474976710655] "" Vector__XXX
 SG_ EPASTP_a069_debugInfo m69 : 16|48@1+ (1,0) [0|281474976710655] "" Vector__XXX
 SG_ EPASTP_a070_debugInfo m70 : 16|48@1+ (1,0) [0|281474976710655] "" Vector__XXX
 SG_ EPASTP_a071_debugInfo m71 : 16|48@1+ (1,0) [0|281474976710655] "" Vector__XXX
 SG_ EPASTP_a072_debugInfo m72 : 16|48@1+ (1,0) [0|281474976710655] "" Vector__XXX
 SG_ EPASTP_a073_debugInfo m73 : 16|48@1+ (1,0) [0|281474976710655] "" Vector__XXX
 SG_ EPASTP_a074_debugInfo m74 : 16|48@1+ (1,0) [0|281474976710655] "" Vector__XXX
 SG_ EPASTP_a075_debugInfo m75 : 16|48@1+ (1,0) [0|281474976710655] "" Vector__XXX
 SG_ EPASTP_a076_debugInfo m76 : 16|48@1+ (1,0) [0|281474976710655] "" Vector__XXX
 SG_ EPASTP_a077_debugInfo m77 : 16|48@1+ (1,0) [0|281474976710655] "" Vector__XXX
 SG_ EPASTP_a078_debugInfo m78 : 16|48@1+ (1,0) [0|281474976710655] "" Vector__XXX
 SG_ EPASTP_a079_debugInfo m79 : 16|48@1+ (1,0) [0|281474976710655] "" Vector__XXX
 SG_ EPASTP_a080_debugInfo m80 : 16|48@1+ (1,0) [0|281474976710655] "" Vector__XXX
 SG_ EPASTP_a081_debugInfo m81 : 16|48@1+ (1,0) [0|281474976710655] "" Vector__XXX
 SG_ EPASTP_a082_debugInfo m82 : 16|48@1+ (1,0) [0|281474976710655] "" Vector__XXX
 SG_ EPASTP_a083_debugInfo m83 : 16|48@1+ (1,0) [0|281474976710655] "" Vector__XXX
 SG_ EPASTP_a084_debugInfo m84 : 16|48@1+ (1,0) [0|281474976710655] "" Vector__XXX
 SG_ EPASTP_a085_debugInfo m85 : 16|48@1+ (1,0) [0|281474976710655] "" Vector__XXX
 SG_ EPASTP_a086_debugInfo m86 : 16|48@1+ (1,0) [0|281474976710655] "" Vector__XXX
 SG_ EPASTP_a087_debugInfo m87 : 16|48@1+ (1,0) [0|281474976710655] "" Vector__XXX
 SG_ EPASTP_a088_debugInfo m88 : 16|48@1+ (1,0) [0|281474976710655] "" Vector__XXX
 SG_ EPASTP_a089_debugInfo m89 : 16|48@1+ (1,0) [0|281474976710655] "" Vector__XXX
 SG_ EPASTP_a090_debugInfo m90 : 16|48@1+ (1,0) [0|281474976710655] "" Vector__XXX
 SG_ EPASTP_a091_debugInfo m91 : 16|48@1+ (1,0) [0|281474976710655] "" Vector__XXX
 SG_ EPASTP_a092_debugInfo m92 : 16|48@1+ (1,0) [0|281474976710655] "" Vector__XXX
 SG_ EPASTP_a093_debugInfo m93 : 16|48@1+ (1,0) [0|281474976710655] "" Vector__XXX
 SG_ EPASTP_a094_debugInfo m94 : 16|48@1+ (1,0) [0|281474976710655] "" Vector__XXX
 SG_ EPASTP_a095_debugInfo m95 : 16|48@1+ (1,0) [0|281474976710655] "" Vector__XXX
 SG_ EPASTP_a096_debugInfo m96 : 16|48@1+ (1,0) [0|281474976710655] "" Vector__XXX
 SG_ EPASTP_a097_debugInfo m97 : 16|48@1+ (1,0) [0|281474976710655] "" Vector__XXX
 SG_ EPASTP_a098_debugInfo m98 : 16|48@1+ (1,0) [0|281474976710655] "" Vector__XXX
 SG_ EPASTP_a099_debugInfo m99 : 16|48@1+ (1,0) [0|281474976710655] "" Vector__XXX
 SG_ EPASTP_a100_debugInfo m100 : 16|48@1+ (1,0) [0|281474976710655] "" Vector__XXX
 SG_ EPASTP_a101_debugInfo m101 : 16|48@1+ (1,0) [0|281474976710655] "" Vector__XXX
 SG_ EPASTP_a102_debugInfo m102 : 16|48@1+ (1,0) [0|281474976710655] "" Vector__XXX
 SG_ EPASTP_a103_debugInfo m103 : 16|48@1+ (1,0) [0|281474976710655] "" Vector__XXX
 SG_ EPASTP_a104_debugInfo m104 : 16|48@1+ (1,0) [0|281474976710655] "" Vector__XXX
 SG_ EPASTP_a105_debugInfo m105 : 16|48@1+ (1,0) [0|281474976710655] "" Vector__XXX
 SG_ EPASTP_a106_debugInfo m106 : 16|48@1+ (1,0) [0|281474976710655] "" Vector__XXX
 SG_ EPASTP_a107_debugInfo m107 : 16|48@1+ (1,0) [0|281474976710655] "" Vector__XXX
 SG_ EPASTP_a108_debugInfo m108 : 16|48@1+ (1,0) [0|281474976710655] "" Vector__XXX
 SG_ EPASTP_a109_debugInfo m109 : 16|48@1+ (1,0) [0|281474976710655] "" Vector__XXX
 SG_ EPASTP_a110_debugInfo m110 : 16|48@1+ (1,0) [0|281474976710655] "" Vector__XXX
 SG_ EPASTP_a111_debugInfo m111 : 16|48@1+ (1,0) [0|281474976710655] "" Vector__XXX
 SG_ EPASTP_a112_debugInfo m112 : 16|48@1+ (1,0) [0|281474976710655] "" Vector__XXX
 SG_ EPASTP_a113_debugInfo m113 : 16|48@1+ (1,0) [0|281474976710655] "" Vector__XXX
 SG_ EPASTP_a114_debugInfo m114 : 16|48@1+ (1,0) [0|281474976710655] "" Vector__XXX
 SG_ EPASTP_a115_debugInfo m115 : 16|48@1+ (1,0) [0|281474976710655] "" Vector__XXX
 SG_ EPASTP_a116_debugInfo m116 : 16|48@1+ (1,0) [0|281474976710655] "" Vector__XXX
 SG_ EPASTP_a117_debugInfo m117 : 16|48@1+ (1,0) [0|281474976710655] "" Vector__XXX
 SG_ EPASTP_a118_debugInfo m118 : 16|48@1+ (1,0) [0|281474976710655] "" Vector__XXX
 SG_ EPASTP_a119_debugInfo m119 : 16|48@1+ (1,0) [0|281474976710655] "" Vector__XXX
 SG_ EPASTP_a120_debugInfo m120 : 16|48@1+ (1,0) [0|281474976710655] "" Vector__XXX
 SG_ EPASTP_a121_debugInfo m121 : 16|48@1+ (1,0) [0|281474976710655] "" Vector__XXX
 SG_ EPASTP_a122_debugInfo m122 : 16|48@1+ (1,0) [0|281474976710655] "" Vector__XXX
 SG_ EPASTP_a123_debugInfo m123 : 16|48@1+ (1,0) [0|281474976710655] "" Vector__XXX
 SG_ EPASTP_a124_debugInfo m124 : 16|48@1+ (1,0) [0|281474976710655] "" Vector__XXX
 SG_ EPASTP_a125_debugInfo m125 : 16|48@1+ (1,0) [0|281474976710655] "" Vector__XXX
 SG_ EPASTP_a126_debugInfo m126 : 16|48@1+ (1,0) [0|281474976710655] "" Vector__XXX
 SG_ EPASTP_a127_debugInfo m127 : 16|48@1+ (1,0) [0|281474976710655] "" Vector__XXX
 SG_ EPASTP_a128_debugInfo m128 : 16|48@1+ (1,0) [0|281474976710655] "" Vector__XXX
 SG_ EPASTP_a129_debugInfo m129 : 16|48@1+ (1,0) [0|281474976710655] "" Vector__XXX
 SG_ EPASTP_a130_debugInfo m130 : 16|48@1+ (1,0) [0|281474976710655] "" Vector__XXX
 SG_ EPASTP_a131_debugInfo m131 : 16|48@1+ (1,0) [0|281474976710655] "" Vector__XXX
 SG_ EPASTP_a132_debugInfo m132 : 16|48@1+ (1,0) [0|281474976710655] "" Vector__XXX
 SG_ EPASTP_a133_debugInfo m133 : 16|48@1+ (1,0) [0|281474976710655] "" Vector__XXX
 SG_ EPASTP_a134_debugInfo m134 : 16|48@1+ (1,0) [0|281474976710655] "" Vector__XXX
 SG_ EPASTP_a135_debugInfo m135 : 16|48@1+ (1,0) [0|281474976710655] "" Vector__XXX
 SG_ EPASTP_a136_debugInfo m136 : 16|48@1+ (1,0) [0|281474976710655] "" Vector__XXX
 SG_ EPASTP_a137_debugInfo m137 : 16|48@1+ (1,0) [0|281474976710655] "" Vector__XXX
 SG_ EPASTP_a138_debugInfo m138 : 16|48@1+ (1,0) [0|281474976710655] "" Vector__XXX
 SG_ EPASTP_a139_debugInfo m139 : 16|48@1+ (1,0) [0|281474976710655] "" Vector__XXX
 SG_ EPASTP_a140_debugInfo m140 : 16|48@1+ (1,0) [0|281474976710655] "" Vector__XXX
 SG_ EPASTP_a141_debugInfo m141 : 16|48@1+ (1,0) [0|281474976710655] "" Vector__XXX
 SG_ EPASTP_a142_debugInfo m142 : 16|48@1+ (1,0) [0|281474976710655] "" Vector__XXX
 SG_ EPASTP_a143_debugInfo m143 : 16|48@1+ (1,0) [0|281474976710655] "" Vector__XXX
 SG_ EPASTP_a144_debugInfo m144 : 16|48@1+ (1,0) [0|281474976710655] "" Vector__XXX
 SG_ EPASTP_a145_debugInfo m145 : 16|48@1+ (1,0) [0|281474976710655] "" Vector__XXX
 SG_ EPASTP_a146_debugInfo m146 : 16|48@1+ (1,0) [0|281474976710655] "" Vector__XXX
 SG_ EPASTP_a147_debugInfo m147 : 16|48@1+ (1,0) [0|281474976710655] "" Vector__XXX
 SG_ EPASTP_a148_debugInfo m148 : 16|48@1+ (1,0) [0|281474976710655] "" Vector__XXX
 SG_ EPASTP_a149_debugInfo m149 : 16|48@1+ (1,0) [0|281474976710655] "" Vector__XXX
 SG_ EPASTP_a150_debugInfo m150 : 16|48@1+ (1,0) [0|281474976710655] "" Vector__XXX
 SG_ EPASTP_a152_debugInfo m152 : 16|48@1+ (1,0) [0|281474976710655] "" Vector__XXX
 SG_ EPASTP_a153_debugInfo m153 : 16|48@1+ (1,0) [0|281474976710655] "" Vector__XXX
 SG_ EPASTP_a154_debugInfo m154 : 16|48@1+ (1,0) [0|281474976710655] "" Vector__XXX
 SG_ EPASTP_a155_debugInfo m155 : 16|48@1+ (1,0) [0|281474976710655] "" Vector__XXX
 SG_ EPASTP_a156_debugInfo m156 : 16|48@1+ (1,0) [0|281474976710655] "" Vector__XXX
 SG_ EPASTP_a157_debugInfo m157 : 16|48@1+ (1,0) [0|281474976710655] "" Vector__XXX
 SG_ EPASTP_a158_debugInfo m158 : 16|48@1+ (1,0) [0|281474976710655] "" Vector__XXX
 SG_ EPASTP_a159_debugInfo m159 : 16|48@1+ (1,0) [0|281474976710655] "" Vector__XXX
 SG_ EPASTP_a160_debugInfo m160 : 16|48@1+ (1,0) [0|281474976710655] "" Vector__XXX
 SG_ EPASTP_a161_debugInfo m161 : 16|48@1+ (1,0) [0|281474976710655] "" Vector__XXX
 SG_ EPASTP_a162_debugInfo m162 : 16|48@1+ (1,0) [0|281474976710655] "" Vector__XXX
 SG_ EPASTP_a163_debugInfo m163 : 16|48@1+ (1,0) [0|281474976710655] "" Vector__XXX
 SG_ EPASTP_a164_debugInfo m164 : 16|48@1+ (1,0) [0|281474976710655] "" Vector__XXX
 SG_ EPASTP_a165_debugInfo m165 : 16|48@1+ (1,0) [0|281474976710655] "" Vector__XXX
 SG_ EPASTP_a166_debugInfo m166 : 16|48@1+ (1,0) [0|281474976710655] "" Vector__XXX
 SG_ EPASTP_a167_debugInfo m167 : 16|48@1+ (1,0) [0|281474976710655] "" Vector__XXX
 SG_ EPASTP_a168_debugInfo m168 : 16|48@1+ (1,0) [0|281474976710655] "" Vector__XXX
 SG_ EPASTP_a169_debugInfo m169 : 16|48@1+ (1,0) [0|281474976710655] "" Vector__XXX
 SG_ EPASTP_a170_debugInfo m170 : 16|48@1+ (1,0) [0|281474976710655] "" Vector__XXX
 SG_ EPASTP_a171_debugInfo m171 : 16|48@1+ (1,0) [0|281474976710655] "" Vector__XXX
 SG_ EPASTP_a172_debugInfo m172 : 16|48@1+ (1,0) [0|281474976710655] "" Vector__XXX
 SG_ EPASTP_a173_debugInfo m173 : 16|48@1+ (1,0) [0|281474976710655] "" Vector__XXX
 SG_ EPASTP_a174_debugInfo m174 : 16|48@1+ (1,0) [0|281474976710655] "" Vector__XXX
 SG_ EPASTP_a175_debugInfo m175 : 16|48@1+ (1,0) [0|281474976710655] "" Vector__XXX
 SG_ EPASTP_a176_debugInfo m176 : 16|48@1+ (1,0) [0|281474976710655] "" Vector__XXX
 SG_ EPASTP_a177_debugInfo m177 : 16|48@1+ (1,0) [0|281474976710655] "" Vector__XXX
 SG_ EPASTP_a178_debugInfo m178 : 16|48@1+ (1,0) [0|281474976710655] "" Vector__XXX
 SG_ EPASTP_a179_debugInfo m179 : 16|48@1+ (1,0) [0|281474976710655] "" Vector__XXX
 SG_ EPASTP_a180_debugInfo m180 : 16|48@1+ (1,0) [0|281474976710655] "" Vector__XXX
 SG_ EPASTP_a181_debugInfo m181 : 16|48@1+ (1,0) [0|281474976710655] "" Vector__XXX
 SG_ EPASTP_a182_debugInfo m182 : 16|48@1+ (1,0) [0|281474976710655] "" Vector__XXX
 SG_ EPASTP_a183_debugInfo m183 : 16|48@1+ (1,0) [0|281474976710655] "" Vector__XXX
 SG_ EPASTP_a184_debugInfo m184 : 16|48@1+ (1,0) [0|281474976710655] "" Vector__XXX
 SG_ EPASTP_a185_debugInfo m185 : 16|48@1+ (1,0) [0|281474976710655] "" Vector__XXX
 SG_ EPASTP_a186_debugInfo m186 : 16|48@1+ (1,0) [0|281474976710655] "" Vector__XXX
 SG_ EPASTP_a188_debugInfo m188 : 16|48@1+ (1,0) [0|281474976710655] "" Vector__XXX
 SG_ EPASTP_a189_debugInfo m189 : 16|48@1+ (1,0) [0|281474976710655] "" Vector__XXX
 SG_ EPASTP_a190_debugInfo m190 : 16|48@1+ (1,0) [0|281474976710655] "" Vector__XXX
 SG_ EPASTP_a191_debugInfo m191 : 16|48@1+ (1,0) [0|281474976710655] "" Vector__XXX
 SG_ EPASTP_a192_debugInfo m192 : 16|48@1+ (1,0) [0|281474976710655] "" Vector__XXX
 SG_ EPASTP_a193_debugInfo m193 : 16|48@1+ (1,0) [0|281474976710655] "" Vector__XXX
 SG_ EPASTP_a194_debugInfo m194 : 16|48@1+ (1,0) [0|281474976710655] "" Vector__XXX
 SG_ EPASTP_a195_debugInfo m195 : 16|48@1+ (1,0) [0|281474976710655] "" Vector__XXX
 SG_ EPASTP_a196_debugInfo m196 : 16|48@1+ (1,0) [0|281474976710655] "" Vector__XXX
 SG_ EPASTP_a197_debugInfo m197 : 16|48@1+ (1,0) [0|281474976710655] "" Vector__XXX
 SG_ EPASTP_a198_debugInfo m198 : 16|48@1+ (1,0) [0|281474976710655] "" Vector__XXX
 SG_ EPASTP_a199_debugInfo m199 : 16|48@1+ (1,0) [0|281474976710655] "" Vector__XXX
 SG_ EPASTP_a200_debugInfo m200 : 16|48@1+ (1,0) [0|281474976710655] "" Vector__XXX
 SG_ EPASTP_a201_debugInfo m201 : 16|48@1+ (1,0) [0|281474976710655] "" Vector__XXX
 SG_ EPASTP_a202_debugInfo m202 : 16|48@1+ (1,0) [0|281474976710655] "" Vector__XXX
 SG_ EPASTP_a203_debugInfo m203 : 16|48@1+ (1,0) [0|281474976710655] "" Vector__XXX
 SG_ EPASTP_a204_debugInfo m204 : 16|48@1+ (1,0) [0|281474976710655] "" Vector__XXX
 SG_ EPASTP_a205_debugInfo m205 : 16|48@1+ (1,0) [0|281474976710655] "" Vector__XXX
 SG_ EPASTP_a206_debugInfo m206 : 16|48@1+ (1,0) [0|281474976710655] "" Vector__XXX
 SG_ EPASTP_a207_debugInfo m207 : 16|48@1+ (1,0) [0|281474976710655] "" Vector__XXX
 SG_ EPASTP_a208_debugInfo m208 : 16|48@1+ (1,0) [0|281474976710655] "" Vector__XXX
 SG_ EPASTP_a209_debugInfo m209 : 16|48@1+ (1,0) [0|281474976710655] "" Vector__XXX
 SG_ EPASTP_a210_debugInfo m210 : 16|48@1+ (1,0) [0|281474976710655] "" Vector__XXX
 SG_ EPASTP_a211_debugInfo m211 : 16|48@1+ (1,0) [0|281474976710655] "" Vector__XXX
 SG_ EPASTP_a212_debugInfo m212 : 16|48@1+ (1,0) [0|281474976710655] "" Vector__XXX
 SG_ EPASTP_a213_debugInfo m213 : 16|48@1+ (1,0) [0|281474976710655] "" Vector__XXX
 SG_ EPASTP_a214_debugInfo m214 : 16|48@1+ (1,0) [0|281474976710655] "" Vector__XXX
 SG_ EPASTP_a215_debugInfo m215 : 16|48@1+ (1,0) [0|281474976710655] "" Vector__XXX
 SG_ EPASTP_a216_debugInfo m216 : 16|48@1+ (1,0) [0|281474976710655] "" Vector__XXX
 SG_ EPASTP_a217_debugInfo m217 : 16|48@1+ (1,0) [0|281474976710655] "" Vector__XXX
 SG_ EPASTP_a218_debugInfo m218 : 16|48@1+ (1,0) [0|281474976710655] "" Vector__XXX
 SG_ EPASTP_a219_debugInfo m219 : 16|48@1+ (1,0) [0|281474976710655] "" Vector__XXX
 SG_ EPASTP_a221_debugInfo m221 : 16|48@1+ (1,0) [0|281474976710655] "" Vector__XXX
 SG_ EPASTP_a222_debugInfo m222 : 16|48@1+ (1,0) [0|281474976710655] "" Vector__XXX
 SG_ EPASTP_a223_debugInfo m223 : 16|48@1+ (1,0) [0|281474976710655] "" Vector__XXX
 SG_ EPASTP_a224_debugInfo m224 : 16|48@1+ (1,0) [0|281474976710655] "" Vector__XXX
 SG_ EPASTP_a225_debugInfo m225 : 16|48@1+ (1,0) [0|281474976710655] "" Vector__XXX
 SG_ EPASTP_a226_debugInfo m226 : 16|48@1+ (1,0) [0|281474976710655] "" Vector__XXX
 SG_ EPASTP_a227_debugInfo m227 : 16|48@1+ (1,0) [0|281474976710655] "" Vector__XXX
 SG_ EPASTP_a228_debugInfo m228 : 16|48@1+ (1,0) [0|281474976710655] "" Vector__XXX
 SG_ EPASTP_a229_debugInfo m229 : 16|48@1+ (1,0) [0|281474976710655] "" Vector__XXX
 SG_ EPASTP_a230_debugInfo m230 : 16|48@1+ (1,0) [0|281474976710655] "" Vector__XXX
 SG_ EPASTP_a231_debugInfo m231 : 16|48@1+ (1,0) [0|281474976710655] "" Vector__XXX
 SG_ EPASTP_a232_debugInfo m232 : 16|48@1+ (1,0) [0|281474976710655] "" Vector__XXX
 SG_ EPASTP_a233_debugInfo m233 : 16|48@1+ (1,0) [0|281474976710655] "" Vector__XXX
 SG_ EPASTP_a234_debugInfo m234 : 16|48@1+ (1,0) [0|281474976710655] "" Vector__XXX
 SG_ EPASTP_a235_debugInfo m235 : 16|48@1+ (1,0) [0|281474976710655] "" Vector__XXX
 SG_ EPASTP_a236_debugInfo m236 : 16|48@1+ (1,0) [0|281474976710655] "" Vector__XXX
 SG_ EPASTP_a237_debugInfo m237 : 16|48@1+ (1,0) [0|281474976710655] "" Vector__XXX
 SG_ EPASTP_a238_debugInfo m238 : 16|48@1+ (1,0) [0|281474976710655] "" Vector__XXX
 SG_ EPASTP_a239_debugInfo m239 : 16|48@1+ (1,0) [0|281474976710655] "" Vector__XXX
 SG_ EPASTP_a240_debugInfo m240 : 16|48@1+ (1,0) [0|281474976710655] "" Vector__XXX
 SG_ EPASTP_a241_debugInfo m241 : 16|48@1+ (1,0) [0|281474976710655] "" Vector__XXX
 SG_ EPASTP_a242_debugInfo m242 : 16|48@1+ (1,0) [0|281474976710655] "" Vector__XXX
 SG_ EPASTP_a243_debugInfo m243 : 16|48@1+ (1,0) [0|281474976710655] "" Vector__XXX
 SG_ EPASTP_a244_debugInfo m244 : 16|48@1+ (1,0) [0|281474976710655] "" Vector__XXX
 SG_ EPASTP_a245_debugInfo m245 : 16|48@1+ (1,0) [0|281474976710655] "" Vector__XXX
 SG_ EPASTP_a246_debugInfo m246 : 16|48@1+ (1,0) [0|281474976710655] "" Vector__XXX
 SG_ EPASTP_a247_debugInfo m247 : 16|48@1+ (1,0) [0|281474976710655] "" Vector__XXX
 SG_ EPASTP_a248_debugInfo m248 : 16|48@1+ (1,0) [0|281474976710655] "" Vector__XXX
 SG_ EPASTP_a249_debugInfo m249 : 16|48@1+ (1,0) [0|281474976710655] "" Vector__XXX
 SG_ EPASTP_a250_debugInfo m250 : 16|48@1+ (1,0) [0|281474976710655] "" Vector__XXX
 SG_ EPASTP_a251_debugInfo m251 : 16|48@1+ (1,0) [0|281474976710655] "" Vector__XXX
 SG_ EPASTP_a252_debugInfo m252 : 16|48@1+ (1,0) [0|281474976710655] "" Vector__XXX
 SG_ EPASTP_a253_debugInfo m253 : 16|48@1+ (1,0) [0|281474976710655] "" Vector__XXX
 SG_ EPASTP_a254_debugInfo m254 : 16|48@1+ (1,0) [0|281474976710655] "" Vector__XXX
 SG_ EPASTP_a255_debugInfo m255 : 16|48@1+ (1,0) [0|281474976710655] "" Vector__XXX
 SG_ EPASTP_a256_debugInfo m256 : 16|48@1+ (1,0) [0|281474976710655] "" Vector__XXX
 SG_ EPASTP_a257_debugInfo m257 : 16|48@1+ (1,0) [0|281474976710655] "" Vector__XXX
 SG_ EPASTP_a258_debugInfo m258 : 16|48@1+ (1,0) [0|281474976710655] "" Vector__XXX
 SG_ EPASTP_a259_debugInfo m259 : 16|48@1+ (1,0) [0|281474976710655] "" Vector__XXX
 SG_ EPASTP_a260_debugInfo m260 : 16|48@1+ (1,0) [0|281474976710655] "" Vector__XXX
 SG_ EPASTP_a261_debugInfo m261 : 16|48@1+ (1,0) [0|281474976710655] "" Vector__XXX
 SG_ EPASTP_a262_debugInfo m262 : 16|48@1+ (1,0) [0|281474976710655] "" Vector__XXX
 SG_ EPASTP_a263_debugInfo m263 : 16|48@1+ (1,0) [0|281474976710655] "" Vector__XXX
 SG_ EPASTP_a264_degradedECU m264 : 16|8@1+ (1,0) [0|255] "" Vector__XXX
 SG_ EPASTP_a264_vehicleSpeed m264 : 24|16@1+ (0.1,0) [0|6553.5] "kph" Vector__XXX
 SG_ EPASTP_a264_powerRatio m264 : 40|8@1+ (1,0) [0|255] "percent" Vector__XXX
 SG_ EPASTP_a264_ownSideDegradationRe m264 : 48|8@1+ (1,0) [0|255] "" Vector__XXX
 SG_ EPASTP_a264_otherSideDegradation m264 : 56|8@1+ (1,0) [0|255] "" Vector__XXX
 SG_ EPASTP_a265_degradedECU m265 : 16|8@1+ (1,0) [0|255] "" Vector__XXX
 SG_ EPASTP_a265_vehicleSpeed m265 : 24|16@1+ (0.1,0) [0|6553.5] "kph" Vector__XXX
 SG_ EPASTP_a265_rawMcuTemperature m265 : 40|16@1+ (1,-100) [-100|65435] "C" Vector__XXX
 SG_ EPASTP_a265_degradedCurrentLimit m265 : 56|8@1+ (1,0) [0|255] "A" Vector__XXX
 SG_ EPASTP_a266_cdpAssistFactor m266 : 16|8@1+ (1,0) [0|255] "percent" Vector__XXX
 SG_ EPASTP_a266_vehicleSpeed m266 : 24|16@1+ (0.1,0) [0|6553.5] "kph" Vector__XXX
 SG_ EPASTP_a267_vehicleSpeed m267 : 16|16@1+ (0.1,0) [0|6553.5] "kph" Vector__XXX
 SG_ EPASTP_a267_velocityEstimatorSta m267 : 32|8@1+ (1,0) [0|255] "" Vector__XXX
 SG_ EPASTP_a269_vehicleSpeed m269 : 16|16@1+ (0.1,0) [0|6553.5] "kph" Vector__XXX
 SG_ EPASTP_a270_debugInfo m270 : 16|48@1+ (1,0) [0|281474976710655] "" Vector__XXX

BO_ 919 EPASTP_alertMatrix: 8 EPASTP
 SG_ EPASTP_matrixIndex M : 0|4@1+ (1,0) [0|15] "" Vector__XXX
 SG_ EPASTP_a001_adcCalibrationOrInit m0 : 4|1@1+ (1,0) [0|1] "" Vector__XXX
 SG_ EPASTP_a002_adcMuxErr m0 : 5|1@1+ (1,0) [0|1] "" Vector__XXX
 SG_ EPASTP_a003_pspInvalidParamset m0 : 6|1@1+ (1,0) [0|1] "" Vector__XXX
 SG_ EPASTP_a004_scpInputMia m0 : 7|1@1+ (1,0) [0|1] "" Vector__XXX
 SG_ EPASTP_a005_scpUnknownResetSourc m0 : 8|1@1+ (1,0) [0|1] "" Vector__XXX
 SG_ EPASTP_a006_swrhResetByInvalidEr m0 : 9|1@1+ (1,0) [0|1] "" Vector__XXX
 SG_ EPASTP_a007_tsmcCoreTempDiff m0 : 10|1@1+ (1,0) [0|1] "" Vector__XXX
 SG_ EPASTP_a008_psdcPlatformShutdown m0 : 11|1@1+ (1,0) [0|1] "" Vector__XXX
 SG_ EPASTP_a009_mcusscLbistPermanent m0 : 12|1@1+ (1,0) [0|1] "" Vector__XXX
 SG_ EPASTP_a010_svcIncompatibleSwVer m0 : 13|1@1+ (1,0) [0|1] "" Vector__XXX
 SG_ EPASTP_a011_mcusscMonbistErr m0 : 14|1@1+ (1,0) [0|1] "" Vector__XXX
 SG_ EPASTP_a012_mcusscMbistEccErr m0 : 15|1@1+ (1,0) [0|1] "" Vector__XXX
 SG_ EPASTP_a013_mcusscSffMonitoringF m0 : 16|1@1+ (1,0) [0|1] "" Vector__XXX
 SG_ EPASTP_a014_mcusscSffMonitoringM m0 : 17|1@1+ (1,0) [0|1] "" Vector__XXX
 SG_ EPASTP_a015_mcusscCsErrorCheckFa m0 : 18|1@1+ (1,0) [0|1] "" Vector__XXX
 SG_ EPASTP_a016_mcufcCsErrorCheckFai m0 : 19|1@1+ (1,0) [0|1] "" Vector__XXX
 SG_ EPASTP_a017_stmdStmPlausibilityC m0 : 20|1@1+ (1,0) [0|1] "" Vector__XXX
 SG_ EPASTP_a018_exchCsErrorCheck m0 : 21|1@1+ (1,0) [0|1] "" Vector__XXX
 SG_ EPASTP_a019_rsthHwResetInfoCorru m0 : 22|1@1+ (1,0) [0|1] "" Vector__XXX
 SG_ EPASTP_a020_mcusscEolEcuIdIntegr m0 : 23|1@1+ (1,0) [0|1] "" Vector__XXX
 SG_ EPASTP_a021_osehCsErrorCheck m0 : 24|1@1+ (1,0) [0|1] "" Vector__XXX
 SG_ EPASTP_a022_swrhSwResetInfoCorru m0 : 25|1@1+ (1,0) [0|1] "" Vector__XXX
 SG_ EPASTP_a023_btarcCorruptionCheck m0 : 26|1@1+ (1,0) [0|1] "" Vector__XXX
 SG_ EPASTP_a024_srhCsErrorCheckFail m0 : 27|1@1+ (1,0) [0|1] "" Vector__XXX
 SG_ EPASTP_a025_btarcCorruptionCheck m0 : 28|1@1+ (1,0) [0|1] "" Vector__XXX
 SG_ EPASTP_a026_mrccCsErrorCheckFail m0 : 29|1@1+ (1,0) [0|1] "" Vector__XXX
 SG_ EPASTP_a027_mcusscDmuHfErr m0 : 30|1@1+ (1,0) [0|1] "" Vector__XXX
 SG_ EPASTP_a028_smuhNonInitDataCorru m0 : 31|1@1+ (1,0) [0|1] "" Vector__XXX
 SG_ EPASTP_a029_smuhSmuCoreCntErrorT m0 : 32|1@1+ (1,0) [0|1] "" Vector__XXX
 SG_ EPASTP_a030_rsthClockReset m0 : 33|1@1+ (1,0) [0|1] "" Vector__XXX
 SG_ EPASTP_a031_pmsProductionModeFai m0 : 34|1@1+ (1,0) [0|1] "" Vector__XXX
 SG_ EPASTP_a032_eolpEolCheckFailed m0 : 35|1@1+ (1,0) [0|1] "" Vector__XXX
 SG_ EPASTP_a033_icsvcPswVersionMisma m0 : 36|1@1+ (1,0) [0|1] "" Vector__XXX
 SG_ EPASTP_a034_sbchReadbackRegFail m0 : 37|1@1+ (1,0) [0|1] "" Vector__XXX
 SG_ EPASTP_a035_sbchChipIdFail m0 : 38|1@1+ (1,0) [0|1] "" Vector__XXX
 SG_ EPASTP_a036_sbcmSbcBistFailed m0 : 39|1@1+ (1,0) [0|1] "" Vector__XXX
 SG_ EPASTP_a037_epmV5P2Fail m0 : 40|1@1+ (1,0) [0|1] "" Vector__XXX
 SG_ EPASTP_a038_csohCh1CsErrorErrAtR m0 : 41|1@1+ (1,0) [0|1] "" Vector__XXX
 SG_ EPASTP_a039_csohCh2CsErrorErrAtR m0 : 42|1@1+ (1,0) [0|1] "" Vector__XXX
 SG_ EPASTP_a040_swrhLimitedResetRetr m0 : 43|1@1+ (1,0) [0|1] "" Vector__XXX
 SG_ EPASTP_a041_imcmCoreConfiguratio m0 : 44|1@1+ (1,0) [0|1] "" Vector__XXX
 SG_ EPASTP_a042_wdhWdTestFail m0 : 45|1@1+ (1,0) [0|1] "" Vector__XXX
 SG_ EPASTP_a043_sbcmWdStateDisabled m0 : 46|1@1+ (1,0) [0|1] "" Vector__XXX
 SG_ EPASTP_a044_sbcmSbcEepromFail m0 : 47|1@1+ (1,0) [0|1] "" Vector__XXX
 SG_ EPASTP_a045_psumSbcBandgapVoltEr m0 : 48|1@1+ (1,0) [0|1] "" Vector__XXX
 SG_ EPASTP_a046_mcusscOscillatorNotR m0 : 49|1@1+ (1,0) [0|1] "" Vector__XXX
 SG_ EPASTP_a047_epmVregVoltFail m0 : 50|1@1+ (1,0) [0|1] "" Vector__XXX
 SG_ EPASTP_a048_epmVcpVoltFail m0 : 51|1@1+ (1,0) [0|1] "" Vector__XXX
 SG_ EPASTP_a049_epmLgFail m0 : 52|1@1+ (1,0) [0|1] "" Vector__XXX
 SG_ EPASTP_a050_erlErr m0 : 53|1@1+ (1,0) [0|1] "" Vector__XXX
 SG_ EPASTP_a051_ermMessageErr m0 : 54|1@1+ (1,0) [0|1] "" Vector__XXX
 SG_ EPASTP_a052_ermSdcInputBufferOve m0 : 55|1@1+ (1,0) [0|1] "" Vector__XXX
 SG_ EPASTP_a053_adcUnexpectedNumOfDa m0 : 56|1@1+ (1,0) [0|1] "" Vector__XXX
 SG_ EPASTP_a054_adcUnexpectedData m0 : 57|1@1+ (1,0) [0|1] "" Vector__XXX
 SG_ EPASTP_a055_amExtendedGduTest m0 : 58|1@1+ (1,0) [0|1] "" Vector__XXX
 SG_ EPASTP_a056_amGduConfigCsErrorCh m0 : 59|1@1+ (1,0) [0|1] "" Vector__XXX
 SG_ EPASTP_a057_amGduVds m0 : 60|1@1+ (1,0) [0|1] "" Vector__XXX
 SG_ EPASTP_a058_amIntVgsUndervtgErr m0 : 61|1@1+ (1,0) [0|1] "" Vector__XXX
 SG_ EPASTP_a059_amStartupTestFailed m0 : 62|1@1+ (1,0) [0|1] "" Vector__XXX
 SG_ EPASTP_a060_amGduFail m0 : 63|1@1+ (1,0) [0|1] "" Vector__XXX
 SG_ EPASTP_a061_amIntSerialErr m1 : 4|1@1+ (1,0) [0|1] "" Vector__XXX
 SG_ EPASTP_a062_amPhaseBridgeCheck m1 : 5|1@1+ (1,0) [0|1] "" Vector__XXX
 SG_ EPASTP_a063_amIntRegulatorErr m1 : 6|1@1+ (1,0) [0|1] "" Vector__XXX
 SG_ EPASTP_a064_amBridgeShort m1 : 7|1@1+ (1,0) [0|1] "" Vector__XXX
 SG_ EPASTP_a065_amGduJuncTemp m1 : 8|1@1+ (1,0) [0|1] "" Vector__XXX
 SG_ EPASTP_a066_amVoltQfErr m1 : 9|1@1+ (1,0) [0|1] "" Vector__XXX
 SG_ EPASTP_a067_tspmPowermoduleTempI m1 : 10|1@1+ (1,0) [0|1] "" Vector__XXX
 SG_ EPASTP_a068_rsthCoreRedundancyEr m1 : 11|1@1+ (1,0) [0|1] "" Vector__XXX
 SG_ EPASTP_a069_rsthCoreTempOutOfRan m1 : 12|1@1+ (1,0) [0|1] "" Vector__XXX
 SG_ EPASTP_a070_rsthInternalLowVolt m1 : 13|1@1+ (1,0) [0|1] "" Vector__XXX
 SG_ EPASTP_a071_rsthInternalHighVolt m1 : 14|1@1+ (1,0) [0|1] "" Vector__XXX
 SG_ EPASTP_a072_rsthFlashUncorrEccOr m1 : 15|1@1+ (1,0) [0|1] "" Vector__XXX
 SG_ EPASTP_a073_rsthOtherEdcEcc m1 : 16|1@1+ (1,0) [0|1] "" Vector__XXX
 SG_ EPASTP_a074_rsthUnexpectedAlarm m1 : 17|1@1+ (1,0) [0|1] "" Vector__XXX
 SG_ EPASTP_a075_rsthUnusedOtherModul m1 : 18|1@1+ (1,0) [0|1] "" Vector__XXX
 SG_ EPASTP_a076_exchGeneralException m1 : 19|1@1+ (1,0) [0|1] "" Vector__XXX
 SG_ EPASTP_a077_dmDeadlineViolation m1 : 20|1@1+ (1,0) [0|1] "" Vector__XXX
 SG_ EPASTP_a078_dmDeadlineViolation m1 : 21|1@1+ (1,0) [0|1] "" Vector__XXX
 SG_ EPASTP_a079_gduhComErr m1 : 22|1@1+ (1,0) [0|1] "" Vector__XXX
 SG_ EPASTP_a080_pwmTimerSyncCheck m1 : 23|1@1+ (1,0) [0|1] "" Vector__XXX
 SG_ EPASTP_a081_exchFloatingPointExc m1 : 24|1@1+ (1,0) [0|1] "" Vector__XXX
 SG_ EPASTP_a082_adcTriggerTimeChk m1 : 25|1@1+ (1,0) [0|1] "" Vector__XXX
 SG_ EPASTP_a083_tdaDclinkcapacitorTe m1 : 26|1@1+ (1,0) [0|1] "" Vector__XXX
 SG_ EPASTP_a084_adcTriggerCheck m1 : 27|1@1+ (1,0) [0|1] "" Vector__XXX
 SG_ EPASTP_a085_amGduSwitchOffTestBy m1 : 28|1@1+ (1,0) [0|1] "" Vector__XXX
 SG_ EPASTP_a086_rsthRamUncorrEcc m1 : 29|1@1+ (1,0) [0|1] "" Vector__XXX
 SG_ EPASTP_a087_rsthFlashConfigErr m1 : 30|1@1+ (1,0) [0|1] "" Vector__XXX
 SG_ EPASTP_a088_tedMainboardTempChec m1 : 31|1@1+ (1,0) [0|1] "" Vector__XXX
 SG_ EPASTP_a089_tedRevercebattfetjun m1 : 32|1@1+ (1,0) [0|1] "" Vector__XXX
 SG_ EPASTP_a090_etsmWarning m1 : 33|1@1+ (1,0) [0|1] "" Vector__XXX
 SG_ EPASTP_a091_bvpBattVoltCrossChkF m1 : 34|1@1+ (1,0) [0|1] "" Vector__XXX
 SG_ EPASTP_a092_amGduSwitchOffTestBy m1 : 35|1@1+ (1,0) [0|1] "" Vector__XXX
 SG_ EPASTP_a093_sctpTsuSingleStaticF m1 : 36|1@1+ (1,0) [0|1] "" Vector__XXX
 SG_ EPASTP_a094_sctpTsuMultipleStati m1 : 37|1@1+ (1,0) [0|1] "" Vector__XXX
 SG_ EPASTP_a095_mdModelBasedMotorInt m1 : 38|1@1+ (1,0) [0|1] "" Vector__XXX
 SG_ EPASTP_a096_rppRpsSingleStaticFa m1 : 39|1@1+ (1,0) [0|1] "" Vector__XXX
 SG_ EPASTP_a097_rppRpsMultipleStatic m1 : 40|1@1+ (1,0) [0|1] "" Vector__XXX
 SG_ EPASTP_a098_invErr m1 : 41|1@1+ (1,0) [0|1] "" Vector__XXX
 SG_ EPASTP_a099_mcdTorqueMismatchFau m1 : 42|1@1+ (1,0) [0|1] "" Vector__XXX
 SG_ EPASTP_a100_amVbrgLssFault m1 : 43|1@1+ (1,0) [0|1] "" Vector__XXX
 SG_ EPASTP_a101_sdrvSpcIdMismatch m1 : 44|1@1+ (1,0) [0|1] "" Vector__XXX
 SG_ EPASTP_a102_amPhasecurrentQosErr m1 : 45|1@1+ (1,0) [0|1] "" Vector__XXX
 SG_ EPASTP_a103_exhaUnusedInterruptC m1 : 46|1@1+ (1,0) [0|1] "" Vector__XXX
 SG_ EPASTP_a104_exhaBusMpuException m1 : 47|1@1+ (1,0) [0|1] "" Vector__XXX
 SG_ EPASTP_a105_exhaSriBusErrExcepti m1 : 48|1@1+ (1,0) [0|1] "" Vector__XXX
 SG_ EPASTP_a106_exhaSpbBusErrExcepti m1 : 49|1@1+ (1,0) [0|1] "" Vector__XXX
 SG_ EPASTP_a107_exhaOtherNmiExceptio m1 : 50|1@1+ (1,0) [0|1] "" Vector__XXX
 SG_ EPASTP_a108_exhaInternalProtecti m1 : 51|1@1+ (1,0) [0|1] "" Vector__XXX
 SG_ EPASTP_a109_exhaSysBusOrPeriphEr m1 : 52|1@1+ (1,0) [0|1] "" Vector__XXX
 SG_ EPASTP_a110_amPhaseRelaySwitchOf m1 : 53|1@1+ (1,0) [0|1] "" Vector__XXX
 SG_ EPASTP_a111_amCurrentSensingDisc m1 : 54|1@1+ (1,0) [0|1] "" Vector__XXX
 SG_ EPASTP_a112_rsthSafetyFlipflopEr m1 : 55|1@1+ (1,0) [0|1] "" Vector__XXX
 SG_ EPASTP_a113_rsthUncorrectableEnd m1 : 56|1@1+ (1,0) [0|1] "" Vector__XXX
 SG_ EPASTP_a114_osehOsErr m1 : 57|1@1+ (1,0) [0|1] "" Vector__XXX
 SG_ EPASTP_a115_mcusscLbistSingleFai m1 : 58|1@1+ (1,0) [0|1] "" Vector__XXX
 SG_ EPASTP_a116_mrccStartupRegCsErro m1 : 59|1@1+ (1,0) [0|1] "" Vector__XXX
 SG_ EPASTP_a117_mrccStartupRegCsErro m1 : 60|1@1+ (1,0) [0|1] "" Vector__XXX
 SG_ EPASTP_a118_mcusscFlashCsErrorEr m1 : 61|1@1+ (1,0) [0|1] "" Vector__XXX
 SG_ EPASTP_a119_mcusscFlashEccCritic m1 : 62|1@1+ (1,0) [0|1] "" Vector__XXX
 SG_ EPASTP_a120_mcusscFlashEccLatent m1 : 63|1@1+ (1,0) [0|1] "" Vector__XXX
 SG_ EPASTP_a121_mcusscMbistEccErr m2 : 4|1@1+ (1,0) [0|1] "" Vector__XXX
 SG_ EPASTP_a122_pcpBridgeFetShort m2 : 5|1@1+ (1,0) [0|1] "" Vector__XXX
 SG_ EPASTP_a123_imcmCommErr m2 : 6|1@1+ (1,0) [0|1] "" Vector__XXX
 SG_ EPASTP_a124_mcusscMbistEccTransi m2 : 7|1@1+ (1,0) [0|1] "" Vector__XXX
 SG_ EPASTP_a125_mcusscMbistMiaErr m2 : 8|1@1+ (1,0) [0|1] "" Vector__XXX
 SG_ EPASTP_a126_mcusscMonbistMiaErr m2 : 9|1@1+ (1,0) [0|1] "" Vector__XXX
 SG_ EPASTP_a127_exchAdditionalExcept m2 : 10|1@1+ (1,0) [0|1] "" Vector__XXX
 SG_ EPASTP_a128_exchExceptionStopRes m2 : 11|1@1+ (1,0) [0|1] "" Vector__XXX
 SG_ EPASTP_a129_exchAdditionalExcept m2 : 12|1@1+ (1,0) [0|1] "" Vector__XXX
 SG_ EPASTP_a130_mrccConfigCsErrorErr m2 : 13|1@1+ (1,0) [0|1] "" Vector__XXX
 SG_ EPASTP_a131_exchGuardedResetAfte m2 : 14|1@1+ (1,0) [0|1] "" Vector__XXX
 SG_ EPASTP_a132_mcusscNotSupportedMc m2 : 15|1@1+ (1,0) [0|1] "" Vector__XXX
 SG_ EPASTP_a133_mcusscLbistEcuIdIsNo m2 : 16|1@1+ (1,0) [0|1] "" Vector__XXX
 SG_ EPASTP_a134_osehGuardedResetAfte m2 : 17|1@1+ (1,0) [0|1] "" Vector__XXX
 SG_ EPASTP_a135_tmpsfetjCalculationO m2 : 18|1@1+ (1,0) [0|1] "" Vector__XXX
 SG_ EPASTP_a136_ftElectricalAngleQf m2 : 19|1@1+ (1,0) [0|1] "" Vector__XXX
 SG_ EPASTP_a137_osehErrWithoutImmedi m2 : 20|1@1+ (1,0) [0|1] "" Vector__XXX
 SG_ EPASTP_a138_osehAdditionalErrWit m2 : 21|1@1+ (1,0) [0|1] "" Vector__XXX
 SG_ EPASTP_a139_osehAdditionalOsErr m2 : 22|1@1+ (1,0) [0|1] "" Vector__XXX
 SG_ EPASTP_a140_imcmConfigurationErr m2 : 23|1@1+ (1,0) [0|1] "" Vector__XXX
 SG_ EPASTP_a141_amFetShortTest m2 : 24|1@1+ (1,0) [0|1] "" Vector__XXX
 SG_ EPASTP_a142_tedEmifilterDmcTempC m2 : 25|1@1+ (1,0) [0|1] "" Vector__XXX
 SG_ EPASTP_a143_tedEmifilterCmcTempC m2 : 26|1@1+ (1,0) [0|1] "" Vector__XXX
 SG_ EPASTP_a144_mriCoreRaminitFailed m2 : 27|1@1+ (1,0) [0|1] "" Vector__XXX
 SG_ EPASTP_a145_mriPeripheralRaminit m2 : 28|1@1+ (1,0) [0|1] "" Vector__XXX
 SG_ EPASTP_a146_btarcRcCircuitCheck m2 : 29|1@1+ (1,0) [0|1] "" Vector__XXX
 SG_ EPASTP_a147_amDcLinkShortedFail m2 : 30|1@1+ (1,0) [0|1] "" Vector__XXX
 SG_ EPASTP_a148_mrccExitFromStandbyD m2 : 31|1@1+ (1,0) [0|1] "" Vector__XXX
 SG_ EPASTP_a149_amReversibleEmergenc m2 : 32|1@1+ (1,0) [0|1] "" Vector__XXX
 SG_ EPASTP_a150_amExternalEmergencyO m2 : 33|1@1+ (1,0) [0|1] "" Vector__XXX
 SG_ EPASTP_a151_amPermanentEmergency m2 : 34|1@1+ (1,0) [0|1] "" Vector__XXX
 SG_ EPASTP_a152_exchFlashEccExceptio m2 : 35|1@1+ (1,0) [0|1] "" Vector__XXX
 SG_ EPASTP_a153_sdsmBlockSelectorInv m2 : 36|1@1+ (1,0) [0|1] "" Vector__XXX
 SG_ EPASTP_a154_sdsmCsErrorInvalidPr m2 : 37|1@1+ (1,0) [0|1] "" Vector__XXX
 SG_ EPASTP_a155_sdsmDataInvalidAll m2 : 38|1@1+ (1,0) [0|1] "" Vector__XXX
 SG_ EPASTP_a156_amIntSerialErrSafety m2 : 39|1@1+ (1,0) [0|1] "" Vector__XXX
 SG_ EPASTP_a157_mcudcpInvalidEcuId m2 : 40|1@1+ (1,0) [0|1] "" Vector__XXX
 SG_ EPASTP_a158_amGduFailDuringRecov m2 : 41|1@1+ (1,0) [0|1] "" Vector__XXX
 SG_ EPASTP_a159_exchFlashWordlineTra m2 : 42|1@1+ (1,0) [0|1] "" Vector__XXX
 SG_ EPASTP_a160_rsthCpu1UnexpectedAl m2 : 43|1@1+ (1,0) [0|1] "" Vector__XXX
 SG_ EPASTP_a161_tdaRelayfetjunctionT m2 : 44|1@1+ (1,0) [0|1] "" Vector__XXX
 SG_ EPASTP_a162_tdaBridgefetjunction m2 : 45|1@1+ (1,0) [0|1] "" Vector__XXX
 SG_ EPASTP_a163_tdaPowermoduleTempCh m2 : 46|1@1+ (1,0) [0|1] "" Vector__XXX
 SG_ EPASTP_a164_tdaBattfetjunctionTe m2 : 47|1@1+ (1,0) [0|1] "" Vector__XXX
 SG_ EPASTP_a165_tdaDcbusshuntTempChe m2 : 48|1@1+ (1,0) [0|1] "" Vector__XXX
 SG_ EPASTP_a166_tdaPhasecurrentshunt m2 : 49|1@1+ (1,0) [0|1] "" Vector__XXX
 SG_ EPASTP_a167_iccd1ErrQueueOverflo m2 : 50|1@1+ (1,0) [0|1] "" Vector__XXX
 SG_ EPASTP_a168_c1csInvalidC1App m2 : 51|1@1+ (1,0) [0|1] "" Vector__XXX
 SG_ EPASTP_a169_scpSafetyReset m2 : 52|1@1+ (1,0) [0|1] "" Vector__XXX
 SG_ EPASTP_a170_pmpDcvoltAge m2 : 53|1@1+ (1,0) [0|1] "" Vector__XXX
 SG_ EPASTP_a171_pmpKgvalueAge m2 : 54|1@1+ (1,0) [0|1] "" Vector__XXX
 SG_ EPASTP_a172_pmpElangMotorcurrent m2 : 55|1@1+ (1,0) [0|1] "" Vector__XXX
 SG_ EPASTP_a173_pmpRotorspeedAge m2 : 56|1@1+ (1,0) [0|1] "" Vector__XXX
 SG_ EPASTP_a174_pmpPhasecurrentAge m2 : 57|1@1+ (1,0) [0|1] "" Vector__XXX
 SG_ EPASTP_a175_exchFlashStoredConfi m2 : 58|1@1+ (1,0) [0|1] "" Vector__XXX
 SG_ EPASTP_a176_exchCpu1ExceptionRes m2 : 59|1@1+ (1,0) [0|1] "" Vector__XXX
 SG_ EPASTP_a177_etsrInvalidated m2 : 60|1@1+ (1,0) [0|1] "" Vector__XXX
 SG_ EPASTP_a178_exchWdtException m2 : 61|1@1+ (1,0) [0|1] "" Vector__XXX
 SG_ EPASTP_a179_tedMotorcoilTempChec m2 : 62|1@1+ (1,0) [0|1] "" Vector__XXX
 SG_ EPASTP_a180_dmDeadlineViolationC m2 : 63|1@1+ (1,0) [0|1] "" Vector__XXX
 SG_ EPASTP_a181_dmDeadlineViolationC m3 : 4|1@1+ (1,0) [0|1] "" Vector__XXX
 SG_ EPASTP_a182_mcdInputMia m3 : 5|1@1+ (1,0) [0|1] "" Vector__XXX
 SG_ EPASTP_a183_sbchCommErrSbcToMcu m3 : 6|1@1+ (1,0) [0|1] "" Vector__XXX
 SG_ EPASTP_a184_sbcmCommBufferOverfl m3 : 7|1@1+ (1,0) [0|1] "" Vector__XXX
 SG_ EPASTP_a185_sbcscpQAWatchdogRese m3 : 8|1@1+ (1,0) [0|1] "" Vector__XXX
 SG_ EPASTP_a186_wdhCommBufferOverflo m3 : 9|1@1+ (1,0) [0|1] "" Vector__XXX
 SG_ EPASTP_a187_epmVoltFail m3 : 10|1@1+ (1,0) [0|1] "" Vector__XXX
 SG_ EPASTP_a188_epmCommBufferOverflo m3 : 11|1@1+ (1,0) [0|1] "" Vector__XXX
 SG_ EPASTP_a189_sbchCommErrMcuToSbc m3 : 12|1@1+ (1,0) [0|1] "" Vector__XXX
 SG_ EPASTP_a190_sbchCommBufferOverfl m3 : 13|1@1+ (1,0) [0|1] "" Vector__XXX
 SG_ EPASTP_a191_sbcscpVcp2VucVoltFai m3 : 14|1@1+ (1,0) [0|1] "" Vector__XXX
 SG_ EPASTP_a192_osumC0CsaNearFull m3 : 15|1@1+ (1,0) [0|1] "" Vector__XXX
 SG_ EPASTP_a193_osumC0StackNearFull m3 : 16|1@1+ (1,0) [0|1] "" Vector__XXX
 SG_ EPASTP_a194_amNvdataLoss m3 : 17|1@1+ (1,0) [0|1] "" Vector__XXX
 SG_ EPASTP_a195_imcmCommErrC1 m3 : 18|1@1+ (1,0) [0|1] "" Vector__XXX
 SG_ EPASTP_a196_topEolTasOffsetInval m3 : 19|1@1+ (1,0) [0|1] "" Vector__XXX
 SG_ EPASTP_a197_difpDifactorInvalid m3 : 20|1@1+ (1,0) [0|1] "" Vector__XXX
 SG_ EPASTP_a198_osumC1CsaNearFull m3 : 21|1@1+ (1,0) [0|1] "" Vector__XXX
 SG_ EPASTP_a199_osumC1StackNearFull m3 : 22|1@1+ (1,0) [0|1] "" Vector__XXX
 SG_ EPASTP_a200_ammInputBufferOverfl m3 : 23|1@1+ (1,0) [0|1] "" Vector__XXX
 SG_ EPASTP_a201_ammOutputBufferOverf m3 : 24|1@1+ (1,0) [0|1] "" Vector__XXX
 SG_ EPASTP_a202_ohnvmpStoredOffsetLo m3 : 25|1@1+ (1,0) [0|1] "" Vector__XXX
 SG_ EPASTP_a203_ctcInterfaceErr m3 : 26|1@1+ (1,0) [0|1] "" Vector__XXX
 SG_ EPASTP_a204_fdpPrevTrqErr m3 : 27|1@1+ (1,0) [0|1] "" Vector__XXX
 SG_ EPASTP_a205_fdrOclFail m3 : 28|1@1+ (1,0) [0|1] "" Vector__XXX
 SG_ EPASTP_a206_fdrOclPartialBlockin m3 : 29|1@1+ (1,0) [0|1] "" Vector__XXX
 SG_ EPASTP_a207_fdrOclFreezing m3 : 30|1@1+ (1,0) [0|1] "" Vector__XXX
 SG_ EPASTP_a208_fdrLowSeverityBlocki m3 : 31|1@1+ (1,0) [0|1] "" Vector__XXX
 SG_ EPASTP_a209_fdrLowSeverityFreezi m3 : 32|1@1+ (1,0) [0|1] "" Vector__XXX
 SG_ EPASTP_a210_fdrTotalBlocking m3 : 33|1@1+ (1,0) [0|1] "" Vector__XXX
 SG_ EPASTP_a211_frmInternalErr m3 : 34|1@1+ (1,0) [0|1] "" Vector__XXX
 SG_ EPASTP_a212_frmDataLost m3 : 35|1@1+ (1,0) [0|1] "" Vector__XXX
 SG_ EPASTP_a213_frmHighFrictionDetec m3 : 36|1@1+ (1,0) [0|1] "" Vector__XXX
 SG_ EPASTP_a214_velInterfaceErr m3 : 37|1@1+ (1,0) [0|1] "" Vector__XXX
 SG_ EPASTP_a215_vsgSafeViolErr m3 : 38|1@1+ (1,0) [0|1] "" Vector__XXX
 SG_ EPASTP_a216_isdgImproperShutdown m3 : 39|1@1+ (1,0) [0|1] "" Vector__XXX
 SG_ EPASTP_a217_msdMasterSilentErr m3 : 40|1@1+ (1,0) [0|1] "" Vector__XXX
 SG_ EPASTP_a218_aadApplicationStateE m3 : 41|1@1+ (1,0) [0|1] "" Vector__XXX
 SG_ EPASTP_a219_frhFastRestartFailed m3 : 42|1@1+ (1,0) [0|1] "" Vector__XXX
 SG_ EPASTP_a221_apsCntError m3 : 43|1@1+ (1,0) [0|1] "" Vector__XXX
 SG_ EPASTP_a222_apsCsError m3 : 44|1@1+ (1,0) [0|1] "" Vector__XXX
 SG_ EPASTP_a223_apsMia m3 : 45|1@1+ (1,0) [0|1] "" Vector__XXX
 SG_ EPASTP_a224_dasCntError m3 : 46|1@1+ (1,0) [0|1] "" Vector__XXX
 SG_ EPASTP_a225_dasCsError m3 : 47|1@1+ (1,0) [0|1] "" Vector__XXX
 SG_ EPASTP_a226_dasMia m3 : 48|1@1+ (1,0) [0|1] "" Vector__XXX
 SG_ EPASTP_a227_dirTorqueCntError m3 : 49|1@1+ (1,0) [0|1] "" Vector__XXX
 SG_ EPASTP_a228_dirTorqueCsError m3 : 50|1@1+ (1,0) [0|1] "" Vector__XXX
 SG_ EPASTP_a229_dirTorqueMia m3 : 51|1@1+ (1,0) [0|1] "" Vector__XXX
 SG_ EPASTP_a230_diSpdCntError m3 : 52|1@1+ (1,0) [0|1] "" Vector__XXX
 SG_ EPASTP_a231_diSpdCsError m3 : 53|1@1+ (1,0) [0|1] "" Vector__XXX
 SG_ EPASTP_a232_diSpdMia m3 : 54|1@1+ (1,0) [0|1] "" Vector__XXX
 SG_ EPASTP_a233_ecu2StatCntError m3 : 55|1@1+ (1,0) [0|1] "" Vector__XXX
 SG_ EPASTP_a234_ecu2StatCsError m3 : 56|1@1+ (1,0) [0|1] "" Vector__XXX
 SG_ EPASTP_a235_ecu2StatMia m3 : 57|1@1+ (1,0) [0|1] "" Vector__XXX
 SG_ EPASTP_a236_espWrCntError m3 : 58|1@1+ (1,0) [0|1] "" Vector__XXX
 SG_ EPASTP_a237_espWrCsError m3 : 59|1@1+ (1,0) [0|1] "" Vector__XXX
 SG_ EPASTP_a238_espWrMia m3 : 60|1@1+ (1,0) [0|1] "" Vector__XXX
 SG_ EPASTP_a239_espWsCntError m3 : 61|1@1+ (1,0) [0|1] "" Vector__XXX
 SG_ EPASTP_a240_espWsCsError m3 : 62|1@1+ (1,0) [0|1] "" Vector__XXX
 SG_ EPASTP_a241_espWsMia m3 : 63|1@1+ (1,0) [0|1] "" Vector__XXX
 SG_ EPASTP_a242_gtwConfigMia m4 : 4|1@1+ (1,0) [0|1] "" Vector__XXX
 SG_ EPASTP_a243_rcmCntError m4 : 5|1@1+ (1,0) [0|1] "" Vector__XXX
 SG_ EPASTP_a244_rcmCsError m4 : 6|1@1+ (1,0) [0|1] "" Vector__XXX
 SG_ EPASTP_a245_rcmMia m4 : 7|1@1+ (1,0) [0|1] "" Vector__XXX
 SG_ EPASTP_a246_sccmCntError m4 : 8|1@1+ (1,0) [0|1] "" Vector__XXX
 SG_ EPASTP_a247_sccmCsError m4 : 9|1@1+ (1,0) [0|1] "" Vector__XXX
 SG_ EPASTP_a248_sccmMia m4 : 10|1@1+ (1,0) [0|1] "" Vector__XXX
 SG_ EPASTP_a249_uiTuneReqCntError m4 : 11|1@1+ (1,0) [0|1] "" Vector__XXX
 SG_ EPASTP_a250_uiTuneReqCsError m4 : 12|1@1+ (1,0) [0|1] "" Vector__XXX
 SG_ EPASTP_a251_uiTuneReqMia m4 : 13|1@1+ (1,0) [0|1] "" Vector__XXX
 SG_ EPASTP_a252_vcFrontCntError m4 : 14|1@1+ (1,0) [0|1] "" Vector__XXX
 SG_ EPASTP_a253_vcFrontCsError m4 : 15|1@1+ (1,0) [0|1] "" Vector__XXX
 SG_ EPASTP_a254_vcFrontMia m4 : 16|1@1+ (1,0) [0|1] "" Vector__XXX
 SG_ EPASTP_a255_pmState2Mia m4 : 17|1@1+ (1,0) [0|1] "" Vector__XXX
 SG_ EPASTP_a256_dcvmOverVolt m4 : 18|1@1+ (1,0) [0|1] "" Vector__XXX
 SG_ EPASTP_a257_dcvmUnderVolt m4 : 19|1@1+ (1,0) [0|1] "" Vector__XXX
 SG_ EPASTP_a258_pspInvalidProjectPar m4 : 20|1@1+ (1,0) [0|1] "" Vector__XXX
 SG_ EPASTP_a259_scoCanBusOff m4 : 21|1@1+ (1,0) [0|1] "" Vector__XXX
 SG_ EPASTP_a260_scoPrivateBusOff m4 : 22|1@1+ (1,0) [0|1] "" Vector__XXX
 SG_ EPASTP_a261_sccmStatusError m4 : 23|1@1+ (1,0) [0|1] "" Vector__XXX
 SG_ EPASTP_a262_yawRateStatus m4 : 24|1@1+ (1,0) [0|1] "" Vector__XXX
 SG_ EPASTP_a263_espWsStatus m4 : 25|1@1+ (1,0) [0|1] "" Vector__XXX
 SG_ EPASTP_a264_assistTorqueLimited m4 : 26|1@1+ (1,0) [0|1] "" Vector__XXX
 SG_ EPASTP_a265_overheatProtect m4 : 27|1@1+ (1,0) [0|1] "" Vector__XXX
 SG_ EPASTP_a266_overloadProtect m4 : 28|1@1+ (1,0) [0|1] "" Vector__XXX
 SG_ EPASTP_a267_safeSpeedAssist m4 : 29|1@1+ (1,0) [0|1] "" Vector__XXX
 SG_ EPASTP_a268_eacCancelled m4 : 30|1@1+ (1,0) [0|1] "" Vector__XXX
 SG_ EPASTP_a269_assistTorqueDisabled m4 : 31|1@1+ (1,0) [0|1] "" Vector__XXX
 SG_ EPASTP_a270_oscillationCompTrqLi m4 : 32|1@1+ (1,0) [0|1] "" Vector__XXX

BO_TX_BU_ 999 : DPB;
BO_TX_BU_ 1427 : EPASTP;
BO_TX_BU_ 919 : EPASTP;
CM_ BO_ 999 "DPB ECU message: alert matrix";
CM_ SG_ 999 DPB_matrixIndex "DPB ECU: matrix index";
CM_ SG_ 999 DPB_a001_pPlungerSensorOffsetHig "DPB ECU: a001 p plunger sensor offset high";
CM_ SG_ 999 DPB_a002_pMC2SensorOffsetHigh "DPB ECU: a002 p MC2 sensor offset high";
CM_ SG_ 999 DPB_a003_AswEEPROMReadFailure "DPB ECU: a003 asw EEPROM read failure";
CM_ SG_ 999 DPB_a004_assertionFault "DPB ECU: a004 assertion fault";
CM_ SG_ 999 DPB_a005_hardPedalChar "DPB ECU: a005 hard pedal char";
CM_ SG_ 999 DPB_a006_hardPedalCharGoodCheck "DPB ECU: a006 hard pedal char good check";
CM_ SG_ 999 DPB_a007_PMCLeakageDetected "DPB ECU: a007 PMC leakage detected";
CM_ SG_ 999 DPB_a008_LiPSPts1Offset "DPB ECU: a008 li PS pts1 offset";
CM_ SG_ 999 DPB_a009_LiPSPts2Offset "DPB ECU: a009 li PS pts2 offset";
CM_ SG_ 999 DPB_a010_LiPSPtsConsistency "DPB ECU: a010 li PS pts consistency";
CM_ SG_ 999 DPB_a011_PtsNonZeroStage1 "DPB ECU: a011 pts non zero stage1";
CM_ SG_ 999 DPB_a012_PtsNonZeroStage2 "DPB ECU: a012 pts non zero stage2";
CM_ SG_ 999 DPB_a013_softPedalChar "DPB ECU: a013 soft pedal char";
CM_ SG_ 999 DPB_a014_CANControllerHWFault "DPB ECU: a014 CAN controller HW fault";
CM_ SG_ 999 DPB_a015_CAN1BusOff "DPB ECU: a015 CAN1 bus off";
CM_ SG_ 999 DPB_a016_CAN2BusOff "DPB ECU: a016 CAN2 bus off";
CM_ SG_ 999 DPB_a017_largeLeakageDetected "DPB ECU: a017 large leakage detected";
CM_ SG_ 999 DPB_a018_largeLeakageDetectedGoo "DPB ECU: a018 large leakage detected good check";
CM_ SG_ 999 DPB_a019_DETReportError "DPB ECU: a019 DET report error";
CM_ SG_ 999 DPB_a020_ecuHuMismatch "DPB ECU: a020 ecu hu mismatch";
CM_ SG_ 999 DPB_a021_brakeSystemOverheatLvl1 "DPB ECU: a021 brake system overheat lvl1";
CM_ SG_ 999 DPB_a022_brakeSystemOverheatLvl2 "DPB ECU: a022 brake system overheat lvl2";
CM_ SG_ 999 DPB_a023_initialPlungerCheckFail "DPB ECU: a023 initial plunger check failed";
CM_ SG_ 999 DPB_a024_ESPLDMFailure "DPB ECU: a024 ESPLDM failure";
CM_ SG_ 999 DPB_a025_backupCircuitLeakage "DPB ECU: a025 backup circuit leakage";
CM_ SG_ 999 DPB_a026_LiPSIDTimeout "DPB ECU: a026 li PSID timeout";
CM_ SG_ 999 DPB_a027_motorTempHighLevel1 "DPB ECU: a027 motor temp high level1";
CM_ SG_ 999 DPB_a028_motorTempHighLevel2 "DPB ECU: a028 motor temp high level2";
CM_ SG_ 999 DPB_a029_motorTestFault "DPB ECU: a029 motor test fault";
CM_ SG_ 999 DPB_a030_notShutDownRight "DPB ECU: a030 not shut down right";
CM_ SG_ 999 DPB_a031_HWParamReadFailed "DPB ECU: a031 HW param read failed";
CM_ SG_ 999 DPB_a032_HWParamWriteFailed "DPB ECU: a032 HW param write failed";
CM_ SG_ 999 DPB_a033_motorDynamicLimited "DPB ECU: a033 motor dynamic limited";
CM_ SG_ 999 DPB_a034_lipsMemoryEmpty "DPB ECU: a034 lips memory empty";
CM_ SG_ 999 DPB_a035_PDURouterinitialization "DPB ECU: a035 PDU routerinitialization failed";
CM_ SG_ 999 DPB_a036_lossOfPDUInstanceDetect "DPB ECU: a036 loss of PDU instance detected";
CM_ SG_ 999 DPB_a037_plungerCircuitPressHigh "DPB ECU: a037 plunger circuit press high";
CM_ SG_ 999 DPB_a038_plungerCircuitPressHigh "DPB ECU: a038 plunger circuit press high good check";
CM_ SG_ 999 DPB_a039_plungerCircuitPressLow "DPB ECU: a039 plunger circuit press low";
CM_ SG_ 999 DPB_a040_plungerCircuitPressLowG "DPB ECU: a040 plunger circuit press low good check";
CM_ SG_ 999 DPB_a041_PSCGearRatioReadFault "DPB ECU: a041 PSC gear ratio read fault";
CM_ SG_ 999 DPB_a042_motorLoadPressImplausib "DPB ECU: a042 motor load press implausible";
CM_ SG_ 999 DPB_a043_PSCMotorSizeReadFault "DPB ECU: a043 PSC motor size read fault";
CM_ SG_ 999 DPB_a044_supplyOvervoltageLvl1 "DPB ECU: a044 supply overvoltage lvl1";
CM_ SG_ 999 DPB_a045_supplyOvervoltageLvl2 "DPB ECU: a045 supply overvoltage lvl2";
CM_ SG_ 999 DPB_a046_supplyOvervoltageLvl3 "DPB ECU: a046 supply overvoltage lvl3";
CM_ SG_ 999 DPB_a047_pPlungerPlausCheckFailu "DPB ECU: a047 p plunger plaus check failure";
CM_ SG_ 999 DPB_a048_supplyUndervoltageLvl1 "DPB ECU: a048 supply undervoltage lvl1";
CM_ SG_ 999 DPB_a049_supplyUndervoltageLvl2 "DPB ECU: a049 supply undervoltage lvl2";
CM_ SG_ 999 DPB_a050_supplyUndervoltageLvl3 "DPB ECU: a050 supply undervoltage lvl3";
CM_ SG_ 999 DPB_a051_PSCVoltageImplausible "DPB ECU: a051 PSC voltage implausible";
CM_ SG_ 999 DPB_a052_PSIDTimeOut "DPB ECU: a052 PSID time out";
CM_ SG_ 999 DPB_a053_hydraulicAssemblyModeAc "DPB ECU: a053 hydraulic assembly mode active";
CM_ SG_ 999 DPB_a054_unsupportedHW "DPB ECU: a054 unsupported HW";
CM_ SG_ 999 DPB_a055_unsupportedSeriesHWDete "DPB ECU: a055 unsupported series HW detected";
CM_ SG_ 999 DPB_a056_AdcPeripheralFault "DPB ECU: a056 adc peripheral fault";
CM_ SG_ 999 DPB_a057_AdcPinTest "DPB ECU: a057 adc pin test";
CM_ SG_ 999 DPB_a058_AdcSelftestC5P "DPB ECU: a058 adc selftest C5 p";
CM_ SG_ 999 DPB_a059_factoryModeActive "DPB ECU: a059 factory mode active";
CM_ SG_ 999 DPB_a060_motorBridgeDriverFault "DPB ECU: a060 motor bridge driver fault";
CM_ SG_ 999 DPB_a061_bridgeSwitchInitError "DPB ECU: a061 bridge switch init error";
CM_ SG_ 999 DPB_a062_loadDumpOnFSLTest "DPB ECU: a062 load dump on FSL test";
CM_ SG_ 999 DPB_a063_motorConfigMismatch "DPB ECU: a063 motor config mismatch";
CM_ SG_ 999 DPB_a064_current1OffsetHigh "DPB ECU: a064 current1 offset high";
CM_ SG_ 999 DPB_a065_current1OffsetLow "DPB ECU: a065 current1 offset low";
CM_ SG_ 999 DPB_a066_current2OffsetHigh "DPB ECU: a066 current2 offset high";
CM_ SG_ 999 DPB_a067_current2OffsetLow "DPB ECU: a067 current2 offset low";
CM_ SG_ 999 DPB_a068_BLMMuxerTimeoutError "DPB ECU: a068 BLM muxer timeout error";
CM_ SG_ 999 DPB_a069_OBDCurrent1OORHigh "DPB ECU: a069 OBD current1 OOR high";
CM_ SG_ 999 DPB_a070_OBDCurrent1OORLow "DPB ECU: a070 OBD current1 OOR low";
CM_ SG_ 999 DPB_a071_OBDCurrent2OORHigh "DPB ECU: a071 OBD current2 OOR high";
CM_ SG_ 999 DPB_a072_OBDCurrent2OORLow "DPB ECU: a072 OBD current2 OOR low";
CM_ SG_ 999 DPB_a073_rotorCosOutOfRangeHigh "DPB ECU: a073 rotor cos out of range high";
CM_ SG_ 999 DPB_a074_rotorCosOutOfRangeLow "DPB ECU: a074 rotor cos out of range low";
CM_ SG_ 999 DPB_a075_rotorSinOutOfRangeHigh "DPB ECU: a075 rotor sin out of range high";
CM_ SG_ 999 DPB_a076_rotorSinOutOfRangeLow "DPB ECU: a076 rotor sin out of range low";
CM_ SG_ 999 DPB_a077_tempSens1ShortToSupply "DPB ECU: a077 temp sens1 short to supply";
CM_ SG_ 999 DPB_a078_tempSens1ShortToGround "DPB ECU: a078 temp sens1 short to ground";
CM_ SG_ 999 DPB_a079_tempSens2ShortToSupply "DPB ECU: a079 temp sens2 short to supply";
CM_ SG_ 999 DPB_a080_tempSens2ShortToGround "DPB ECU: a080 temp sens2 short to ground";
CM_ SG_ 999 DPB_a081_tempSensImplausVoltage "DPB ECU: a081 temp sens implaus voltage";
CM_ SG_ 999 DPB_a082_chargePumpFault "DPB ECU: a082 charge pump fault";
CM_ SG_ 999 DPB_a083_chargePumpUndervoltage "DPB ECU: a083 charge pump undervoltage";
CM_ SG_ 999 DPB_a084_RBCPUException "DPB ECU: a084 RBCPU exception";
CM_ SG_ 999 DPB_a085_infoFailureWrongCUBASHa "DPB ECU: a085 info failure wrong CUBAS handling detected";
CM_ SG_ 999 DPB_a086_diagHydProtectionPressF "DPB ECU: a086 diag hyd protection press fault";
CM_ SG_ 999 DPB_a087_diagHydProtectionVlvFau "DPB ECU: a087 diag hyd protection vlv fault";
CM_ SG_ 999 DPB_a088_DMATransferError "DPB ECU: a088 DMA transfer error";
CM_ SG_ 999 DPB_a089_ecuBandgap "DPB ECU: a089 ecu bandgap";
CM_ SG_ 999 DPB_a090_flashFault "DPB ECU: a090 flash fault";
CM_ SG_ 999 DPB_a091_MRGPathTestFault "DPB ECU: a091 MRG path test fault";
CM_ SG_ 999 DPB_a092_decoupleBitTestFault "DPB ECU: a092 decouple bit test fault";
CM_ SG_ 999 DPB_a093_ecuBistFaultCtrFault "DPB ECU: a093 ecu bist fault ctr fault";
CM_ SG_ 999 DPB_a094_ecuClockTestFault "DPB ECU: a094 ecu clock test fault";
CM_ SG_ 999 DPB_a095_ecuEnableElHighFault "DPB ECU: a095 ecu enable el high fault";
CM_ SG_ 999 DPB_a096_ecuEnableElLowFault "DPB ECU: a096 ecu enable el low fault";
CM_ SG_ 999 DPB_a097_ecuEnableHyHighFault "DPB ECU: a097 ecu enable hy high fault";
CM_ SG_ 999 DPB_a098_ecuEnableHyLowFault "DPB ECU: a098 ecu enable hy low fault";
CM_ SG_ 999 DPB_a099_ecuEnContinuousError "DPB ECU: a099 ecu en continuous error";
CM_ SG_ 999 DPB_a100_ecuErrpinCounterFault "DPB ECU: a100 ecu errpin counter fault";
CM_ SG_ 999 DPB_a101_ecuFastWdTestFault "DPB ECU: a101 ecu fast wd test fault";
CM_ SG_ 999 DPB_a102_ecuVrOnWhileWdTimeout "DPB ECU: a102 ecu vr on while wd timeout";
CM_ SG_ 999 DPB_a103_ecuVrViaSpiFails "DPB ECU: a103 ecu vr via spi fails";
CM_ SG_ 999 DPB_a104_ecuWdStartuptestFault "DPB ECU: a104 ecu wd startuptest fault";
CM_ SG_ 999 DPB_a105_ecuWdSContinuousError "DPB ECU: a105 ecu wd s continuous error";
CM_ SG_ 999 DPB_a106_ecuBistCmdTestFault "DPB ECU: a106 ecu bist cmd test fault";
CM_ SG_ 999 DPB_a107_vrOnFails "DPB ECU: a107 vr on fails";
CM_ SG_ 999 DPB_a108_GTMRefFrequencyError "DPB ECU: a108 GTM ref frequency error";
CM_ SG_ 999 DPB_a109_GTMTbuMonError "DPB ECU: a109 GTM tbu mon error";
CM_ SG_ 999 DPB_a110_HWBISTError "DPB ECU: a110 HWBIST error";
CM_ SG_ 999 DPB_a111_hydraulicHardUndervolta "DPB ECU: a111 hydraulic hard undervoltage";
CM_ SG_ 999 DPB_a112_hydraulicUndervoltage "DPB ECU: a112 hydraulic undervoltage";
CM_ SG_ 999 DPB_a113_LiPS1SentLineHigh "DPB ECU: a113 li PS1 sent line high";
CM_ SG_ 999 DPB_a114_LiPS1SentLineLow "DPB ECU: a114 li PS1 sent line low";
CM_ SG_ 999 DPB_a115_LiPS1SentSensor "DPB ECU: a115 li PS1 sent sensor";
CM_ SG_ 999 DPB_a116_LiPS1SentTransmission "DPB ECU: a116 li PS1 sent transmission";
CM_ SG_ 999 DPB_a117_LiPS2PwmLineHigh "DPB ECU: a117 li PS2 pwm line high";
CM_ SG_ 999 DPB_a118_LiPS2PwmLineLow "DPB ECU: a118 li PS2 pwm line low";
CM_ SG_ 999 DPB_a119_LiPS2PwmTransmission "DPB ECU: a119 li PS2 pwm transmission";
CM_ SG_ 999 DPB_a120_LiPSOutOfRangeHigh "DPB ECU: a120 li PS out of range high";
CM_ SG_ 999 DPB_a121_LiPSOutOfRangeLow "DPB ECU: a121 li PS out of range low";
CM_ SG_ 999 DPB_a122_micAsicClkInError "DPB ECU: a122 mic asic clk in error";
CM_ SG_ 999 DPB_a123_micAsicInitTestError "DPB ECU: a123 mic asic init test error";
CM_ SG_ 999 DPB_a124_asicOscillatorError "DPB ECU: a124 asic oscillator error";
CM_ SG_ 999 DPB_a125_B6AsicFault "DPB ECU: a125 B6 asic fault";
CM_ SG_ 999 DPB_a126_MICB6TransferError "DPB ECU: a126 MICB6 transfer error";
CM_ SG_ 999 DPB_a127_hydraulicAsicShortCircu "DPB ECU: a127 hydraulic asic short circuit";
CM_ SG_ 999 DPB_a128_micSpiTransferError "DPB ECU: a128 mic spi transfer error";
CM_ SG_ 999 DPB_a129_AsicTrimmingNotComplete "DPB ECU: a129 asic trimming not completed";
CM_ SG_ 999 DPB_a130_AsicMalfunctionDetected "DPB ECU: a130 asic malfunction detected";
CM_ SG_ 999 DPB_a131_ASICOvercurrentOnGPIO25 "DPB ECU: a131 ASIC overcurrent on GPIO250 1";
CM_ SG_ 999 DPB_a132_ASICOvercurrentOnGPIO25 "DPB ECU: a132 ASIC overcurrent on GPIO250 2";
CM_ SG_ 999 DPB_a133_ASICOvercurrentOnGPIO50 "DPB ECU: a133 ASIC overcurrent on GPIO50 1";
CM_ SG_ 999 DPB_a134_ASICOvercurrentOnGPIO50 "DPB ECU: a134 ASIC overcurrent on GPIO50 2";
CM_ SG_ 999 DPB_a135_ASICOvercurrentOnGPIO50 "DPB ECU: a135 ASIC overcurrent on GPIO50 3";
CM_ SG_ 999 DPB_a136_ASICOvercurrentOnGPIO50 "DPB ECU: a136 ASIC overcurrent on GPIO50 4";
CM_ SG_ 999 DPB_a137_ASICOvercurrentOnWRHS "DPB ECU: a137 ASIC overcurrent on WRHS";
CM_ SG_ 999 DPB_a138_DIchassisControlCounter "DPB ECU: a138 d ichassis control counter";
CM_ SG_ 999 DPB_a139_DIchassisControlChecksu "DPB ECU: a139 d ichassis control checksum";
CM_ SG_ 999 DPB_a140_DIchassisControlDLC "DPB ECU: a140 d ichassis control DLC";
CM_ SG_ 999 DPB_a141_DIchassisControlTimeout "DPB ECU: a141 d ichassis control timeout";
CM_ SG_ 999 DPB_a142_DIsystemStatusCounter "DPB ECU: a142 d isystem status counter";
CM_ SG_ 999 DPB_a143_DIsystemStatusChecksum "DPB ECU: a143 d isystem status checksum";
CM_ SG_ 999 DPB_a144_DIsystemStatusDLC "DPB ECU: a144 d isystem status DLC";
CM_ SG_ 999 DPB_a145_DIsystemStatusTimeout "DPB ECU: a145 d isystem status timeout";
CM_ SG_ 999 DPB_a146_DIFtorqueCounter "DPB ECU: a146 DI ftorque counter";
CM_ SG_ 999 DPB_a147_DIFtorqueChecksum "DPB ECU: a147 DI ftorque checksum";
CM_ SG_ 999 DPB_a148_DIFtorqueDLC "DPB ECU: a148 DI ftorque DLC";
CM_ SG_ 999 DPB_a149_DIFtorqueTimeout "DPB ECU: a149 DI ftorque timeout";
CM_ SG_ 999 DPB_a150_DIRtorqueCounter "DPB ECU: a150 DI rtorque counter";
CM_ SG_ 999 DPB_a151_DIRtorqueChecksum "DPB ECU: a151 DI rtorque checksum";
CM_ SG_ 999 DPB_a152_DIRtorqueDLC "DPB ECU: a152 DI rtorque DLC";
CM_ SG_ 999 DPB_a153_DIRtorqueTimeout "DPB ECU: a153 DI rtorque timeout";
CM_ SG_ 999 DPB_a154_EPBLstatusCounter "DPB ECU: a154 EPB lstatus counter";
CM_ SG_ 999 DPB_a155_EPBLstatusChecksum "DPB ECU: a155 EPB lstatus checksum";
CM_ SG_ 999 DPB_a156_EPBLstatusDLC "DPB ECU: a156 EPB lstatus DLC";
CM_ SG_ 999 DPB_a157_EPBLstatusTimeout "DPB ECU: a157 EPB lstatus timeout";
CM_ SG_ 999 DPB_a158_EPBRstatusCounter "DPB ECU: a158 EPB rstatus counter";
CM_ SG_ 999 DPB_a159_EPBRstatusChecksum "DPB ECU: a159 EPB rstatus checksum";
CM_ SG_ 999 DPB_a160_EPBRstatusDLC "DPB ECU: a160 EPB rstatus DLC";
CM_ SG_ 999 DPB_a161_EPBRstatusTimeout "DPB ECU: a161 EPB rstatus timeout";
CM_ SG_ 999 DPB_a162_ESP_modulator1Counter "DPB ECU: a162 ESP modulator1 counter";
CM_ SG_ 999 DPB_a163_ESP_modulator1Checksum "DPB ECU: a163 ESP modulator1 checksum";
CM_ SG_ 999 DPB_a164_ESP_modulator1DLC "DPB ECU: a164 ESP modulator1 DLC";
CM_ SG_ 999 DPB_a165_ESP_modulator1Timeout "DPB ECU: a165 ESP modulator1 timeout";
CM_ SG_ 999 DPB_a166_ESP_chassis3Counter "DPB ECU: a166 ESP chassis3 counter";
CM_ SG_ 999 DPB_a167_ESP_chassis3Checksum "DPB ECU: a167 ESP chassis3 checksum";
CM_ SG_ 999 DPB_a168_ESP_chassis3DLC "DPB ECU: a168 ESP chassis3 DLC";
CM_ SG_ 999 DPB_a169_ESP_chassis3Timeout "DPB ECU: a169 ESP chassis3 timeout";
CM_ SG_ 999 DPB_a170_ESP_modulator2Counter "DPB ECU: a170 ESP modulator2 counter";
CM_ SG_ 999 DPB_a171_ESP_modulator2Checksum "DPB ECU: a171 ESP modulator2 checksum";
CM_ SG_ 999 DPB_a172_ESP_modulator2DLC "DPB ECU: a172 ESP modulator2 DLC";
CM_ SG_ 999 DPB_a173_ESP_modulator2Timeout "DPB ECU: a173 ESP modulator2 timeout";
CM_ SG_ 999 DPB_a174_ESP_modulator3Counter "DPB ECU: a174 ESP modulator3 counter";
CM_ SG_ 999 DPB_a175_ESP_modulator3Checksum "DPB ECU: a175 ESP modulator3 checksum";
CM_ SG_ 999 DPB_a176_ESP_modulator3DLC "DPB ECU: a176 ESP modulator3 DLC";
CM_ SG_ 999 DPB_a177_ESP_modulator3Timeout "DPB ECU: a177 ESP modulator3 timeout";
CM_ SG_ 999 DPB_a178_PMstate2Counter "DPB ECU: a178 p mstate2 counter";
CM_ SG_ 999 DPB_a179_PMstate2Checksum "DPB ECU: a179 p mstate2 checksum";
CM_ SG_ 999 DPB_a180_PMstate2DLC "DPB ECU: a180 p mstate2 DLC";
CM_ SG_ 999 DPB_a181_PMstate2Timeout "DPB ECU: a181 p mstate2 timeout";
CM_ SG_ 999 DPB_a182_RCMInertial2Counter "DPB ECU: a182 RCM inertial2 counter";
CM_ SG_ 999 DPB_a183_RCMInertial2Checksum "DPB ECU: a183 RCM inertial2 checksum";
CM_ SG_ 999 DPB_a184_RCMInertial2DLC "DPB ECU: a184 RCM inertial2 DLC";
CM_ SG_ 999 DPB_a185_RCMInertial2Timeout "DPB ECU: a185 RCM inertial2 timeout";
CM_ SG_ 999 DPB_a186_LVPowerStateTimeout "DPB ECU: a186 LV power state timeout";
CM_ SG_ 999 DPB_a187_LVPowerStateChecksum "DPB ECU: a187 LV power state checksum";
CM_ SG_ 999 DPB_a188_LVPowerStateDLC "DPB ECU: a188 LV power state DLC";
CM_ SG_ 999 DPB_a189_LVPowerStateCounter "DPB ECU: a189 LV power state counter";
CM_ SG_ 999 DPB_a190_VCLEFTepbmStatusCounter "DPB ECU: a190 VCLEF tepbm status counter";
CM_ SG_ 999 DPB_a191_VCLEFTepbmStatusChecksu "DPB ECU: a191 VCLEF tepbm status checksum";
CM_ SG_ 999 DPB_a192_VCLEFTepbmStatusDLC "DPB ECU: a192 VCLEF tepbm status DLC";
CM_ SG_ 999 DPB_a193_VCLEFTepbmStatusTimeout "DPB ECU: a193 VCLEF tepbm status timeout";
CM_ SG_ 999 DPB_a194_VCRIGHTepbmStatusCounte "DPB ECU: a194 VCRIGH tepbm status counter";
CM_ SG_ 999 DPB_a195_VCRIGHTepbmStatusChecks "DPB ECU: a195 VCRIGH tepbm status checksum";
CM_ SG_ 999 DPB_a196_VCRIGHTepbmStatusDLC "DPB ECU: a196 VCRIGH tepbm status DLC";
CM_ SG_ 999 DPB_a197_VCRIGHTepbmStatusTimeou "DPB ECU: a197 VCRIGH tepbm status timeout";
CM_ SG_ 999 DPB_a198_CANOvervoltage "DPB ECU: a198 CAN overvoltage";
CM_ SG_ 999 DPB_a199_pMC1QFaulty "DPB ECU: a199 p MC1 q faulty";
CM_ SG_ 999 DPB_a200_ESPRunoutSupportNotAvai "DPB ECU: a200 ESP runout support not available";
CM_ SG_ 999 DPB_a201_vehicleSpeedQFaulty "DPB ECU: a201 vehicle speed q faulty";
CM_ SG_ 999 DPB_a202_vehicleStandstillQFault "DPB ECU: a202 vehicle standstill q faulty";
CM_ SG_ 999 DPB_a203_ABSNotAvailable "DPB ECU: a203 ABS not available";
CM_ SG_ 999 DPB_a204_CANUndervoltage "DPB ECU: a204 CAN undervoltage";
CM_ SG_ 999 DPB_a205_NvMWriteCycleExceed "DPB ECU: a205 nv m write cycle exceed";
CM_ SG_ 999 DPB_a206_OSTaskSchemeError "DPB ECU: a206 OS task scheme error";
CM_ SG_ 999 DPB_a207_hydraulicOvervoltage "DPB ECU: a207 hydraulic overvoltage";
CM_ SG_ 999 DPB_a208_pressureSensor1Short "DPB ECU: a208 pressure sensor1 short";
CM_ SG_ 999 DPB_a209_pressureSensor1High "DPB ECU: a209 pressure sensor1 high";
CM_ SG_ 999 DPB_a210_pressureSensor1Low "DPB ECU: a210 pressure sensor1 low";
CM_ SG_ 999 DPB_a211_pressureSensor1Fault "DPB ECU: a211 pressure sensor1 fault";
CM_ SG_ 999 DPB_a212_pressureSensor1Temp "DPB ECU: a212 pressure sensor1 temp";
CM_ SG_ 999 DPB_a213_pressureSensor1Fault "DPB ECU: a213 pressure sensor1 fault";
CM_ SG_ 999 DPB_a214_pressureSensor2Short "DPB ECU: a214 pressure sensor2 short";
CM_ SG_ 999 DPB_a215_pressureSensor2High "DPB ECU: a215 pressure sensor2 high";
CM_ SG_ 999 DPB_a216_pressureSensor2Low "DPB ECU: a216 pressure sensor2 low";
CM_ SG_ 999 DPB_a217_pressureSensor2Fault "DPB ECU: a217 pressure sensor2 fault";
CM_ SG_ 999 DPB_a218_pressureSensor2Temp "DPB ECU: a218 pressure sensor2 temp";
CM_ SG_ 999 DPB_a219_pressureSensor2Fault "DPB ECU: a219 pressure sensor2 fault";
CM_ SG_ 999 DPB_a220_excessiveBoostWakeupsDe "DPB ECU: a220 excessive boost wakeups detected";
CM_ SG_ 999 DPB_a221_notShutdownRight "DPB ECU: a221 not shutdown right";
CM_ SG_ 999 DPB_a222_excessiveEcuResetsDetec "DPB ECU: a222 excessive ecu resets detected";
CM_ SG_ 999 DPB_a223_RAMFault "DPB ECU: a223 RAM fault";
CM_ SG_ 999 DPB_a224_brakeBoostLost "DPB ECU: a224 brake boost lost";
CM_ SG_ 999 DPB_a225_U5VOutOfRange "DPB ECU: a225 U5 v out of range";
CM_ SG_ 999 DPB_a226_U5VTestFault "DPB ECU: a226 U5 v test fault";
CM_ SG_ 999 DPB_a227_brakeFluidLoss "DPB ECU: a227 brake fluid loss";
CM_ SG_ 999 DPB_a228_supplyASICInitFault "DPB ECU: a228 supply ASIC init fault";
CM_ SG_ 999 DPB_a229_IREFOutOfRange "DPB ECU: a229 IREF out of range";
CM_ SG_ 999 DPB_a230_OSErrorHook "DPB ECU: a230 OS error hook";
CM_ SG_ 999 DPB_a231_stackOverUnderFlow "DPB ECU: a231 stack over under flow";
CM_ SG_ 999 DPB_a232_systemErrorHook "DPB ECU: a232 system error hook";
CM_ SG_ 999 DPB_a233_systemTaskJitter "DPB ECU: a233 system task jitter";
CM_ SG_ 999 DPB_a234_systemTaskOverRun "DPB ECU: a234 system task over run";
CM_ SG_ 999 DPB_a235_UB6PlausiMonFault "DPB ECU: a235 UB6 plausi mon fault";
CM_ SG_ 999 DPB_a236_UB6SupplyPathFault "DPB ECU: a236 UB6 supply path fault";
CM_ SG_ 999 DPB_a237_uCVoltageDividerDrift "DPB ECU: a237 u c voltage divider drift";
CM_ SG_ 999 DPB_a238_microRegisterFault "DPB ECU: a238 micro register fault";
CM_ SG_ 999 DPB_a239_microSafetyFault "DPB ECU: a239 micro safety fault";
CM_ SG_ 999 DPB_a240_microSafetyLogicFault "DPB ECU: a240 micro safety logic fault";
CM_ SG_ 999 DPB_a241_uCSafetyNotification "DPB ECU: a241 u c safety notification";
CM_ SG_ 999 DPB_a242_uCSafetyNotificationGRA "DPB ECU: a242 u c safety notification GRAM";
CM_ SG_ 999 DPB_a243_microSupplyError "DPB ECU: a243 micro supply error";
CM_ SG_ 999 DPB_a244_valvesGenericFault "DPB ECU: a244 valves generic fault";
CM_ SG_ 999 DPB_a245_valveMV0Fault "DPB ECU: a245 valve MV0 fault";
CM_ SG_ 999 DPB_a246_valveMV5Fault "DPB ECU: a246 valve MV5 fault";
CM_ SG_ 999 DPB_a247_valveMV6Fault "DPB ECU: a247 valve MV6 fault";
CM_ SG_ 999 DPB_a248_valveMV61Fault "DPB ECU: a248 valve MV61 fault";
CM_ SG_ 999 DPB_a249_valveMV62Fault "DPB ECU: a249 valve MV62 fault";
CM_ SG_ 999 DPB_a250_valveMV7Fault "DPB ECU: a250 valve MV7 fault";
CM_ SG_ 999 DPB_a251_valveMV8Fault "DPB ECU: a251 valve MV8 fault";
CM_ SG_ 999 DPB_a252_valveMV81Fault "DPB ECU: a252 valve MV81 fault";
CM_ SG_ 999 DPB_a253_valveMV82Fault "DPB ECU: a253 valve MV82 fault";
CM_ SG_ 999 DPB_a254_valveMV9Fault "DPB ECU: a254 valve MV9 fault";
CM_ SG_ 999 DPB_a255_valveRelayShort "DPB ECU: a255 valve relay short";
CM_ SG_ 999 DPB_a256_valveRelayActuationFaul "DPB ECU: a256 valve relay actuation fault";
CM_ SG_ 999 DPB_a257_valveRelayOnContinuous "DPB ECU: a257 valve relay on continuous";
CM_ SG_ 999 DPB_a258_valveRelayOffContinuous "DPB ECU: a258 valve relay off continuous";
CM_ SG_ 999 DPB_a259_valveRelayTestUndervolt "DPB ECU: a259 valve relay test undervoltage";
CM_ SG_ 999 DPB_a260_valveRelaySafetySwitchF "DPB ECU: a260 valve relay safety switch fault";
CM_ SG_ 999 DPB_a261_WdhAsicWdCmdMissing "DPB ECU: a261 wdh asic wd cmd missing";
CM_ SG_ 999 DPB_a262_WdhAsicWdErrorCntLimit "DPB ECU: a262 wdh asic wd error cnt limit";
CM_ SG_ 999 DPB_a263_WdhAsicWdErrorCntStuck "DPB ECU: a263 wdh asic wd error cnt stuck";
CM_ SG_ 999 DPB_a264_WdhSwBistConCnt "DPB ECU: a264 wdh sw bist con cnt";
CM_ SG_ 999 DPB_a265_WdhTaskMonConCnt "DPB ECU: a265 wdh task mon con cnt";
CM_ SG_ 999 DPB_a266_RPSNvMReadFault "DPB ECU: a266 RPS nv m read fault";
CM_ SG_ 999 DPB_a267_RpsAngleImplausible "DPB ECU: a267 rps angle implausible";
CM_ SG_ 999 DPB_a268_RPSVectorOscillating "DPB ECU: a268 RPS vector oscillating";
CM_ SG_ 999 DPB_a269_RPSVectorRangeHigh "DPB ECU: a269 RPS vector range high";
CM_ SG_ 999 DPB_a270_RPSVectorRangeLow "DPB ECU: a270 RPS vector range low";
CM_ SG_ 999 DPB_a271_RPSWrongCalibData "DPB ECU: a271 RPS wrong calib data";
CM_ SG_ 999 DPB_a272_runtimeAssertionFault "DPB ECU: a272 runtime assertion fault";
CM_ SG_ 999 DPB_a273_SMMOneRequestsInit "DPB ECU: a273 SMM one requests init";
CM_ SG_ 999 DPB_a274_AswSystemTimeOut "DPB ECU: a274 asw system time out";
CM_ SG_ 999 DPB_a275_Ps1Ps2PlausibilityFault "DPB ECU: a275 ps1 ps2 plausibility fault";
CM_ SG_ 999 DPB_a276_VCFRONTsensorsCounter "DPB ECU: a276 VCFRON tsensors counter";
CM_ SG_ 999 DPB_a277_VCFRONTsensorsChecksum "DPB ECU: a277 VCFRON tsensors checksum";
CM_ SG_ 999 DPB_a278_VCFRONTsensorsDLC "DPB ECU: a278 VCFRON tsensors DLC";
CM_ SG_ 999 DPB_a279_VCFRONTsensorsTimeout "DPB ECU: a279 VCFRON tsensors timeout";
CM_ SG_ 999 DPB_a280_LowBrakeFluid "DPB ECU: a280 low brake fluid";
CM_ SG_ 999 DPB_a281_brakeFluidOORHigh "DPB ECU: a281 brake fluid OOR high";
CM_ SG_ 999 DPB_a282_DIbrakeCommandCounter "DPB ECU: a282 d ibrake command counter";
CM_ SG_ 999 DPB_a283_DIbrakeCommandChecksum "DPB ECU: a283 d ibrake command checksum";
CM_ SG_ 999 DPB_a284_DIbrakeCommandDLC "DPB ECU: a284 d ibrake command DLC";
CM_ SG_ 999 DPB_a285_DIbrakeCommandTimeout "DPB ECU: a285 d ibrake command timeout";
CM_ SG_ 999 DPB_a286_ebrCmdStateInvalid "DPB ECU: a286 ebr cmd state invalid";
CM_ SG_ 999 DPB_a287_brakeCmdStateInvalid "DPB ECU: a287 brake cmd state invalid";
CM_ SG_ 999 DPB_a288_PlantDegradedSW "DPB ECU: a288 plant degraded SW";
CM_ SG_ 999 DPB_a289_evacFillNotComplete "DPB ECU: a289 evac fill not complete";
CM_ SG_ 999 DPB_a290_securityInfo "DPB ECU: a290 security info";
CM_ SG_ 999 DPB_a291_extDBRRequestTooLow "DPB ECU: a291 ext DBR request too low";
CM_ SG_ 999 DPB_a292_CBDS_fillBufferThreshol "DPB ECU: a292 CBDS fill buffer threshold";
CM_ SG_ 999 DPB_a293_CBDS_fmeInternalEvent "DPB ECU: a293 CBDS fme internal event";
CM_ SG_ 999 DPB_a294_hbaNormalModeActive "DPB ECU: a294 hba normal mode active";
CM_ SG_ 999 DPB_a295_hbaTrackModeActive "DPB ECU: a295 hba track mode active";
CM_ SG_ 999 DPB_a296_StatInvalid_DI_FullSNA "DPB ECU: a296 stat invalid DI full SNA";
CM_ SG_ 999 DPB_a297_undefinedAlertDetected "DPB ECU: a297 undefined alert detected";
CM_ SG_ 999 DPB_a298_RunningActiveSystemTest "DPB ECU: a298 running active system tests";
CM_ SG_ 999 DPB_a299_PM_locStateCounter "DPB ECU: a299 PM loc state counter";
CM_ SG_ 999 DPB_a300_PM_locStateChecksum "DPB ECU: a300 PM loc state checksum";
CM_ SG_ 999 DPB_a301_PM_locStateDLC "DPB ECU: a301 PM loc state DLC";
CM_ SG_ 999 DPB_a302_PM_locStateTimeout "DPB ECU: a302 PM loc state timeout";
CM_ SG_ 999 DPB_a303_actuatingDIFullTorqueCm "DPB ECU: a303 actuating DI full torque cmd";
CM_ SG_ 999 DPB_a304_actuatingDITorqueCmd "DPB ECU: a304 actuating DI torque cmd";
CM_ SG_ 999 DPB_a305_DIbrakeTorqueCommandAnd "DPB ECU: a305 d ibrake torque command and flag mismatch";
CM_ SG_ 999 DPB_a306_actuatorFallbackBasicMa "DPB ECU: a306 actuator fallback basic map";
CM_ SG_ 999 DPB_a307_actuatorDegradedMap "DPB ECU: a307 actuator degraded map";
CM_ SG_ 999 DPB_a308_hydraulicPushthroughAct "DPB ECU: a308 hydraulic pushthrough active";
CM_ SG_ 999 DPB_a309_DIFAxleTorqueInvalid "DPB ECU: a309 DIF axle torque invalid";
CM_ SG_ 999 DPB_a310_DIRAxleTorqueInvalid "DPB ECU: a310 DIR axle torque invalid";
CM_ SG_ 999 DPB_a311_postrunDurationTooLong "DPB ECU: a311 postrun duration too long";
CM_ SG_ 999 DPB_a312_cyclicVolumeCheckDisabl "DPB ECU: a312 cyclic volume check disabled";
CM_ SG_ 999 DPB_a313_qualifiedBrakeEventDete "DPB ECU: a313 qualified brake event detected";
CM_ BO_ 1427 "EPASTP ECU message: alert log";
CM_ SG_ 1427 EPASTP_alertID "EPASTP ECU: alert ID";
CM_ SG_ 1427 EPASTP_alertState "EPASTP ECU: alert state";
CM_ SG_ 1427 EPASTP_a001_debugInfo "EPASTP ECU: a001 debug info";
CM_ SG_ 1427 EPASTP_a002_debugInfo "EPASTP ECU: a002 debug info";
CM_ SG_ 1427 EPASTP_a003_debugInfo "EPASTP ECU: a003 debug info";
CM_ SG_ 1427 EPASTP_a004_debugInfo "EPASTP ECU: a004 debug info";
CM_ SG_ 1427 EPASTP_a005_debugInfo "EPASTP ECU: a005 debug info";
CM_ SG_ 1427 EPASTP_a006_debugInfo "EPASTP ECU: a006 debug info";
CM_ SG_ 1427 EPASTP_a007_debugInfo "EPASTP ECU: a007 debug info";
CM_ SG_ 1427 EPASTP_a009_debugInfo "EPASTP ECU: a009 debug info";
CM_ SG_ 1427 EPASTP_a010_debugInfo "EPASTP ECU: a010 debug info";
CM_ SG_ 1427 EPASTP_a011_debugInfo "EPASTP ECU: a011 debug info";
CM_ SG_ 1427 EPASTP_a012_debugInfo "EPASTP ECU: a012 debug info";
CM_ SG_ 1427 EPASTP_a013_debugInfo "EPASTP ECU: a013 debug info";
CM_ SG_ 1427 EPASTP_a014_debugInfo "EPASTP ECU: a014 debug info";
CM_ SG_ 1427 EPASTP_a015_debugInfo "EPASTP ECU: a015 debug info";
CM_ SG_ 1427 EPASTP_a016_debugInfo "EPASTP ECU: a016 debug info";
CM_ SG_ 1427 EPASTP_a017_debugInfo "EPASTP ECU: a017 debug info";
CM_ SG_ 1427 EPASTP_a018_debugInfo "EPASTP ECU: a018 debug info";
CM_ SG_ 1427 EPASTP_a019_debugInfo "EPASTP ECU: a019 debug info";
CM_ SG_ 1427 EPASTP_a020_debugInfo "EPASTP ECU: a020 debug info";
CM_ SG_ 1427 EPASTP_a021_debugInfo "EPASTP ECU: a021 debug info";
CM_ SG_ 1427 EPASTP_a022_debugInfo "EPASTP ECU: a022 debug info";
CM_ SG_ 1427 EPASTP_a023_debugInfo "EPASTP ECU: a023 debug info";
CM_ SG_ 1427 EPASTP_a024_debugInfo "EPASTP ECU: a024 debug info";
CM_ SG_ 1427 EPASTP_a025_debugInfo "EPASTP ECU: a025 debug info";
CM_ SG_ 1427 EPASTP_a026_debugInfo "EPASTP ECU: a026 debug info";
CM_ SG_ 1427 EPASTP_a027_debugInfo "EPASTP ECU: a027 debug info";
CM_ SG_ 1427 EPASTP_a028_debugInfo "EPASTP ECU: a028 debug info";
CM_ SG_ 1427 EPASTP_a029_debugInfo "EPASTP ECU: a029 debug info";
CM_ SG_ 1427 EPASTP_a030_debugInfo "EPASTP ECU: a030 debug info";
CM_ SG_ 1427 EPASTP_a031_debugInfo "EPASTP ECU: a031 debug info";
CM_ SG_ 1427 EPASTP_a032_debugInfo "EPASTP ECU: a032 debug info";
CM_ SG_ 1427 EPASTP_a033_debugInfo "EPASTP ECU: a033 debug info";
CM_ SG_ 1427 EPASTP_a034_debugInfo "EPASTP ECU: a034 debug info";
CM_ SG_ 1427 EPASTP_a035_debugInfo "EPASTP ECU: a035 debug info";
CM_ SG_ 1427 EPASTP_a036_debugInfo "EPASTP ECU: a036 debug info";
CM_ SG_ 1427 EPASTP_a037_debugInfo "EPASTP ECU: a037 debug info";
CM_ SG_ 1427 EPASTP_a038_debugInfo "EPASTP ECU: a038 debug info";
CM_ SG_ 1427 EPASTP_a039_debugInfo "EPASTP ECU: a039 debug info";
CM_ SG_ 1427 EPASTP_a040_debugInfo "EPASTP ECU: a040 debug info";
CM_ SG_ 1427 EPASTP_a041_debugInfo "EPASTP ECU: a041 debug info";
CM_ SG_ 1427 EPASTP_a042_debugInfo "EPASTP ECU: a042 debug info";
CM_ SG_ 1427 EPASTP_a043_debugInfo "EPASTP ECU: a043 debug info";
CM_ SG_ 1427 EPASTP_a044_debugInfo "EPASTP ECU: a044 debug info";
CM_ SG_ 1427 EPASTP_a045_debugInfo "EPASTP ECU: a045 debug info";
CM_ SG_ 1427 EPASTP_a046_debugInfo "EPASTP ECU: a046 debug info";
CM_ SG_ 1427 EPASTP_a047_debugInfo "EPASTP ECU: a047 debug info";
CM_ SG_ 1427 EPASTP_a048_debugInfo "EPASTP ECU: a048 debug info";
CM_ SG_ 1427 EPASTP_a049_debugInfo "EPASTP ECU: a049 debug info";
CM_ SG_ 1427 EPASTP_a050_debugInfo "EPASTP ECU: a050 debug info";
CM_ SG_ 1427 EPASTP_a051_debugInfo "EPASTP ECU: a051 debug info";
CM_ SG_ 1427 EPASTP_a052_debugInfo "EPASTP ECU: a052 debug info";
CM_ SG_ 1427 EPASTP_a053_debugInfo "EPASTP ECU: a053 debug info";
CM_ SG_ 1427 EPASTP_a054_debugInfo "EPASTP ECU: a054 debug info";
CM_ SG_ 1427 EPASTP_a055_debugInfo "EPASTP ECU: a055 debug info";
CM_ SG_ 1427 EPASTP_a056_debugInfo "EPASTP ECU: a056 debug info";
CM_ SG_ 1427 EPASTP_a057_debugInfo "EPASTP ECU: a057 debug info";
CM_ SG_ 1427 EPASTP_a058_debugInfo "EPASTP ECU: a058 debug info";
CM_ SG_ 1427 EPASTP_a059_debugInfo "EPASTP ECU: a059 debug info";
CM_ SG_ 1427 EPASTP_a060_debugInfo "EPASTP ECU: a060 debug info";
CM_ SG_ 1427 EPASTP_a061_debugInfo "EPASTP ECU: a061 debug info";
CM_ SG_ 1427 EPASTP_a062_debugInfo "EPASTP ECU: a062 debug info";
CM_ SG_ 1427 EPASTP_a063_debugInfo "EPASTP ECU: a063 debug info";
CM_ SG_ 1427 EPASTP_a064_debugInfo "EPASTP ECU: a064 debug info";
CM_ SG_ 1427 EPASTP_a065_debugInfo "EPASTP ECU: a065 debug info";
CM_ SG_ 1427 EPASTP_a066_debugInfo "EPASTP ECU: a066 debug info";
CM_ SG_ 1427 EPASTP_a067_debugInfo "EPASTP ECU: a067 debug info";
CM_ SG_ 1427 EPASTP_a068_debugInfo "EPASTP ECU: a068 debug info";
CM_ SG_ 1427 EPASTP_a069_debugInfo "EPASTP ECU: a069 debug info";
CM_ SG_ 1427 EPASTP_a070_debugInfo "EPASTP ECU: a070 debug info";
CM_ SG_ 1427 EPASTP_a071_debugInfo "EPASTP ECU: a071 debug info";
CM_ SG_ 1427 EPASTP_a072_debugInfo "EPASTP ECU: a072 debug info";
CM_ SG_ 1427 EPASTP_a073_debugInfo "EPASTP ECU: a073 debug info";
CM_ SG_ 1427 EPASTP_a074_debugInfo "EPASTP ECU: a074 debug info";
CM_ SG_ 1427 EPASTP_a075_debugInfo "EPASTP ECU: a075 debug info";
CM_ SG_ 1427 EPASTP_a076_debugInfo "EPASTP ECU: a076 debug info";
CM_ SG_ 1427 EPASTP_a077_debugInfo "EPASTP ECU: a077 debug info";
CM_ SG_ 1427 EPASTP_a078_debugInfo "EPASTP ECU: a078 debug info";
CM_ SG_ 1427 EPASTP_a079_debugInfo "EPASTP ECU: a079 debug info";
CM_ SG_ 1427 EPASTP_a080_debugInfo "EPASTP ECU: a080 debug info";
CM_ SG_ 1427 EPASTP_a081_debugInfo "EPASTP ECU: a081 debug info";
CM_ SG_ 1427 EPASTP_a082_debugInfo "EPASTP ECU: a082 debug info";
CM_ SG_ 1427 EPASTP_a083_debugInfo "EPASTP ECU: a083 debug info";
CM_ SG_ 1427 EPASTP_a084_debugInfo "EPASTP ECU: a084 debug info";
CM_ SG_ 1427 EPASTP_a085_debugInfo "EPASTP ECU: a085 debug info";
CM_ SG_ 1427 EPASTP_a086_debugInfo "EPASTP ECU: a086 debug info";
CM_ SG_ 1427 EPASTP_a087_debugInfo "EPASTP ECU: a087 debug info";
CM_ SG_ 1427 EPASTP_a088_debugInfo "EPASTP ECU: a088 debug info";
CM_ SG_ 1427 EPASTP_a089_debugInfo "EPASTP ECU: a089 debug info";
CM_ SG_ 1427 EPASTP_a090_debugInfo "EPASTP ECU: a090 debug info";
CM_ SG_ 1427 EPASTP_a091_debugInfo "EPASTP ECU: a091 debug info";
CM_ SG_ 1427 EPASTP_a092_debugInfo "EPASTP ECU: a092 debug info";
CM_ SG_ 1427 EPASTP_a093_debugInfo "EPASTP ECU: a093 debug info";
CM_ SG_ 1427 EPASTP_a094_debugInfo "EPASTP ECU: a094 debug info";
CM_ SG_ 1427 EPASTP_a095_debugInfo "EPASTP ECU: a095 debug info";
CM_ SG_ 1427 EPASTP_a096_debugInfo "EPASTP ECU: a096 debug info";
CM_ SG_ 1427 EPASTP_a097_debugInfo "EPASTP ECU: a097 debug info";
CM_ SG_ 1427 EPASTP_a098_debugInfo "EPASTP ECU: a098 debug info";
CM_ SG_ 1427 EPASTP_a099_debugInfo "EPASTP ECU: a099 debug info";
CM_ SG_ 1427 EPASTP_a100_debugInfo "EPASTP ECU: a100 debug info";
CM_ SG_ 1427 EPASTP_a101_debugInfo "EPASTP ECU: a101 debug info";
CM_ SG_ 1427 EPASTP_a102_debugInfo "EPASTP ECU: a102 debug info";
CM_ SG_ 1427 EPASTP_a103_debugInfo "EPASTP ECU: a103 debug info";
CM_ SG_ 1427 EPASTP_a104_debugInfo "EPASTP ECU: a104 debug info";
CM_ SG_ 1427 EPASTP_a105_debugInfo "EPASTP ECU: a105 debug info";
CM_ SG_ 1427 EPASTP_a106_debugInfo "EPASTP ECU: a106 debug info";
CM_ SG_ 1427 EPASTP_a107_debugInfo "EPASTP ECU: a107 debug info";
CM_ SG_ 1427 EPASTP_a108_debugInfo "EPASTP ECU: a108 debug info";
CM_ SG_ 1427 EPASTP_a109_debugInfo "EPASTP ECU: a109 debug info";
CM_ SG_ 1427 EPASTP_a110_debugInfo "EPASTP ECU: a110 debug info";
CM_ SG_ 1427 EPASTP_a111_debugInfo "EPASTP ECU: a111 debug info";
CM_ SG_ 1427 EPASTP_a112_debugInfo "EPASTP ECU: a112 debug info";
CM_ SG_ 1427 EPASTP_a113_debugInfo "EPASTP ECU: a113 debug info";
CM_ SG_ 1427 EPASTP_a114_debugInfo "EPASTP ECU: a114 debug info";
CM_ SG_ 1427 EPASTP_a115_debugInfo "EPASTP ECU: a115 debug info";
CM_ SG_ 1427 EPASTP_a116_debugInfo "EPASTP ECU: a116 debug info";
CM_ SG_ 1427 EPASTP_a117_debugInfo "EPASTP ECU: a117 debug info";
CM_ SG_ 1427 EPASTP_a118_debugInfo "EPASTP ECU: a118 debug info";
CM_ SG_ 1427 EPASTP_a119_debugInfo "EPASTP ECU: a119 debug info";
CM_ SG_ 1427 EPASTP_a120_debugInfo "EPASTP ECU: a120 debug info";
CM_ SG_ 1427 EPASTP_a121_debugInfo "EPASTP ECU: a121 debug info";
CM_ SG_ 1427 EPASTP_a122_debugInfo "EPASTP ECU: a122 debug info";
CM_ SG_ 1427 EPASTP_a123_debugInfo "EPASTP ECU: a123 debug info";
CM_ SG_ 1427 EPASTP_a124_debugInfo "EPASTP ECU: a124 debug info";
CM_ SG_ 1427 EPASTP_a125_debugInfo "EPASTP ECU: a125 debug info";
CM_ SG_ 1427 EPASTP_a126_debugInfo "EPASTP ECU: a126 debug info";
CM_ SG_ 1427 EPASTP_a127_debugInfo "EPASTP ECU: a127 debug info";
CM_ SG_ 1427 EPASTP_a128_debugInfo "EPASTP ECU: a128 debug info";
CM_ SG_ 1427 EPASTP_a129_debugInfo "EPASTP ECU: a129 debug info";
CM_ SG_ 1427 EPASTP_a130_debugInfo "EPASTP ECU: a130 debug info";
CM_ SG_ 1427 EPASTP_a131_debugInfo "EPASTP ECU: a131 debug info";
CM_ SG_ 1427 EPASTP_a132_debugInfo "EPASTP ECU: a132 debug info";
CM_ SG_ 1427 EPASTP_a133_debugInfo "EPASTP ECU: a133 debug info";
CM_ SG_ 1427 EPASTP_a134_debugInfo "EPASTP ECU: a134 debug info";
CM_ SG_ 1427 EPASTP_a135_debugInfo "EPASTP ECU: a135 debug info";
CM_ SG_ 1427 EPASTP_a136_debugInfo "EPASTP ECU: a136 debug info";
CM_ SG_ 1427 EPASTP_a137_debugInfo "EPASTP ECU: a137 debug info";
CM_ SG_ 1427 EPASTP_a138_debugInfo "EPASTP ECU: a138 debug info";
CM_ SG_ 1427 EPASTP_a139_debugInfo "EPASTP ECU: a139 debug info";
CM_ SG_ 1427 EPASTP_a140_debugInfo "EPASTP ECU: a140 debug info";
CM_ SG_ 1427 EPASTP_a141_debugInfo "EPASTP ECU: a141 debug info";
CM_ SG_ 1427 EPASTP_a142_debugInfo "EPASTP ECU: a142 debug info";
CM_ SG_ 1427 EPASTP_a143_debugInfo "EPASTP ECU: a143 debug info";
CM_ SG_ 1427 EPASTP_a144_debugInfo "EPASTP ECU: a144 debug info";
CM_ SG_ 1427 EPASTP_a145_debugInfo "EPASTP ECU: a145 debug info";
CM_ SG_ 1427 EPASTP_a146_debugInfo "EPASTP ECU: a146 debug info";
CM_ SG_ 1427 EPASTP_a147_debugInfo "EPASTP ECU: a147 debug info";
CM_ SG_ 1427 EPASTP_a148_debugInfo "EPASTP ECU: a148 debug info";
CM_ SG_ 1427 EPASTP_a149_debugInfo "EPASTP ECU: a149 debug info";
CM_ SG_ 1427 EPASTP_a150_debugInfo "EPASTP ECU: a150 debug info";
CM_ SG_ 1427 EPASTP_a152_debugInfo "EPASTP ECU: a152 debug info";
CM_ SG_ 1427 EPASTP_a153_debugInfo "EPASTP ECU: a153 debug info";
CM_ SG_ 1427 EPASTP_a154_debugInfo "EPASTP ECU: a154 debug info";
CM_ SG_ 1427 EPASTP_a155_debugInfo "EPASTP ECU: a155 debug info";
CM_ SG_ 1427 EPASTP_a156_debugInfo "EPASTP ECU: a156 debug info";
CM_ SG_ 1427 EPASTP_a157_debugInfo "EPASTP ECU: a157 debug info";
CM_ SG_ 1427 EPASTP_a158_debugInfo "EPASTP ECU: a158 debug info";
CM_ SG_ 1427 EPASTP_a159_debugInfo "EPASTP ECU: a159 debug info";
CM_ SG_ 1427 EPASTP_a160_debugInfo "EPASTP ECU: a160 debug info";
CM_ SG_ 1427 EPASTP_a161_debugInfo "EPASTP ECU: a161 debug info";
CM_ SG_ 1427 EPASTP_a162_debugInfo "EPASTP ECU: a162 debug info";
CM_ SG_ 1427 EPASTP_a163_debugInfo "EPASTP ECU: a163 debug info";
CM_ SG_ 1427 EPASTP_a164_debugInfo "EPASTP ECU: a164 debug info";
CM_ SG_ 1427 EPASTP_a165_debugInfo "EPASTP ECU: a165 debug info";
CM_ SG_ 1427 EPASTP_a166_debugInfo "EPASTP ECU: a166 debug info";
CM_ SG_ 1427 EPASTP_a167_debugInfo "EPASTP ECU: a167 debug info";
CM_ SG_ 1427 EPASTP_a168_debugInfo "EPASTP ECU: a168 debug info";
CM_ SG_ 1427 EPASTP_a169_debugInfo "EPASTP ECU: a169 debug info";
CM_ SG_ 1427 EPASTP_a170_debugInfo "EPASTP ECU: a170 debug info";
CM_ SG_ 1427 EPASTP_a171_debugInfo "EPASTP ECU: a171 debug info";
CM_ SG_ 1427 EPASTP_a172_debugInfo "EPASTP ECU: a172 debug info";
CM_ SG_ 1427 EPASTP_a173_debugInfo "EPASTP ECU: a173 debug info";
CM_ SG_ 1427 EPASTP_a174_debugInfo "EPASTP ECU: a174 debug info";
CM_ SG_ 1427 EPASTP_a175_debugInfo "EPASTP ECU: a175 debug info";
CM_ SG_ 1427 EPASTP_a176_debugInfo "EPASTP ECU: a176 debug info";
CM_ SG_ 1427 EPASTP_a177_debugInfo "EPASTP ECU: a177 debug info";
CM_ SG_ 1427 EPASTP_a178_debugInfo "EPASTP ECU: a178 debug info";
CM_ SG_ 1427 EPASTP_a179_debugInfo "EPASTP ECU: a179 debug info";
CM_ SG_ 1427 EPASTP_a180_debugInfo "EPASTP ECU: a180 debug info";
CM_ SG_ 1427 EPASTP_a181_debugInfo "EPASTP ECU: a181 debug info";
CM_ SG_ 1427 EPASTP_a182_debugInfo "EPASTP ECU: a182 debug info";
CM_ SG_ 1427 EPASTP_a183_debugInfo "EPASTP ECU: a183 debug info";
CM_ SG_ 1427 EPASTP_a184_debugInfo "EPASTP ECU: a184 debug info";
CM_ SG_ 1427 EPASTP_a185_debugInfo "EPASTP ECU: a185 debug info";
CM_ SG_ 1427 EPASTP_a186_debugInfo "EPASTP ECU: a186 debug info";
CM_ SG_ 1427 EPASTP_a188_debugInfo "EPASTP ECU: a188 debug info";
CM_ SG_ 1427 EPASTP_a189_debugInfo "EPASTP ECU: a189 debug info";
CM_ SG_ 1427 EPASTP_a190_debugInfo "EPASTP ECU: a190 debug info";
CM_ SG_ 1427 EPASTP_a191_debugInfo "EPASTP ECU: a191 debug info";
CM_ SG_ 1427 EPASTP_a192_debugInfo "EPASTP ECU: a192 debug info";
CM_ SG_ 1427 EPASTP_a193_debugInfo "EPASTP ECU: a193 debug info";
CM_ SG_ 1427 EPASTP_a194_debugInfo "EPASTP ECU: a194 debug info";
CM_ SG_ 1427 EPASTP_a195_debugInfo "EPASTP ECU: a195 debug info";
CM_ SG_ 1427 EPASTP_a196_debugInfo "EPASTP ECU: a196 debug info";
CM_ SG_ 1427 EPASTP_a197_debugInfo "EPASTP ECU: a197 debug info";
CM_ SG_ 1427 EPASTP_a198_debugInfo "EPASTP ECU: a198 debug info";
CM_ SG_ 1427 EPASTP_a199_debugInfo "EPASTP ECU: a199 debug info";
CM_ SG_ 1427 EPASTP_a200_debugInfo "EPASTP ECU: a200 debug info";
CM_ SG_ 1427 EPASTP_a201_debugInfo "EPASTP ECU: a201 debug info";
CM_ SG_ 1427 EPASTP_a202_debugInfo "EPASTP ECU: a202 debug info";
CM_ SG_ 1427 EPASTP_a203_debugInfo "EPASTP ECU: a203 debug info";
CM_ SG_ 1427 EPASTP_a204_debugInfo "EPASTP ECU: a204 debug info";
CM_ SG_ 1427 EPASTP_a205_debugInfo "EPASTP ECU: a205 debug info";
CM_ SG_ 1427 EPASTP_a206_debugInfo "EPASTP ECU: a206 debug info";
CM_ SG_ 1427 EPASTP_a207_debugInfo "EPASTP ECU: a207 debug info";
CM_ SG_ 1427 EPASTP_a208_debugInfo "EPASTP ECU: a208 debug info";
CM_ SG_ 1427 EPASTP_a209_debugInfo "EPASTP ECU: a209 debug info";
CM_ SG_ 1427 EPASTP_a210_debugInfo "EPASTP ECU: a210 debug info";
CM_ SG_ 1427 EPASTP_a211_debugInfo "EPASTP ECU: a211 debug info";
CM_ SG_ 1427 EPASTP_a212_debugInfo "EPASTP ECU: a212 debug info";
CM_ SG_ 1427 EPASTP_a213_debugInfo "EPASTP ECU: a213 debug info";
CM_ SG_ 1427 EPASTP_a214_debugInfo "EPASTP ECU: a214 debug info";
CM_ SG_ 1427 EPASTP_a215_debugInfo "EPASTP ECU: a215 debug info";
CM_ SG_ 1427 EPASTP_a216_debugInfo "EPASTP ECU: a216 debug info";
CM_ SG_ 1427 EPASTP_a217_debugInfo "EPASTP ECU: a217 debug info";
CM_ SG_ 1427 EPASTP_a218_debugInfo "EPASTP ECU: a218 debug info";
CM_ SG_ 1427 EPASTP_a219_debugInfo "EPASTP ECU: a219 debug info";
CM_ SG_ 1427 EPASTP_a221_debugInfo "EPASTP ECU: a221 debug info";
CM_ SG_ 1427 EPASTP_a222_debugInfo "EPASTP ECU: a222 debug info";
CM_ SG_ 1427 EPASTP_a223_debugInfo "EPASTP ECU: a223 debug info";
CM_ SG_ 1427 EPASTP_a224_debugInfo "EPASTP ECU: a224 debug info";
CM_ SG_ 1427 EPASTP_a225_debugInfo "EPASTP ECU: a225 debug info";
CM_ SG_ 1427 EPASTP_a226_debugInfo "EPASTP ECU: a226 debug info";
CM_ SG_ 1427 EPASTP_a227_debugInfo "EPASTP ECU: a227 debug info";
CM_ SG_ 1427 EPASTP_a228_debugInfo "EPASTP ECU: a228 debug info";
CM_ SG_ 1427 EPASTP_a229_debugInfo "EPASTP ECU: a229 debug info";
CM_ SG_ 1427 EPASTP_a230_debugInfo "EPASTP ECU: a230 debug info";
CM_ SG_ 1427 EPASTP_a231_debugInfo "EPASTP ECU: a231 debug info";
CM_ SG_ 1427 EPASTP_a232_debugInfo "EPASTP ECU: a232 debug info";
CM_ SG_ 1427 EPASTP_a233_debugInfo "EPASTP ECU: a233 debug info";
CM_ SG_ 1427 EPASTP_a234_debugInfo "EPASTP ECU: a234 debug info";
CM_ SG_ 1427 EPASTP_a235_debugInfo "EPASTP ECU: a235 debug info";
CM_ SG_ 1427 EPASTP_a236_debugInfo "EPASTP ECU: a236 debug info";
CM_ SG_ 1427 EPASTP_a237_debugInfo "EPASTP ECU: a237 debug info";
CM_ SG_ 1427 EPASTP_a238_debugInfo "EPASTP ECU: a238 debug info";
CM_ SG_ 1427 EPASTP_a239_debugInfo "EPASTP ECU: a239 debug info";
CM_ SG_ 1427 EPASTP_a240_debugInfo "EPASTP ECU: a240 debug info";
CM_ SG_ 1427 EPASTP_a241_debugInfo "EPASTP ECU: a241 debug info";
CM_ SG_ 1427 EPASTP_a242_debugInfo "EPASTP ECU: a242 debug info";
CM_ SG_ 1427 EPASTP_a243_debugInfo "EPASTP ECU: a243 debug info";
CM_ SG_ 1427 EPASTP_a244_debugInfo "EPASTP ECU: a244 debug info";
CM_ SG_ 1427 EPASTP_a245_debugInfo "EPASTP ECU: a245 debug info";
CM_ SG_ 1427 EPASTP_a246_debugInfo "EPASTP ECU: a246 debug info";
CM_ SG_ 1427 EPASTP_a247_debugInfo "EPASTP ECU: a247 debug info";
CM_ SG_ 1427 EPASTP_a248_debugInfo "EPASTP ECU: a248 debug info";
CM_ SG_ 1427 EPASTP_a249_debugInfo "EPASTP ECU: a249 debug info";
CM_ SG_ 1427 EPASTP_a250_debugInfo "EPASTP ECU: a250 debug info";
CM_ SG_ 1427 EPASTP_a251_debugInfo "EPASTP ECU: a251 debug info";
CM_ SG_ 1427 EPASTP_a252_debugInfo "EPASTP ECU: a252 debug info";
CM_ SG_ 1427 EPASTP_a253_debugInfo "EPASTP ECU: a253 debug info";
CM_ SG_ 1427 EPASTP_a254_debugInfo "EPASTP ECU: a254 debug info";
CM_ SG_ 1427 EPASTP_a255_debugInfo "EPASTP ECU: a255 debug info";
CM_ SG_ 1427 EPASTP_a256_debugInfo "EPASTP ECU: a256 debug info";
CM_ SG_ 1427 EPASTP_a257_debugInfo "EPASTP ECU: a257 debug info";
CM_ SG_ 1427 EPASTP_a258_debugInfo "EPASTP ECU: a258 debug info";
CM_ SG_ 1427 EPASTP_a259_debugInfo "EPASTP ECU: a259 debug info";
CM_ SG_ 1427 EPASTP_a260_debugInfo "EPASTP ECU: a260 debug info";
CM_ SG_ 1427 EPASTP_a261_debugInfo "EPASTP ECU: a261 debug info";
CM_ SG_ 1427 EPASTP_a262_debugInfo "EPASTP ECU: a262 debug info";
CM_ SG_ 1427 EPASTP_a263_debugInfo "EPASTP ECU: a263 debug info";
CM_ SG_ 1427 EPASTP_a264_degradedECU "EPASTP ECU: a264 degraded ECU";
CM_ SG_ 1427 EPASTP_a264_vehicleSpeed "EPASTP ECU: a264 vehicle speed";
CM_ SG_ 1427 EPASTP_a264_powerRatio "EPASTP ECU: a264 power ratio";
CM_ SG_ 1427 EPASTP_a264_ownSideDegradationRe "EPASTP ECU: a264 own side degradation reason";
CM_ SG_ 1427 EPASTP_a264_otherSideDegradation "EPASTP ECU: a264 other side degradation reason";
CM_ SG_ 1427 EPASTP_a265_degradedECU "EPASTP ECU: a265 degraded ECU";
CM_ SG_ 1427 EPASTP_a265_vehicleSpeed "EPASTP ECU: a265 vehicle speed";
CM_ SG_ 1427 EPASTP_a265_rawMcuTemperature "EPASTP ECU: a265 raw mcu temperature";
CM_ SG_ 1427 EPASTP_a265_degradedCurrentLimit "EPASTP ECU: a265 degraded current limit";
CM_ SG_ 1427 EPASTP_a266_cdpAssistFactor "EPASTP ECU: a266 cdp assist factor";
CM_ SG_ 1427 EPASTP_a266_vehicleSpeed "EPASTP ECU: a266 vehicle speed";
CM_ SG_ 1427 EPASTP_a267_vehicleSpeed "EPASTP ECU: a267 vehicle speed";
CM_ SG_ 1427 EPASTP_a267_velocityEstimatorSta "EPASTP ECU: a267 velocity estimator state";
CM_ SG_ 1427 EPASTP_a269_vehicleSpeed "EPASTP ECU: a269 vehicle speed";
CM_ SG_ 1427 EPASTP_a270_debugInfo "EPASTP ECU: a270 debug info";
CM_ BO_ 919 "EPASTP ECU message: alert matrix";
CM_ SG_ 919 EPASTP_matrixIndex "EPASTP ECU: matrix index";
CM_ SG_ 919 EPASTP_a001_adcCalibrationOrInit "EPASTP ECU: a001 adc calibration or init fail";
CM_ SG_ 919 EPASTP_a002_adcMuxErr "EPASTP ECU: a002 adc mux err";
CM_ SG_ 919 EPASTP_a003_pspInvalidParamset "EPASTP ECU: a003 psp invalid paramset";
CM_ SG_ 919 EPASTP_a004_scpInputMia "EPASTP ECU: a004 scp input mia";
CM_ SG_ 919 EPASTP_a005_scpUnknownResetSourc "EPASTP ECU: a005 scp unknown reset source";
CM_ SG_ 919 EPASTP_a006_swrhResetByInvalidEr "EPASTP ECU: a006 swrh reset by invalid errid";
CM_ SG_ 919 EPASTP_a007_tsmcCoreTempDiff "EPASTP ECU: a007 tsmc core temp diff";
CM_ SG_ 919 EPASTP_a008_psdcPlatformShutdown "EPASTP ECU: a008 psdc platform shutdown";
CM_ SG_ 919 EPASTP_a009_mcusscLbistPermanent "EPASTP ECU: a009 mcussc lbist permanent fail";
CM_ SG_ 919 EPASTP_a010_svcIncompatibleSwVer "EPASTP ECU: a010 svc incompatible sw versions";
CM_ SG_ 919 EPASTP_a011_mcusscMonbistErr "EPASTP ECU: a011 mcussc monbist err";
CM_ SG_ 919 EPASTP_a012_mcusscMbistEccErr "EPASTP ECU: a012 mcussc mbist ecc err";
CM_ SG_ 919 EPASTP_a013_mcusscSffMonitoringF "EPASTP ECU: a013 mcussc sff monitoring failed";
CM_ SG_ 919 EPASTP_a014_mcusscSffMonitoringM "EPASTP ECU: a014 mcussc sff monitoring mia";
CM_ SG_ 919 EPASTP_a015_mcusscCsErrorCheckFa "EPASTP ECU: a015 mcussc cs error check fail";
CM_ SG_ 919 EPASTP_a016_mcufcCsErrorCheckFai "EPASTP ECU: a016 mcufc cs error check fail";
CM_ SG_ 919 EPASTP_a017_stmdStmPlausibilityC "EPASTP ECU: a017 stmd stm plausibility check err";
CM_ SG_ 919 EPASTP_a018_exchCsErrorCheck "EPASTP ECU: a018 exch cs error check";
CM_ SG_ 919 EPASTP_a019_rsthHwResetInfoCorru "EPASTP ECU: a019 rsth hw reset info corruption check";
CM_ SG_ 919 EPASTP_a020_mcusscEolEcuIdIntegr "EPASTP ECU: a020 mcussc eol ecu id integritiy fail";
CM_ SG_ 919 EPASTP_a021_osehCsErrorCheck "EPASTP ECU: a021 oseh cs error check";
CM_ SG_ 919 EPASTP_a022_swrhSwResetInfoCorru "EPASTP ECU: a022 swrh sw reset info corruption check";
CM_ SG_ 919 EPASTP_a023_btarcCorruptionCheck "EPASTP ECU: a023 btarc corruption check";
CM_ SG_ 919 EPASTP_a024_srhCsErrorCheckFail "EPASTP ECU: a024 srh cs error check fail";
CM_ SG_ 919 EPASTP_a025_btarcCorruptionCheck "EPASTP ECU: a025 btarc corruption check";
CM_ SG_ 919 EPASTP_a026_mrccCsErrorCheckFail "EPASTP ECU: a026 mrcc cs error check fail";
CM_ SG_ 919 EPASTP_a027_mcusscDmuHfErr "EPASTP ECU: a027 mcussc dmu hf err";
CM_ SG_ 919 EPASTP_a028_smuhNonInitDataCorru "EPASTP ECU: a028 smuh non init data corruption";
CM_ SG_ 919 EPASTP_a029_smuhSmuCoreCntErrorT "EPASTP ECU: a029 smuh smu core cnt error test fail";
CM_ SG_ 919 EPASTP_a030_rsthClockReset "EPASTP ECU: a030 rsth clock reset";
CM_ SG_ 919 EPASTP_a031_pmsProductionModeFai "EPASTP ECU: a031 pms production mode failed";
CM_ SG_ 919 EPASTP_a032_eolpEolCheckFailed "EPASTP ECU: a032 eolp eol check failed";
CM_ SG_ 919 EPASTP_a033_icsvcPswVersionMisma "EPASTP ECU: a033 icsvc psw version mismatch";
CM_ SG_ 919 EPASTP_a034_sbchReadbackRegFail "EPASTP ECU: a034 sbch readback reg fail";
CM_ SG_ 919 EPASTP_a035_sbchChipIdFail "EPASTP ECU: a035 sbch chip id fail";
CM_ SG_ 919 EPASTP_a036_sbcmSbcBistFailed "EPASTP ECU: a036 sbcm sbc bist failed";
CM_ SG_ 919 EPASTP_a037_epmV5P2Fail "EPASTP ECU: a037 epm V5 P2 fail";
CM_ SG_ 919 EPASTP_a038_csohCh1CsErrorErrAtR "EPASTP ECU: a038 csoh ch1 cs error err at reset";
CM_ SG_ 919 EPASTP_a039_csohCh2CsErrorErrAtR "EPASTP ECU: a039 csoh ch2 cs error err at reset";
CM_ SG_ 919 EPASTP_a040_swrhLimitedResetRetr "EPASTP ECU: a040 swrh limited reset retries expired";
CM_ SG_ 919 EPASTP_a041_imcmCoreConfiguratio "EPASTP ECU: a041 imcm core configuration mismatch";
CM_ SG_ 919 EPASTP_a042_wdhWdTestFail "EPASTP ECU: a042 wdh wd test fail";
CM_ SG_ 919 EPASTP_a043_sbcmWdStateDisabled "EPASTP ECU: a043 sbcm wd state disabled";
CM_ SG_ 919 EPASTP_a044_sbcmSbcEepromFail "EPASTP ECU: a044 sbcm sbc eeprom fail";
CM_ SG_ 919 EPASTP_a045_psumSbcBandgapVoltEr "EPASTP ECU: a045 psum sbc bandgap volt err";
CM_ SG_ 919 EPASTP_a046_mcusscOscillatorNotR "EPASTP ECU: a046 mcussc oscillator not reliable";
CM_ SG_ 919 EPASTP_a047_epmVregVoltFail "EPASTP ECU: a047 epm vreg volt fail";
CM_ SG_ 919 EPASTP_a048_epmVcpVoltFail "EPASTP ECU: a048 epm vcp volt fail";
CM_ SG_ 919 EPASTP_a049_epmLgFail "EPASTP ECU: a049 epm lg fail";
CM_ SG_ 919 EPASTP_a050_erlErr "EPASTP ECU: a050 erl err";
CM_ SG_ 919 EPASTP_a051_ermMessageErr "EPASTP ECU: a051 erm message err";
CM_ SG_ 919 EPASTP_a052_ermSdcInputBufferOve "EPASTP ECU: a052 erm sdc input buffer overflow";
CM_ SG_ 919 EPASTP_a053_adcUnexpectedNumOfDa "EPASTP ECU: a053 adc unexpected num of data";
CM_ SG_ 919 EPASTP_a054_adcUnexpectedData "EPASTP ECU: a054 adc unexpected data";
CM_ SG_ 919 EPASTP_a055_amExtendedGduTest "EPASTP ECU: a055 am extended gdu test";
CM_ SG_ 919 EPASTP_a056_amGduConfigCsErrorCh "EPASTP ECU: a056 am gdu config cs error check";
CM_ SG_ 919 EPASTP_a057_amGduVds "EPASTP ECU: a057 am gdu vds";
CM_ SG_ 919 EPASTP_a058_amIntVgsUndervtgErr "EPASTP ECU: a058 am int vgs undervtg err";
CM_ SG_ 919 EPASTP_a059_amStartupTestFailed "EPASTP ECU: a059 am startup test failed";
CM_ SG_ 919 EPASTP_a060_amGduFail "EPASTP ECU: a060 am gdu fail";
CM_ SG_ 919 EPASTP_a061_amIntSerialErr "EPASTP ECU: a061 am int serial err";
CM_ SG_ 919 EPASTP_a062_amPhaseBridgeCheck "EPASTP ECU: a062 am phase bridge check";
CM_ SG_ 919 EPASTP_a063_amIntRegulatorErr "EPASTP ECU: a063 am int regulator err";
CM_ SG_ 919 EPASTP_a064_amBridgeShort "EPASTP ECU: a064 am bridge short";
CM_ SG_ 919 EPASTP_a065_amGduJuncTemp "EPASTP ECU: a065 am gdu junc temp";
CM_ SG_ 919 EPASTP_a066_amVoltQfErr "EPASTP ECU: a066 am volt qf err";
CM_ SG_ 919 EPASTP_a067_tspmPowermoduleTempI "EPASTP ECU: a067 tspm powermodule temp implausible";
CM_ SG_ 919 EPASTP_a068_rsthCoreRedundancyEr "EPASTP ECU: a068 rsth core redundancy err";
CM_ SG_ 919 EPASTP_a069_rsthCoreTempOutOfRan "EPASTP ECU: a069 rsth core temp out of range hw check";
CM_ SG_ 919 EPASTP_a070_rsthInternalLowVolt "EPASTP ECU: a070 rsth internal low volt";
CM_ SG_ 919 EPASTP_a071_rsthInternalHighVolt "EPASTP ECU: a071 rsth internal high volt";
CM_ SG_ 919 EPASTP_a072_rsthFlashUncorrEccOr "EPASTP ECU: a072 rsth flash uncorr ecc or ovfl";
CM_ SG_ 919 EPASTP_a073_rsthOtherEdcEcc "EPASTP ECU: a073 rsth other edc ecc";
CM_ SG_ 919 EPASTP_a074_rsthUnexpectedAlarm "EPASTP ECU: a074 rsth unexpected alarm";
CM_ SG_ 919 EPASTP_a075_rsthUnusedOtherModul "EPASTP ECU: a075 rsth unused other module alarm";
CM_ SG_ 919 EPASTP_a076_exchGeneralException "EPASTP ECU: a076 exch general exception";
CM_ SG_ 919 EPASTP_a077_dmDeadlineViolation "EPASTP ECU: a077 dm deadline violation";
CM_ SG_ 919 EPASTP_a078_dmDeadlineViolation "EPASTP ECU: a078 dm deadline violation";
CM_ SG_ 919 EPASTP_a079_gduhComErr "EPASTP ECU: a079 gduh com err";
CM_ SG_ 919 EPASTP_a080_pwmTimerSyncCheck "EPASTP ECU: a080 pwm timer sync check";
CM_ SG_ 919 EPASTP_a081_exchFloatingPointExc "EPASTP ECU: a081 exch floating point exception";
CM_ SG_ 919 EPASTP_a082_adcTriggerTimeChk "EPASTP ECU: a082 adc trigger time chk";
CM_ SG_ 919 EPASTP_a083_tdaDclinkcapacitorTe "EPASTP ECU: a083 tda dclinkcapacitor temp checker";
CM_ SG_ 919 EPASTP_a084_adcTriggerCheck "EPASTP ECU: a084 adc trigger check";
CM_ SG_ 919 EPASTP_a085_amGduSwitchOffTestBy "EPASTP ECU: a085 am gdu switch off test by mcu";
CM_ SG_ 919 EPASTP_a086_rsthRamUncorrEcc "EPASTP ECU: a086 rsth ram uncorr ecc";
CM_ SG_ 919 EPASTP_a087_rsthFlashConfigErr "EPASTP ECU: a087 rsth flash config err";
CM_ SG_ 919 EPASTP_a088_tedMainboardTempChec "EPASTP ECU: a088 ted mainboard temp checker";
CM_ SG_ 919 EPASTP_a089_tedRevercebattfetjun "EPASTP ECU: a089 ted revercebattfetjunction temp checker";
CM_ SG_ 919 EPASTP_a090_etsmWarning "EPASTP ECU: a090 etsm warning";
CM_ SG_ 919 EPASTP_a091_bvpBattVoltCrossChkF "EPASTP ECU: a091 bvp batt volt cross chk failed";
CM_ SG_ 919 EPASTP_a092_amGduSwitchOffTestBy "EPASTP ECU: a092 am gdu switch off test by sbc";
CM_ SG_ 919 EPASTP_a093_sctpTsuSingleStaticF "EPASTP ECU: a093 sctp tsu single static fail";
CM_ SG_ 919 EPASTP_a094_sctpTsuMultipleStati "EPASTP ECU: a094 sctp tsu multiple static fail";
CM_ SG_ 919 EPASTP_a095_mdModelBasedMotorInt "EPASTP ECU: a095 md model based motor integrity check";
CM_ SG_ 919 EPASTP_a096_rppRpsSingleStaticFa "EPASTP ECU: a096 rpp rps single static fail";
CM_ SG_ 919 EPASTP_a097_rppRpsMultipleStatic "EPASTP ECU: a097 rpp rps multiple static fail";
CM_ SG_ 919 EPASTP_a098_invErr "EPASTP ECU: a098 inv err";
CM_ SG_ 919 EPASTP_a099_mcdTorqueMismatchFau "EPASTP ECU: a099 mcd torque mismatch fault";
CM_ SG_ 919 EPASTP_a100_amVbrgLssFault "EPASTP ECU: a100 am vbrg lss fault";
CM_ SG_ 919 EPASTP_a101_sdrvSpcIdMismatch "EPASTP ECU: a101 sdrv spc id mismatch";
CM_ SG_ 919 EPASTP_a102_amPhasecurrentQosErr "EPASTP ECU: a102 am phasecurrent qos err";
CM_ SG_ 919 EPASTP_a103_exhaUnusedInterruptC "EPASTP ECU: a103 exha unused interrupt call exception";
CM_ SG_ 919 EPASTP_a104_exhaBusMpuException "EPASTP ECU: a104 exha bus mpu exception";
CM_ SG_ 919 EPASTP_a105_exhaSriBusErrExcepti "EPASTP ECU: a105 exha sri bus err exception";
CM_ SG_ 919 EPASTP_a106_exhaSpbBusErrExcepti "EPASTP ECU: a106 exha spb bus err exception";
CM_ SG_ 919 EPASTP_a107_exhaOtherNmiExceptio "EPASTP ECU: a107 exha other nmi exception";
CM_ SG_ 919 EPASTP_a108_exhaInternalProtecti "EPASTP ECU: a108 exha internal protection exception";
CM_ SG_ 919 EPASTP_a109_exhaSysBusOrPeriphEr "EPASTP ECU: a109 exha sys bus or periph err exception";
CM_ SG_ 919 EPASTP_a110_amPhaseRelaySwitchOf "EPASTP ECU: a110 am phase relay switch off test";
CM_ SG_ 919 EPASTP_a111_amCurrentSensingDisc "EPASTP ECU: a111 am current sensing disconnection";
CM_ SG_ 919 EPASTP_a112_rsthSafetyFlipflopEr "EPASTP ECU: a112 rsth safety flipflop err";
CM_ SG_ 919 EPASTP_a113_rsthUncorrectableEnd "EPASTP ECU: a113 rsth uncorrectable end to end bus err";
CM_ SG_ 919 EPASTP_a114_osehOsErr "EPASTP ECU: a114 oseh os err";
CM_ SG_ 919 EPASTP_a115_mcusscLbistSingleFai "EPASTP ECU: a115 mcussc lbist single fail";
CM_ SG_ 919 EPASTP_a116_mrccStartupRegCsErro "EPASTP ECU: a116 mrcc startup reg cs error static err";
CM_ SG_ 919 EPASTP_a117_mrccStartupRegCsErro "EPASTP ECU: a117 mrcc startup reg cs error transient err";
CM_ SG_ 919 EPASTP_a118_mcusscFlashCsErrorEr "EPASTP ECU: a118 mcussc flash cs error err";
CM_ SG_ 919 EPASTP_a119_mcusscFlashEccCritic "EPASTP ECU: a119 mcussc flash ecc critical err";
CM_ SG_ 919 EPASTP_a120_mcusscFlashEccLatent "EPASTP ECU: a120 mcussc flash ecc latent err";
CM_ SG_ 919 EPASTP_a121_mcusscMbistEccErr "EPASTP ECU: a121 mcussc mbist ecc err";
CM_ SG_ 919 EPASTP_a122_pcpBridgeFetShort "EPASTP ECU: a122 pcp bridge fet short";
CM_ SG_ 919 EPASTP_a123_imcmCommErr "EPASTP ECU: a123 imcm comm err";
CM_ SG_ 919 EPASTP_a124_mcusscMbistEccTransi "EPASTP ECU: a124 mcussc mbist ecc transient err";
CM_ SG_ 919 EPASTP_a125_mcusscMbistMiaErr "EPASTP ECU: a125 mcussc mbist mia err";
CM_ SG_ 919 EPASTP_a126_mcusscMonbistMiaErr "EPASTP ECU: a126 mcussc monbist mia err";
CM_ SG_ 919 EPASTP_a127_exchAdditionalExcept "EPASTP ECU: a127 exch additional exception after rst";
CM_ SG_ 919 EPASTP_a128_exchExceptionStopRes "EPASTP ECU: a128 exch exception stop restart";
CM_ SG_ 919 EPASTP_a129_exchAdditionalExcept "EPASTP ECU: a129 exch additional exception stop restart";
CM_ SG_ 919 EPASTP_a130_mrccConfigCsErrorErr "EPASTP ECU: a130 mrcc config cs error err";
CM_ SG_ 919 EPASTP_a131_exchGuardedResetAfte "EPASTP ECU: a131 exch guarded reset after partition stop";
CM_ SG_ 919 EPASTP_a132_mcusscNotSupportedMc "EPASTP ECU: a132 mcussc not supported mcu";
CM_ SG_ 919 EPASTP_a133_mcusscLbistEcuIdIsNo "EPASTP ECU: a133 mcussc lbist ecu id is not supported";
CM_ SG_ 919 EPASTP_a134_osehGuardedResetAfte "EPASTP ECU: a134 oseh guarded reset after err without reset";
CM_ SG_ 919 EPASTP_a135_tmpsfetjCalculationO "EPASTP ECU: a135 tmpsfetj calculation overflow err";
CM_ SG_ 919 EPASTP_a136_ftElectricalAngleQf "EPASTP ECU: a136 ft electrical angle qf";
CM_ SG_ 919 EPASTP_a137_osehErrWithoutImmedi "EPASTP ECU: a137 oseh err without immediate reset";
CM_ SG_ 919 EPASTP_a138_osehAdditionalErrWit "EPASTP ECU: a138 oseh additional err without imm reset";
CM_ SG_ 919 EPASTP_a139_osehAdditionalOsErr "EPASTP ECU: a139 oseh additional os err";
CM_ SG_ 919 EPASTP_a140_imcmConfigurationErr "EPASTP ECU: a140 imcm configuration err";
CM_ SG_ 919 EPASTP_a141_amFetShortTest "EPASTP ECU: a141 am fet short test";
CM_ SG_ 919 EPASTP_a142_tedEmifilterDmcTempC "EPASTP ECU: a142 ted emifilter dmc temp checker";
CM_ SG_ 919 EPASTP_a143_tedEmifilterCmcTempC "EPASTP ECU: a143 ted emifilter cmc temp checker";
CM_ SG_ 919 EPASTP_a144_mriCoreRaminitFailed "EPASTP ECU: a144 mri core raminit failed";
CM_ SG_ 919 EPASTP_a145_mriPeripheralRaminit "EPASTP ECU: a145 mri peripheral raminit failed";
CM_ SG_ 919 EPASTP_a146_btarcRcCircuitCheck "EPASTP ECU: a146 btarc rc circuit check";
CM_ SG_ 919 EPASTP_a147_amDcLinkShortedFail "EPASTP ECU: a147 am dc link shorted fail";
CM_ SG_ 919 EPASTP_a148_mrccExitFromStandbyD "EPASTP ECU: a148 mrcc exit from standby detected";
CM_ SG_ 919 EPASTP_a149_amReversibleEmergenc "EPASTP ECU: a149 am reversible emergency off requested";
CM_ SG_ 919 EPASTP_a150_amExternalEmergencyO "EPASTP ECU: a150 am external emergency off requested";
CM_ SG_ 919 EPASTP_a151_amPermanentEmergency "EPASTP ECU: a151 am permanent emergency off requested";
CM_ SG_ 919 EPASTP_a152_exchFlashEccExceptio "EPASTP ECU: a152 exch flash ecc exception";
CM_ SG_ 919 EPASTP_a153_sdsmBlockSelectorInv "EPASTP ECU: a153 sdsm block selector invalid";
CM_ SG_ 919 EPASTP_a154_sdsmCsErrorInvalidPr "EPASTP ECU: a154 sdsm cs error invalid primary";
CM_ SG_ 919 EPASTP_a155_sdsmDataInvalidAll "EPASTP ECU: a155 sdsm data invalid all";
CM_ SG_ 919 EPASTP_a156_amIntSerialErrSafety "EPASTP ECU: a156 am int serial err safety reset";
CM_ SG_ 919 EPASTP_a157_mcudcpInvalidEcuId "EPASTP ECU: a157 mcudcp invalid ecu id";
CM_ SG_ 919 EPASTP_a158_amGduFailDuringRecov "EPASTP ECU: a158 am gdu fail during recovery";
CM_ SG_ 919 EPASTP_a159_exchFlashWordlineTra "EPASTP ECU: a159 exch flash wordline transient err";
CM_ SG_ 919 EPASTP_a160_rsthCpu1UnexpectedAl "EPASTP ECU: a160 rsth cpu1 unexpected alarm";
CM_ SG_ 919 EPASTP_a161_tdaRelayfetjunctionT "EPASTP ECU: a161 tda relayfetjunction temp checker";
CM_ SG_ 919 EPASTP_a162_tdaBridgefetjunction "EPASTP ECU: a162 tda bridgefetjunction temp checker";
CM_ SG_ 919 EPASTP_a163_tdaPowermoduleTempCh "EPASTP ECU: a163 tda powermodule temp checker";
CM_ SG_ 919 EPASTP_a164_tdaBattfetjunctionTe "EPASTP ECU: a164 tda battfetjunction temp checker";
CM_ SG_ 919 EPASTP_a165_tdaDcbusshuntTempChe "EPASTP ECU: a165 tda dcbusshunt temp checker";
CM_ SG_ 919 EPASTP_a166_tdaPhasecurrentshunt "EPASTP ECU: a166 tda phasecurrentshunt temp checker";
CM_ SG_ 919 EPASTP_a167_iccd1ErrQueueOverflo "EPASTP ECU: a167 iccd1 err queue overflow";
CM_ SG_ 919 EPASTP_a168_c1csInvalidC1App "EPASTP ECU: a168 c1cs invalid C1 app";
CM_ SG_ 919 EPASTP_a169_scpSafetyReset "EPASTP ECU: a169 scp safety reset";
CM_ SG_ 919 EPASTP_a170_pmpDcvoltAge "EPASTP ECU: a170 pmp dcvolt age";
CM_ SG_ 919 EPASTP_a171_pmpKgvalueAge "EPASTP ECU: a171 pmp kgvalue age";
CM_ SG_ 919 EPASTP_a172_pmpElangMotorcurrent "EPASTP ECU: a172 pmp elang motorcurrent age";
CM_ SG_ 919 EPASTP_a173_pmpRotorspeedAge "EPASTP ECU: a173 pmp rotorspeed age";
CM_ SG_ 919 EPASTP_a174_pmpPhasecurrentAge "EPASTP ECU: a174 pmp phasecurrent age";
CM_ SG_ 919 EPASTP_a175_exchFlashStoredConfi "EPASTP ECU: a175 exch flash stored config err";
CM_ SG_ 919 EPASTP_a176_exchCpu1ExceptionRes "EPASTP ECU: a176 exch cpu1 exception reset";
CM_ SG_ 919 EPASTP_a177_etsrInvalidated "EPASTP ECU: a177 etsr invalidated";
CM_ SG_ 919 EPASTP_a178_exchWdtException "EPASTP ECU: a178 exch wdt exception";
CM_ SG_ 919 EPASTP_a179_tedMotorcoilTempChec "EPASTP ECU: a179 ted motorcoil temp checker";
CM_ SG_ 919 EPASTP_a180_dmDeadlineViolationC "EPASTP ECU: a180 dm deadline violation C1";
CM_ SG_ 919 EPASTP_a181_dmDeadlineViolationC "EPASTP ECU: a181 dm deadline violation C1";
CM_ SG_ 919 EPASTP_a182_mcdInputMia "EPASTP ECU: a182 mcd input mia";
CM_ SG_ 919 EPASTP_a183_sbchCommErrSbcToMcu "EPASTP ECU: a183 sbch comm err sbc to mcu";
CM_ SG_ 919 EPASTP_a184_sbcmCommBufferOverfl "EPASTP ECU: a184 sbcm comm buffer overflow";
CM_ SG_ 919 EPASTP_a185_sbcscpQAWatchdogRese "EPASTP ECU: a185 sbcscp QA watchdog reset";
CM_ SG_ 919 EPASTP_a186_wdhCommBufferOverflo "EPASTP ECU: a186 wdh comm buffer overflow";
CM_ SG_ 919 EPASTP_a187_epmVoltFail "EPASTP ECU: a187 epm volt fail";
CM_ SG_ 919 EPASTP_a188_epmCommBufferOverflo "EPASTP ECU: a188 epm comm buffer overflow";
CM_ SG_ 919 EPASTP_a189_sbchCommErrMcuToSbc "EPASTP ECU: a189 sbch comm err mcu to sbc";
CM_ SG_ 919 EPASTP_a190_sbchCommBufferOverfl "EPASTP ECU: a190 sbch comm buffer overflow";
CM_ SG_ 919 EPASTP_a191_sbcscpVcp2VucVoltFai "EPASTP ECU: a191 sbcscp vcp2 vuc volt fail";
CM_ SG_ 919 EPASTP_a192_osumC0CsaNearFull "EPASTP ECU: a192 osum C0 csa near full";
CM_ SG_ 919 EPASTP_a193_osumC0StackNearFull "EPASTP ECU: a193 osum C0 stack near full";
CM_ SG_ 919 EPASTP_a194_amNvdataLoss "EPASTP ECU: a194 am nvdata loss";
CM_ SG_ 919 EPASTP_a195_imcmCommErrC1 "EPASTP ECU: a195 imcm comm err C1";
CM_ SG_ 919 EPASTP_a196_topEolTasOffsetInval "EPASTP ECU: a196 top eol tas offset invalid";
CM_ SG_ 919 EPASTP_a197_difpDifactorInvalid "EPASTP ECU: a197 difp difactor invalid";
CM_ SG_ 919 EPASTP_a198_osumC1CsaNearFull "EPASTP ECU: a198 osum C1 csa near full";
CM_ SG_ 919 EPASTP_a199_osumC1StackNearFull "EPASTP ECU: a199 osum C1 stack near full";
CM_ SG_ 919 EPASTP_a200_ammInputBufferOverfl "EPASTP ECU: a200 amm input buffer overflow";
CM_ SG_ 919 EPASTP_a201_ammOutputBufferOverf "EPASTP ECU: a201 amm output buffer overflow";
CM_ SG_ 919 EPASTP_a202_ohnvmpStoredOffsetLo "EPASTP ECU: a202 ohnvmp stored offset lost";
CM_ SG_ 919 EPASTP_a203_ctcInterfaceErr "EPASTP ECU: a203 ctc interface err";
CM_ SG_ 919 EPASTP_a204_fdpPrevTrqErr "EPASTP ECU: a204 fdp prev trq err";
CM_ SG_ 919 EPASTP_a205_fdrOclFail "EPASTP ECU: a205 fdr ocl fail";
CM_ SG_ 919 EPASTP_a206_fdrOclPartialBlockin "EPASTP ECU: a206 fdr ocl partial blocking";
CM_ SG_ 919 EPASTP_a207_fdrOclFreezing "EPASTP ECU: a207 fdr ocl freezing";
CM_ SG_ 919 EPASTP_a208_fdrLowSeverityBlocki "EPASTP ECU: a208 fdr low severity blocking";
CM_ SG_ 919 EPASTP_a209_fdrLowSeverityFreezi "EPASTP ECU: a209 fdr low severity freezing";
CM_ SG_ 919 EPASTP_a210_fdrTotalBlocking "EPASTP ECU: a210 fdr total blocking";
CM_ SG_ 919 EPASTP_a211_frmInternalErr "EPASTP ECU: a211 frm internal err";
CM_ SG_ 919 EPASTP_a212_frmDataLost "EPASTP ECU: a212 frm data lost";
CM_ SG_ 919 EPASTP_a213_frmHighFrictionDetec "EPASTP ECU: a213 frm high friction detected";
CM_ SG_ 919 EPASTP_a214_velInterfaceErr "EPASTP ECU: a214 vel interface err";
CM_ SG_ 919 EPASTP_a215_vsgSafeViolErr "EPASTP ECU: a215 vsg safe viol err";
CM_ SG_ 919 EPASTP_a216_isdgImproperShutdown "EPASTP ECU: a216 isdg improper shutdown";
CM_ SG_ 919 EPASTP_a217_msdMasterSilentErr "EPASTP ECU: a217 msd master silent err";
CM_ SG_ 919 EPASTP_a218_aadApplicationStateE "EPASTP ECU: a218 aad application state err";
CM_ SG_ 919 EPASTP_a219_frhFastRestartFailed "EPASTP ECU: a219 frh fast restart failed";
CM_ SG_ 919 EPASTP_a221_apsCntError "EPASTP ECU: a221 aps cnt error";
CM_ SG_ 919 EPASTP_a222_apsCsError "EPASTP ECU: a222 aps cs error";
CM_ SG_ 919 EPASTP_a223_apsMia "EPASTP ECU: a223 aps mia";
CM_ SG_ 919 EPASTP_a224_dasCntError "EPASTP ECU: a224 das cnt error";
CM_ SG_ 919 EPASTP_a225_dasCsError "EPASTP ECU: a225 das cs error";
CM_ SG_ 919 EPASTP_a226_dasMia "EPASTP ECU: a226 das mia";
CM_ SG_ 919 EPASTP_a227_dirTorqueCntError "EPASTP ECU: a227 dir torque cnt error";
CM_ SG_ 919 EPASTP_a228_dirTorqueCsError "EPASTP ECU: a228 dir torque cs error";
CM_ SG_ 919 EPASTP_a229_dirTorqueMia "EPASTP ECU: a229 dir torque mia";
CM_ SG_ 919 EPASTP_a230_diSpdCntError "EPASTP ECU: a230 di spd cnt error";
CM_ SG_ 919 EPASTP_a231_diSpdCsError "EPASTP ECU: a231 di spd cs error";
CM_ SG_ 919 EPASTP_a232_diSpdMia "EPASTP ECU: a232 di spd mia";
CM_ SG_ 919 EPASTP_a233_ecu2StatCntError "EPASTP ECU: a233 ecu2 stat cnt error";
CM_ SG_ 919 EPASTP_a234_ecu2StatCsError "EPASTP ECU: a234 ecu2 stat cs error";
CM_ SG_ 919 EPASTP_a235_ecu2StatMia "EPASTP ECU: a235 ecu2 stat mia";
CM_ SG_ 919 EPASTP_a236_espWrCntError "EPASTP ECU: a236 esp wr cnt error";
CM_ SG_ 919 EPASTP_a237_espWrCsError "EPASTP ECU: a237 esp wr cs error";
CM_ SG_ 919 EPASTP_a238_espWrMia "EPASTP ECU: a238 esp wr mia";
CM_ SG_ 919 EPASTP_a239_espWsCntError "EPASTP ECU: a239 esp ws cnt error";
CM_ SG_ 919 EPASTP_a240_espWsCsError "EPASTP ECU: a240 esp ws cs error";
CM_ SG_ 919 EPASTP_a241_espWsMia "EPASTP ECU: a241 esp ws mia";
CM_ SG_ 919 EPASTP_a242_gtwConfigMia "EPASTP ECU: a242 gtw config mia";
CM_ SG_ 919 EPASTP_a243_rcmCntError "EPASTP ECU: a243 rcm cnt error";
CM_ SG_ 919 EPASTP_a244_rcmCsError "EPASTP ECU: a244 rcm cs error";
CM_ SG_ 919 EPASTP_a245_rcmMia "EPASTP ECU: a245 rcm mia";
CM_ SG_ 919 EPASTP_a246_sccmCntError "EPASTP ECU: a246 sccm cnt error";
CM_ SG_ 919 EPASTP_a247_sccmCsError "EPASTP ECU: a247 sccm cs error";
CM_ SG_ 919 EPASTP_a248_sccmMia "EPASTP ECU: a248 sccm mia";
CM_ SG_ 919 EPASTP_a249_uiTuneReqCntError "EPASTP ECU: a249 ui tune req cnt error";
CM_ SG_ 919 EPASTP_a250_uiTuneReqCsError "EPASTP ECU: a250 ui tune req cs error";
CM_ SG_ 919 EPASTP_a251_uiTuneReqMia "EPASTP ECU: a251 ui tune req mia";
CM_ SG_ 919 EPASTP_a252_vcFrontCntError "EPASTP ECU: a252 vc front cnt error";
CM_ SG_ 919 EPASTP_a253_vcFrontCsError "EPASTP ECU: a253 vc front cs error";
CM_ SG_ 919 EPASTP_a254_vcFrontMia "EPASTP ECU: a254 vc front mia";
CM_ SG_ 919 EPASTP_a255_pmState2Mia "EPASTP ECU: a255 pm state2 mia";
CM_ SG_ 919 EPASTP_a256_dcvmOverVolt "EPASTP ECU: a256 dcvm over volt";
CM_ SG_ 919 EPASTP_a257_dcvmUnderVolt "EPASTP ECU: a257 dcvm under volt";
CM_ SG_ 919 EPASTP_a258_pspInvalidProjectPar "EPASTP ECU: a258 psp invalid project paramset";
CM_ SG_ 919 EPASTP_a259_scoCanBusOff "EPASTP ECU: a259 sco can bus off";
CM_ SG_ 919 EPASTP_a260_scoPrivateBusOff "EPASTP ECU: a260 sco private bus off";
CM_ SG_ 919 EPASTP_a261_sccmStatusError "EPASTP ECU: a261 sccm status error";
CM_ SG_ 919 EPASTP_a262_yawRateStatus "EPASTP ECU: a262 yaw rate status";
CM_ SG_ 919 EPASTP_a263_espWsStatus "EPASTP ECU: a263 esp ws status";
CM_ SG_ 919 EPASTP_a264_assistTorqueLimited "EPASTP ECU: a264 assist torque limited";
CM_ SG_ 919 EPASTP_a265_overheatProtect "EPASTP ECU: a265 overheat protect";
CM_ SG_ 919 EPASTP_a266_overloadProtect "EPASTP ECU: a266 overload protect";
CM_ SG_ 919 EPASTP_a267_safeSpeedAssist "EPASTP ECU: a267 safe speed assist";
CM_ SG_ 919 EPASTP_a268_eacCancelled "EPASTP ECU: a268 eac cancelled";
CM_ SG_ 919 EPASTP_a269_assistTorqueDisabled "EPASTP ECU: a269 assist torque disabled";
CM_ SG_ 919 EPASTP_a270_oscillationCompTrqLi "EPASTP ECU: a270 oscillation comp trq lim reached";
BA_DEF_ BO_ "GenMsgCycleTime" INT 0 3600000;
BA_DEF_ BO_ "GenMsgSendType" ENUM "Cyclic","NotUsed","NotUsed","NotUsed","NotUsed","NotUsed","NotUsed","IfActive","NoMsgSendType","NotUsed";
BA_DEF_ BO_ "VFrameFormat" ENUM "StandardCAN","ExtendedCAN","reserved","J1939PG","reserved","reserved","reserved","reserved","reserved","reserved","reserved","reserved","reserved","reserved","StandardCAN_FD","ExtendedCAN_FD";
BA_DEF_ BO_ "CANFD_BRS" ENUM "0","1";
BA_DEF_ SG_ "GenSigSNA" STRING;
BA_DEF_ SG_ "SystemSignalLongSymbol" STRING;
BA_DEF_ SG_ "Confidence" ENUM "validated","plausible","layout-only","contradicted";
BA_DEF_DEF_ "GenMsgCycleTime" 0;
BA_DEF_DEF_ "GenMsgSendType" "NoMsgSendType";
BA_DEF_DEF_ "VFrameFormat" "StandardCAN";
BA_DEF_DEF_ "CANFD_BRS" "1";
BA_DEF_DEF_ "GenSigSNA" "";
BA_DEF_DEF_ "SystemSignalLongSymbol" "";
BA_DEF_DEF_ "Confidence" "layout-only";
BA_ "GenMsgCycleTime" BO_ 999 1000;
BA_ "GenMsgSendType" BO_ 999 0;
BA_ "GenMsgCycleTime" BO_ 919 1000;
BA_ "GenMsgSendType" BO_ 919 0;
BA_ "Confidence" SG_ 999 DPB_matrixIndex 1;
BA_ "SystemSignalLongSymbol" SG_ 999 DPB_a001_pPlungerSensorOffsetHig "DPB_a001_pPlungerSensorOffsetHigh";
BA_ "SystemSignalLongSymbol" SG_ 999 DPB_a018_largeLeakageDetectedGoo "DPB_a018_largeLeakageDetectedGoodCheck";
BA_ "SystemSignalLongSymbol" SG_ 999 DPB_a023_initialPlungerCheckFail "DPB_a023_initialPlungerCheckFailed";
BA_ "SystemSignalLongSymbol" SG_ 999 DPB_a035_PDURouterinitialization "DPB_a035_PDURouterinitializationFailed";
BA_ "SystemSignalLongSymbol" SG_ 999 DPB_a036_lossOfPDUInstanceDetect "DPB_a036_lossOfPDUInstanceDetected";
BA_ "SystemSignalLongSymbol" SG_ 999 DPB_a038_plungerCircuitPressHigh "DPB_a038_plungerCircuitPressHighGoodCheck";
BA_ "SystemSignalLongSymbol" SG_ 999 DPB_a040_plungerCircuitPressLowG "DPB_a040_plungerCircuitPressLowGoodCheck";
BA_ "SystemSignalLongSymbol" SG_ 999 DPB_a042_motorLoadPressImplausib "DPB_a042_motorLoadPressImplausible";
BA_ "SystemSignalLongSymbol" SG_ 999 DPB_a047_pPlungerPlausCheckFailu "DPB_a047_pPlungerPlausCheckFailure";
BA_ "SystemSignalLongSymbol" SG_ 999 DPB_a053_hydraulicAssemblyModeAc "DPB_a053_hydraulicAssemblyModeActive";
BA_ "SystemSignalLongSymbol" SG_ 999 DPB_a055_unsupportedSeriesHWDete "DPB_a055_unsupportedSeriesHWDetected";
BA_ "SystemSignalLongSymbol" SG_ 999 DPB_a085_infoFailureWrongCUBASHa "DPB_a085_infoFailureWrongCUBASHandlingDetected";
BA_ "SystemSignalLongSymbol" SG_ 999 DPB_a086_diagHydProtectionPressF "DPB_a086_diagHydProtectionPressFault";
BA_ "SystemSignalLongSymbol" SG_ 999 DPB_a087_diagHydProtectionVlvFau "DPB_a087_diagHydProtectionVlvFault";
BA_ "SystemSignalLongSymbol" SG_ 999 DPB_a111_hydraulicHardUndervolta "DPB_a111_hydraulicHardUndervoltage";
BA_ "SystemSignalLongSymbol" SG_ 999 DPB_a127_hydraulicAsicShortCircu "DPB_a127_hydraulicAsicShortCircuit";
BA_ "SystemSignalLongSymbol" SG_ 999 DPB_a129_AsicTrimmingNotComplete "DPB_a129_AsicTrimmingNotCompleted";
BA_ "SystemSignalLongSymbol" SG_ 999 DPB_a131_ASICOvercurrentOnGPIO25 "DPB_a131_ASICOvercurrentOnGPIO250_1";
BA_ "SystemSignalLongSymbol" SG_ 999 DPB_a132_ASICOvercurrentOnGPIO25 "DPB_a132_ASICOvercurrentOnGPIO250_2";
BA_ "SystemSignalLongSymbol" SG_ 999 DPB_a133_ASICOvercurrentOnGPIO50 "DPB_a133_ASICOvercurrentOnGPIO50_1";
BA_ "SystemSignalLongSymbol" SG_ 999 DPB_a134_ASICOvercurrentOnGPIO50 "DPB_a134_ASICOvercurrentOnGPIO50_2";
BA_ "SystemSignalLongSymbol" SG_ 999 DPB_a135_ASICOvercurrentOnGPIO50 "DPB_a135_ASICOvercurrentOnGPIO50_3";
BA_ "SystemSignalLongSymbol" SG_ 999 DPB_a136_ASICOvercurrentOnGPIO50 "DPB_a136_ASICOvercurrentOnGPIO50_4";
BA_ "SystemSignalLongSymbol" SG_ 999 DPB_a139_DIchassisControlChecksu "DPB_a139_DIchassisControlChecksum";
BA_ "SystemSignalLongSymbol" SG_ 999 DPB_a191_VCLEFTepbmStatusChecksu "DPB_a191_VCLEFTepbmStatusChecksum";
BA_ "SystemSignalLongSymbol" SG_ 999 DPB_a194_VCRIGHTepbmStatusCounte "DPB_a194_VCRIGHTepbmStatusCounter";
BA_ "SystemSignalLongSymbol" SG_ 999 DPB_a195_VCRIGHTepbmStatusChecks "DPB_a195_VCRIGHTepbmStatusChecksum";
BA_ "SystemSignalLongSymbol" SG_ 999 DPB_a197_VCRIGHTepbmStatusTimeou "DPB_a197_VCRIGHTepbmStatusTimeout";
BA_ "SystemSignalLongSymbol" SG_ 999 DPB_a200_ESPRunoutSupportNotAvai "DPB_a200_ESPRunoutSupportNotAvailable";
BA_ "SystemSignalLongSymbol" SG_ 999 DPB_a202_vehicleStandstillQFault "DPB_a202_vehicleStandstillQFaulty";
BA_ "SystemSignalLongSymbol" SG_ 999 DPB_a220_excessiveBoostWakeupsDe "DPB_a220_excessiveBoostWakeupsDetected";
BA_ "SystemSignalLongSymbol" SG_ 999 DPB_a222_excessiveEcuResetsDetec "DPB_a222_excessiveEcuResetsDetected";
BA_ "SystemSignalLongSymbol" SG_ 999 DPB_a242_uCSafetyNotificationGRA "DPB_a242_uCSafetyNotificationGRAM";
BA_ "SystemSignalLongSymbol" SG_ 999 DPB_a256_valveRelayActuationFaul "DPB_a256_valveRelayActuationFault";
BA_ "SystemSignalLongSymbol" SG_ 999 DPB_a259_valveRelayTestUndervolt "DPB_a259_valveRelayTestUndervoltage";
BA_ "SystemSignalLongSymbol" SG_ 999 DPB_a260_valveRelaySafetySwitchF "DPB_a260_valveRelaySafetySwitchFault";
BA_ "SystemSignalLongSymbol" SG_ 999 DPB_a292_CBDS_fillBufferThreshol "DPB_a292_CBDS_fillBufferThreshold";
BA_ "SystemSignalLongSymbol" SG_ 999 DPB_a298_RunningActiveSystemTest "DPB_a298_RunningActiveSystemTests";
BA_ "SystemSignalLongSymbol" SG_ 999 DPB_a303_actuatingDIFullTorqueCm "DPB_a303_actuatingDIFullTorqueCmd";
BA_ "SystemSignalLongSymbol" SG_ 999 DPB_a305_DIbrakeTorqueCommandAnd "DPB_a305_DIbrakeTorqueCommandAndFlagMismatch";
BA_ "SystemSignalLongSymbol" SG_ 999 DPB_a306_actuatorFallbackBasicMa "DPB_a306_actuatorFallbackBasicMap";
BA_ "SystemSignalLongSymbol" SG_ 999 DPB_a308_hydraulicPushthroughAct "DPB_a308_hydraulicPushthroughActive";
BA_ "SystemSignalLongSymbol" SG_ 999 DPB_a312_cyclicVolumeCheckDisabl "DPB_a312_cyclicVolumeCheckDisabled";
BA_ "SystemSignalLongSymbol" SG_ 999 DPB_a313_qualifiedBrakeEventDete "DPB_a313_qualifiedBrakeEventDetected";
BA_ "Confidence" SG_ 1427 EPASTP_alertID 1;
BA_ "Confidence" SG_ 1427 EPASTP_alertState 1;
BA_ "Confidence" SG_ 1427 EPASTP_a264_degradedECU 1;
BA_ "Confidence" SG_ 1427 EPASTP_a264_vehicleSpeed 1;
BA_ "Confidence" SG_ 1427 EPASTP_a264_powerRatio 1;
BA_ "Confidence" SG_ 1427 EPASTP_a264_ownSideDegradationRe 1;
BA_ "SystemSignalLongSymbol" SG_ 1427 EPASTP_a264_ownSideDegradationRe "EPASTP_a264_ownSideDegradationReason";
BA_ "Confidence" SG_ 1427 EPASTP_a264_otherSideDegradation 1;
BA_ "SystemSignalLongSymbol" SG_ 1427 EPASTP_a264_otherSideDegradation "EPASTP_a264_otherSideDegradationReason";
BA_ "Confidence" SG_ 1427 EPASTP_a265_degradedECU 1;
BA_ "Confidence" SG_ 1427 EPASTP_a265_vehicleSpeed 1;
BA_ "Confidence" SG_ 1427 EPASTP_a265_rawMcuTemperature 1;
BA_ "Confidence" SG_ 1427 EPASTP_a265_degradedCurrentLimit 1;
BA_ "Confidence" SG_ 1427 EPASTP_a266_cdpAssistFactor 1;
BA_ "Confidence" SG_ 1427 EPASTP_a266_vehicleSpeed 1;
BA_ "Confidence" SG_ 1427 EPASTP_a267_vehicleSpeed 1;
BA_ "Confidence" SG_ 1427 EPASTP_a267_velocityEstimatorSta 1;
BA_ "SystemSignalLongSymbol" SG_ 1427 EPASTP_a267_velocityEstimatorSta "EPASTP_a267_velocityEstimatorState";
BA_ "Confidence" SG_ 1427 EPASTP_a269_vehicleSpeed 1;
BA_ "Confidence" SG_ 919 EPASTP_matrixIndex 1;
BA_ "SystemSignalLongSymbol" SG_ 919 EPASTP_a001_adcCalibrationOrInit "EPASTP_a001_adcCalibrationOrInitFail";
BA_ "SystemSignalLongSymbol" SG_ 919 EPASTP_a005_scpUnknownResetSourc "EPASTP_a005_scpUnknownResetSource";
BA_ "SystemSignalLongSymbol" SG_ 919 EPASTP_a006_swrhResetByInvalidEr "EPASTP_a006_swrhResetByInvalidErrid";
BA_ "SystemSignalLongSymbol" SG_ 919 EPASTP_a009_mcusscLbistPermanent "EPASTP_a009_mcusscLbistPermanentFail";
BA_ "SystemSignalLongSymbol" SG_ 919 EPASTP_a010_svcIncompatibleSwVer "EPASTP_a010_svcIncompatibleSwVersions";
BA_ "SystemSignalLongSymbol" SG_ 919 EPASTP_a013_mcusscSffMonitoringF "EPASTP_a013_mcusscSffMonitoringFailed";
BA_ "SystemSignalLongSymbol" SG_ 919 EPASTP_a014_mcusscSffMonitoringM "EPASTP_a014_mcusscSffMonitoringMia";
BA_ "SystemSignalLongSymbol" SG_ 919 EPASTP_a015_mcusscCsErrorCheckFa "EPASTP_a015_mcusscCsErrorCheckFail";
BA_ "SystemSignalLongSymbol" SG_ 919 EPASTP_a016_mcufcCsErrorCheckFai "EPASTP_a016_mcufcCsErrorCheckFail";
BA_ "SystemSignalLongSymbol" SG_ 919 EPASTP_a017_stmdStmPlausibilityC "EPASTP_a017_stmdStmPlausibilityCheckErr";
BA_ "SystemSignalLongSymbol" SG_ 919 EPASTP_a019_rsthHwResetInfoCorru "EPASTP_a019_rsthHwResetInfoCorruptionCheck";
BA_ "SystemSignalLongSymbol" SG_ 919 EPASTP_a020_mcusscEolEcuIdIntegr "EPASTP_a020_mcusscEolEcuIdIntegritiyFail";
BA_ "SystemSignalLongSymbol" SG_ 919 EPASTP_a022_swrhSwResetInfoCorru "EPASTP_a022_swrhSwResetInfoCorruptionCheck";
BA_ "SystemSignalLongSymbol" SG_ 919 EPASTP_a028_smuhNonInitDataCorru "EPASTP_a028_smuhNonInitDataCorruption";
BA_ "SystemSignalLongSymbol" SG_ 919 EPASTP_a029_smuhSmuCoreCntErrorT "EPASTP_a029_smuhSmuCoreCntErrorTestFail";
BA_ "SystemSignalLongSymbol" SG_ 919 EPASTP_a031_pmsProductionModeFai "EPASTP_a031_pmsProductionModeFailed";
BA_ "SystemSignalLongSymbol" SG_ 919 EPASTP_a033_icsvcPswVersionMisma "EPASTP_a033_icsvcPswVersionMismatch";
BA_ "SystemSignalLongSymbol" SG_ 919 EPASTP_a038_csohCh1CsErrorErrAtR "EPASTP_a038_csohCh1CsErrorErrAtReset";
BA_ "SystemSignalLongSymbol" SG_ 919 EPASTP_a039_csohCh2CsErrorErrAtR "EPASTP_a039_csohCh2CsErrorErrAtReset";
BA_ "SystemSignalLongSymbol" SG_ 919 EPASTP_a040_swrhLimitedResetRetr "EPASTP_a040_swrhLimitedResetRetriesExpired";
BA_ "SystemSignalLongSymbol" SG_ 919 EPASTP_a041_imcmCoreConfiguratio "EPASTP_a041_imcmCoreConfigurationMismatch";
BA_ "SystemSignalLongSymbol" SG_ 919 EPASTP_a045_psumSbcBandgapVoltEr "EPASTP_a045_psumSbcBandgapVoltErr";
BA_ "SystemSignalLongSymbol" SG_ 919 EPASTP_a046_mcusscOscillatorNotR "EPASTP_a046_mcusscOscillatorNotReliable";
BA_ "SystemSignalLongSymbol" SG_ 919 EPASTP_a052_ermSdcInputBufferOve "EPASTP_a052_ermSdcInputBufferOverflow";
BA_ "SystemSignalLongSymbol" SG_ 919 EPASTP_a053_adcUnexpectedNumOfDa "EPASTP_a053_adcUnexpectedNumOfData";
BA_ "SystemSignalLongSymbol" SG_ 919 EPASTP_a056_amGduConfigCsErrorCh "EPASTP_a056_amGduConfigCsErrorCheck";
BA_ "SystemSignalLongSymbol" SG_ 919 EPASTP_a067_tspmPowermoduleTempI "EPASTP_a067_tspmPowermoduleTempImplausible";
BA_ "SystemSignalLongSymbol" SG_ 919 EPASTP_a068_rsthCoreRedundancyEr "EPASTP_a068_rsthCoreRedundancyErr";
BA_ "SystemSignalLongSymbol" SG_ 919 EPASTP_a069_rsthCoreTempOutOfRan "EPASTP_a069_rsthCoreTempOutOfRangeHwCheck";
BA_ "SystemSignalLongSymbol" SG_ 919 EPASTP_a072_rsthFlashUncorrEccOr "EPASTP_a072_rsthFlashUncorrEccOrOvfl";
BA_ "SystemSignalLongSymbol" SG_ 919 EPASTP_a075_rsthUnusedOtherModul "EPASTP_a075_rsthUnusedOtherModuleAlarm";
BA_ "SystemSignalLongSymbol" SG_ 919 EPASTP_a081_exchFloatingPointExc "EPASTP_a081_exchFloatingPointException";
BA_ "SystemSignalLongSymbol" SG_ 919 EPASTP_a083_tdaDclinkcapacitorTe "EPASTP_a083_tdaDclinkcapacitorTempChecker";
BA_ "SystemSignalLongSymbol" SG_ 919 EPASTP_a085_amGduSwitchOffTestBy "EPASTP_a085_amGduSwitchOffTestByMcu";
BA_ "SystemSignalLongSymbol" SG_ 919 EPASTP_a088_tedMainboardTempChec "EPASTP_a088_tedMainboardTempChecker";
BA_ "SystemSignalLongSymbol" SG_ 919 EPASTP_a089_tedRevercebattfetjun "EPASTP_a089_tedRevercebattfetjunctionTempChecker";
BA_ "SystemSignalLongSymbol" SG_ 919 EPASTP_a091_bvpBattVoltCrossChkF "EPASTP_a091_bvpBattVoltCrossChkFailed";
BA_ "SystemSignalLongSymbol" SG_ 919 EPASTP_a092_amGduSwitchOffTestBy "EPASTP_a092_amGduSwitchOffTestBySbc";
BA_ "SystemSignalLongSymbol" SG_ 919 EPASTP_a093_sctpTsuSingleStaticF "EPASTP_a093_sctpTsuSingleStaticFail";
BA_ "SystemSignalLongSymbol" SG_ 919 EPASTP_a094_sctpTsuMultipleStati "EPASTP_a094_sctpTsuMultipleStaticFail";
BA_ "SystemSignalLongSymbol" SG_ 919 EPASTP_a095_mdModelBasedMotorInt "EPASTP_a095_mdModelBasedMotorIntegrityCheck";
BA_ "SystemSignalLongSymbol" SG_ 919 EPASTP_a096_rppRpsSingleStaticFa "EPASTP_a096_rppRpsSingleStaticFail";
BA_ "SystemSignalLongSymbol" SG_ 919 EPASTP_a097_rppRpsMultipleStatic "EPASTP_a097_rppRpsMultipleStaticFail";
BA_ "SystemSignalLongSymbol" SG_ 919 EPASTP_a099_mcdTorqueMismatchFau "EPASTP_a099_mcdTorqueMismatchFault";
BA_ "SystemSignalLongSymbol" SG_ 919 EPASTP_a103_exhaUnusedInterruptC "EPASTP_a103_exhaUnusedInterruptCallException";
BA_ "SystemSignalLongSymbol" SG_ 919 EPASTP_a105_exhaSriBusErrExcepti "EPASTP_a105_exhaSriBusErrException";
BA_ "SystemSignalLongSymbol" SG_ 919 EPASTP_a106_exhaSpbBusErrExcepti "EPASTP_a106_exhaSpbBusErrException";
BA_ "SystemSignalLongSymbol" SG_ 919 EPASTP_a107_exhaOtherNmiExceptio "EPASTP_a107_exhaOtherNmiException";
BA_ "SystemSignalLongSymbol" SG_ 919 EPASTP_a108_exhaInternalProtecti "EPASTP_a108_exhaInternalProtectionException";
BA_ "SystemSignalLongSymbol" SG_ 919 EPASTP_a109_exhaSysBusOrPeriphEr "EPASTP_a109_exhaSysBusOrPeriphErrException";
BA_ "SystemSignalLongSymbol" SG_ 919 EPASTP_a110_amPhaseRelaySwitchOf "EPASTP_a110_amPhaseRelaySwitchOffTest";
BA_ "SystemSignalLongSymbol" SG_ 919 EPASTP_a111_amCurrentSensingDisc "EPASTP_a111_amCurrentSensingDisconnection";
BA_ "SystemSignalLongSymbol" SG_ 919 EPASTP_a112_rsthSafetyFlipflopEr "EPASTP_a112_rsthSafetyFlipflopErr";
BA_ "SystemSignalLongSymbol" SG_ 919 EPASTP_a113_rsthUncorrectableEnd "EPASTP_a113_rsthUncorrectableEndToEndBusErr";
BA_ "SystemSignalLongSymbol" SG_ 919 EPASTP_a115_mcusscLbistSingleFai "EPASTP_a115_mcusscLbistSingleFail";
BA_ "SystemSignalLongSymbol" SG_ 919 EPASTP_a116_mrccStartupRegCsErro "EPASTP_a116_mrccStartupRegCsErrorStaticErr";
BA_ "SystemSignalLongSymbol" SG_ 919 EPASTP_a117_mrccStartupRegCsErro "EPASTP_a117_mrccStartupRegCsErrorTransientErr";
BA_ "SystemSignalLongSymbol" SG_ 919 EPASTP_a118_mcusscFlashCsErrorEr "EPASTP_a118_mcusscFlashCsErrorErr";
BA_ "SystemSignalLongSymbol" SG_ 919 EPASTP_a119_mcusscFlashEccCritic "EPASTP_a119_mcusscFlashEccCriticalErr";
BA_ "SystemSignalLongSymbol" SG_ 919 EPASTP_a120_mcusscFlashEccLatent "EPASTP_a120_mcusscFlashEccLatentErr";
BA_ "SystemSignalLongSymbol" SG_ 919 EPASTP_a124_mcusscMbistEccTransi "EPASTP_a124_mcusscMbistEccTransientErr";
BA_ "SystemSignalLongSymbol" SG_ 919 EPASTP_a127_exchAdditionalExcept "EPASTP_a127_exchAdditionalExceptionAfterRst";
BA_ "SystemSignalLongSymbol" SG_ 919 EPASTP_a128_exchExceptionStopRes "EPASTP_a128_exchExceptionStopRestart";
BA_ "SystemSignalLongSymbol" SG_ 919 EPASTP_a129_exchAdditionalExcept "EPASTP_a129_exchAdditionalExceptionStopRestart";
BA_ "SystemSignalLongSymbol" SG_ 919 EPASTP_a131_exchGuardedResetAfte "EPASTP_a131_exchGuardedResetAfterPartitionStop";
BA_ "SystemSignalLongSymbol" SG_ 919 EPASTP_a132_mcusscNotSupportedMc "EPASTP_a132_mcusscNotSupportedMcu";
BA_ "SystemSignalLongSymbol" SG_ 919 EPASTP_a133_mcusscLbistEcuIdIsNo "EPASTP_a133_mcusscLbistEcuIdIsNotSupported";
BA_ "SystemSignalLongSymbol" SG_ 919 EPASTP_a134_osehGuardedResetAfte "EPASTP_a134_osehGuardedResetAfterErrWithoutReset";
BA_ "SystemSignalLongSymbol" SG_ 919 EPASTP_a135_tmpsfetjCalculationO "EPASTP_a135_tmpsfetjCalculationOverflowErr";
BA_ "SystemSignalLongSymbol" SG_ 919 EPASTP_a137_osehErrWithoutImmedi "EPASTP_a137_osehErrWithoutImmediateReset";
BA_ "SystemSignalLongSymbol" SG_ 919 EPASTP_a138_osehAdditionalErrWit "EPASTP_a138_osehAdditionalErrWithoutImmReset";
BA_ "SystemSignalLongSymbol" SG_ 919 EPASTP_a142_tedEmifilterDmcTempC "EPASTP_a142_tedEmifilterDmcTempChecker";
BA_ "SystemSignalLongSymbol" SG_ 919 EPASTP_a143_tedEmifilterCmcTempC "EPASTP_a143_tedEmifilterCmcTempChecker";
BA_ "SystemSignalLongSymbol" SG_ 919 EPASTP_a145_mriPeripheralRaminit "EPASTP_a145_mriPeripheralRaminitFailed";
BA_ "SystemSignalLongSymbol" SG_ 919 EPASTP_a148_mrccExitFromStandbyD "EPASTP_a148_mrccExitFromStandbyDetected";
BA_ "SystemSignalLongSymbol" SG_ 919 EPASTP_a149_amReversibleEmergenc "EPASTP_a149_amReversibleEmergencyOffRequested";
BA_ "SystemSignalLongSymbol" SG_ 919 EPASTP_a150_amExternalEmergencyO "EPASTP_a150_amExternalEmergencyOffRequested";
BA_ "SystemSignalLongSymbol" SG_ 919 EPASTP_a151_amPermanentEmergency "EPASTP_a151_amPermanentEmergencyOffRequested";
BA_ "SystemSignalLongSymbol" SG_ 919 EPASTP_a152_exchFlashEccExceptio "EPASTP_a152_exchFlashEccException";
BA_ "SystemSignalLongSymbol" SG_ 919 EPASTP_a153_sdsmBlockSelectorInv "EPASTP_a153_sdsmBlockSelectorInvalid";
BA_ "SystemSignalLongSymbol" SG_ 919 EPASTP_a154_sdsmCsErrorInvalidPr "EPASTP_a154_sdsmCsErrorInvalidPrimary";
BA_ "SystemSignalLongSymbol" SG_ 919 EPASTP_a156_amIntSerialErrSafety "EPASTP_a156_amIntSerialErrSafetyReset";
BA_ "SystemSignalLongSymbol" SG_ 919 EPASTP_a158_amGduFailDuringRecov "EPASTP_a158_amGduFailDuringRecovery";
BA_ "SystemSignalLongSymbol" SG_ 919 EPASTP_a159_exchFlashWordlineTra "EPASTP_a159_exchFlashWordlineTransientErr";
BA_ "SystemSignalLongSymbol" SG_ 919 EPASTP_a160_rsthCpu1UnexpectedAl "EPASTP_a160_rsthCpu1UnexpectedAlarm";
BA_ "SystemSignalLongSymbol" SG_ 919 EPASTP_a161_tdaRelayfetjunctionT "EPASTP_a161_tdaRelayfetjunctionTempChecker";
BA_ "SystemSignalLongSymbol" SG_ 919 EPASTP_a162_tdaBridgefetjunction "EPASTP_a162_tdaBridgefetjunctionTempChecker";
BA_ "SystemSignalLongSymbol" SG_ 919 EPASTP_a163_tdaPowermoduleTempCh "EPASTP_a163_tdaPowermoduleTempChecker";
BA_ "SystemSignalLongSymbol" SG_ 919 EPASTP_a164_tdaBattfetjunctionTe "EPASTP_a164_tdaBattfetjunctionTempChecker";
BA_ "SystemSignalLongSymbol" SG_ 919 EPASTP_a165_tdaDcbusshuntTempChe "EPASTP_a165_tdaDcbusshuntTempChecker";
BA_ "SystemSignalLongSymbol" SG_ 919 EPASTP_a166_tdaPhasecurrentshunt "EPASTP_a166_tdaPhasecurrentshuntTempChecker";
BA_ "SystemSignalLongSymbol" SG_ 919 EPASTP_a167_iccd1ErrQueueOverflo "EPASTP_a167_iccd1ErrQueueOverflow";
BA_ "SystemSignalLongSymbol" SG_ 919 EPASTP_a172_pmpElangMotorcurrent "EPASTP_a172_pmpElangMotorcurrentAge";
BA_ "SystemSignalLongSymbol" SG_ 919 EPASTP_a175_exchFlashStoredConfi "EPASTP_a175_exchFlashStoredConfigErr";
BA_ "SystemSignalLongSymbol" SG_ 919 EPASTP_a176_exchCpu1ExceptionRes "EPASTP_a176_exchCpu1ExceptionReset";
BA_ "SystemSignalLongSymbol" SG_ 919 EPASTP_a179_tedMotorcoilTempChec "EPASTP_a179_tedMotorcoilTempChecker";
BA_ "SystemSignalLongSymbol" SG_ 919 EPASTP_a180_dmDeadlineViolationC "EPASTP_a180_dmDeadlineViolationC1";
BA_ "SystemSignalLongSymbol" SG_ 919 EPASTP_a181_dmDeadlineViolationC "EPASTP_a181_dmDeadlineViolationC1";
BA_ "SystemSignalLongSymbol" SG_ 919 EPASTP_a184_sbcmCommBufferOverfl "EPASTP_a184_sbcmCommBufferOverflow";
BA_ "SystemSignalLongSymbol" SG_ 919 EPASTP_a185_sbcscpQAWatchdogRese "EPASTP_a185_sbcscpQAWatchdogReset";
BA_ "SystemSignalLongSymbol" SG_ 919 EPASTP_a186_wdhCommBufferOverflo "EPASTP_a186_wdhCommBufferOverflow";
BA_ "SystemSignalLongSymbol" SG_ 919 EPASTP_a188_epmCommBufferOverflo "EPASTP_a188_epmCommBufferOverflow";
BA_ "SystemSignalLongSymbol" SG_ 919 EPASTP_a190_sbchCommBufferOverfl "EPASTP_a190_sbchCommBufferOverflow";
BA_ "SystemSignalLongSymbol" SG_ 919 EPASTP_a191_sbcscpVcp2VucVoltFai "EPASTP_a191_sbcscpVcp2VucVoltFail";
BA_ "SystemSignalLongSymbol" SG_ 919 EPASTP_a196_topEolTasOffsetInval "EPASTP_a196_topEolTasOffsetInvalid";
BA_ "SystemSignalLongSymbol" SG_ 919 EPASTP_a200_ammInputBufferOverfl "EPASTP_a200_ammInputBufferOverflow";
BA_ "SystemSignalLongSymbol" SG_ 919 EPASTP_a201_ammOutputBufferOverf "EPASTP_a201_ammOutputBufferOverflow";
BA_ "SystemSignalLongSymbol" SG_ 919 EPASTP_a202_ohnvmpStoredOffsetLo "EPASTP_a202_ohnvmpStoredOffsetLost";
BA_ "SystemSignalLongSymbol" SG_ 919 EPASTP_a206_fdrOclPartialBlockin "EPASTP_a206_fdrOclPartialBlocking";
BA_ "SystemSignalLongSymbol" SG_ 919 EPASTP_a208_fdrLowSeverityBlocki "EPASTP_a208_fdrLowSeverityBlocking";
BA_ "SystemSignalLongSymbol" SG_ 919 EPASTP_a209_fdrLowSeverityFreezi "EPASTP_a209_fdrLowSeverityFreezing";
BA_ "SystemSignalLongSymbol" SG_ 919 EPASTP_a213_frmHighFrictionDetec "EPASTP_a213_frmHighFrictionDetected";
BA_ "SystemSignalLongSymbol" SG_ 919 EPASTP_a218_aadApplicationStateE "EPASTP_a218_aadApplicationStateErr";
BA_ "SystemSignalLongSymbol" SG_ 919 EPASTP_a258_pspInvalidProjectPar "EPASTP_a258_pspInvalidProjectParamset";
BA_ "SystemSignalLongSymbol" SG_ 919 EPASTP_a270_oscillationCompTrqLi "EPASTP_a270_oscillationCompTrqLimReached";
VAL_ 999 DPB_matrixIndex 5 "AlertMatrix5" 4 "AlertMatrix4" 3 "AlertMatrix3" 2 "AlertMatrix2" 1 "AlertMatrix1" 0 "AlertMatrix0" ;
VAL_ 1427 EPASTP_alertID 270 "a270_oscillationCompTrqLimReached" 269 "a269_assistTorqueDisabled" 268 "a268_eacCancelled" 267 "a267_safeSpeedAssist" 266 "a266_overloadProtect" 265 "a265_overheatProtect" 264 "a264_assistTorqueLimited" 263 "a263_espWsStatus" 262 "a262_yawRateStatus" 261 "a261_sccmStatusError" 260 "a260_scoPrivateBusOff" 259 "a259_scoCanBusOff" 258 "a258_pspInvalidProjectParamset" 257 "a257_dcvmUnderVolt" 256 "a256_dcvmOverVolt" 255 "a255_pmState2Mia" 254 "a254_vcFrontMia" 253 "a253_vcFrontCsError" 252 "a252_vcFrontCntError" 251 "a251_uiTuneReqMia" 250 "a250_uiTuneReqCsError" 249 "a249_uiTuneReqCntError" 248 "a248_sccmMia" 247 "a247_sccmCsError" 246 "a246_sccmCntError" 245 "a245_rcmMia" 244 "a244_rcmCsError" 243 "a243_rcmCntError" 242 "a242_gtwConfigMia" 241 "a241_espWsMia" 240 "a240_espWsCsError" 239 "a239_espWsCntError" 238 "a238_espWrMia" 237 "a237_espWrCsError" 236 "a236_espWrCntError" 235 "a235_ecu2StatMia" 234 "a234_ecu2StatCsError" 233 "a233_ecu2StatCntError" 232 "a232_diSpdMia" 231 "a231_diSpdCsError" 230 "a230_diSpdCntError" 229 "a229_dirTorqueMia" 228 "a228_dirTorqueCsError" 227 "a227_dirTorqueCntError" 226 "a226_dasMia" 225 "a225_dasCsError" 224 "a224_dasCntError" 223 "a223_apsMia" 222 "a222_apsCsError" 221 "a221_apsCntError" 219 "a219_frhFastRestartFailed" 218 "a218_aadApplicationStateErr" 217 "a217_msdMasterSilentErr" 216 "a216_isdgImproperShutdown" 215 "a215_vsgSafeViolErr" 214 "a214_velInterfaceErr" 213 "a213_frmHighFrictionDetected" 212 "a212_frmDataLost" 211 "a211_frmInternalErr" 210 "a210_fdrTotalBlocking" 209 "a209_fdrLowSeverityFreezing" 208 "a208_fdrLowSeverityBlocking" 207 "a207_fdrOclFreezing" 206 "a206_fdrOclPartialBlocking" 205 "a205_fdrOclFail" 204 "a204_fdpPrevTrqErr" 203 "a203_ctcInterfaceErr" 202 "a202_ohnvmpStoredOffsetLost" 201 "a201_ammOutputBufferOverflow" 200 "a200_ammInputBufferOverflow" 199 "a199_osumC1StackNearFull" 198 "a198_osumC1CsaNearFull" 197 "a197_difpDifactorInvalid" 196 "a196_topEolTasOffsetInvalid" 195 "a195_imcmCommErrC1" 194 "a194_amNvdataLoss" 193 "a193_osumC0StackNearFull" 192 "a192_osumC0CsaNearFull" 191 "a191_sbcscpVcp2VucVoltFail" 190 "a190_sbchCommBufferOverflow" 189 "a189_sbchCommErrMcuToSbc" 188 "a188_epmCommBufferOverflow" 187 "a187_epmVoltFail" 186 "a186_wdhCommBufferOverflow" 185 "a185_sbcscpQAWatchdogReset" 184 "a184_sbcmCommBufferOverflow" 183 "a183_sbchCommErrSbcToMcu" 182 "a182_mcdInputMia" 181 "a181_dmDeadlineViolationC1" 180 "a180_dmDeadlineViolationC1" 179 "a179_tedMotorcoilTempChecker" 178 "a178_exchWdtException" 177 "a177_etsrInvalidated" 176 "a176_exchCpu1ExceptionReset" 175 "a175_exchFlashStoredConfigErr" 174 "a174_pmpPhasecurrentAge" 173 "a173_pmpRotorspeedAge" 172 "a172_pmpElangMotorcurrentAge" 171 "a171_pmpKgvalueAge" 170 "a170_pmpDcvoltAge" 169 "a169_scpSafetyReset" 168 "a168_c1csInvalidC1App" 167 "a167_iccd1ErrQueueOverflow" 166 "a166_tdaPhasecurrentshuntTempChecker" 165 "a165_tdaDcbusshuntTempChecker" 164 "a164_tdaBattfetjunctionTempChecker" 163 "a163_tdaPowermoduleTempChecker" 162 "a162_tdaBridgefetjunctionTempChecker" 161 "a161_tdaRelayfetjunctionTempChecker" 160 "a160_rsthCpu1UnexpectedAlarm" 159 "a159_exchFlashWordlineTransientErr" 158 "a158_amGduFailDuringRecovery" 157 "a157_mcudcpInvalidEcuId" 156 "a156_amIntSerialErrSafetyReset" 155 "a155_sdsmDataInvalidAll" 154 "a154_sdsmCsErrorInvalidPrimary" 153 "a153_sdsmBlockSelectorInvalid" 152 "a152_exchFlashEccException" 151 "a151_amPermanentEmergencyOffRequested" 150 "a150_amExternalEmergencyOffRequested" 149 "a149_amReversibleEmergencyOffRequested" 148 "a148_mrccExitFromStandbyDetected" 147 "a147_amDcLinkShortedFail" 146 "a146_btarcRcCircuitCheck" 145 "a145_mriPeripheralRaminitFailed" 144 "a144_mriCoreRaminitFailed" 143 "a143_tedEmifilterCmcTempChecker" 142 "a142_tedEmifilterDmcTempChecker" 141 "a141_amFetShortTest" 140 "a140_imcmConfigurationErr" 139 "a139_osehAdditionalOsErr" 138 "a138_osehAdditionalErrWithoutImmReset" 137 "a137_osehErrWithoutImmediateReset" 136 "a136_ftElectricalAngleQf" 135 "a135_tmpsfetjCalculationOverflowErr" 134 "a134_osehGuardedResetAfterErrWithoutReset" 133 "a133_mcusscLbistEcuIdIsNotSupported" 132 "a132_mcusscNotSupportedMcu" 131 "a131_exchGuardedResetAfterPartitionStop" 130 "a130_mrccConfigCsErrorErr" 129 "a129_exchAdditionalExceptionStopRestart" 128 "a128_exchExceptionStopRestart" 127 "a127_exchAdditionalExceptionAfterRst" 126 "a126_mcusscMonbistMiaErr" 125 "a125_mcusscMbistMiaErr" 124 "a124_mcusscMbistEccTransientErr" 123 "a123_imcmCommErr" 122 "a122_pcpBridgeFetShort" 121 "a121_mcusscMbistEccErr" 120 "a120_mcusscFlashEccLatentErr" 119 "a119_mcusscFlashEccCriticalErr" 118 "a118_mcusscFlashCsErrorErr" 117 "a117_mrccStartupRegCsErrorTransientErr" 116 "a116_mrccStartupRegCsErrorStaticErr" 115 "a115_mcusscLbistSingleFail" 114 "a114_osehOsErr" 113 "a113_rsthUncorrectableEndToEndBusErr" 112 "a112_rsthSafetyFlipflopErr" 111 "a111_amCurrentSensingDisconnection" 110 "a110_amPhaseRelaySwitchOffTest" 109 "a109_exhaSysBusOrPeriphErrException" 108 "a108_exhaInternalProtectionException" 107 "a107_exhaOtherNmiException" 106 "a106_exhaSpbBusErrException" 105 "a105_exhaSriBusErrException" 104 "a104_exhaBusMpuException" 103 "a103_exhaUnusedInterruptCallException" 102 "a102_amPhasecurrentQosErr" 101 "a101_sdrvSpcIdMismatch" 100 "a100_amVbrgLssFault" 99 "a099_mcdTorqueMismatchFault" 98 "a098_invErr" 97 "a097_rppRpsMultipleStaticFail" 96 "a096_rppRpsSingleStaticFail" 95 "a095_mdModelBasedMotorIntegrityCheck" 94 "a094_sctpTsuMultipleStaticFail" 93 "a093_sctpTsuSingleStaticFail" 92 "a092_amGduSwitchOffTestBySbc" 91 "a091_bvpBattVoltCrossChkFailed" 90 "a090_etsmWarning" 89 "a089_tedRevercebattfetjunctionTempChecker" 88 "a088_tedMainboardTempChecker" 87 "a087_rsthFlashConfigErr" 86 "a086_rsthRamUncorrEcc" 85 "a085_amGduSwitchOffTestByMcu" 84 "a084_adcTriggerCheck" 83 "a083_tdaDclinkcapacitorTempChecker" 82 "a082_adcTriggerTimeChk" 81 "a081_exchFloatingPointException" 80 "a080_pwmTimerSyncCheck" 79 "a079_gduhComErr" 78 "a078_dmDeadlineViolation" 77 "a077_dmDeadlineViolation" 76 "a076_exchGeneralException" 75 "a075_rsthUnusedOtherModuleAlarm" 74 "a074_rsthUnexpectedAlarm" 73 "a073_rsthOtherEdcEcc" 72 "a072_rsthFlashUncorrEccOrOvfl" 71 "a071_rsthInternalHighVolt" 70 "a070_rsthInternalLowVolt" 69 "a069_rsthCoreTempOutOfRangeHwCheck" 68 "a068_rsthCoreRedundancyErr" 67 "a067_tspmPowermoduleTempImplausible" 66 "a066_amVoltQfErr" 65 "a065_amGduJuncTemp" 64 "a064_amBridgeShort" 63 "a063_amIntRegulatorErr" 62 "a062_amPhaseBridgeCheck" 61 "a061_amIntSerialErr" 60 "a060_amGduFail" 59 "a059_amStartupTestFailed" 58 "a058_amIntVgsUndervtgErr" 57 "a057_amGduVds" 56 "a056_amGduConfigCsErrorCheck" 55 "a055_amExtendedGduTest" 54 "a054_adcUnexpectedData" 53 "a053_adcUnexpectedNumOfData" 52 "a052_ermSdcInputBufferOverflow" 51 "a051_ermMessageErr" 50 "a050_erlErr" 49 "a049_epmLgFail" 48 "a048_epmVcpVoltFail" 47 "a047_epmVregVoltFail" 46 "a046_mcusscOscillatorNotReliable" 45 "a045_psumSbcBandgapVoltErr" 44 "a044_sbcmSbcEepromFail" 43 "a043_sbcmWdStateDisabled" 42 "a042_wdhWdTestFail" 41 "a041_imcmCoreConfigurationMismatch" 40 "a040_swrhLimitedResetRetriesExpired" 39 "a039_csohCh2CsErrorErrAtReset" 38 "a038_csohCh1CsErrorErrAtReset" 37 "a037_epmV5P2Fail" 36 "a036_sbcmSbcBistFailed" 35 "a035_sbchChipIdFail" 34 "a034_sbchReadbackRegFail" 33 "a033_icsvcPswVersionMismatch" 32 "a032_eolpEolCheckFailed" 31 "a031_pmsProductionModeFailed" 30 "a030_rsthClockReset" 29 "a029_smuhSmuCoreCntErrorTestFail" 28 "a028_smuhNonInitDataCorruption" 27 "a027_mcusscDmuHfErr" 26 "a026_mrccCsErrorCheckFail" 25 "a025_btarcCorruptionCheck" 24 "a024_srhCsErrorCheckFail" 23 "a023_btarcCorruptionCheck" 22 "a022_swrhSwResetInfoCorruptionCheck" 21 "a021_osehCsErrorCheck" 20 "a020_mcusscEolEcuIdIntegritiyFail" 19 "a019_rsthHwResetInfoCorruptionCheck" 18 "a018_exchCsErrorCheck" 17 "a017_stmdStmPlausibilityCheckErr" 16 "a016_mcufcCsErrorCheckFail" 15 "a015_mcusscCsErrorCheckFail" 14 "a014_mcusscSffMonitoringMia" 13 "a013_mcusscSffMonitoringFailed" 12 "a012_mcusscMbistEccErr" 11 "a011_mcusscMonbistErr" 10 "a010_svcIncompatibleSwVersions" 9 "a009_mcusscLbistPermanentFail" 8 "a008_psdcPlatformShutdown" 7 "a007_tsmcCoreTempDiff" 6 "a006_swrhResetByInvalidErrid" 5 "a005_scpUnknownResetSource" 4 "a004_scpInputMia" 3 "a003_pspInvalidParamset" 2 "a002_adcMuxErr" 1 "a001_adcCalibrationOrInitFail" 0 "ALERT_DO_NOT_USE_ZERO" ;
VAL_ 1427 EPASTP_alertState 1 "SET" 0 "CLEARED" ;
VAL_ 1427 EPASTP_a264_degradedECU 3 "BOTH_ECU_SIDES" 2 "OTHER_ECU_SIDE" 1 "OWN_ECU_SIDE" 0 "NONE" ;
VAL_ 1427 EPASTP_a264_ownSideDegradationRe 92 "DC_LINK_CAPACITOR_HOTSPOTCASEDIFF_TEMPERATURE" 84 "PHASECURRENT_SHUNT_TEMPERATURE_MOMENTARY" 80 "DC_LINK_CAPACITOR_TEMPERATURE" 52 "EMIFILTER_DMC_TEMPERATURE" 48 "EMIFILTER_CMC_TEMPERATURE" 44 "DCLINK_SHUNT_TEMPERATURE" 40 "PHASECURRENT_SHUNT_TEMPERATURE" 36 "POWER_MODULE_TEMPERATURE" 32 "MOTOR_COIL_TEMPERATURE" 28 "BATTERY_FET_JUNCTION_TEMPERATURE" 24 "MAIN_BOARD_TEMPERATURE" 20 "REVERSE_BATTERY_FET_JUNCTION_TEMPERATURE" 12 "RELAY_FET_JUNCTION_TEMPERATURE" 8 "BRIDGE_FET_JUNCTION_TEMPERATURE" 4 "CORE1_DEGRADATION" 0 "NO_DEGRADATION_ON_THIS_ECU_SIDE" ;
VAL_ 1427 EPASTP_a264_otherSideDegradation 92 "DC_LINK_CAPACITOR_HOTSPOTCASEDIFF_TEMPERATURE" 84 "PHASECURRENT_SHUNT_TEMPERATURE_MOMENTARY" 80 "DC_LINK_CAPACITOR_TEMPERATURE" 52 "EMIFILTER_DMC_TEMPERATURE" 48 "EMIFILTER_CMC_TEMPERATURE" 44 "DCLINK_SHUNT_TEMPERATURE" 40 "PHASECURRENT_SHUNT_TEMPERATURE" 36 "POWER_MODULE_TEMPERATURE" 32 "MOTOR_COIL_TEMPERATURE" 28 "BATTERY_FET_JUNCTION_TEMPERATURE" 24 "MAIN_BOARD_TEMPERATURE" 20 "REVERSE_BATTERY_FET_JUNCTION_TEMPERATURE" 12 "RELAY_FET_JUNCTION_TEMPERATURE" 8 "BRIDGE_FET_JUNCTION_TEMPERATURE" 4 "CORE1_DEGRADATION" 0 "NO_DEGRADATION_ON_THIS_ECU_SIDE" ;
VAL_ 1427 EPASTP_a265_degradedECU 3 "BOTH_ECU_SIDES" 2 "OTHER_ECU_SIDE" 1 "OWN_ECU_SIDE" 0 "NONE" ;
VAL_ 1427 EPASTP_a267_velocityEstimatorSta 5 "BACKUP_MOTOR" 4 "BACKUP_WHEELS_B" 3 "BACKUP_WHEELS_A" 2 "WHEELS_REDUCED" 1 "WHEELS_NORMAL" 0 "NOT_INITIALIZED" ;
VAL_ 919 EPASTP_matrixIndex 4 "AlertMatrix4" 3 "AlertMatrix3" 2 "AlertMatrix2" 1 "AlertMatrix1" 0 "AlertMatrix0" ;
