VERSION "dbc-export 1 2025.20.8"

NS_ :

BS_:

BU_: APP BMS CC CMP CMPD CP DAS DI DIF DIR EPBL EPBR EVSE FC GTW HCML HCMR HVP ICR PCS PM PMF PMR PTC SCCM SCM SCS SDCR TAS UMC VC VCFRONT VCLEFT VCRIGHT VCSEC

BO_ 1332 VCFRONT_alertLog: 8 VCFRONT
 SG_ VCFRONT_alertID M : 0|10@1+ (1,0) [0|1023] "" Vector__XXX
 SG_ VCFRONT_a092_VEH_restraintStatus m92 : 16|1@1+ (1,0) [0|1] "" Vector__XXX
 SG_ VCFRONT_a092_VEH_switchStatus m92 : 17|1@1+ (1,0) [0|1] "" Vector__XXX
 SG_ VCFRONT_a092_VEH_seatStatus2 m92 : 18|1@1+ (1,0) [0|1] "" Vector__XXX
 SG_ VCFRONT_a092_VEH_vehNm m92 : 19|1@1+ (1,0) [0|1] "" Vector__XXX
 SG_ VCFRONT_a093_VEH_restraintStatus m93 : 16|1@1+ (1,0) [0|1] "" Vector__XXX
 SG_ VCFRONT_a093_VEH_switchStatus m93 : 17|1@1+ (1,0) [0|1] "" Vector__XXX
 SG_ VCFRONT_a093_VEH_seatStatus2 m93 : 18|1@1+ (1,0) [0|1] "" Vector__XXX
 SG_ VCFRONT_a093_VEH_vehNm m93 : 19|1@1+ (1,0) [0|1] "" Vector__XXX
 SG_ VCFRONT_a094_VEH_sysStatus m94 : 16|1@1+ (1,0) [0|1] "" Vector__XXX
 SG_ VCFRONT_a094_PARTY_sysStatus m94 : 17|1@1+ (1,0) [0|1] "" Vector__XXX
 SG_ VCFRONT_a095_PT_ptNm m95 : 16|1@1+ (1,0) [0|1] "" Vector__XXX
 SG_ VCFRONT_a095_PT_status m95 : 17|1@1+ (1,0) [0|1] "" Vector__XXX
 SG_ VCFRONT_a096_VEH_status m96 : 16|1@1+ (1,0) [0|1] "" Vector__XXX
 SG_ VCFRONT_a096_CH_status m96 : 17|1@1+ (1,0) [0|1] "" Vector__XXX
 SG_ VCFRONT_a098_CH_torque m98 : 16|1@1+ (1,0) [0|1] "" Vector__XXX
 SG_ VCFRONT_a098_VEH_hvStatus m98 : 17|1@1+ (1,0) [0|1] "" Vector__XXX
 SG_ VCFRONT_a098_VEH_status m98 : 18|1@1+ (1,0) [0|1] "" Vector__XXX
 SG_ VCFRONT_a098_VEH_thermalControl m98 : 19|1@1+ (1,0) [0|1] "" Vector__XXX
 SG_ VCFRONT_a098_VEH_temperature m98 : 20|1@1+ (1,0) [0|1] "" Vector__XXX
 SG_ VCFRONT_a098_VEH_torque m98 : 21|1@1+ (1,0) [0|1] "" Vector__XXX
 SG_ VCFRONT_a098_PARTY_status m98 : 22|1@1+ (1,0) [0|1] "" Vector__XXX
 SG_ VCFRONT_a098_PARTY_temperature m98 : 23|1@1+ (1,0) [0|1] "" Vector__XXX
 SG_ VCFRONT_a098_PARTY_thermalContro m98 : 24|1@1+ (1,0) [0|1] "" Vector__XXX
 SG_ VCFRONT_a098_PARTY_torque m98 : 25|1@1+ (1,0) [0|1] "" Vector__XXX
 SG_ VCFRONT_a098_PT_thermalControl m98 : 26|1@1+ (1,0) [0|1] "" Vector__XXX
 SG_ VCFRONT_a098_PT_temperature m98 : 27|1@1+ (1,0) [0|1] "" Vector__XXX
 SG_ VCFRONT_a099_VEH_oocStatus m99 : 16|1@1+ (1,0) [0|1] "" Vector__XXX
 SG_ VCFRONT_a100_VEH m100 : 16|1@1+ (1,0) [0|1] "" Vector__XXX
 SG_ VCFRONT_a100_PARTY m100 : 17|1@1+ (1,0) [0|1] "" Vector__XXX
 SG_ VCFRONT_a100_PT m100 : 18|1@1+ (1,0) [0|1] "" Vector__XXX
 SG_ VCFRONT_a100_CH m100 : 19|1@1+ (1,0) [0|1] "" Vector__XXX
 SG_ VCFRONT_a100_OBD m100 : 20|1@1+ (1,0) [0|1] "" Vector__XXX
 SG_ VCFRONT_a101_VEH_state m101 : 16|1@1+ (1,0) [0|1] "" Vector__XXX
 SG_ VCFRONT_a101_PARTY_locState m101 : 17|1@1+ (1,0) [0|1] "" Vector__XXX
 SG_ VCFRONT_a101_LIPC_externalWatchd m101 : 18|1@1+ (1,0) [0|1] "" Vector__XXX
 SG_ VCFRONT_a101_VEH_locState m101 : 19|1@1+ (1,0) [0|1] "" Vector__XXX
 SG_ VCFRONT_a101_BDY_locState m101 : 20|1@1+ (1,0) [0|1] "" Vector__XXX
 SG_ VCFRONT_a102_VEH_faultsAndExtras m102 : 16|1@1+ (1,0) [0|1] "" Vector__XXX
 SG_ VCFRONT_a102_VEH_feedbackStatus m102 : 17|1@1+ (1,0) [0|1] "" Vector__XXX
 SG_ VCFRONT_a102_VEH_sensorStatus m102 : 18|1@1+ (1,0) [0|1] "" Vector__XXX
 SG_ VCFRONT_a102_VEH_rods m102 : 19|1@1+ (1,0) [0|1] "" Vector__XXX
 SG_ VCFRONT_a103_VEH_hvsNm m103 : 16|1@1+ (1,0) [0|1] "" Vector__XXX
 SG_ VCFRONT_a103_VEH_vehNm m103 : 17|1@1+ (1,0) [0|1] "" Vector__XXX
 SG_ VCFRONT_a103_VEH_status m103 : 18|1@1+ (1,0) [0|1] "" Vector__XXX
 SG_ VCFRONT_a103_PT_ptNm m103 : 19|1@1+ (1,0) [0|1] "" Vector__XXX
 SG_ VCFRONT_a103_PT_status m103 : 20|1@1+ (1,0) [0|1] "" Vector__XXX
 SG_ VCFRONT_a103_VEH_evseStatus m103 : 21|1@1+ (1,0) [0|1] "" Vector__XXX
 SG_ VCFRONT_a105_VEH_states m105 : 16|1@1+ (1,0) [0|1] "" Vector__XXX
 SG_ VCFRONT_a105_VEH_chNm m105 : 17|1@1+ (1,0) [0|1] "" Vector__XXX
 SG_ VCFRONT_a105_VEH_dampingStates m105 : 18|1@1+ (1,0) [0|1] "" Vector__XXX
 SG_ VCFRONT_a106_VEH_dcdcStatus m106 : 16|1@1+ (1,0) [0|1] "" Vector__XXX
 SG_ VCFRONT_a106_VEH_thermalControl m106 : 17|1@1+ (1,0) [0|1] "" Vector__XXX
 SG_ VCFRONT_a106_VEH_thermalInterfac m106 : 18|1@1+ (1,0) [0|1] "" Vector__XXX
 SG_ VCFRONT_a106_VEH_dcdcRailStatus m106 : 19|1@1+ (1,0) [0|1] "" Vector__XXX
 SG_ VCFRONT_a106_CH_dcdcRailStatus m106 : 20|1@1+ (1,0) [0|1] "" Vector__XXX
 SG_ VCFRONT_a106_CH_alertMatrix m106 : 21|1@1+ (1,0) [0|1] "" Vector__XXX
 SG_ VCFRONT_a107_VEH_hvsNm m107 : 16|1@1+ (1,0) [0|1] "" Vector__XXX
 SG_ VCFRONT_a107_VEH_vehNm m107 : 17|1@1+ (1,0) [0|1] "" Vector__XXX
 SG_ VCFRONT_a107_VEH_status m107 : 18|1@1+ (1,0) [0|1] "" Vector__XXX
 SG_ VCFRONT_a107_VEH_thermalStatus m107 : 19|1@1+ (1,0) [0|1] "" Vector__XXX
 SG_ VCFRONT_a107_VEH_thermalStatus2 m107 : 20|1@1+ (1,0) [0|1] "" Vector__XXX
 SG_ VCFRONT_a107_VEH_bmbMinMax m107 : 21|1@1+ (1,0) [0|1] "" Vector__XXX
 SG_ VCFRONT_a107_VEH_powerAvailable m107 : 22|1@1+ (1,0) [0|1] "" Vector__XXX
 SG_ VCFRONT_a107_PT_ptNm m107 : 23|1@1+ (1,0) [0|1] "" Vector__XXX
 SG_ VCFRONT_a107_PT_status m107 : 24|1@1+ (1,0) [0|1] "" Vector__XXX
 SG_ VCFRONT_a107_PT_thermalStatus m107 : 25|1@1+ (1,0) [0|1] "" Vector__XXX
 SG_ VCFRONT_a107_PT_socStatus m107 : 26|1@1+ (1,0) [0|1] "" Vector__XXX
 SG_ VCFRONT_a107_VEH_socStatus m107 : 27|1@1+ (1,0) [0|1] "" Vector__XXX
 SG_ VCFRONT_a107_VEH_packConfig m107 : 28|1@1+ (1,0) [0|1] "" Vector__XXX
 SG_ VCFRONT_a107_VEH_energyStatus m107 : 29|1@1+ (1,0) [0|1] "" Vector__XXX
 SG_ VCFRONT_a107_VEH_chargeInfo m107 : 30|1@1+ (1,0) [0|1] "" Vector__XXX
 SG_ VCFRONT_a108_VEH_hvStatus m108 : 16|1@1+ (1,0) [0|1] "" Vector__XXX
 SG_ VCFRONT_a108_VEH_temperature m108 : 17|1@1+ (1,0) [0|1] "" Vector__XXX
 SG_ VCFRONT_a108_VEH_thermalControl m108 : 18|1@1+ (1,0) [0|1] "" Vector__XXX
 SG_ VCFRONT_a108_VEH_torque m108 : 19|1@1+ (1,0) [0|1] "" Vector__XXX
 SG_ VCFRONT_a108_VEH_status m108 : 20|1@1+ (1,0) [0|1] "" Vector__XXX
 SG_ VCFRONT_a108_PARTY_torque m108 : 21|1@1+ (1,0) [0|1] "" Vector__XXX
 SG_ VCFRONT_a108_PARTY_status m108 : 22|1@1+ (1,0) [0|1] "" Vector__XXX
 SG_ VCFRONT_a108_PARTY_temperature m108 : 23|1@1+ (1,0) [0|1] "" Vector__XXX
 SG_ VCFRONT_a108_PARTY_thermalContro m108 : 24|1@1+ (1,0) [0|1] "" Vector__XXX
 SG_ VCFRONT_a108_PT_temperature m108 : 25|1@1+ (1,0) [0|1] "" Vector__XXX
 SG_ VCFRONT_a108_PT_thermalControl m108 : 26|1@1+ (1,0) [0|1] "" Vector__XXX
 SG_ VCFRONT_a109_PARTY_status m109 : 16|1@1+ (1,0) [0|1] "" Vector__XXX
 SG_ VCFRONT_a109_PARTY_inertial2 m109 : 17|1@1+ (1,0) [0|1] "" Vector__XXX
 SG_ VCFRONT_a109_PARTY_nearDeploy m109 : 18|1@1+ (1,0) [0|1] "" Vector__XXX
 SG_ VCFRONT_a109_PARTY_collision m109 : 19|1@1+ (1,0) [0|1] "" Vector__XXX
 SG_ VCFRONT_a109_VEH_status m109 : 20|1@1+ (1,0) [0|1] "" Vector__XXX
 SG_ VCFRONT_a109_VEH_imuOffsets m109 : 21|1@1+ (1,0) [0|1] "" Vector__XXX
 SG_ VCFRONT_a109_PARTY_inertial1 m109 : 22|1@1+ (1,0) [0|1] "" Vector__XXX
 SG_ VCFRONT_a109_BDY_imuOffsets m109 : 23|1@1+ (1,0) [0|1] "" Vector__XXX
 SG_ VCFRONT_a109_BDY_inertial1 m109 : 24|1@1+ (1,0) [0|1] "" Vector__XXX
 SG_ VCFRONT_a109_BDY_inertial2 m109 : 25|1@1+ (1,0) [0|1] "" Vector__XXX
 SG_ VCFRONT_a109_BDY_status m109 : 26|1@1+ (1,0) [0|1] "" Vector__XXX
 SG_ VCFRONT_a109_VEH_inertial1 m109 : 27|1@1+ (1,0) [0|1] "" Vector__XXX
 SG_ VCFRONT_a109_VEH_inertial2 m109 : 28|1@1+ (1,0) [0|1] "" Vector__XXX
 SG_ VCFRONT_a109_CH_inertial1 m109 : 29|1@1+ (1,0) [0|1] "" Vector__XXX
 SG_ VCFRONT_a109_CH_inertial2 m109 : 30|1@1+ (1,0) [0|1] "" Vector__XXX
 SG_ VCFRONT_a109_CH_status m109 : 31|1@1+ (1,0) [0|1] "" Vector__XXX
 SG_ VCFRONT_a110_VEH_status m110 : 16|1@1+ (1,0) [0|1] "" Vector__XXX
 SG_ VCFRONT_a110_VEH_carState m110 : 17|1@1+ (1,0) [0|1] "" Vector__XXX
 SG_ VCFRONT_a110_VEH_carConfig m110 : 18|1@1+ (1,0) [0|1] "" Vector__XXX
 SG_ VCFRONT_a110_VEH_time m110 : 19|1@1+ (1,0) [0|1] "" Vector__XXX
 SG_ VCFRONT_a110_VEH_updateStatus m110 : 20|1@1+ (1,0) [0|1] "" Vector__XXX
 SG_ VCFRONT_a110_VEH_vehNm m110 : 21|1@1+ (1,0) [0|1] "" Vector__XXX
 SG_ VCFRONT_a110_VEH_mismatchFault m110 : 22|1@1+ (1,0) [0|1] "" Vector__XXX
 SG_ VCFRONT_a110_VEH_vin m110 : 23|1@1+ (1,0) [0|1] "" Vector__XXX
 SG_ VCFRONT_a110_VEH_bmpDebug m110 : 24|1@1+ (1,0) [0|1] "" Vector__XXX
 SG_ VCFRONT_a110_VEH_gearControl m110 : 25|1@1+ (1,0) [0|1] "" Vector__XXX
 SG_ VCFRONT_a110_VEH_canLogAvailabil m110 : 26|1@1+ (1,0) [0|1] "" Vector__XXX
 SG_ VCFRONT_a110_CH_airbagCutoffStat m110 : 27|1@1+ (1,0) [0|1] "" Vector__XXX
 SG_ VCFRONT_a110_CH_carConfig m110 : 28|1@1+ (1,0) [0|1] "" Vector__XXX
 SG_ VCFRONT_a110_CH_carState m110 : 29|1@1+ (1,0) [0|1] "" Vector__XXX
 SG_ VCFRONT_a110_CH_vin m110 : 30|1@1+ (1,0) [0|1] "" Vector__XXX
 SG_ VCFRONT_a110_CH_chNm m110 : 31|1@1+ (1,0) [0|1] "" Vector__XXX
 SG_ VCFRONT_a110_CH_epochTimeGtw m110 : 32|1@1+ (1,0) [0|1] "" Vector__XXX
 SG_ VCFRONT_a111_VEH_internalStatus m111 : 16|1@1+ (1,0) [0|1] "" Vector__XXX
 SG_ VCFRONT_a111_VEH_status m111 : 17|1@1+ (1,0) [0|1] "" Vector__XXX
 SG_ VCFRONT_a111_VEH_vehNm m111 : 18|1@1+ (1,0) [0|1] "" Vector__XXX
 SG_ VCFRONT_a111_RIPC_LVPowerState m111 : 19|1@1+ (1,0) [0|1] "" Vector__XXX
 SG_ VCFRONT_a111_RIPC_epbPrivateStat m111 : 20|1@1+ (1,0) [0|1] "" Vector__XXX
 SG_ VCFRONT_a111_RIPC_railStatus m111 : 21|1@1+ (1,0) [0|1] "" Vector__XXX
 SG_ VCFRONT_a111_RIPC_remoteADC m111 : 22|1@1+ (1,0) [0|1] "" Vector__XXX
 SG_ VCFRONT_a111_RIPC_switchStatus m111 : 23|1@1+ (1,0) [0|1] "" Vector__XXX
 SG_ VCFRONT_a111_VEH_LVPowerState m111 : 24|1@1+ (1,0) [0|1] "" Vector__XXX
 SG_ VCFRONT_a111_VEH_seatStatus m111 : 25|1@1+ (1,0) [0|1] "" Vector__XXX
 SG_ VCFRONT_a111_PARTY_status m111 : 26|1@1+ (1,0) [0|1] "" Vector__XXX
 SG_ VCFRONT_a111_CH_status m111 : 27|1@1+ (1,0) [0|1] "" Vector__XXX
 SG_ VCFRONT_a112_VEH_internalStatus m112 : 16|1@1+ (1,0) [0|1] "" Vector__XXX
 SG_ VCFRONT_a112_VEH_status m112 : 17|1@1+ (1,0) [0|1] "" Vector__XXX
 SG_ VCFRONT_a112_VEH_vehNm m112 : 18|1@1+ (1,0) [0|1] "" Vector__XXX
 SG_ VCFRONT_a112_LIPC_LVPowerState m112 : 19|1@1+ (1,0) [0|1] "" Vector__XXX
 SG_ VCFRONT_a112_LIPC_epbPrivateStat m112 : 20|1@1+ (1,0) [0|1] "" Vector__XXX
 SG_ VCFRONT_a112_LIPC_railStatus m112 : 21|1@1+ (1,0) [0|1] "" Vector__XXX
 SG_ VCFRONT_a112_LIPC_remoteADC m112 : 22|1@1+ (1,0) [0|1] "" Vector__XXX
 SG_ VCFRONT_a112_LIPC_switchStatus m112 : 23|1@1+ (1,0) [0|1] "" Vector__XXX
 SG_ VCFRONT_a112_VEH_LVPowerState m112 : 24|1@1+ (1,0) [0|1] "" Vector__XXX
 SG_ VCFRONT_a112_PARTY_status m112 : 25|1@1+ (1,0) [0|1] "" Vector__XXX
 SG_ VCFRONT_a112_CH_status m112 : 26|1@1+ (1,0) [0|1] "" Vector__XXX
 SG_ VCFRONT_a114_PARTY_status m114 : 16|1@1+ (1,0) [0|1] "" Vector__XXX
 SG_ VCFRONT_a114_PARTY_wheelSpeeds m114 : 17|1@1+ (1,0) [0|1] "" Vector__XXX
 SG_ VCFRONT_a114_VEH_wheelSpeeds m114 : 18|1@1+ (1,0) [0|1] "" Vector__XXX
 SG_ VCFRONT_a114_CH_wheelSpeeds m114 : 19|1@1+ (1,0) [0|1] "" Vector__XXX
 SG_ VCFRONT_a114_PARTY_party3 m114 : 20|1@1+ (1,0) [0|1] "" Vector__XXX
 SG_ VCFRONT_a114_VEH_party3 m114 : 21|1@1+ (1,0) [0|1] "" Vector__XXX
 SG_ VCFRONT_a114_VEH_status m114 : 22|1@1+ (1,0) [0|1] "" Vector__XXX
 SG_ VCFRONT_a114_PARTY_wheelRotation m114 : 23|1@1+ (1,0) [0|1] "" Vector__XXX
 SG_ VCFRONT_a114_CH_wheelRotation m114 : 24|1@1+ (1,0) [0|1] "" Vector__XXX
 SG_ VCFRONT_a114_VEH_wheelRotation m114 : 25|1@1+ (1,0) [0|1] "" Vector__XXX
 SG_ VCFRONT_a114_PARTY_brakeTorque m114 : 26|1@1+ (1,0) [0|1] "" Vector__XXX
 SG_ VCFRONT_a114_PARTY_offsets m114 : 27|1@1+ (1,0) [0|1] "" Vector__XXX
 SG_ VCFRONT_a114_BDY_offsets m114 : 28|1@1+ (1,0) [0|1] "" Vector__XXX
 SG_ VCFRONT_a114_BDY_party3 m114 : 29|1@1+ (1,0) [0|1] "" Vector__XXX
 SG_ VCFRONT_a114_BDY_status m114 : 30|1@1+ (1,0) [0|1] "" Vector__XXX
 SG_ VCFRONT_a114_BDY_wheelRotation m114 : 31|1@1+ (1,0) [0|1] "" Vector__XXX
 SG_ VCFRONT_a114_BDY_wheelSpeeds m114 : 32|1@1+ (1,0) [0|1] "" Vector__XXX
 SG_ VCFRONT_a114_CH_party1 m114 : 33|1@1+ (1,0) [0|1] "" Vector__XXX
 SG_ VCFRONT_a114_CH_party3 m114 : 34|1@1+ (1,0) [0|1] "" Vector__XXX
 SG_ VCFRONT_a114_CH_status m114 : 35|1@1+ (1,0) [0|1] "" Vector__XXX
 SG_ VCFRONT_a115_VEH_vehNm m115 : 16|1@1+ (1,0) [0|1] "" Vector__XXX
 SG_ VCFRONT_a115_VEH_authentication m115 : 17|1@1+ (1,0) [0|1] "" Vector__XXX
 SG_ VCFRONT_a115_VEH_BLEResetRequest m115 : 18|1@1+ (1,0) [0|1] "" Vector__XXX
 SG_ VCFRONT_a115_VEH_requests m115 : 19|1@1+ (1,0) [0|1] "" Vector__XXX
 SG_ VCFRONT_a115_VEH_requests2 m115 : 20|1@1+ (1,0) [0|1] "" Vector__XXX
 SG_ VCFRONT_a115_REM_authentication m115 : 21|1@1+ (1,0) [0|1] "" Vector__XXX
 SG_ VCFRONT_a115_UI_corianderVehicle m115 : 22|1@1+ (1,0) [0|1] "" Vector__XXX
 SG_ VCFRONT_a115_CH_TPMSDisplay m115 : 23|1@1+ (1,0) [0|1] "" Vector__XXX
 SG_ VCFRONT_a116_PARTY_epbmStatus m116 : 16|1@1+ (1,0) [0|1] "" Vector__XXX
 SG_ VCFRONT_a116_VEH_vehNm m116 : 17|1@1+ (1,0) [0|1] "" Vector__XXX
 SG_ VCFRONT_a116_VEH_hvacRequest m116 : 18|1@1+ (1,0) [0|1] "" Vector__XXX
 SG_ VCFRONT_a116_VEH_hvacStatus m116 : 19|1@1+ (1,0) [0|1] "" Vector__XXX
 SG_ VCFRONT_a116_VEH_LVPowerState m116 : 20|1@1+ (1,0) [0|1] "" Vector__XXX
 SG_ VCFRONT_a116_VEH_lightStatus m116 : 21|1@1+ (1,0) [0|1] "" Vector__XXX
 SG_ VCFRONT_a116_VEH_seatStatus m116 : 22|1@1+ (1,0) [0|1] "" Vector__XXX
 SG_ VCFRONT_a116_VEH_thsStatus m116 : 23|1@1+ (1,0) [0|1] "" Vector__XXX
 SG_ VCFRONT_a116_VEH_doorStatus m116 : 24|1@1+ (1,0) [0|1] "" Vector__XXX
 SG_ VCFRONT_a116_VEH_seatHeatStatus m116 : 25|1@1+ (1,0) [0|1] "" Vector__XXX
 SG_ VCFRONT_a116_VEH_restraintStatus m116 : 26|1@1+ (1,0) [0|1] "" Vector__XXX
 SG_ VCFRONT_a116_VEH_switchStatus m116 : 27|1@1+ (1,0) [0|1] "" Vector__XXX
 SG_ VCFRONT_a116_VEH_logging1Hz m116 : 28|1@1+ (1,0) [0|1] "" Vector__XXX
 SG_ VCFRONT_a116_VEH_seatStatus2 m116 : 29|1@1+ (1,0) [0|1] "" Vector__XXX
 SG_ VCFRONT_a116_VEH_status m116 : 30|1@1+ (1,0) [0|1] "" Vector__XXX
 SG_ VCFRONT_a116_VEH_thermalCommand m116 : 31|1@1+ (1,0) [0|1] "" Vector__XXX
 SG_ VCFRONT_a116_VEH_windowStatus m116 : 32|1@1+ (1,0) [0|1] "" Vector__XXX
 SG_ VCFRONT_a116_PARTY_restraintStat m116 : 33|1@1+ (1,0) [0|1] "" Vector__XXX
 SG_ VCFRONT_a116_PARTY_doorStatus m116 : 34|1@1+ (1,0) [0|1] "" Vector__XXX
 SG_ VCFRONT_a116_BDY_epbmStatus m116 : 35|1@1+ (1,0) [0|1] "" Vector__XXX
 SG_ VCFRONT_a116_BDY_restraintStatus m116 : 36|1@1+ (1,0) [0|1] "" Vector__XXX
 SG_ VCFRONT_a117_BDY_epbmStatus m117 : 16|1@1+ (1,0) [0|1] "" Vector__XXX
 SG_ VCFRONT_a117_BDY_restraintStatus m117 : 17|1@1+ (1,0) [0|1] "" Vector__XXX
 SG_ VCFRONT_a117_VEH_prndStatus m117 : 18|1@1+ (1,0) [0|1] "" Vector__XXX
 SG_ VCFRONT_a117_PARTY_epbmStatus m117 : 19|1@1+ (1,0) [0|1] "" Vector__XXX
 SG_ VCFRONT_a117_VEH_vehNm m117 : 20|1@1+ (1,0) [0|1] "" Vector__XXX
 SG_ VCFRONT_a117_VEH_hvacBlowerFdb m117 : 21|1@1+ (1,0) [0|1] "" Vector__XXX
 SG_ VCFRONT_a117_VEH_LVPowerState m117 : 22|1@1+ (1,0) [0|1] "" Vector__XXX
 SG_ VCFRONT_a117_VEH_restraintStatus m117 : 23|1@1+ (1,0) [0|1] "" Vector__XXX
 SG_ VCFRONT_a117_VEH_lightStatus m117 : 24|1@1+ (1,0) [0|1] "" Vector__XXX
 SG_ VCFRONT_a117_VEH_seatStatus m117 : 25|1@1+ (1,0) [0|1] "" Vector__XXX
 SG_ VCFRONT_a117_BDY_falconSwitchSta m117 : 26|1@1+ (1,0) [0|1] "" Vector__XXX
 SG_ VCFRONT_a117_VEH_doorStatus m117 : 27|1@1+ (1,0) [0|1] "" Vector__XXX
 SG_ VCFRONT_a117_VEH_doorStatus2 m117 : 28|1@1+ (1,0) [0|1] "" Vector__XXX
 SG_ VCFRONT_a117_VEH_windowStatus m117 : 29|1@1+ (1,0) [0|1] "" Vector__XXX
 SG_ VCFRONT_a117_VEH_switchStatus m117 : 30|1@1+ (1,0) [0|1] "" Vector__XXX
 SG_ VCFRONT_a117_VEH_intrusionSensor m117 : 31|1@1+ (1,0) [0|1] "" Vector__XXX
 SG_ VCFRONT_a117_VEH_liftgateStatus m117 : 32|1@1+ (1,0) [0|1] "" Vector__XXX
 SG_ VCFRONT_a117_VEH_seatStatus2 m117 : 33|1@1+ (1,0) [0|1] "" Vector__XXX
 SG_ VCFRONT_a117_PARTY_restraintStat m117 : 34|1@1+ (1,0) [0|1] "" Vector__XXX
 SG_ VCFRONT_a117_VEH_thermalStatus m117 : 35|1@1+ (1,0) [0|1] "" Vector__XXX
 SG_ VCFRONT_a117_PARTY_doorStatus m117 : 36|1@1+ (1,0) [0|1] "" Vector__XXX
 SG_ VCFRONT_a117_VEH_status m117 : 37|1@1+ (1,0) [0|1] "" Vector__XXX
 SG_ VCFRONT_a117_PARTY_prndStatus m117 : 38|1@1+ (1,0) [0|1] "" Vector__XXX
 SG_ VCFRONT_a118_VEH_vehNm m118 : 16|1@1+ (1,0) [0|1] "" Vector__XXX
 SG_ VCFRONT_a118_VEH_lighting m118 : 17|1@1+ (1,0) [0|1] "" Vector__XXX
 SG_ VCFRONT_a118_VEH_sensors m118 : 18|1@1+ (1,0) [0|1] "" Vector__XXX
 SG_ VCFRONT_a118_VEH_status m118 : 19|1@1+ (1,0) [0|1] "" Vector__XXX
 SG_ VCFRONT_a118_VEH_okToUseHighPwr m118 : 20|1@1+ (1,0) [0|1] "" Vector__XXX
 SG_ VCFRONT_a118_VEH_LVPowerState m118 : 21|1@1+ (1,0) [0|1] "" Vector__XXX
 SG_ VCFRONT_a118_VEH_coolant m118 : 22|1@1+ (1,0) [0|1] "" Vector__XXX
 SG_ VCFRONT_a118_VEH_vehicleStatus m118 : 23|1@1+ (1,0) [0|1] "" Vector__XXX
 SG_ VCFRONT_a118_VEH_12VBatteryStatu m118 : 24|1@1+ (1,0) [0|1] "" Vector__XXX
 SG_ VCFRONT_a118_VEH_systemStatus m118 : 25|1@1+ (1,0) [0|1] "" Vector__XXX
 SG_ VCFRONT_a118_PARTY_LVPowerState m118 : 26|1@1+ (1,0) [0|1] "" Vector__XXX
 SG_ VCFRONT_a118_PARTY_outputPowerSt m118 : 27|1@1+ (1,0) [0|1] "" Vector__XXX
 SG_ VCFRONT_a118_PARTY_vehicleTime m118 : 28|1@1+ (1,0) [0|1] "" Vector__XXX
 SG_ VCFRONT_a118_VEH_thermalCommand m118 : 29|1@1+ (1,0) [0|1] "" Vector__XXX
 SG_ VCFRONT_a118_CH_LVPowerState m118 : 30|1@1+ (1,0) [0|1] "" Vector__XXX
 SG_ VCFRONT_a118_PARTY_sensors m118 : 31|1@1+ (1,0) [0|1] "" Vector__XXX
 SG_ VCFRONT_a118_CH_sensors m118 : 32|1@1+ (1,0) [0|1] "" Vector__XXX
 SG_ VCFRONT_a118_VEH_interNodeResist m118 : 33|1@1+ (1,0) [0|1] "" Vector__XXX
 SG_ VCFRONT_a118_CH_lighting m118 : 34|1@1+ (1,0) [0|1] "" Vector__XXX
 SG_ VCFRONT_a118_VEH_lightStatus m118 : 35|1@1+ (1,0) [0|1] "" Vector__XXX
 SG_ VCFRONT_a118_PARTY_vehNm m118 : 36|1@1+ (1,0) [0|1] "" Vector__XXX
 SG_ VCFRONT_a118_CH_12VBatteryStatus m118 : 37|1@1+ (1,0) [0|1] "" Vector__XXX
 SG_ VCFRONT_a118_CH_LVBMS_statusHigh m118 : 38|1@1+ (1,0) [0|1] "" Vector__XXX
 SG_ VCFRONT_a118_CH_alertMatrix m118 : 39|1@1+ (1,0) [0|1] "" Vector__XXX
 SG_ VCFRONT_a118_BDY_outputPowerStat m118 : 40|1@1+ (1,0) [0|1] "" Vector__XXX
 SG_ VCFRONT_a118_BDY_vehicleTime m118 : 41|1@1+ (1,0) [0|1] "" Vector__XXX
 SG_ VCFRONT_a118_PARTY_AP_vehicleSta m118 : 42|1@1+ (1,0) [0|1] "" Vector__XXX
 SG_ VCFRONT_a118_BDY_AP_vehicleState m118 : 43|1@1+ (1,0) [0|1] "" Vector__XXX
 SG_ VCFRONT_a119_VEH_steerAngle m119 : 16|1@1+ (1,0) [0|1] "" Vector__XXX
 SG_ VCFRONT_a119_VEH_leftStalk m119 : 17|1@1+ (1,0) [0|1] "" Vector__XXX
 SG_ VCFRONT_a119_VEH_rightStalk m119 : 18|1@1+ (1,0) [0|1] "" Vector__XXX
 SG_ VCFRONT_a119_PARTY_rightStalk m119 : 19|1@1+ (1,0) [0|1] "" Vector__XXX
 SG_ VCFRONT_a119_CH_steerAngle m119 : 20|1@1+ (1,0) [0|1] "" Vector__XXX
 SG_ VCFRONT_a119_PARTY_steerAngle m119 : 21|1@1+ (1,0) [0|1] "" Vector__XXX
 SG_ VCFRONT_a120_PARTY_chassisCntl m120 : 16|1@1+ (1,0) [0|1] "" Vector__XXX
 SG_ VCFRONT_a120_VEH_systemStatus m120 : 17|1@1+ (1,0) [0|1] "" Vector__XXX
 SG_ VCFRONT_a120_CH_chassisCntl m120 : 18|1@1+ (1,0) [0|1] "" Vector__XXX
 SG_ VCFRONT_a120_PARTY_systemStatus m120 : 19|1@1+ (1,0) [0|1] "" Vector__XXX
 SG_ VCFRONT_a120_PARTY_torque m120 : 20|1@1+ (1,0) [0|1] "" Vector__XXX
 SG_ VCFRONT_a120_VEH_torque m120 : 21|1@1+ (1,0) [0|1] "" Vector__XXX
 SG_ VCFRONT_a120_PARTY_locStatus m120 : 22|1@1+ (1,0) [0|1] "" Vector__XXX
 SG_ VCFRONT_a120_PARTY_speed m120 : 23|1@1+ (1,0) [0|1] "" Vector__XXX
 SG_ VCFRONT_a120_VEH_speed m120 : 24|1@1+ (1,0) [0|1] "" Vector__XXX
 SG_ VCFRONT_a120_PARTY_status m120 : 25|1@1+ (1,0) [0|1] "" Vector__XXX
 SG_ VCFRONT_a120_PT_speed m120 : 26|1@1+ (1,0) [0|1] "" Vector__XXX
 SG_ VCFRONT_a120_PT_systemStatus m120 : 27|1@1+ (1,0) [0|1] "" Vector__XXX
 SG_ VCFRONT_a120_PARTY_vehicleEstima m120 : 28|1@1+ (1,0) [0|1] "" Vector__XXX
 SG_ VCFRONT_a120_VEH_aggregatedAxleS m120 : 29|1@1+ (1,0) [0|1] "" Vector__XXX
 SG_ VCFRONT_a120_PARTY_aggregatedAxl m120 : 30|1@1+ (1,0) [0|1] "" Vector__XXX
 SG_ VCFRONT_a120_VEH_systemPower m120 : 31|1@1+ (1,0) [0|1] "" Vector__XXX
 SG_ VCFRONT_a120_PT_systemPower m120 : 32|1@1+ (1,0) [0|1] "" Vector__XXX
 SG_ VCFRONT_a120_PARTY_stalklessInte m120 : 33|1@1+ (1,0) [0|1] "" Vector__XXX
 SG_ VCFRONT_a120_CH_speed m120 : 34|1@1+ (1,0) [0|1] "" Vector__XXX
 SG_ VCFRONT_a120_VEH_estimatedBrakeT m120 : 35|1@1+ (1,0) [0|1] "" Vector__XXX
 SG_ VCFRONT_a120_PARTY_prndControl m120 : 36|1@1+ (1,0) [0|1] "" Vector__XXX
 SG_ VCFRONT_a120_PARTY_locStatus2 m120 : 37|1@1+ (1,0) [0|1] "" Vector__XXX
 SG_ VCFRONT_a120_VEH_chassisCntl m120 : 38|1@1+ (1,0) [0|1] "" Vector__XXX
 SG_ VCFRONT_a120_VEH_locStatus m120 : 39|1@1+ (1,0) [0|1] "" Vector__XXX
 SG_ VCFRONT_a120_VEH_locStatus2 m120 : 40|1@1+ (1,0) [0|1] "" Vector__XXX
 SG_ VCFRONT_a120_VEH_prndControl m120 : 41|1@1+ (1,0) [0|1] "" Vector__XXX
 SG_ VCFRONT_a120_VEH_vehicleEstimate m120 : 42|1@1+ (1,0) [0|1] "" Vector__XXX
 SG_ VCFRONT_a121_overCurrentError m121 : 16|1@1+ (1,0) [0|1] "" Vector__XXX
 SG_ VCFRONT_a121_fetShortCircuit m121 : 17|1@1+ (1,0) [0|1] "" Vector__XXX
 SG_ VCFRONT_a121_lockedRotor m121 : 18|1@1+ (1,0) [0|1] "" Vector__XXX
 SG_ VCFRONT_a122_junctionTempWarning m122 : 16|1@1+ (1,0) [0|1] "" Vector__XXX
 SG_ VCFRONT_a122_junctionOverTemp m122 : 17|1@1+ (1,0) [0|1] "" Vector__XXX
 SG_ VCFRONT_a122_startUpOperation m122 : 18|1@1+ (1,0) [0|1] "" Vector__XXX
 SG_ VCFRONT_a122_lossOfSpeedLock m122 : 19|1@1+ (1,0) [0|1] "" Vector__XXX
 SG_ VCFRONT_a122_vccUnderVoltage m122 : 20|1@1+ (1,0) [0|1] "" Vector__XXX
 SG_ VCFRONT_a123_overCurrentError m123 : 16|1@1+ (1,0) [0|1] "" Vector__XXX
 SG_ VCFRONT_a123_fetShortCircuit m123 : 17|1@1+ (1,0) [0|1] "" Vector__XXX
 SG_ VCFRONT_a123_lockedRotor m123 : 18|1@1+ (1,0) [0|1] "" Vector__XXX
 SG_ VCFRONT_a124_junctionTempWarning m124 : 16|1@1+ (1,0) [0|1] "" Vector__XXX
 SG_ VCFRONT_a124_junctionOverTemp m124 : 17|1@1+ (1,0) [0|1] "" Vector__XXX
 SG_ VCFRONT_a124_startUpOperation m124 : 18|1@1+ (1,0) [0|1] "" Vector__XXX
 SG_ VCFRONT_a124_lossOfSpeedLock m124 : 19|1@1+ (1,0) [0|1] "" Vector__XXX
 SG_ VCFRONT_a124_vccUnderVoltage m124 : 20|1@1+ (1,0) [0|1] "" Vector__XXX
 SG_ VCFRONT_a125_overCurrentError m125 : 16|1@1+ (1,0) [0|1] "" Vector__XXX
 SG_ VCFRONT_a125_fetShortCircuit m125 : 17|1@1+ (1,0) [0|1] "" Vector__XXX
 SG_ VCFRONT_a125_lockedRotor m125 : 18|1@1+ (1,0) [0|1] "" Vector__XXX
 SG_ VCFRONT_a126_junctionTempWarning m126 : 16|1@1+ (1,0) [0|1] "" Vector__XXX
 SG_ VCFRONT_a126_junctionOverTemp m126 : 17|1@1+ (1,0) [0|1] "" Vector__XXX
 SG_ VCFRONT_a126_startUpOperation m126 : 18|1@1+ (1,0) [0|1] "" Vector__XXX
 SG_ VCFRONT_a126_lossOfSpeedLock m126 : 19|1@1+ (1,0) [0|1] "" Vector__XXX
 SG_ VCFRONT_a126_vccUnderVoltage m126 : 20|1@1+ (1,0) [0|1] "" Vector__XXX
 SG_ VCFRONT_a127_vcleftEFuseCurrent m127 : 16|16@1+ (0.1,0) [0|6553.5] "A" Vector__XXX
 SG_ VCFRONT_a127_vcleftEFuseVoltage m127 : 32|16@1+ (0.1,0) [0|6553.5] "V" Vector__XXX
 SG_ VCFRONT_a127_vcleftEFuseTemp m127 : 48|11@1+ (0.125,-40) [-40|215.875] "degC" Vector__XXX
 SG_ VCFRONT_a127_vcleftEFuseRemainin m127 : 59|4@1+ (1,0) [0|15] "" Vector__XXX
 SG_ VCFRONT_a128_vcrightEFuseCurrent m128 : 16|16@1+ (0.1,0) [0|6553.5] "A" Vector__XXX
 SG_ VCFRONT_a128_vcrightEFuseVoltage m128 : 32|16@1+ (0.1,0) [0|6553.5] "V" Vector__XXX
 SG_ VCFRONT_a128_vcrightEFuseTemp m128 : 48|11@1+ (0.125,-40) [-40|215.875] "degC" Vector__XXX
 SG_ VCFRONT_a128_vcrightEFuseRemaini m128 : 59|4@1+ (1,0) [0|15] "" Vector__XXX
 SG_ VCFRONT_a129_pcsEFuseCurrent m129 : 16|16@1+ (0.1,0) [0|6553.5] "A" Vector__XXX
 SG_ VCFRONT_a129_pcsEFuseVoltage m129 : 32|16@1+ (0.1,0) [0|6553.5] "V" Vector__XXX
 SG_ VCFRONT_a129_pcsEFuseTemp m129 : 48|11@1+ (0.125,-40) [-40|215.875] "degC" Vector__XXX
 SG_ VCFRONT_a129_pcsEFuseRemainingRe m129 : 59|4@1+ (1,0) [0|15] "" Vector__XXX
 SG_ VCFRONT_a130_epas3pEFuseCurrent m130 : 16|16@1+ (0.1,0) [0|6553.5] "A" Vector__XXX
 SG_ VCFRONT_a130_epas3pEFuseVoltage m130 : 32|16@1+ (0.1,0) [0|6553.5] "V" Vector__XXX
 SG_ VCFRONT_a130_epas3pEFuseTemp m130 : 48|11@1+ (0.125,-40) [-40|215.875] "degC" Vector__XXX
 SG_ VCFRONT_a131_epas3sEFuseCurrent m131 : 16|16@1+ (0.1,0) [0|6553.5] "A" Vector__XXX
 SG_ VCFRONT_a131_epas3sEFuseVoltage m131 : 32|16@1+ (0.1,0) [0|6553.5] "V" Vector__XXX
 SG_ VCFRONT_a131_epas3sEFuseTemp m131 : 48|11@1+ (0.125,-40) [-40|215.875] "degC" Vector__XXX
 SG_ VCFRONT_a132_iBoosterCurrent m132 : 16|16@1+ (0.1,0) [0|6553.5] "A" Vector__XXX
 SG_ VCFRONT_a132_iBoosterVoltage m132 : 32|16@1+ (0.1,0) [0|6553.5] "V" Vector__XXX
 SG_ VCFRONT_a132_iBoosterEFuseTemp m132 : 48|11@1+ (0.125,-40) [-40|215.875] "degC" Vector__XXX
 SG_ VCFRONT_a133_espEFuseCurrent m133 : 16|16@1+ (0.1,0) [0|6553.5] "A" Vector__XXX
 SG_ VCFRONT_a133_espEFuseVoltage m133 : 32|16@1+ (0.1,0) [0|6553.5] "V" Vector__XXX
 SG_ VCFRONT_a133_espEFuseTemp m133 : 48|11@1+ (0.125,-40) [-40|215.875] "degC" Vector__XXX
 SG_ VCFRONT_a134_fusedHighCurrent m134 : 16|16@1+ (0.1,0) [0|6553.5] "A" Vector__XXX
 SG_ VCFRONT_a134_fusedHighVoltage m134 : 32|16@1+ (0.1,0) [0|6553.5] "V" Vector__XXX
 SG_ VCFRONT_a134_fusedHighTemp m134 : 48|11@1+ (0.125,-40) [-40|215.875] "degC" Vector__XXX
 SG_ VCFRONT_a134_vbatFusedEFuseRemai m134 : 59|4@1+ (1,0) [0|15] "" Vector__XXX
 SG_ VCFRONT_a136_snsShortCircuit m136 : 16|1@1+ (1,0) [0|1] "" Vector__XXX
 SG_ VCFRONT_a136_snsDisconnect m136 : 17|1@1+ (1,0) [0|1] "" Vector__XXX
 SG_ VCFRONT_a136_snsRateChangeUp m136 : 18|1@1+ (1,0) [0|1] "" Vector__XXX
 SG_ VCFRONT_a136_snsRateChangeDown m136 : 19|1@1+ (1,0) [0|1] "" Vector__XXX
 SG_ VCFRONT_a137_snsShortCircuit m137 : 16|1@1+ (1,0) [0|1] "" Vector__XXX
 SG_ VCFRONT_a137_snsDisconnect m137 : 17|1@1+ (1,0) [0|1] "" Vector__XXX
 SG_ VCFRONT_a137_snsRateChangeUp m137 : 18|1@1+ (1,0) [0|1] "" Vector__XXX
 SG_ VCFRONT_a137_snsRateChangeDown m137 : 19|1@1+ (1,0) [0|1] "" Vector__XXX
 SG_ VCFRONT_a138_snsShortCircuit m138 : 16|1@1+ (1,0) [0|1] "" Vector__XXX
 SG_ VCFRONT_a138_snsDisconnect m138 : 17|1@1+ (1,0) [0|1] "" Vector__XXX
 SG_ VCFRONT_a138_snsRateChangeUp m138 : 18|1@1+ (1,0) [0|1] "" Vector__XXX
 SG_ VCFRONT_a138_snsRateChangeDown m138 : 19|1@1+ (1,0) [0|1] "" Vector__XXX
 SG_ VCFRONT_a139_snsShortCircuit m139 : 16|1@1+ (1,0) [0|1] "" Vector__XXX
 SG_ VCFRONT_a139_snsDisconnect m139 : 17|1@1+ (1,0) [0|1] "" Vector__XXX
 SG_ VCFRONT_a139_snsRateChangeUp m139 : 18|1@1+ (1,0) [0|1] "" Vector__XXX
 SG_ VCFRONT_a139_snsRateChangeDown m139 : 19|1@1+ (1,0) [0|1] "" Vector__XXX
 SG_ VCFRONT_a140_snsShortCircuit m140 : 16|1@1+ (1,0) [0|1] "" Vector__XXX
 SG_ VCFRONT_a140_snsDisconnect m140 : 17|1@1+ (1,0) [0|1] "" Vector__XXX
 SG_ VCFRONT_a140_snsRateChangeUp m140 : 18|1@1+ (1,0) [0|1] "" Vector__XXX
 SG_ VCFRONT_a140_snsRateChangeDown m140 : 19|1@1+ (1,0) [0|1] "" Vector__XXX
 SG_ VCFRONT_a141_snsShortCircuit m141 : 16|1@1+ (1,0) [0|1] "" Vector__XXX
 SG_ VCFRONT_a141_snsDisconnect m141 : 17|1@1+ (1,0) [0|1] "" Vector__XXX
 SG_ VCFRONT_a141_snsRateChangeUp m141 : 18|1@1+ (1,0) [0|1] "" Vector__XXX
 SG_ VCFRONT_a141_snsRateChangeDown m141 : 19|1@1+ (1,0) [0|1] "" Vector__XXX
 SG_ VCFRONT_a142_driverState m142 : 16|4@1+ (1,0) [0|15] "" Vector__XXX
 SG_ VCFRONT_a142_driverThermWarn m142 : 20|1@1+ (1,0) [0|1] "" Vector__XXX
 SG_ VCFRONT_a142_driverThermShutdown m142 : 21|1@1+ (1,0) [0|1] "" Vector__XXX
 SG_ VCFRONT_a142_undervoltage m142 : 22|1@1+ (1,0) [0|1] "" Vector__XXX
 SG_ VCFRONT_a142_chargePumpUndervolt m142 : 23|1@1+ (1,0) [0|1] "" Vector__XXX
 SG_ VCFRONT_a142_isCoilOpenX m142 : 24|1@1+ (1,0) [0|1] "" Vector__XXX
 SG_ VCFRONT_a142_isCoilOpenY m142 : 25|1@1+ (1,0) [0|1] "" Vector__XXX
 SG_ VCFRONT_a142_isCoilShortXPGnd m142 : 26|1@1+ (1,0) [0|1] "" Vector__XXX
 SG_ VCFRONT_a142_isCoilShortXPVbb m142 : 27|1@1+ (1,0) [0|1] "" Vector__XXX
 SG_ VCFRONT_a142_isCoilShortXNGnd m142 : 28|1@1+ (1,0) [0|1] "" Vector__XXX
 SG_ VCFRONT_a142_isCoilShortXNVbb m142 : 29|1@1+ (1,0) [0|1] "" Vector__XXX
 SG_ VCFRONT_a142_isCoilShortYPGnd m142 : 30|1@1+ (1,0) [0|1] "" Vector__XXX
 SG_ VCFRONT_a142_isCoilShortYPVbb m142 : 31|1@1+ (1,0) [0|1] "" Vector__XXX
 SG_ VCFRONT_a142_isCoilShortYNGnd m142 : 32|1@1+ (1,0) [0|1] "" Vector__XXX
 SG_ VCFRONT_a142_isCoilShortYNVbb m142 : 33|1@1+ (1,0) [0|1] "" Vector__XXX
 SG_ VCFRONT_a142_driverHasCommError m142 : 34|1@1+ (1,0) [0|1] "" Vector__XXX
 SG_ VCFRONT_a143_vsUnderVoltage m143 : 16|1@1+ (1,0) [0|1] "" Vector__XXX
 SG_ VCFRONT_a143_vsOverVoltage m143 : 17|1@1+ (1,0) [0|1] "" Vector__XXX
 SG_ VCFRONT_a143_chpUnderVoltage m143 : 18|1@1+ (1,0) [0|1] "" Vector__XXX
 SG_ VCFRONT_a143_vglUnderVoltage m143 : 19|1@1+ (1,0) [0|1] "" Vector__XXX
 SG_ VCFRONT_a143_thOverTemperature m143 : 20|1@1+ (1,0) [0|1] "" Vector__XXX
 SG_ VCFRONT_a144_vsUnderVoltage m144 : 16|1@1+ (1,0) [0|1] "" Vector__XXX
 SG_ VCFRONT_a144_vsOverVoltage m144 : 17|1@1+ (1,0) [0|1] "" Vector__XXX
 SG_ VCFRONT_a144_chpUnderVoltage m144 : 18|1@1+ (1,0) [0|1] "" Vector__XXX
 SG_ VCFRONT_a144_vglUnderVoltage m144 : 19|1@1+ (1,0) [0|1] "" Vector__XXX
 SG_ VCFRONT_a144_thOverTemperature m144 : 20|1@1+ (1,0) [0|1] "" Vector__XXX
 SG_ VCFRONT_a145_vsUnderVoltage m145 : 16|1@1+ (1,0) [0|1] "" Vector__XXX
 SG_ VCFRONT_a145_vsOverVoltage m145 : 17|1@1+ (1,0) [0|1] "" Vector__XXX
 SG_ VCFRONT_a145_chpUnderVoltage m145 : 18|1@1+ (1,0) [0|1] "" Vector__XXX
 SG_ VCFRONT_a145_vglUnderVoltage m145 : 19|1@1+ (1,0) [0|1] "" Vector__XXX
 SG_ VCFRONT_a145_thOverTemperature m145 : 20|1@1+ (1,0) [0|1] "" Vector__XXX
 SG_ VCFRONT_a146_RPMActual m146 : 16|10@1+ (10,0) [0|10230] "RPM" Vector__XXX
 SG_ VCFRONT_a146_RPMTarget m146 : 26|10@1+ (10,0) [0|10230] "RPM" Vector__XXX
 SG_ VCFRONT_a147_RPMActual m147 : 16|10@1+ (10,0) [0|10230] "RPM" Vector__XXX
 SG_ VCFRONT_a147_RPMTarget m147 : 26|10@1+ (10,0) [0|10230] "RPM" Vector__XXX
 SG_ VCFRONT_a148_RPMActual m148 : 16|10@1+ (10,0) [0|10230] "RPM" Vector__XXX
 SG_ VCFRONT_a148_RPMTarget m148 : 26|10@1+ (10,0) [0|10230] "RPM" Vector__XXX
 SG_ VCFRONT_a150_RPMActual m150 : 16|10@1+ (10,0) [0|10230] "RPM" Vector__XXX
 SG_ VCFRONT_a150_RPMTarget m150 : 26|10@1+ (10,0) [0|10230] "RPM" Vector__XXX
 SG_ VCFRONT_a151_RPMActual m151 : 16|10@1+ (10,0) [0|10230] "RPM" Vector__XXX
 SG_ VCFRONT_a151_RPMTarget m151 : 26|10@1+ (10,0) [0|10230] "RPM" Vector__XXX
 SG_ VCFRONT_a152_RPMActual m152 : 16|10@1+ (10,0) [0|10230] "RPM" Vector__XXX
 SG_ VCFRONT_a152_RPMTarget m152 : 26|10@1+ (10,0) [0|10230] "RPM" Vector__XXX
 SG_ VCFRONT_a156_motorCounts m156 : 16|11@1+ (1,-100) [-100|1947] "ticks" Vector__XXX
 SG_ VCFRONT_a157_motorCounts m157 : 16|11@1+ (1,-100) [-100|1947] "ticks" Vector__XXX
 SG_ VCFRONT_a159_stall m159 : 16|1@1+ (1,0) [0|1] "" Vector__XXX
 SG_ VCFRONT_a159_angleActual m159 : 17|10@1+ (0.25,-70) [-70|185.75] "deg" Vector__XXX
 SG_ VCFRONT_a159_angleTarget m159 : 27|10@1+ (0.25,-10) [-10|245.75] "deg" Vector__XXX
 SG_ VCFRONT_a160_highDischTemp m160 : 16|1@1+ (1,0) [0|1] "" Vector__XXX
 SG_ VCFRONT_a160_lowDischPressure m160 : 17|1@1+ (1,0) [0|1] "" Vector__XXX
 SG_ VCFRONT_a160_highDischPressure m160 : 18|1@1+ (1,0) [0|1] "" Vector__XXX
 SG_ VCFRONT_a160_lowSuctionPressure m160 : 19|1@1+ (1,0) [0|1] "" Vector__XXX
 SG_ VCFRONT_a160_faultSnsDischPress m160 : 20|1@1+ (1,0) [0|1] "" Vector__XXX
 SG_ VCFRONT_a160_faultSnsDischTemp m160 : 21|1@1+ (1,0) [0|1] "" Vector__XXX
 SG_ VCFRONT_a160_faultSnsSuctPress m160 : 22|1@1+ (1,0) [0|1] "" Vector__XXX
 SG_ VCFRONT_a160_faultSnsSuctTemp m160 : 23|1@1+ (1,0) [0|1] "" Vector__XXX
 SG_ VCFRONT_a160_faultSnsAmbientTemp m160 : 24|1@1+ (1,0) [0|1] "" Vector__XXX
 SG_ VCFRONT_a160_faultValveEXV m160 : 25|1@1+ (1,0) [0|1] "" Vector__XXX
 SG_ VCFRONT_a160_faultValveEvapSol m160 : 26|1@1+ (1,0) [0|1] "" Vector__XXX
 SG_ VCFRONT_a160_highDischargePressu m160 : 27|1@1+ (1,0) [0|1] "" Vector__XXX
 SG_ VCFRONT_a160_highDischargeTempCu m160 : 28|1@1+ (1,0) [0|1] "" Vector__XXX
 SG_ VCFRONT_a160_compressorRpm m160 : 32|7@1+ (90,0) [0|11430] "RPM" Vector__XXX
 SG_ VCFRONT_a161_failedStart m161 : 16|1@1+ (1,0) [0|1] "" Vector__XXX
 SG_ VCFRONT_a161_HVOverVoltage m161 : 17|1@1+ (1,0) [0|1] "" Vector__XXX
 SG_ VCFRONT_a161_HVUnderVoltage m161 : 18|1@1+ (1,0) [0|1] "" Vector__XXX
 SG_ VCFRONT_a161_overCurrent m161 : 19|1@1+ (1,0) [0|1] "" Vector__XXX
 SG_ VCFRONT_a161_overTemperature m161 : 20|1@1+ (1,0) [0|1] "" Vector__XXX
 SG_ VCFRONT_a161_shortCircuit m161 : 21|1@1+ (1,0) [0|1] "" Vector__XXX
 SG_ VCFRONT_a161_underTemperature m161 : 22|1@1+ (1,0) [0|1] "" Vector__XXX
 SG_ VCFRONT_a161_LVUnderVoltage m161 : 23|1@1+ (1,0) [0|1] "" Vector__XXX
 SG_ VCFRONT_a161_LVOverVoltage m161 : 24|1@1+ (1,0) [0|1] "" Vector__XXX
 SG_ VCFRONT_a161_tempSnsFaultIPM1 m161 : 25|1@1+ (1,0) [0|1] "" Vector__XXX
 SG_ VCFRONT_a161_tempSnsFaultIPM2 m161 : 26|1@1+ (1,0) [0|1] "" Vector__XXX
 SG_ VCFRONT_a161_tempSnsFaultCPU m161 : 27|1@1+ (1,0) [0|1] "" Vector__XXX
 SG_ VCFRONT_a161_currentSnsError m161 : 28|1@1+ (1,0) [0|1] "" Vector__XXX
 SG_ VCFRONT_a161_selfTestFailCPU m161 : 29|1@1+ (1,0) [0|1] "" Vector__XXX
 SG_ VCFRONT_a161_internalPowerSupply m161 : 30|1@1+ (1,0) [0|1] "" Vector__XXX
 SG_ VCFRONT_a161_inverterOpenCircuit m161 : 31|1@1+ (1,0) [0|1] "" Vector__XXX
 SG_ VCFRONT_a161_warnOverTemperature m161 : 32|1@1+ (1,0) [0|1] "" Vector__XXX
 SG_ VCFRONT_a161_failedStartRepeated m161 : 33|1@1+ (1,0) [0|1] "" Vector__XXX
 SG_ VCFRONT_a161_overload m161 : 34|1@1+ (1,0) [0|1] "" Vector__XXX
 SG_ VCFRONT_a162_dischargePressure m162 : 16|6@1+ (0.5,0) [0|31.5] "bar" Vector__XXX
 SG_ VCFRONT_a162_chillerExvFlow m162 : 22|7@1+ (1,0) [0|127] "%" Vector__XXX
 SG_ VCFRONT_a162_lccExvFlow m162 : 29|7@1+ (1,0) [0|127] "%" Vector__XXX
 SG_ VCFRONT_a162_ccLeftExvFlow m162 : 36|7@1+ (1,0) [0|127] "%" Vector__XXX
 SG_ VCFRONT_a162_ccRightExvFlow m162 : 43|7@1+ (1,0) [0|127] "%" Vector__XXX
 SG_ VCFRONT_a162_evapExvFlow m162 : 50|7@1+ (1,0) [0|127] "%" Vector__XXX
 SG_ VCFRONT_a162_recircExvFlow m162 : 57|7@1+ (1,0) [0|127] "%" Vector__XXX
 SG_ VCFRONT_a164_lockoutVoltage m164 : 16|16@1+ (0.1,0) [0|6553.5] "V" Vector__XXX
 SG_ VCFRONT_a165_lockoutVoltage m165 : 16|16@1+ (0.1,0) [0|6553.5] "V" Vector__XXX
 SG_ VCFRONT_a168_leftECU m168 : 16|1@1+ (1,0) [0|1] "" Vector__XXX
 SG_ VCFRONT_a168_rightECU m168 : 17|1@1+ (1,0) [0|1] "" Vector__XXX
 SG_ VCFRONT_a169_leftECU m169 : 16|1@1+ (1,0) [0|1] "" Vector__XXX
 SG_ VCFRONT_a169_rightECU m169 : 17|1@1+ (1,0) [0|1] "" Vector__XXX
 SG_ VCFRONT_a170_leftECU m170 : 16|1@1+ (1,0) [0|1] "" Vector__XXX
 SG_ VCFRONT_a170_rightECU m170 : 17|1@1+ (1,0) [0|1] "" Vector__XXX
 SG_ VCFRONT_a171_VCFRONT m171 : 16|1@1+ (1,0) [0|1] "" Vector__XXX
 SG_ VCFRONT_a171_VCRIGHT m171 : 17|1@1+ (1,0) [0|1] "" Vector__XXX
 SG_ VCFRONT_a171_VCLEFT m171 : 18|1@1+ (1,0) [0|1] "" Vector__XXX
 SG_ VCFRONT_a171_BMS m171 : 19|1@1+ (1,0) [0|1] "" Vector__XXX
 SG_ VCFRONT_a171_HVP m171 : 20|1@1+ (1,0) [0|1] "" Vector__XXX
 SG_ VCFRONT_a171_GTW m171 : 21|1@1+ (1,0) [0|1] "" Vector__XXX
 SG_ VCFRONT_a171_CP m171 : 22|1@1+ (1,0) [0|1] "" Vector__XXX
 SG_ VCFRONT_a171_PCS m171 : 23|1@1+ (1,0) [0|1] "" Vector__XXX
 SG_ VCFRONT_a171_PCSCPU2 m171 : 24|1@1+ (1,0) [0|1] "" Vector__XXX
 SG_ VCFRONT_a171_DI m171 : 25|1@1+ (1,0) [0|1] "" Vector__XXX
 SG_ VCFRONT_a171_DIS m171 : 26|1@1+ (1,0) [0|1] "" Vector__XXX
 SG_ VCFRONT_a171_PM m171 : 27|1@1+ (1,0) [0|1] "" Vector__XXX
 SG_ VCFRONT_a171_PMS m171 : 28|1@1+ (1,0) [0|1] "" Vector__XXX
 SG_ VCFRONT_a171_EPBR m171 : 29|1@1+ (1,0) [0|1] "" Vector__XXX
 SG_ VCFRONT_a171_EPBL m171 : 30|1@1+ (1,0) [0|1] "" Vector__XXX
 SG_ VCFRONT_a171_IBST m171 : 31|1@1+ (1,0) [0|1] "" Vector__XXX
 SG_ VCFRONT_a171_IBSTCAL m171 : 32|1@1+ (1,0) [0|1] "" Vector__XXX
 SG_ VCFRONT_a171_ESP m171 : 33|1@1+ (1,0) [0|1] "" Vector__XXX
 SG_ VCFRONT_a171_ESPCAL m171 : 34|1@1+ (1,0) [0|1] "" Vector__XXX
 SG_ VCFRONT_a171_OPC m171 : 35|1@1+ (1,0) [0|1] "" Vector__XXX
 SG_ VCFRONT_a171_OPCS m171 : 36|1@1+ (1,0) [0|1] "" Vector__XXX
 SG_ VCFRONT_a171_SCCM m171 : 37|1@1+ (1,0) [0|1] "" Vector__XXX
 SG_ VCFRONT_a171_LVBMS m171 : 38|1@1+ (1,0) [0|1] "" Vector__XXX
 SG_ VCFRONT_a171_IDB m171 : 39|1@1+ (1,0) [0|1] "" Vector__XXX
 SG_ VCFRONT_a171_IDB1 m171 : 40|1@1+ (1,0) [0|1] "" Vector__XXX
 SG_ VCFRONT_a171_IDBCAL m171 : 41|1@1+ (1,0) [0|1] "" Vector__XXX
 SG_ VCFRONT_a171_RCU m171 : 42|1@1+ (1,0) [0|1] "" Vector__XXX
 SG_ VCFRONT_a171_RCUCAL m171 : 43|1@1+ (1,0) [0|1] "" Vector__XXX
 SG_ VCFRONT_a171_DPB m171 : 44|1@1+ (1,0) [0|1] "" Vector__XXX
 SG_ VCFRONT_a171_DPBCAL m171 : 45|1@1+ (1,0) [0|1] "" Vector__XXX
 SG_ VCFRONT_a171_serviceMode m171 : 46|1@1+ (1,0) [0|1] "" Vector__XXX
 SG_ VCFRONT_a172_ECUMismatchBits m172 : 16|47@1+ (1,0) [0|140737488355327] "" Vector__XXX
 SG_ VCFRONT_a172_serviceMode m172 : 63|1@1+ (1,0) [0|1] "" Vector__XXX
 SG_ VCFRONT_a173_ECUMismatchBits m173 : 16|47@1+ (1,0) [0|140737488355327] "" Vector__XXX
 SG_ VCFRONT_a173_serviceMode m173 : 63|1@1+ (1,0) [0|1] "" Vector__XXX
 SG_ VCFRONT_a175_snsShortCircuit m175 : 16|1@1+ (1,0) [0|1] "" Vector__XXX
 SG_ VCFRONT_a175_snsDisconnect m175 : 17|1@1+ (1,0) [0|1] "" Vector__XXX
 SG_ VCFRONT_a175_snsRateChangeUp m175 : 18|1@1+ (1,0) [0|1] "" Vector__XXX
 SG_ VCFRONT_a175_snsRateChangeDown m175 : 19|1@1+ (1,0) [0|1] "" Vector__XXX
 SG_ VCFRONT_a176_vehicleState m176 : 16|3@1+ (1,0) [0|7] "" Vector__XXX
 SG_ VCFRONT_a177_mcuAudioCurrent m177 : 16|10@1+ (0.1,0) [0|102.3] "A" Vector__XXX
 SG_ VCFRONT_a179_highLVAmpsIntoPCSLo m179 : 16|1@1+ (1,0) [0|1] "" Vector__XXX
 SG_ VCFRONT_a180_vehiclePowerState m180 : 16|2@1+ (1,0) [0|3] "" Vector__XXX
 SG_ VCFRONT_a180_hvState m180 : 18|3@1+ (1,0) [0|7] "" Vector__XXX
 SG_ VCFRONT_a180_bmsState m180 : 24|4@1+ (1,0) [0|15] "" Vector__XXX
 SG_ VCFRONT_a180_notEnoughPowerForSu m180 : 28|1@1+ (1,0) [0|1] "" Vector__XXX
 SG_ VCFRONT_a180_pcsEFuseStable m180 : 29|1@1+ (1,0) [0|1] "" Vector__XXX
 SG_ VCFRONT_a180_vcrightEFuseStable m180 : 30|1@1+ (1,0) [0|1] "" Vector__XXX
 SG_ VCFRONT_a180_contactorEFuseStabl m180 : 31|1@1+ (1,0) [0|1] "" Vector__XXX
 SG_ VCFRONT_a180_hvcEFuseStable m180 : 32|1@1+ (1,0) [0|1] "" Vector__XXX
 SG_ VCFRONT_a180_replaceLVBattery m180 : 33|1@1+ (1,0) [0|1] "" Vector__XXX
 SG_ VCFRONT_a180_BMS_MIA m180 : 34|1@1+ (1,0) [0|1] "" Vector__XXX
 SG_ VCFRONT_a180_PCS_MIA m180 : 35|1@1+ (1,0) [0|1] "" Vector__XXX
 SG_ VCFRONT_a180_HVBlockingMismatch m180 : 36|1@1+ (1,0) [0|1] "" Vector__XXX
 SG_ VCFRONT_a180_serviceMode m180 : 37|1@1+ (1,0) [0|1] "" Vector__XXX
 SG_ VCFRONT_a180_transportMode m180 : 38|1@1+ (1,0) [0|1] "" Vector__XXX
 SG_ VCFRONT_a180_frunkOpen m180 : 39|1@1+ (1,0) [0|1] "" Vector__XXX
 SG_ VCFRONT_a180_dcdcLVSupportStatus m180 : 40|2@1+ (1,0) [0|3] "" Vector__XXX
 SG_ VCFRONT_a181_vehicleState m181 : 16|2@1+ (1,0) [0|3] "" Vector__XXX
 SG_ VCFRONT_a182_deadLV m182 : 16|1@1+ (1,0) [0|1] "" Vector__XXX
 SG_ VCFRONT_a182_voltageDrop m182 : 17|1@1+ (1,0) [0|1] "" Vector__XXX
 SG_ VCFRONT_a182_overcharge m182 : 18|1@1+ (1,0) [0|1] "" Vector__XXX
 SG_ VCFRONT_a182_LVFloorReached m182 : 19|1@1+ (1,0) [0|1] "" Vector__XXX
 SG_ VCFRONT_a182_shortedCell m182 : 20|1@1+ (1,0) [0|1] "" Vector__XXX
 SG_ VCFRONT_a182_postPORExcessiveAh m182 : 21|1@1+ (1,0) [0|1] "" Vector__XXX
 SG_ VCFRONT_a182_resistanceEstimatio m182 : 22|1@1+ (1,0) [0|1] "" Vector__XXX
 SG_ VCFRONT_a182_dcrMilliOhmsAboveTh m182 : 23|1@1+ (1,0) [0|1] "" Vector__XXX
 SG_ VCFRONT_a182_prechargeLVLoadRedu m182 : 24|1@1+ (1,0) [0|1] "" Vector__XXX
 SG_ VCFRONT_a182_factoryMode m182 : 25|1@1+ (1,0) [0|1] "" Vector__XXX
 SG_ VCFRONT_a182_serviceMode m182 : 26|1@1+ (1,0) [0|1] "" Vector__XXX
 SG_ VCFRONT_a182_transportMode m182 : 27|1@1+ (1,0) [0|1] "" Vector__XXX
 SG_ VCFRONT_a182_frunkOpen m182 : 28|1@1+ (1,0) [0|1] "" Vector__XXX
 SG_ VCFRONT_a182_packOverDischarged m182 : 29|1@1+ (1,0) [0|1] "" Vector__XXX
 SG_ VCFRONT_a182_cellImbalance m182 : 30|1@1+ (1,0) [0|1] "" Vector__XXX
 SG_ VCFRONT_a182_instantPrechargeDCR m182 : 31|1@1+ (1,0) [0|1] "" Vector__XXX
 SG_ VCFRONT_a182_ambientTemp m182 : 32|7@1+ (1,-40) [-39|87] "degC" Vector__XXX
 SG_ VCFRONT_a182_dischargedAmpHours m182 : 40|8@1+ (60,0) [0|15300] "Ah" Vector__XXX
 SG_ VCFRONT_a182_chargedAmpHours m182 : 48|8@1+ (60,0) [0|15300] "Ah" Vector__XXX
 SG_ VCFRONT_a182_calibrationLostFaul m182 : 56|1@1+ (1,0) [0|1] "" Vector__XXX
 SG_ VCFRONT_a182_samplingHWError m182 : 57|1@1+ (1,0) [0|1] "" Vector__XXX
 SG_ VCFRONT_a182_brickOverDischarged m182 : 58|1@1+ (1,0) [0|1] "" Vector__XXX
 SG_ VCFRONT_a182_batteryType m182 : 59|3@1+ (1,0) [0|7] "" Vector__XXX
 SG_ VCFRONT_a186_noDriveChgCableConX m186 : 16|1@1+ (1,0) [0|1] "" Vector__XXX
 SG_ VCFRONT_a187_vehBusRetryCount m187 : 16|9@1+ (1,0) [0|511] "" Vector__XXX
 SG_ VCFRONT_a187_partyBusRetryCount m187 : 25|9@1+ (1,0) [0|511] "" Vector__XXX
 SG_ VCFRONT_a187_hvsBusRetryCount m187 : 34|9@1+ (1,0) [0|511] "" Vector__XXX
 SG_ VCFRONT_a187_ethBusRetryCount m187 : 43|9@1+ (1,0) [0|511] "" Vector__XXX
 SG_ VCFRONT_a187_chBusRetryCount m187 : 52|9@1+ (1,0) [0|511] "" Vector__XXX
 SG_ VCFRONT_a188_sleepBypassCurrent m188 : 16|8@1+ (0.2,0) [0|51] "A" Vector__XXX
 SG_ VCFRONT_a188_IBSCurrent m188 : 24|12@1- (0.02,0) [-40.96|40.94] "A" Vector__XXX
 SG_ VCFRONT_a188_vehicleState m188 : 36|5@1+ (1,0) [0|31] "" Vector__XXX
 SG_ VCFRONT_a188_timeNotSleeping m188 : 41|6@1+ (1,0) [0|63] "sec" Vector__XXX
 SG_ VCFRONT_a188_chargeRequest m188 : 47|1@1+ (1,0) [0|1] "" Vector__XXX
 SG_ VCFRONT_a188_12VSupport m188 : 48|1@1+ (1,0) [0|1] "" Vector__XXX
 SG_ VCFRONT_a188_ThermalSupport m188 : 49|1@1+ (1,0) [0|1] "" Vector__XXX
 SG_ VCFRONT_a188_accessoryRequest m188 : 50|1@1+ (1,0) [0|1] "" Vector__XXX
 SG_ VCFRONT_a188_CANAfterQuiet m188 : 51|1@1+ (1,0) [0|1] "" Vector__XXX
 SG_ VCFRONT_a188_SleepRequestTimeout m188 : 52|1@1+ (1,0) [0|1] "" Vector__XXX
 SG_ VCFRONT_a188_wakeUpMsgID m188 : 53|11@1+ (1,0) [0|2047] "" Vector__XXX
 SG_ VCFRONT_a191_vehiclePowerState m191 : 16|2@1+ (1,0) [0|3] "" Vector__XXX
 SG_ VCFRONT_a191_hvState m191 : 18|3@1+ (1,0) [0|7] "" Vector__XXX
 SG_ VCFRONT_a191_reverseBatteryEFuse m191 : 21|1@1+ (1,0) [0|1] "" Vector__XXX
 SG_ VCFRONT_a191_vehicleLoadShedActi m191 : 22|1@1+ (1,0) [0|1] "" Vector__XXX
 SG_ VCFRONT_a191_vehicleLoadShedHvFa m191 : 23|1@1+ (1,0) [0|1] "" Vector__XXX
 SG_ VCFRONT_a191_vehicleLoadShedPost m191 : 24|1@1+ (1,0) [0|1] "" Vector__XXX
 SG_ VCFRONT_a191_IBSVoltage m191 : 25|8@1+ (0.08741903,0) [0|22.29185265] "V" Vector__XXX
 SG_ VCFRONT_a191_a180_DCDCNotSupport m191 : 33|1@1+ (1,0) [0|1] "" Vector__XXX
 SG_ VCFRONT_a191_MOSState m191 : 34|2@1+ (1,0) [0|2] "" Vector__XXX
 SG_ VCFRONT_a191_LVBMSVoltage m191 : 36|8@1+ (0.08741903,0) [0|22.29185265] "V" Vector__XXX
 SG_ VCFRONT_a191_ECPAState m191 : 44|2@1+ (1,0) [0|2] "" Vector__XXX
 SG_ VCFRONT_a191_LVBMSCurrentTargetV m191 : 46|1@1+ (1,0) [0|1] "" Vector__XXX
 SG_ VCFRONT_a191_LVBMSVoltageTargetV m191 : 47|1@1+ (1,0) [0|1] "" Vector__XXX
 SG_ VCFRONT_a191_serviceMode m191 : 48|1@1+ (1,0) [0|1] "" Vector__XXX
 SG_ VCFRONT_a191_frunkOpen m191 : 49|1@1+ (1,0) [0|1] "" Vector__XXX
 SG_ VCFRONT_a191_vehicleLoadShedStag m191 : 50|2@1+ (1,0) [0|3] "" Vector__XXX
 SG_ VCFRONT_a191_exitDriveWarningTim m191 : 52|1@1+ (1,0) [0|1] "" Vector__XXX
 SG_ VCFRONT_a191_LVBMSMIA m191 : 53|1@1+ (1,0) [0|1] "" Vector__XXX
 SG_ VCFRONT_a191_PCS_MIA m191 : 54|1@1+ (1,0) [0|1] "" Vector__XXX
 SG_ VCFRONT_a191_NotEnoughPowerForSu m191 : 55|1@1+ (1,0) [0|1] "" Vector__XXX
 SG_ VCFRONT_a191_bmsState m191 : 56|4@1+ (1,0) [0|15] "" Vector__XXX
 SG_ VCFRONT_a192_vehiclePowerState m192 : 16|2@1+ (1,0) [0|3] "" Vector__XXX
 SG_ VCFRONT_a192_hvState m192 : 18|3@1+ (1,0) [0|7] "" Vector__XXX
 SG_ VCFRONT_a192_notEnoughPowerForSu m192 : 21|1@1+ (1,0) [0|1] "" Vector__XXX
 SG_ VCFRONT_a192_pcsEFuseStable m192 : 22|1@1+ (1,0) [0|1] "" Vector__XXX
 SG_ VCFRONT_a192_vcrightEFuseStable m192 : 23|1@1+ (1,0) [0|1] "" Vector__XXX
 SG_ VCFRONT_a192_contactorEFuseStabl m192 : 24|1@1+ (1,0) [0|1] "" Vector__XXX
 SG_ VCFRONT_a192_hvcEFuseStable m192 : 25|1@1+ (1,0) [0|1] "" Vector__XXX
 SG_ VCFRONT_a192_replaceLVBattery m192 : 26|1@1+ (1,0) [0|1] "" Vector__XXX
 SG_ VCFRONT_a192_BMS_MIA m192 : 27|1@1+ (1,0) [0|1] "" Vector__XXX
 SG_ VCFRONT_a192_PCS_MIA m192 : 28|1@1+ (1,0) [0|1] "" Vector__XXX
 SG_ VCFRONT_a192_HVBlockingMismatch m192 : 29|1@1+ (1,0) [0|1] "" Vector__XXX
 SG_ VCFRONT_a192_disconnected12V m192 : 30|1@1+ (1,0) [0|1] "" Vector__XXX
 SG_ VCFRONT_a192_LVBatteryCannotSupp m192 : 31|1@1+ (1,0) [0|1] "" Vector__XXX
 SG_ VCFRONT_a192_DI_gear m192 : 32|3@1+ (1,0) [0|6] "" Vector__XXX
 SG_ VCFRONT_a192_GTW_factoryGated m192 : 35|1@1+ (1,0) [0|1] "" Vector__XXX
 SG_ VCFRONT_a192_GTW_updateStarted m192 : 36|1@1+ (1,0) [0|1] "" Vector__XXX
 SG_ VCFRONT_a192_serviceMode m192 : 37|1@1+ (1,0) [0|1] "" Vector__XXX
 SG_ VCFRONT_a192_frunkOpen m192 : 38|1@1+ (1,0) [0|1] "" Vector__XXX
 SG_ VCFRONT_a192_IBSCurrent m192 : 40|8@1+ (0.5,-63) [-63|64.5] "A" Vector__XXX
 SG_ VCFRONT_a192_PCSCurrent m192 : 48|8@1+ (0.5,-127) [-127|0.5] "A" Vector__XXX
 SG_ VCFRONT_a192_HVFaultLoadShedActi m192 : 56|1@1+ (1,0) [0|1] "" Vector__XXX
 SG_ VCFRONT_a192_postCrashLoadShedAc m192 : 57|1@1+ (1,0) [0|1] "" Vector__XXX
 SG_ VCFRONT_a195_IBSVoltage m195 : 16|12@1+ (0.005443676,0) [0|22.29185322] "V" Vector__XXX
 SG_ VCFRONT_a195_serviceMode m195 : 28|1@1+ (1,0) [0|1] "" Vector__XXX
 SG_ VCFRONT_a195_frunkOpen m195 : 29|1@1+ (1,0) [0|1] "" Vector__XXX
 SG_ VCFRONT_a196_factoryMode m196 : 16|1@1+ (1,0) [0|1] "" Vector__XXX
 SG_ VCFRONT_a196_serviceMode m196 : 17|1@1+ (1,0) [0|1] "" Vector__XXX
 SG_ VCFRONT_a196_transportMode m196 : 18|1@1+ (1,0) [0|1] "" Vector__XXX
 SG_ VCFRONT_a196_frunkOpen m196 : 19|1@1+ (1,0) [0|1] "" Vector__XXX
 SG_ VCFRONT_a196_vehiclePowerState m196 : 20|2@1+ (1,0) [0|3] "" Vector__XXX
 SG_ VCFRONT_a196_batterySMState m196 : 24|4@1+ (1,0) [0|15] "" Vector__XXX
 SG_ VCFRONT_a196_disconnectedBattery m196 : 28|12@1+ (0.004884005,-10) [-10|10.000000475] "A" Vector__XXX
 SG_ VCFRONT_a196_disconnectedBa_0002 m196 : 40|8@1+ (0.0392156876624,6) [6|16.0000003539] "V" Vector__XXX
 SG_ VCFRONT_a196_disconnectedBa_0001 m196 : 48|8@1+ (0.0392156876624,6) [6|16.0000003539] "V" Vector__XXX
 SG_ VCFRONT_a196_ECPAState m196 : 56|2@1+ (1,0) [0|2] "" Vector__XXX
 SG_ VCFRONT_a198_outputState m198 : 16|1@1+ (1,0) [0|1] "" Vector__XXX
 SG_ VCFRONT_a198_NVRAMState m198 : 17|1@1+ (1,0) [0|1] "" Vector__XXX
 SG_ VCFRONT_a198_lockoutState m198 : 18|1@1+ (1,0) [0|1] "" Vector__XXX
 SG_ VCFRONT_a199_outputState m199 : 16|1@1+ (1,0) [0|1] "" Vector__XXX
 SG_ VCFRONT_a199_NVRAMState m199 : 17|1@1+ (1,0) [0|1] "" Vector__XXX
 SG_ VCFRONT_a199_lockoutState m199 : 18|1@1+ (1,0) [0|1] "" Vector__XXX
 SG_ VCFRONT_a200_vcleftSelfTest m200 : 16|4@1+ (1,0) [0|15] "" Vector__XXX
 SG_ VCFRONT_a201_vcrightSelfTest m201 : 16|4@1+ (1,0) [0|15] "" Vector__XXX
 SG_ VCFRONT_a202_pcsSelfTest m202 : 16|4@1+ (1,0) [0|15] "" Vector__XXX
 SG_ VCFRONT_a207_vbatFusedSelfTest m207 : 16|4@1+ (1,0) [0|15] "" Vector__XXX
 SG_ VCFRONT_a210_valveUnderTravel m210 : 16|1@1+ (1,0) [0|1] "" Vector__XXX
 SG_ VCFRONT_a210_valveOverTravel m210 : 17|1@1+ (1,0) [0|1] "" Vector__XXX
 SG_ VCFRONT_a210_valveNoTravel m210 : 18|1@1+ (1,0) [0|1] "" Vector__XXX
 SG_ VCFRONT_a212_IBSTemp m212 : 16|16@1- (0.01,0) [-327.68|327.67] "degC" Vector__XXX
 SG_ VCFRONT_a213_IBSVolts m213 : 16|12@1+ (0.005443676,0) [0|22.29185322] "V" Vector__XXX
 SG_ VCFRONT_a213_IBSAh m213 : 32|14@1- (0.01,0) [-81.92|81.91] "Ah" Vector__XXX
 SG_ VCFRONT_a213_LVBatteryTemp m213 : 48|16@1- (0.01,0) [-327.68|327.67] "degC" Vector__XXX
 SG_ VCFRONT_a214_motorFaulted m214 : 16|1@1+ (1,0) [0|1] "" Vector__XXX
 SG_ VCFRONT_a214_motorLocked m214 : 17|1@1+ (1,0) [0|1] "" Vector__XXX
 SG_ VCFRONT_a214_ecuReset m214 : 18|1@1+ (1,0) [0|1] "" Vector__XXX
 SG_ VCFRONT_a214_fetTempIrrational m214 : 19|1@1+ (1,0) [0|1] "" Vector__XXX
 SG_ VCFRONT_a214_motorControlError m214 : 20|1@1+ (1,0) [0|1] "" Vector__XXX
 SG_ VCFRONT_a214_underVoltage m214 : 21|1@1+ (1,0) [0|1] "" Vector__XXX
 SG_ VCFRONT_a214_overVoltage m214 : 22|1@1+ (1,0) [0|1] "" Vector__XXX
 SG_ VCFRONT_a214_hardwareOvercurrent m214 : 23|1@1+ (1,0) [0|1] "" Vector__XXX
 SG_ VCFRONT_a214_motorOpenPhase m214 : 24|1@1+ (1,0) [0|1] "" Vector__XXX
 SG_ VCFRONT_a214_motorSoftOpenPhase m214 : 25|1@1+ (1,0) [0|1] "" Vector__XXX
 SG_ VCFRONT_a214_motorOvertemp m214 : 26|1@1+ (1,0) [0|1] "" Vector__XXX
 SG_ VCFRONT_a214_dcOvercurrent m214 : 27|1@1+ (1,0) [0|1] "" Vector__XXX
 SG_ VCFRONT_a214_motorStalled m214 : 28|1@1+ (1,0) [0|1] "" Vector__XXX
 SG_ VCFRONT_a214_selfTestFailed m214 : 29|1@1+ (1,0) [0|1] "" Vector__XXX
 SG_ VCFRONT_a214_selfTestResult m214 : 32|3@1+ (1,0) [0|7] "" Vector__XXX
 SG_ VCFRONT_a214_linChecksumError m214 : 35|1@1+ (1,0) [0|1] "" Vector__XXX
 SG_ VCFRONT_a214_linFramingError m214 : 36|1@1+ (1,0) [0|1] "" Vector__XXX
 SG_ VCFRONT_a214_phaseShorted m214 : 37|1@1+ (1,0) [0|1] "" Vector__XXX
 SG_ VCFRONT_a214_busVoltageIrrationa m214 : 38|1@1+ (1,0) [0|1] "" Vector__XXX
 SG_ VCFRONT_a214_dcCurrentIrrational m214 : 39|1@1+ (1,0) [0|1] "" Vector__XXX
 SG_ VCFRONT_a214_motorSpeedIrrationa m214 : 40|1@1+ (1,0) [0|1] "" Vector__XXX
 SG_ VCFRONT_a214_supplyVoltageIrrati m214 : 41|1@1+ (1,0) [0|1] "" Vector__XXX
 SG_ VCFRONT_a214_motorPhaseCurrentIr m214 : 42|1@1+ (1,0) [0|1] "" Vector__XXX
 SG_ VCFRONT_a214_chipOvertemp m214 : 43|1@1+ (1,0) [0|1] "" Vector__XXX
 SG_ VCFRONT_a214_motorSpeedTooHigh m214 : 44|1@1+ (1,0) [0|1] "" Vector__XXX
 SG_ VCFRONT_a214_phaseOvercurrent m214 : 45|1@1+ (1,0) [0|1] "" Vector__XXX
 SG_ VCFRONT_a214_vddaOvercurrent m214 : 46|1@1+ (1,0) [0|1] "" Vector__XXX
 SG_ VCFRONT_a214_busVoltageUnhealthy m214 : 47|1@1+ (1,0) [0|1] "" Vector__XXX
 SG_ VCFRONT_a214_hsVdsOvervoltage m214 : 48|1@1+ (1,0) [0|1] "" Vector__XXX
 SG_ VCFRONT_a214_hsVdsOvervoltageMas m214 : 49|3@1+ (1,0) [0|7] "" Vector__XXX
 SG_ VCFRONT_a214_lsVdsOvervoltage m214 : 52|1@1+ (1,0) [0|1] "" Vector__XXX
 SG_ VCFRONT_a214_lsVdsOvervoltageMas m214 : 53|3@1+ (1,0) [0|7] "" Vector__XXX
 SG_ VCFRONT_a214_payloadBitsNotSet m214 : 56|1@1+ (1,0) [0|1] "" Vector__XXX
 SG_ VCFRONT_a216_inDrive m216 : 16|1@1+ (1,0) [0|1] "" Vector__XXX
 SG_ VCFRONT_a216_hvState m216 : 17|3@1+ (1,0) [0|7] "" Vector__XXX
 SG_ VCFRONT_a216_vcleftFastBlowImmin m216 : 20|1@1+ (1,0) [0|1] "" Vector__XXX
 SG_ VCFRONT_a216_vcleftFastBlowDebou m216 : 21|1@1+ (1,0) [0|1] "" Vector__XXX
 SG_ VCFRONT_a216_vcleftStaticImminen m216 : 22|1@1+ (1,0) [0|1] "" Vector__XXX
 SG_ VCFRONT_a216_vcleftDynamicImmine m216 : 23|1@1+ (1,0) [0|1] "" Vector__XXX
 SG_ VCFRONT_a216_vcrightFastBlowImmi m216 : 24|1@1+ (1,0) [0|1] "" Vector__XXX
 SG_ VCFRONT_a216_vcrightFastBlowDebo m216 : 25|1@1+ (1,0) [0|1] "" Vector__XXX
 SG_ VCFRONT_a216_vcrightStaticImmine m216 : 26|1@1+ (1,0) [0|1] "" Vector__XXX
 SG_ VCFRONT_a216_vcrightDynamicImmin m216 : 27|1@1+ (1,0) [0|1] "" Vector__XXX
 SG_ VCFRONT_a217_motorFaulted m217 : 16|1@1+ (1,0) [0|1] "" Vector__XXX
 SG_ VCFRONT_a217_motorLocked m217 : 17|1@1+ (1,0) [0|1] "" Vector__XXX
 SG_ VCFRONT_a217_ecuReset m217 : 18|1@1+ (1,0) [0|1] "" Vector__XXX
 SG_ VCFRONT_a217_fetTempIrrational m217 : 19|1@1+ (1,0) [0|1] "" Vector__XXX
 SG_ VCFRONT_a217_motorControlError m217 : 20|1@1+ (1,0) [0|1] "" Vector__XXX
 SG_ VCFRONT_a217_underVoltage m217 : 21|1@1+ (1,0) [0|1] "" Vector__XXX
 SG_ VCFRONT_a217_overVoltage m217 : 22|1@1+ (1,0) [0|1] "" Vector__XXX
 SG_ VCFRONT_a217_hardwareOvercurrent m217 : 23|1@1+ (1,0) [0|1] "" Vector__XXX
 SG_ VCFRONT_a217_motorOpenPhase m217 : 24|1@1+ (1,0) [0|1] "" Vector__XXX
 SG_ VCFRONT_a217_motorSoftOpenPhase m217 : 25|1@1+ (1,0) [0|1] "" Vector__XXX
 SG_ VCFRONT_a217_motorOvertemp m217 : 26|1@1+ (1,0) [0|1] "" Vector__XXX
 SG_ VCFRONT_a217_dcOvercurrent m217 : 27|1@1+ (1,0) [0|1] "" Vector__XXX
 SG_ VCFRONT_a217_motorStalled m217 : 28|1@1+ (1,0) [0|1] "" Vector__XXX
 SG_ VCFRONT_a217_selfTestFailed m217 : 29|1@1+ (1,0) [0|1] "" Vector__XXX
 SG_ VCFRONT_a217_selfTestResult m217 : 32|3@1+ (1,0) [0|7] "" Vector__XXX
 SG_ VCFRONT_a217_linChecksumError m217 : 35|1@1+ (1,0) [0|1] "" Vector__XXX
 SG_ VCFRONT_a217_linFramingError m217 : 36|1@1+ (1,0) [0|1] "" Vector__XXX
 SG_ VCFRONT_a217_phaseShorted m217 : 37|1@1+ (1,0) [0|1] "" Vector__XXX
 SG_ VCFRONT_a217_busVoltageIrrationa m217 : 38|1@1+ (1,0) [0|1] "" Vector__XXX
 SG_ VCFRONT_a217_dcCurrentIrrational m217 : 39|1@1+ (1,0) [0|1] "" Vector__XXX
 SG_ VCFRONT_a217_motorSpeedIrrationa m217 : 40|1@1+ (1,0) [0|1] "" Vector__XXX
 SG_ VCFRONT_a217_supplyVoltageIrrati m217 : 41|1@1+ (1,0) [0|1] "" Vector__XXX
 SG_ VCFRONT_a217_motorPhaseCurrentIr m217 : 42|1@1+ (1,0) [0|1] "" Vector__XXX
 SG_ VCFRONT_a217_chipOvertemp m217 : 43|1@1+ (1,0) [0|1] "" Vector__XXX
 SG_ VCFRONT_a217_motorSpeedTooHigh m217 : 44|1@1+ (1,0) [0|1] "" Vector__XXX
 SG_ VCFRONT_a217_phaseOvercurrent m217 : 45|1@1+ (1,0) [0|1] "" Vector__XXX
 SG_ VCFRONT_a217_vddaOvercurrent m217 : 46|1@1+ (1,0) [0|1] "" Vector__XXX
 SG_ VCFRONT_a217_busVoltageUnhealthy m217 : 47|1@1+ (1,0) [0|1] "" Vector__XXX
 SG_ VCFRONT_a217_hsVdsOvervoltage m217 : 48|1@1+ (1,0) [0|1] "" Vector__XXX
 SG_ VCFRONT_a217_hsVdsOvervoltageMas m217 : 49|3@1+ (1,0) [0|7] "" Vector__XXX
 SG_ VCFRONT_a217_lsVdsOvervoltage m217 : 52|1@1+ (1,0) [0|1] "" Vector__XXX
 SG_ VCFRONT_a217_lsVdsOvervoltageMas m217 : 53|3@1+ (1,0) [0|7] "" Vector__XXX
 SG_ VCFRONT_a217_payloadBitsNotSet m217 : 56|1@1+ (1,0) [0|1] "" Vector__XXX
 SG_ VCFRONT_a219_IBSVolts m219 : 16|12@1+ (0.005443676,0) [0|22.29185322] "V" Vector__XXX
 SG_ VCFRONT_a219_IBSAh m219 : 32|14@1- (0.01,0) [-81.92|81.91] "Ah" Vector__XXX
 SG_ VCFRONT_a219_IBSCurrent m219 : 48|16@1- (0.005,0) [-163.84|163.835] "A" Vector__XXX
 SG_ VCFRONT_a220_IBSCurrent m220 : 16|16@1- (0.005,0) [-163.84|163.835] "A" Vector__XXX
 SG_ VCFRONT_a220_PCSCurrent m220 : 32|8@1+ (0.5,-127) [-127|0.5] "A" Vector__XXX
 SG_ VCFRONT_a220_serviceMode m220 : 40|1@1+ (1,0) [0|1] "" Vector__XXX
 SG_ VCFRONT_a220_frunkOpen m220 : 41|1@1+ (1,0) [0|1] "" Vector__XXX
 SG_ VCFRONT_a221_outputFaulted m221 : 16|1@1+ (1,0) [0|1] "" Vector__XXX
 SG_ VCFRONT_a221_currentSenseFaulted m221 : 17|1@1+ (1,0) [0|1] "" Vector__XXX
 SG_ VCFRONT_a221_tempSenseFaulted m221 : 18|1@1+ (1,0) [0|1] "" Vector__XXX
 SG_ VCFRONT_a221_underCurrent m221 : 19|1@1+ (1,0) [0|1] "" Vector__XXX
 SG_ VCFRONT_a221_overCurrent m221 : 20|1@1+ (1,0) [0|1] "" Vector__XXX
 SG_ VCFRONT_a221_overTemperature m221 : 21|1@1+ (1,0) [0|1] "" Vector__XXX
 SG_ VCFRONT_a222_outputFaulted m222 : 16|1@1+ (1,0) [0|1] "" Vector__XXX
 SG_ VCFRONT_a222_currentSenseFaulted m222 : 17|1@1+ (1,0) [0|1] "" Vector__XXX
 SG_ VCFRONT_a222_tempSenseFaulted m222 : 18|1@1+ (1,0) [0|1] "" Vector__XXX
 SG_ VCFRONT_a222_underCurrent m222 : 19|1@1+ (1,0) [0|1] "" Vector__XXX
 SG_ VCFRONT_a222_overCurrent m222 : 20|1@1+ (1,0) [0|1] "" Vector__XXX
 SG_ VCFRONT_a222_overTemperature m222 : 21|1@1+ (1,0) [0|1] "" Vector__XXX
 SG_ VCFRONT_a223_12VTemperature m223 : 16|16@1- (0.1,0) [-3276.8|3276.7] "C" Vector__XXX
 SG_ VCFRONT_a227_motorFaulted m227 : 16|1@1+ (1,0) [0|1] "" Vector__XXX
 SG_ VCFRONT_a227_motorLocked m227 : 17|1@1+ (1,0) [0|1] "" Vector__XXX
 SG_ VCFRONT_a227_ecuReset m227 : 18|1@1+ (1,0) [0|1] "" Vector__XXX
 SG_ VCFRONT_a227_fetTempIrrational m227 : 19|1@1+ (1,0) [0|1] "" Vector__XXX
 SG_ VCFRONT_a227_motorControlError m227 : 20|1@1+ (1,0) [0|1] "" Vector__XXX
 SG_ VCFRONT_a227_underVoltage m227 : 21|1@1+ (1,0) [0|1] "" Vector__XXX
 SG_ VCFRONT_a227_overVoltage m227 : 22|1@1+ (1,0) [0|1] "" Vector__XXX
 SG_ VCFRONT_a227_hardwareOvercurrent m227 : 23|1@1+ (1,0) [0|1] "" Vector__XXX
 SG_ VCFRONT_a227_motorOpenPhase m227 : 24|1@1+ (1,0) [0|1] "" Vector__XXX
 SG_ VCFRONT_a227_motorSoftOpenPhase m227 : 25|1@1+ (1,0) [0|1] "" Vector__XXX
 SG_ VCFRONT_a227_motorOvertemp m227 : 26|1@1+ (1,0) [0|1] "" Vector__XXX
 SG_ VCFRONT_a227_dcOvercurrent m227 : 27|1@1+ (1,0) [0|1] "" Vector__XXX
 SG_ VCFRONT_a227_motorStalled m227 : 28|1@1+ (1,0) [0|1] "" Vector__XXX
 SG_ VCFRONT_a227_selfTestFailed m227 : 29|1@1+ (1,0) [0|1] "" Vector__XXX
 SG_ VCFRONT_a227_selfTestResult m227 : 32|3@1+ (1,0) [0|7] "" Vector__XXX
 SG_ VCFRONT_a227_linChecksumError m227 : 35|1@1+ (1,0) [0|1] "" Vector__XXX
 SG_ VCFRONT_a227_linFramingError m227 : 36|1@1+ (1,0) [0|1] "" Vector__XXX
 SG_ VCFRONT_a227_phaseShorted m227 : 37|1@1+ (1,0) [0|1] "" Vector__XXX
 SG_ VCFRONT_a227_busVoltageIrrationa m227 : 38|1@1+ (1,0) [0|1] "" Vector__XXX
 SG_ VCFRONT_a227_dcCurrentIrrational m227 : 39|1@1+ (1,0) [0|1] "" Vector__XXX
 SG_ VCFRONT_a227_motorSpeedIrrationa m227 : 40|1@1+ (1,0) [0|1] "" Vector__XXX
 SG_ VCFRONT_a227_supplyVoltageIrrati m227 : 41|1@1+ (1,0) [0|1] "" Vector__XXX
 SG_ VCFRONT_a227_motorPhaseCurrentIr m227 : 42|1@1+ (1,0) [0|1] "" Vector__XXX
 SG_ VCFRONT_a227_chipOvertemp m227 : 43|1@1+ (1,0) [0|1] "" Vector__XXX
 SG_ VCFRONT_a227_motorSpeedTooHigh m227 : 44|1@1+ (1,0) [0|1] "" Vector__XXX
 SG_ VCFRONT_a227_phaseOvercurrent m227 : 45|1@1+ (1,0) [0|1] "" Vector__XXX
 SG_ VCFRONT_a227_vddaOvercurrent m227 : 46|1@1+ (1,0) [0|1] "" Vector__XXX
 SG_ VCFRONT_a227_busVoltageUnhealthy m227 : 47|1@1+ (1,0) [0|1] "" Vector__XXX
 SG_ VCFRONT_a227_hsVdsOvervoltage m227 : 48|1@1+ (1,0) [0|1] "" Vector__XXX
 SG_ VCFRONT_a227_hsVdsOvervoltageMas m227 : 49|3@1+ (1,0) [0|7] "" Vector__XXX
 SG_ VCFRONT_a227_lsVdsOvervoltage m227 : 52|1@1+ (1,0) [0|1] "" Vector__XXX
 SG_ VCFRONT_a227_lsVdsOvervoltageMas m227 : 53|3@1+ (1,0) [0|7] "" Vector__XXX
 SG_ VCFRONT_a227_payloadBitsNotSet m227 : 56|1@1+ (1,0) [0|1] "" Vector__XXX
 SG_ VCFRONT_a231_12VTemperature m231 : 16|16@1- (0.1,0) [-3276.8|3276.7] "C" Vector__XXX
 SG_ VCFRONT_a233_current m233 : 16|10@1+ (0.1,0) [0|102.3] "A" Vector__XXX
 SG_ VCFRONT_a234_current m234 : 16|10@1+ (0.1,0) [0|102.3] "A" Vector__XXX
 SG_ VCFRONT_a235_ptSensorTemp m235 : 16|11@1+ (0.125,-40) [-40|215.875] "degC" Vector__XXX
 SG_ VCFRONT_a236_batSensorTemp m236 : 16|11@1+ (0.125,-40) [-40|215.875] "degC" Vector__XXX
 SG_ VCFRONT_a242_LVBatteryTemp m242 : 16|7@1+ (1,-40) [-40|86] "degC" Vector__XXX
 SG_ VCFRONT_a242_IBSCurrent m242 : 24|12@1- (0.1,0) [-204.8|204.7] "A" Vector__XXX
 SG_ VCFRONT_a242_IBSVoltage m242 : 36|11@1+ (0.0108873518184,0) [0|22.2864091723] "V" Vector__XXX
 SG_ VCFRONT_a242_IBSAmpHours m242 : 48|8@1+ (0.01,-2.55) [-2.55|4.4408920985e-16] "Ah" Vector__XXX
 SG_ VCFRONT_a242_vehiclePowerState m242 : 56|2@1+ (1,0) [0|3] "" Vector__XXX
 SG_ VCFRONT_a243_IBSVolts m243 : 16|12@1+ (0.005443676,0) [0|22.29185322] "V" Vector__XXX
 SG_ VCFRONT_a243_IBSCurrent m243 : 32|16@1- (0.005,0) [-163.84|163.835] "A" Vector__XXX
 SG_ VCFRONT_a243_LVBatteryTemp m243 : 48|16@1- (0.01,0) [-327.68|327.67] "degC" Vector__XXX
 SG_ VCFRONT_a244_current m244 : 16|16@1+ (0.1,0) [0|6553.5] "A" Vector__XXX
 SG_ VCFRONT_a244_voltage m244 : 32|16@1+ (0.1,0) [0|6553.5] "V" Vector__XXX
 SG_ VCFRONT_a244_vbatProtVoltage m244 : 48|16@1+ (0.1,0) [0|6553.5] "V" Vector__XXX
 SG_ VCFRONT_a245_current m245 : 16|16@1+ (0.1,0) [0|6553.5] "A" Vector__XXX
 SG_ VCFRONT_a245_voltage m245 : 32|16@1+ (0.1,0) [0|6553.5] "V" Vector__XXX
 SG_ VCFRONT_a245_eFuseRemainingRetri m245 : 48|4@1+ (1,0) [0|15] "" Vector__XXX
 SG_ VCFRONT_a246_current m246 : 16|16@1+ (0.1,0) [0|6553.5] "A" Vector__XXX
 SG_ VCFRONT_a246_voltage m246 : 32|16@1+ (0.1,0) [0|6553.5] "V" Vector__XXX
 SG_ VCFRONT_a246_eFuseRemainingRetri m246 : 48|4@1+ (1,0) [0|15] "" Vector__XXX
 SG_ VCFRONT_a247_solenoidISense m247 : 16|8@1- (0.01,0) [-1.28|1.27] "A" Vector__XXX
 SG_ VCFRONT_a248_AS8510Voltage m248 : 16|12@1+ (0.005443676,0) [0|22.29185322] "V" Vector__XXX
 SG_ VCFRONT_a248_IBSVoltage m248 : 28|12@1+ (0.005443676,0) [0|22.29185322] "V" Vector__XXX
 SG_ VCFRONT_a248_vbatMonitor m248 : 40|12@1+ (0.005443676,0) [0|22.29185322] "V" Vector__XXX
 SG_ VCFRONT_a248_voltageCalScaling m248 : 52|12@1+ (0.025,0) [0|102.375] "%" Vector__XXX
 SG_ VCFRONT_a249_tempCoolantBatInlet m249 : 16|10@1+ (0.125,-40) [-40|87.875] "degC" Vector__XXX
 SG_ VCFRONT_a249_tempCoolantPTInlet m249 : 26|11@1+ (0.125,-40) [-40|215.875] "degC" Vector__XXX
 SG_ VCFRONT_a250_isGlobalHeadlamps m250 : 16|1@1+ (1,0) [0|1] "" Vector__XXX
 SG_ VCFRONT_a250_isVirtualPitchSenso m250 : 17|1@1+ (1,0) [0|1] "" Vector__XXX
 SG_ VCFRONT_a250_isAimedHCML m250 : 18|1@1+ (1,0) [0|1] "" Vector__XXX
 SG_ VCFRONT_a250_isAimedHCMR m250 : 19|1@1+ (1,0) [0|1] "" Vector__XXX
 SG_ VCFRONT_a250_calibratedVerticalP m250 : 20|10@1+ (1,0) [0|1022] "Steps" Vector__XXX
 SG_ VCFRONT_a250_calibratedVert_0001 m250 : 30|10@1+ (1,0) [0|1022] "Steps" Vector__XXX
 SG_ VCFRONT_a250_calibratedHorizonta m250 : 40|10@1+ (1,0) [0|1022] "Steps" Vector__XXX
 SG_ VCFRONT_a250_calibratedHori_0001 m250 : 50|10@1+ (1,0) [0|1022] "Steps" Vector__XXX
 SG_ VCFRONT_a253_currentNotTapered m253 : 16|1@1+ (1,0) [0|1] "" Vector__XXX
 SG_ VCFRONT_a253_ampHourTargetNotRea m253 : 17|1@1+ (1,0) [0|1] "" Vector__XXX
 SG_ VCFRONT_a253_IBSCurrent m253 : 18|16@1- (0.005,0) [-163.84|163.835] "A" Vector__XXX
 SG_ VCFRONT_a253_IBSAmpHours m253 : 34|14@1- (0.01,0) [-81.92|81.91] "Ah" Vector__XXX
 SG_ VCFRONT_a253_LVBatteryTemp m253 : 48|7@1+ (1,-40) [-40|86] "degC" Vector__XXX
 SG_ VCFRONT_a253_firstChargeOTA m253 : 55|1@1+ (1,0) [0|1] "" Vector__XXX
 SG_ VCFRONT_a253_firstChargePOR m253 : 56|1@1+ (1,0) [0|1] "" Vector__XXX
 SG_ VCFRONT_a253_serviceMode m253 : 57|1@1+ (1,0) [0|1] "" Vector__XXX
 SG_ VCFRONT_a253_frunkOpen m253 : 58|1@1+ (1,0) [0|1] "" Vector__XXX
 SG_ VCFRONT_a254_RPMActual m254 : 16|10@1+ (10,0) [0|10230] "RPM" Vector__XXX
 SG_ VCFRONT_a254_RPMTarget m254 : 26|10@1+ (10,0) [0|10230] "RPM" Vector__XXX
 SG_ VCFRONT_a255_RPMActual m255 : 16|10@1+ (10,0) [0|10230] "RPM" Vector__XXX
 SG_ VCFRONT_a255_RPMTarget m255 : 26|10@1+ (10,0) [0|10230] "RPM" Vector__XXX
 SG_ VCFRONT_a257_lockoutVoltage m257 : 16|16@1+ (0.1,0) [0|6553.5] "V" Vector__XXX
 SG_ VCFRONT_a257_vcrightLockoutStatu m257 : 32|2@1+ (1,0) [0|3] "" Vector__XXX
 SG_ VCFRONT_a257_vcleftFault m257 : 34|1@1+ (1,0) [0|1] "" Vector__XXX
 SG_ VCFRONT_a257_vcrightFault m257 : 35|1@1+ (1,0) [0|1] "" Vector__XXX
 SG_ VCFRONT_a257_pcsFault m257 : 36|1@1+ (1,0) [0|1] "" Vector__XXX
 SG_ VCFRONT_a257_vbatFusedFault m257 : 37|1@1+ (1,0) [0|1] "" Vector__XXX
 SG_ VCFRONT_a257_iBoosterFault m257 : 38|1@1+ (1,0) [0|1] "" Vector__XXX
 SG_ VCFRONT_a257_espFault m257 : 39|1@1+ (1,0) [0|1] "" Vector__XXX
 SG_ VCFRONT_a257_epas3pFault m257 : 40|1@1+ (1,0) [0|1] "" Vector__XXX
 SG_ VCFRONT_a257_epas3sFault m257 : 41|1@1+ (1,0) [0|1] "" Vector__XXX
 SG_ VCFRONT_a257_revBattFault m257 : 42|1@1+ (1,0) [0|1] "" Vector__XXX
 SG_ VCFRONT_a257_vehicleState m257 : 43|5@1+ (1,0) [0|31] "" Vector__XXX
 SG_ VCFRONT_a259_serviceMode m259 : 16|1@1+ (1,0) [0|1] "" Vector__XXX
 SG_ VCFRONT_a259_voltageDropCounter m259 : 17|3@1+ (2,0) [0|14] "-" Vector__XXX
 SG_ VCFRONT_a259_minVoltageReached m259 : 20|12@1+ (0.005443676,0) [0|22.29185322] "V" Vector__XXX
 SG_ VCFRONT_a259_IBSTemp m259 : 32|16@1- (0.01,0) [-327.68|327.67] "degC" Vector__XXX
 SG_ VCFRONT_a259_maxCurrentReached m259 : 48|16@1- (0.005,0) [-163.84|163.835] "A" Vector__XXX
 SG_ VCFRONT_a260_IBSVolts m260 : 16|12@1+ (0.005443676,0) [0|22.29185322] "V" Vector__XXX
 SG_ VCFRONT_a260_IBSAh m260 : 28|12@1- (0.1,0) [-204.8|204.7] "Ah" Vector__XXX
 SG_ VCFRONT_a260_vehiclePowerState m260 : 40|2@1+ (1,0) [0|3] "" Vector__XXX
 SG_ VCFRONT_a260_batterySMState m260 : 42|4@1+ (1,0) [0|15] "" Vector__XXX
 SG_ VCFRONT_a260_HV_UP m260 : 46|1@1+ (1,0) [0|1] "" Vector__XXX
 SG_ VCFRONT_a260_notEnoughPowerForSu m260 : 47|1@1+ (1,0) [0|1] "" Vector__XXX
 SG_ VCFRONT_a260_coolantHasBeenFille m260 : 48|1@1+ (1,0) [0|1] "" Vector__XXX
 SG_ VCFRONT_a260_ampHourTrigger m260 : 49|1@1+ (1,0) [0|1] "" Vector__XXX
 SG_ VCFRONT_a260_voltageTrigger m260 : 50|1@1+ (1,0) [0|1] "" Vector__XXX
 SG_ VCFRONT_a260_crashDetected m260 : 51|1@1+ (1,0) [0|1] "" Vector__XXX
 SG_ VCFRONT_a260_BMS_MIA m260 : 52|1@1+ (1,0) [0|1] "" Vector__XXX
 SG_ VCFRONT_a260_PCS_MIA m260 : 53|1@1+ (1,0) [0|1] "" Vector__XXX
 SG_ VCFRONT_a260_HVBlockingMismatch m260 : 54|1@1+ (1,0) [0|1] "" Vector__XXX
 SG_ VCFRONT_a260_serviceMode m260 : 55|1@1+ (1,0) [0|1] "" Vector__XXX
 SG_ VCFRONT_a260_dcdcLVSupportStatus m260 : 56|2@1+ (1,0) [0|3] "" Vector__XXX
 SG_ VCFRONT_a260_PCSAndVCREFuseStabl m260 : 58|1@1+ (1,0) [0|1] "" Vector__XXX
 SG_ VCFRONT_a260_bmsState m260 : 59|4@1+ (1,0) [0|15] "" Vector__XXX
 SG_ VCFRONT_a261_eFuseVoltage m261 : 16|16@1+ (0.1,0) [0|6553.5] "V" Vector__XXX
 SG_ VCFRONT_a261_vbatProtVoltage m261 : 32|16@1+ (0.1,0) [0|6553.5] "V" Vector__XXX
 SG_ VCFRONT_a262_eFuseVoltage m262 : 16|16@1+ (0.1,0) [0|6553.5] "V" Vector__XXX
 SG_ VCFRONT_a262_vbatProtVoltage m262 : 32|16@1+ (0.1,0) [0|6553.5] "V" Vector__XXX
 SG_ VCFRONT_a263_eFuseVoltage m263 : 16|16@1+ (0.1,0) [0|6553.5] "V" Vector__XXX
 SG_ VCFRONT_a263_vbatProtVoltage m263 : 32|16@1+ (0.1,0) [0|6553.5] "V" Vector__XXX
 SG_ VCFRONT_a264_eFuseVoltage m264 : 16|16@1+ (0.1,0) [0|6553.5] "V" Vector__XXX
 SG_ VCFRONT_a264_vbatProtVoltage m264 : 32|16@1+ (0.1,0) [0|6553.5] "V" Vector__XXX
 SG_ VCFRONT_a265_eFuseVoltage m265 : 16|16@1+ (0.1,0) [0|6553.5] "V" Vector__XXX
 SG_ VCFRONT_a265_vbatProtVoltage m265 : 32|16@1+ (0.1,0) [0|6553.5] "V" Vector__XXX
 SG_ VCFRONT_a266_eFuseVoltage m266 : 16|16@1+ (0.1,0) [0|6553.5] "V" Vector__XXX
 SG_ VCFRONT_a266_vbatProtVoltage m266 : 32|16@1+ (0.1,0) [0|6553.5] "V" Vector__XXX
 SG_ VCFRONT_a267_eFuseVoltage m267 : 16|16@1+ (0.1,0) [0|6553.5] "V" Vector__XXX
 SG_ VCFRONT_a267_vbatProtVoltage m267 : 32|16@1+ (0.1,0) [0|6553.5] "V" Vector__XXX
 SG_ VCFRONT_a268_eFuseVoltage m268 : 16|16@1+ (0.1,0) [0|6553.5] "V" Vector__XXX
 SG_ VCFRONT_a268_vbatProtVoltage m268 : 32|16@1+ (0.1,0) [0|6553.5] "V" Vector__XXX
 SG_ VCFRONT_a269_LVBatteryTemp m269 : 16|7@1+ (1,-40) [-40|86] "degC" Vector__XXX
 SG_ VCFRONT_a269_IBSCurrent m269 : 24|12@1- (0.1,0) [-204.8|204.7] "A" Vector__XXX
 SG_ VCFRONT_a269_IBSVoltage m269 : 36|11@1+ (0.0108873518184,0) [0|22.2864091723] "V" Vector__XXX
 SG_ VCFRONT_a269_IBSAmpHours m269 : 48|8@1+ (0.01,-2.55) [-2.55|4.4408920985e-16] "Ah" Vector__XXX
 SG_ VCFRONT_a269_vehiclePowerState m269 : 56|2@1+ (1,0) [0|3] "" Vector__XXX
 SG_ VCFRONT_a270_prechargeChannel m270 : 16|3@1+ (1,0) [0|7] "" Vector__XXX
 SG_ VCFRONT_a270_sourceVoltage m270 : 19|10@1+ (0.1,0) [0|102.3] "V" Vector__XXX
 SG_ VCFRONT_a270_loadVoltage m270 : 29|10@1+ (0.1,0) [0|102.3] "V" Vector__XXX
 SG_ VCFRONT_a270_timeout m270 : 40|12@1+ (1,0) [0|4095] "ms" Vector__XXX
 SG_ VCFRONT_a271_shortedCellTestTrig m271 : 16|1@1+ (1,0) [0|1] "" Vector__XXX
 SG_ VCFRONT_a271_voltDropOnHighCurre m271 : 17|1@1+ (1,0) [0|1] "" Vector__XXX
 SG_ VCFRONT_a271_deadLVMinimalAhDisc m271 : 18|1@1+ (1,0) [0|1] "" Vector__XXX
 SG_ VCFRONT_a271_resistanceEstimatio m271 : 19|1@1+ (1,0) [0|1] "" Vector__XXX
 SG_ VCFRONT_a271_dcrMilliOhmsAboveTh m271 : 20|1@1+ (1,0) [0|1] "" Vector__XXX
 SG_ VCFRONT_a271_prechargeLVLoadRedu m271 : 21|1@1+ (1,0) [0|1] "" Vector__XXX
 SG_ VCFRONT_a271_instantPrechargeDCR m271 : 22|1@1+ (1,0) [0|1] "" Vector__XXX
 SG_ VCFRONT_a279_snsShortCircuit m279 : 16|1@1+ (1,0) [0|1] "" Vector__XXX
 SG_ VCFRONT_a279_snsDisconnect m279 : 17|1@1+ (1,0) [0|1] "" Vector__XXX
 SG_ VCFRONT_a279_snsRateChangeUp m279 : 18|1@1+ (1,0) [0|1] "" Vector__XXX
 SG_ VCFRONT_a279_snsRateChangeDown m279 : 19|1@1+ (1,0) [0|1] "" Vector__XXX
 SG_ VCFRONT_a280_snsShortCircuit m280 : 16|1@1+ (1,0) [0|1] "" Vector__XXX
 SG_ VCFRONT_a280_snsDisconnect m280 : 17|1@1+ (1,0) [0|1] "" Vector__XXX
 SG_ VCFRONT_a280_snsRateChangeUp m280 : 18|1@1+ (1,0) [0|1] "" Vector__XXX
 SG_ VCFRONT_a280_snsRateChangeDown m280 : 19|1@1+ (1,0) [0|1] "" Vector__XXX
 SG_ VCFRONT_a283_thmlFanDisabled m283 : 16|1@1+ (1,0) [0|1] "" Vector__XXX
 SG_ VCFRONT_a283_thmlFanLimited m283 : 17|1@1+ (1,0) [0|1] "" Vector__XXX
 SG_ VCFRONT_a283_thmlFanDemand m283 : 24|7@1+ (1,0) [0|127] "%" Vector__XXX
 SG_ VCFRONT_a283_thmlFanDemandLimit m283 : 32|7@1+ (1,0) [0|127] "%" Vector__XXX
 SG_ VCFRONT_a283_thmlFanPhaseI m283 : 40|7@1+ (0.25,0) [0|31.75] "A" Vector__XXX
 SG_ VCFRONT_a283_thmlFanPhaseILimit m283 : 48|7@1+ (0.25,0) [0|31.75] "A" Vector__XXX
 SG_ VCFRONT_a284_driverState m284 : 16|4@1+ (1,0) [0|15] "" Vector__XXX
 SG_ VCFRONT_a284_driverThermWarn m284 : 20|1@1+ (1,0) [0|1] "" Vector__XXX
 SG_ VCFRONT_a284_driverThermShutdown m284 : 21|1@1+ (1,0) [0|1] "" Vector__XXX
 SG_ VCFRONT_a284_undervoltage m284 : 22|1@1+ (1,0) [0|1] "" Vector__XXX
 SG_ VCFRONT_a284_chargePumpUndervolt m284 : 23|1@1+ (1,0) [0|1] "" Vector__XXX
 SG_ VCFRONT_a284_isCoilOpenX m284 : 24|1@1+ (1,0) [0|1] "" Vector__XXX
 SG_ VCFRONT_a284_isCoilOpenY m284 : 25|1@1+ (1,0) [0|1] "" Vector__XXX
 SG_ VCFRONT_a284_isCoilShortXPGnd m284 : 26|1@1+ (1,0) [0|1] "" Vector__XXX
 SG_ VCFRONT_a284_isCoilShortXPVbb m284 : 27|1@1+ (1,0) [0|1] "" Vector__XXX
 SG_ VCFRONT_a284_isCoilShortXNGnd m284 : 28|1@1+ (1,0) [0|1] "" Vector__XXX
 SG_ VCFRONT_a284_isCoilShortXNVbb m284 : 29|1@1+ (1,0) [0|1] "" Vector__XXX
 SG_ VCFRONT_a284_isCoilShortYPGnd m284 : 30|1@1+ (1,0) [0|1] "" Vector__XXX
 SG_ VCFRONT_a284_isCoilShortYPVbb m284 : 31|1@1+ (1,0) [0|1] "" Vector__XXX
 SG_ VCFRONT_a284_isCoilShortYNGnd m284 : 32|1@1+ (1,0) [0|1] "" Vector__XXX
 SG_ VCFRONT_a284_isCoilShortYNVbb m284 : 33|1@1+ (1,0) [0|1] "" Vector__XXX
 SG_ VCFRONT_a284_driverHasCommError m284 : 34|1@1+ (1,0) [0|1] "" Vector__XXX
 SG_ VCFRONT_a285_driverState m285 : 16|4@1+ (1,0) [0|15] "" Vector__XXX
 SG_ VCFRONT_a285_driverThermWarn m285 : 20|1@1+ (1,0) [0|1] "" Vector__XXX
 SG_ VCFRONT_a285_driverThermShutdown m285 : 21|1@1+ (1,0) [0|1] "" Vector__XXX
 SG_ VCFRONT_a285_undervoltage m285 : 22|1@1+ (1,0) [0|1] "" Vector__XXX
 SG_ VCFRONT_a285_chargePumpUndervolt m285 : 23|1@1+ (1,0) [0|1] "" Vector__XXX
 SG_ VCFRONT_a285_isCoilOpenX m285 : 24|1@1+ (1,0) [0|1] "" Vector__XXX
 SG_ VCFRONT_a285_isCoilOpenY m285 : 25|1@1+ (1,0) [0|1] "" Vector__XXX
 SG_ VCFRONT_a285_isCoilShortXPGnd m285 : 26|1@1+ (1,0) [0|1] "" Vector__XXX
 SG_ VCFRONT_a285_isCoilShortXPVbb m285 : 27|1@1+ (1,0) [0|1] "" Vector__XXX
 SG_ VCFRONT_a285_isCoilShortXNGnd m285 : 28|1@1+ (1,0) [0|1] "" Vector__XXX
 SG_ VCFRONT_a285_isCoilShortXNVbb m285 : 29|1@1+ (1,0) [0|1] "" Vector__XXX
 SG_ VCFRONT_a285_isCoilShortYPGnd m285 : 30|1@1+ (1,0) [0|1] "" Vector__XXX
 SG_ VCFRONT_a285_isCoilShortYPVbb m285 : 31|1@1+ (1,0) [0|1] "" Vector__XXX
 SG_ VCFRONT_a285_isCoilShortYNGnd m285 : 32|1@1+ (1,0) [0|1] "" Vector__XXX
 SG_ VCFRONT_a285_isCoilShortYNVbb m285 : 33|1@1+ (1,0) [0|1] "" Vector__XXX
 SG_ VCFRONT_a285_driverHasCommError m285 : 34|1@1+ (1,0) [0|1] "" Vector__XXX
 SG_ VCFRONT_a286_driverState m286 : 16|4@1+ (1,0) [0|15] "" Vector__XXX
 SG_ VCFRONT_a286_driverThermWarn m286 : 20|1@1+ (1,0) [0|1] "" Vector__XXX
 SG_ VCFRONT_a286_driverThermShutdown m286 : 21|1@1+ (1,0) [0|1] "" Vector__XXX
 SG_ VCFRONT_a286_undervoltage m286 : 22|1@1+ (1,0) [0|1] "" Vector__XXX
 SG_ VCFRONT_a286_chargePumpUndervolt m286 : 23|1@1+ (1,0) [0|1] "" Vector__XXX
 SG_ VCFRONT_a286_isCoilOpenX m286 : 24|1@1+ (1,0) [0|1] "" Vector__XXX
 SG_ VCFRONT_a286_isCoilOpenY m286 : 25|1@1+ (1,0) [0|1] "" Vector__XXX
 SG_ VCFRONT_a286_isCoilShortXPGnd m286 : 26|1@1+ (1,0) [0|1] "" Vector__XXX
 SG_ VCFRONT_a286_isCoilShortXPVbb m286 : 27|1@1+ (1,0) [0|1] "" Vector__XXX
 SG_ VCFRONT_a286_isCoilShortXNGnd m286 : 28|1@1+ (1,0) [0|1] "" Vector__XXX
 SG_ VCFRONT_a286_isCoilShortXNVbb m286 : 29|1@1+ (1,0) [0|1] "" Vector__XXX
 SG_ VCFRONT_a286_isCoilShortYPGnd m286 : 30|1@1+ (1,0) [0|1] "" Vector__XXX
 SG_ VCFRONT_a286_isCoilShortYPVbb m286 : 31|1@1+ (1,0) [0|1] "" Vector__XXX
 SG_ VCFRONT_a286_isCoilShortYNGnd m286 : 32|1@1+ (1,0) [0|1] "" Vector__XXX
 SG_ VCFRONT_a286_isCoilShortYNVbb m286 : 33|1@1+ (1,0) [0|1] "" Vector__XXX
 SG_ VCFRONT_a286_driverHasCommError m286 : 34|1@1+ (1,0) [0|1] "" Vector__XXX
 SG_ VCFRONT_a287_driverState m287 : 16|4@1+ (1,0) [0|15] "" Vector__XXX
 SG_ VCFRONT_a287_driverThermWarn m287 : 20|1@1+ (1,0) [0|1] "" Vector__XXX
 SG_ VCFRONT_a287_driverThermShutdown m287 : 21|1@1+ (1,0) [0|1] "" Vector__XXX
 SG_ VCFRONT_a287_undervoltage m287 : 22|1@1+ (1,0) [0|1] "" Vector__XXX
 SG_ VCFRONT_a287_chargePumpUndervolt m287 : 23|1@1+ (1,0) [0|1] "" Vector__XXX
 SG_ VCFRONT_a287_isCoilOpenX m287 : 24|1@1+ (1,0) [0|1] "" Vector__XXX
 SG_ VCFRONT_a287_isCoilOpenY m287 : 25|1@1+ (1,0) [0|1] "" Vector__XXX
 SG_ VCFRONT_a287_isCoilShortXPGnd m287 : 26|1@1+ (1,0) [0|1] "" Vector__XXX
 SG_ VCFRONT_a287_isCoilShortXPVbb m287 : 27|1@1+ (1,0) [0|1] "" Vector__XXX
 SG_ VCFRONT_a287_isCoilShortXNGnd m287 : 28|1@1+ (1,0) [0|1] "" Vector__XXX
 SG_ VCFRONT_a287_isCoilShortXNVbb m287 : 29|1@1+ (1,0) [0|1] "" Vector__XXX
 SG_ VCFRONT_a287_isCoilShortYPGnd m287 : 30|1@1+ (1,0) [0|1] "" Vector__XXX
 SG_ VCFRONT_a287_isCoilShortYPVbb m287 : 31|1@1+ (1,0) [0|1] "" Vector__XXX
 SG_ VCFRONT_a287_isCoilShortYNGnd m287 : 32|1@1+ (1,0) [0|1] "" Vector__XXX
 SG_ VCFRONT_a287_isCoilShortYNVbb m287 : 33|1@1+ (1,0) [0|1] "" Vector__XXX
 SG_ VCFRONT_a287_driverHasCommError m287 : 34|1@1+ (1,0) [0|1] "" Vector__XXX
 SG_ VCFRONT_a288_driverState m288 : 16|4@1+ (1,0) [0|15] "" Vector__XXX
 SG_ VCFRONT_a288_driverThermWarn m288 : 20|1@1+ (1,0) [0|1] "" Vector__XXX
 SG_ VCFRONT_a288_driverThermShutdown m288 : 21|1@1+ (1,0) [0|1] "" Vector__XXX
 SG_ VCFRONT_a288_undervoltage m288 : 22|1@1+ (1,0) [0|1] "" Vector__XXX
 SG_ VCFRONT_a288_chargePumpUndervolt m288 : 23|1@1+ (1,0) [0|1] "" Vector__XXX
 SG_ VCFRONT_a288_isCoilOpenX m288 : 24|1@1+ (1,0) [0|1] "" Vector__XXX
 SG_ VCFRONT_a288_isCoilOpenY m288 : 25|1@1+ (1,0) [0|1] "" Vector__XXX
 SG_ VCFRONT_a288_isCoilShortXPGnd m288 : 26|1@1+ (1,0) [0|1] "" Vector__XXX
 SG_ VCFRONT_a288_isCoilShortXPVbb m288 : 27|1@1+ (1,0) [0|1] "" Vector__XXX
 SG_ VCFRONT_a288_isCoilShortXNGnd m288 : 28|1@1+ (1,0) [0|1] "" Vector__XXX
 SG_ VCFRONT_a288_isCoilShortXNVbb m288 : 29|1@1+ (1,0) [0|1] "" Vector__XXX
 SG_ VCFRONT_a288_isCoilShortYPGnd m288 : 30|1@1+ (1,0) [0|1] "" Vector__XXX
 SG_ VCFRONT_a288_isCoilShortYPVbb m288 : 31|1@1+ (1,0) [0|1] "" Vector__XXX
 SG_ VCFRONT_a288_isCoilShortYNGnd m288 : 32|1@1+ (1,0) [0|1] "" Vector__XXX
 SG_ VCFRONT_a288_isCoilShortYNVbb m288 : 33|1@1+ (1,0) [0|1] "" Vector__XXX
 SG_ VCFRONT_a288_driverHasCommError m288 : 34|1@1+ (1,0) [0|1] "" Vector__XXX
 SG_ VCFRONT_a289_driverState m289 : 16|4@1+ (1,0) [0|15] "" Vector__XXX
 SG_ VCFRONT_a289_driverThermWarn m289 : 20|1@1+ (1,0) [0|1] "" Vector__XXX
 SG_ VCFRONT_a289_driverThermShutdown m289 : 21|1@1+ (1,0) [0|1] "" Vector__XXX
 SG_ VCFRONT_a289_undervoltage m289 : 22|1@1+ (1,0) [0|1] "" Vector__XXX

CM_ SG_ 1332 VCFRONT_a092_VEH_restraintStatus "Front body controller: a092 VEH restraint status";
CM_ SG_ 1332 VCFRONT_a092_VEH_switchStatus "Front body controller: a092 VEH switch status";
CM_ SG_ 1332 VCFRONT_a092_VEH_seatStatus2 "Front body controller: a092 VEH seat status2";
CM_ SG_ 1332 VCFRONT_a092_VEH_vehNm "Front body controller: a092 VEH veh nm";
CM_ SG_ 1332 VCFRONT_a093_VEH_restraintStatus "Front body controller: a093 VEH restraint status";
CM_ SG_ 1332 VCFRONT_a093_VEH_switchStatus "Front body controller: a093 VEH switch status";
CM_ SG_ 1332 VCFRONT_a093_VEH_seatStatus2 "Front body controller: a093 VEH seat status2";
CM_ SG_ 1332 VCFRONT_a093_VEH_vehNm "Front body controller: a093 VEH veh nm";
CM_ SG_ 1332 VCFRONT_a094_VEH_sysStatus "Front body controller: a094 VEH sys status";
CM_ SG_ 1332 VCFRONT_a094_PARTY_sysStatus "Front body controller: a094 PARTY sys status";
CM_ SG_ 1332 VCFRONT_a095_PT_ptNm "Front body controller: a095 PT pt nm";
CM_ SG_ 1332 VCFRONT_a095_PT_status "Front body controller: a095 PT status";
CM_ SG_ 1332 VCFRONT_a096_VEH_status "Front body controller: a096 VEH status";
CM_ SG_ 1332 VCFRONT_a096_CH_status "Front body controller: a096 CH status";
CM_ SG_ 1332 VCFRONT_a098_CH_torque "Front body controller: a098 CH torque";
CM_ SG_ 1332 VCFRONT_a098_VEH_hvStatus "Front body controller: a098 VEH hv status";
CM_ SG_ 1332 VCFRONT_a098_VEH_status "Front body controller: a098 VEH status";
CM_ SG_ 1332 VCFRONT_a098_VEH_thermalControl "Front body controller: a098 VEH thermal control";
CM_ SG_ 1332 VCFRONT_a098_VEH_temperature "Front body controller: a098 VEH temperature";
CM_ SG_ 1332 VCFRONT_a098_VEH_torque "Front body controller: a098 VEH torque";
CM_ SG_ 1332 VCFRONT_a098_PARTY_status "Front body controller: a098 PARTY status";
CM_ SG_ 1332 VCFRONT_a098_PARTY_temperature "Front body controller: a098 PARTY temperature";
CM_ SG_ 1332 VCFRONT_a098_PARTY_thermalContro "Front body controller: a098 PARTY thermal control";
CM_ SG_ 1332 VCFRONT_a098_PARTY_torque "Front body controller: a098 PARTY torque";
CM_ SG_ 1332 VCFRONT_a098_PT_thermalControl "Front body controller: a098 PT thermal control";
CM_ SG_ 1332 VCFRONT_a098_PT_temperature "Front body controller: a098 PT temperature";
CM_ SG_ 1332 VCFRONT_a099_VEH_oocStatus "Front body controller: a099 VEH ooc status";
CM_ SG_ 1332 VCFRONT_a100_VEH "Front body controller: a100 VEH";
CM_ SG_ 1332 VCFRONT_a100_PARTY "Front body controller: a100 PARTY";
CM_ SG_ 1332 VCFRONT_a100_PT "Front body controller: a100 PT";
CM_ SG_ 1332 VCFRONT_a100_CH "Front body controller: a100 CH";
CM_ SG_ 1332 VCFRONT_a100_OBD "Front body controller: a100 OBD";
CM_ SG_ 1332 VCFRONT_a101_VEH_state "Front body controller: a101 VEH state";
CM_ SG_ 1332 VCFRONT_a101_PARTY_locState "Front body controller: a101 PARTY loc state";
CM_ SG_ 1332 VCFRONT_a101_LIPC_externalWatchd "Front body controller: a101 LIPC external watchdog heart beat";
CM_ SG_ 1332 VCFRONT_a101_VEH_locState "Front body controller: a101 VEH loc state";
CM_ SG_ 1332 VCFRONT_a101_BDY_locState "Front body controller: a101 BDY loc state";
CM_ SG_ 1332 VCFRONT_a102_VEH_faultsAndExtras "Front body controller: a102 VEH faults and extras";
CM_ SG_ 1332 VCFRONT_a102_VEH_feedbackStatus "Front body controller: a102 VEH feedback status";
CM_ SG_ 1332 VCFRONT_a102_VEH_sensorStatus "Front body controller: a102 VEH sensor status";
CM_ SG_ 1332 VCFRONT_a102_VEH_rods "Front body controller: a102 VEH rods";
CM_ SG_ 1332 VCFRONT_a103_VEH_hvsNm "Front body controller: a103 VEH hvs nm";
CM_ SG_ 1332 VCFRONT_a103_VEH_vehNm "Front body controller: a103 VEH veh nm";
CM_ SG_ 1332 VCFRONT_a103_VEH_status "Front body controller: a103 VEH status";
CM_ SG_ 1332 VCFRONT_a103_PT_ptNm "Front body controller: a103 PT pt nm";
CM_ SG_ 1332 VCFRONT_a103_PT_status "Front body controller: a103 PT status";
CM_ SG_ 1332 VCFRONT_a103_VEH_evseStatus "Front body controller: a103 VEH evse status";
CM_ SG_ 1332 VCFRONT_a105_VEH_states "Front body controller: a105 VEH states";
CM_ SG_ 1332 VCFRONT_a105_VEH_chNm "Front body controller: a105 VEH ch nm";
CM_ SG_ 1332 VCFRONT_a105_VEH_dampingStates "Front body controller: a105 VEH damping states";
CM_ SG_ 1332 VCFRONT_a106_VEH_dcdcStatus "Front body controller: a106 VEH dcdc status";
CM_ SG_ 1332 VCFRONT_a106_VEH_thermalControl "Front body controller: a106 VEH thermal control";
CM_ SG_ 1332 VCFRONT_a106_VEH_thermalInterfac "Front body controller: a106 VEH thermal interface";
CM_ SG_ 1332 VCFRONT_a106_VEH_dcdcRailStatus "Front body controller: a106 VEH dcdc rail status";
CM_ SG_ 1332 VCFRONT_a106_CH_dcdcRailStatus "Front body controller: a106 CH dcdc rail status";
CM_ SG_ 1332 VCFRONT_a106_CH_alertMatrix "Front body controller: a106 CH alert matrix";
CM_ SG_ 1332 VCFRONT_a107_VEH_hvsNm "Front body controller: a107 VEH hvs nm";
CM_ SG_ 1332 VCFRONT_a107_VEH_vehNm "Front body controller: a107 VEH veh nm";
CM_ SG_ 1332 VCFRONT_a107_VEH_status "Front body controller: a107 VEH status";
CM_ SG_ 1332 VCFRONT_a107_VEH_thermalStatus "Front body controller: a107 VEH thermal status";
CM_ SG_ 1332 VCFRONT_a107_VEH_thermalStatus2 "Front body controller: a107 VEH thermal status2";
CM_ SG_ 1332 VCFRONT_a107_VEH_bmbMinMax "Front body controller: a107 VEH bmb min max";
CM_ SG_ 1332 VCFRONT_a107_VEH_powerAvailable "Front body controller: a107 VEH power available";
CM_ SG_ 1332 VCFRONT_a107_PT_ptNm "Front body controller: a107 PT pt nm";
CM_ SG_ 1332 VCFRONT_a107_PT_status "Front body controller: a107 PT status";
CM_ SG_ 1332 VCFRONT_a107_PT_thermalStatus "Front body controller: a107 PT thermal status";
CM_ SG_ 1332 VCFRONT_a107_PT_socStatus "Front body controller: a107 PT soc status";
CM_ SG_ 1332 VCFRONT_a107_VEH_socStatus "Front body controller: a107 VEH soc status";
CM_ SG_ 1332 VCFRONT_a107_VEH_packConfig "Front body controller: a107 VEH pack config";
CM_ SG_ 1332 VCFRONT_a107_VEH_energyStatus "Front body controller: a107 VEH energy status";
CM_ SG_ 1332 VCFRONT_a107_VEH_chargeInfo "Front body controller: a107 VEH charge info";
CM_ SG_ 1332 VCFRONT_a108_VEH_hvStatus "Front body controller: a108 VEH hv status";
CM_ SG_ 1332 VCFRONT_a108_VEH_temperature "Front body controller: a108 VEH temperature";
CM_ SG_ 1332 VCFRONT_a108_VEH_thermalControl "Front body controller: a108 VEH thermal control";
CM_ SG_ 1332 VCFRONT_a108_VEH_torque "Front body controller: a108 VEH torque";
CM_ SG_ 1332 VCFRONT_a108_VEH_status "Front body controller: a108 VEH status";
CM_ SG_ 1332 VCFRONT_a108_PARTY_torque "Front body controller: a108 PARTY torque";
CM_ SG_ 1332 VCFRONT_a108_PARTY_status "Front body controller: a108 PARTY status";
CM_ SG_ 1332 VCFRONT_a108_PARTY_temperature "Front body controller: a108 PARTY temperature";
CM_ SG_ 1332 VCFRONT_a108_PARTY_thermalContro "Front body controller: a108 PARTY thermal control";
CM_ SG_ 1332 VCFRONT_a108_PT_temperature "Front body controller: a108 PT temperature";
CM_ SG_ 1332 VCFRONT_a108_PT_thermalControl "Front body controller: a108 PT thermal control";
CM_ SG_ 1332 VCFRONT_a109_PARTY_status "Front body controller: a109 PARTY status";
CM_ SG_ 1332 VCFRONT_a109_PARTY_inertial2 "Front body controller: a109 PARTY inertial2";
CM_ SG_ 1332 VCFRONT_a109_PARTY_nearDeploy "Front body controller: a109 PARTY near deploy";
CM_ SG_ 1332 VCFRONT_a109_PARTY_collision "Front body controller: a109 PARTY collision";
CM_ SG_ 1332 VCFRONT_a109_VEH_status "Front body controller: a109 VEH status";
CM_ SG_ 1332 VCFRONT_a109_VEH_imuOffsets "Front body controller: a109 VEH imu offsets";
CM_ SG_ 1332 VCFRONT_a109_PARTY_inertial1 "Front body controller: a109 PARTY inertial1";
CM_ SG_ 1332 VCFRONT_a109_BDY_imuOffsets "Front body controller: a109 BDY imu offsets";
CM_ SG_ 1332 VCFRONT_a109_BDY_inertial1 "Front body controller: a109 BDY inertial1";
CM_ SG_ 1332 VCFRONT_a109_BDY_inertial2 "Front body controller: a109 BDY inertial2";
CM_ SG_ 1332 VCFRONT_a109_BDY_status "Front body controller: a109 BDY status";
CM_ SG_ 1332 VCFRONT_a109_VEH_inertial1 "Front body controller: a109 VEH inertial1";
CM_ SG_ 1332 VCFRONT_a109_VEH_inertial2 "Front body controller: a109 VEH inertial2";
CM_ SG_ 1332 VCFRONT_a109_CH_inertial1 "Front body controller: a109 CH inertial1";
CM_ SG_ 1332 VCFRONT_a109_CH_inertial2 "Front body controller: a109 CH inertial2";
CM_ SG_ 1332 VCFRONT_a109_CH_status "Front body controller: a109 CH status";
CM_ SG_ 1332 VCFRONT_a110_VEH_status "Front body controller: a110 VEH status";
CM_ SG_ 1332 VCFRONT_a110_VEH_carState "Front body controller: a110 VEH car state";
CM_ SG_ 1332 VCFRONT_a110_VEH_carConfig "Front body controller: a110 VEH car config";
CM_ SG_ 1332 VCFRONT_a110_VEH_time "Front body controller: a110 VEH time";
CM_ SG_ 1332 VCFRONT_a110_VEH_updateStatus "Front body controller: a110 VEH update status";
CM_ SG_ 1332 VCFRONT_a110_VEH_vehNm "Front body controller: a110 VEH veh nm";
CM_ SG_ 1332 VCFRONT_a110_VEH_mismatchFault "Front body controller: a110 VEH mismatch fault";
CM_ SG_ 1332 VCFRONT_a110_VEH_vin "Front body controller: a110 VEH vin";
CM_ SG_ 1332 VCFRONT_a110_VEH_bmpDebug "Front body controller: a110 VEH bmp debug";
CM_ SG_ 1332 VCFRONT_a110_VEH_gearControl "Front body controller: a110 VEH gear control";
CM_ SG_ 1332 VCFRONT_a110_VEH_canLogAvailabil "Front body controller: a110 VEH can log availability";
CM_ SG_ 1332 VCFRONT_a110_CH_airbagCutoffStat "Front body controller: a110 CH airbag cutoff status";
CM_ SG_ 1332 VCFRONT_a110_CH_carConfig "Front body controller: a110 CH car config";
CM_ SG_ 1332 VCFRONT_a110_CH_carState "Front body controller: a110 CH car state";
CM_ SG_ 1332 VCFRONT_a110_CH_vin "Front body controller: a110 CH vin";
CM_ SG_ 1332 VCFRONT_a110_CH_chNm "Front body controller: a110 CH ch nm";
CM_ SG_ 1332 VCFRONT_a110_CH_epochTimeGtw "Front body controller: a110 CH epoch time gtw";
CM_ SG_ 1332 VCFRONT_a111_VEH_internalStatus "Front body controller: a111 VEH internal status";
CM_ SG_ 1332 VCFRONT_a111_VEH_status "Front body controller: a111 VEH status";
CM_ SG_ 1332 VCFRONT_a111_VEH_vehNm "Front body controller: a111 VEH veh nm";
CM_ SG_ 1332 VCFRONT_a111_RIPC_LVPowerState "Front body controller: a111 RIPC LV power state";
CM_ SG_ 1332 VCFRONT_a111_RIPC_epbPrivateStat "Front body controller: a111 RIPC epb private state";
CM_ SG_ 1332 VCFRONT_a111_RIPC_railStatus "Front body controller: a111 RIPC rail status";
CM_ SG_ 1332 VCFRONT_a111_RIPC_remoteADC "Front body controller: a111 RIPC remote ADC";
CM_ SG_ 1332 VCFRONT_a111_RIPC_switchStatus "Front body controller: a111 RIPC switch status";
CM_ SG_ 1332 VCFRONT_a111_VEH_LVPowerState "Front body controller: a111 VEH LV power state";
CM_ SG_ 1332 VCFRONT_a111_VEH_seatStatus "Front body controller: a111 VEH seat status";
CM_ SG_ 1332 VCFRONT_a111_PARTY_status "Front body controller: a111 PARTY status";
CM_ SG_ 1332 VCFRONT_a111_CH_status "Front body controller: a111 CH status";
CM_ SG_ 1332 VCFRONT_a112_VEH_internalStatus "Front body controller: a112 VEH internal status";
CM_ SG_ 1332 VCFRONT_a112_VEH_status "Front body controller: a112 VEH status";
CM_ SG_ 1332 VCFRONT_a112_VEH_vehNm "Front body controller: a112 VEH veh nm";
CM_ SG_ 1332 VCFRONT_a112_LIPC_LVPowerState "Front body controller: a112 LIPC LV power state";
CM_ SG_ 1332 VCFRONT_a112_LIPC_epbPrivateStat "Front body controller: a112 LIPC epb private state";
CM_ SG_ 1332 VCFRONT_a112_LIPC_railStatus "Front body controller: a112 LIPC rail status";
CM_ SG_ 1332 VCFRONT_a112_LIPC_remoteADC "Front body controller: a112 LIPC remote ADC";
CM_ SG_ 1332 VCFRONT_a112_LIPC_switchStatus "Front body controller: a112 LIPC switch status";
CM_ SG_ 1332 VCFRONT_a112_VEH_LVPowerState "Front body controller: a112 VEH LV power state";
CM_ SG_ 1332 VCFRONT_a112_PARTY_status "Front body controller: a112 PARTY status";
CM_ SG_ 1332 VCFRONT_a112_CH_status "Front body controller: a112 CH status";
CM_ SG_ 1332 VCFRONT_a114_PARTY_status "Front body controller: a114 PARTY status";
CM_ SG_ 1332 VCFRONT_a114_PARTY_wheelSpeeds "Front body controller: a114 PARTY wheel speeds";
CM_ SG_ 1332 VCFRONT_a114_VEH_wheelSpeeds "Front body controller: a114 VEH wheel speeds";
CM_ SG_ 1332 VCFRONT_a114_CH_wheelSpeeds "Front body controller: a114 CH wheel speeds";
CM_ SG_ 1332 VCFRONT_a114_PARTY_party3 "Front body controller: a114 PARTY party3";
CM_ SG_ 1332 VCFRONT_a114_VEH_party3 "Front body controller: a114 VEH party3";
CM_ SG_ 1332 VCFRONT_a114_VEH_status "Front body controller: a114 VEH status";
CM_ SG_ 1332 VCFRONT_a114_PARTY_wheelRotation "Front body controller: a114 PARTY wheel rotation";
CM_ SG_ 1332 VCFRONT_a114_CH_wheelRotation "Front body controller: a114 CH wheel rotation";
CM_ SG_ 1332 VCFRONT_a114_VEH_wheelRotation "Front body controller: a114 VEH wheel rotation";
CM_ SG_ 1332 VCFRONT_a114_PARTY_brakeTorque "Front body controller: a114 PARTY brake torque";
CM_ SG_ 1332 VCFRONT_a114_PARTY_offsets "Front body controller: a114 PARTY offsets";
CM_ SG_ 1332 VCFRONT_a114_BDY_offsets "Front body controller: a114 BDY offsets";
CM_ SG_ 1332 VCFRONT_a114_BDY_party3 "Front body controller: a114 BDY party3";
CM_ SG_ 1332 VCFRONT_a114_BDY_status "Front body controller: a114 BDY status";
CM_ SG_ 1332 VCFRONT_a114_BDY_wheelRotation "Front body controller: a114 BDY wheel rotation";
CM_ SG_ 1332 VCFRONT_a114_BDY_wheelSpeeds "Front body controller: a114 BDY wheel speeds";
CM_ SG_ 1332 VCFRONT_a114_CH_party1 "Front body controller: a114 CH party1";
CM_ SG_ 1332 VCFRONT_a114_CH_party3 "Front body controller: a114 CH party3";
CM_ SG_ 1332 VCFRONT_a114_CH_status "Front body controller: a114 CH status";
CM_ SG_ 1332 VCFRONT_a115_VEH_vehNm "Front body controller: a115 VEH veh nm";
CM_ SG_ 1332 VCFRONT_a115_VEH_authentication "Front body controller: a115 VEH authentication";
CM_ SG_ 1332 VCFRONT_a115_VEH_BLEResetRequest "Front body controller: a115 VEH BLE reset request";
CM_ SG_ 1332 VCFRONT_a115_VEH_requests "Front body controller: a115 VEH requests";
CM_ SG_ 1332 VCFRONT_a115_VEH_requests2 "Front body controller: a115 VEH requests2";
CM_ SG_ 1332 VCFRONT_a115_REM_authentication "Front body controller: a115 REM authentication";
CM_ SG_ 1332 VCFRONT_a115_UI_corianderVehicle "Front body controller: a115 UI coriander vehicle control";
CM_ SG_ 1332 VCFRONT_a115_CH_TPMSDisplay "Front body controller: a115 CH TPMS display";
CM_ SG_ 1332 VCFRONT_a116_PARTY_epbmStatus "Front body controller: a116 PARTY epbm status";
CM_ SG_ 1332 VCFRONT_a116_VEH_vehNm "Front body controller: a116 VEH veh nm";
CM_ SG_ 1332 VCFRONT_a116_VEH_hvacRequest "Front body controller: a116 VEH hvac request";
CM_ SG_ 1332 VCFRONT_a116_VEH_hvacStatus "Front body controller: a116 VEH hvac status";
CM_ SG_ 1332 VCFRONT_a116_VEH_LVPowerState "Front body controller: a116 VEH LV power state";
CM_ SG_ 1332 VCFRONT_a116_VEH_lightStatus "Front body controller: a116 VEH light status";
CM_ SG_ 1332 VCFRONT_a116_VEH_seatStatus "Front body controller: a116 VEH seat status";
CM_ SG_ 1332 VCFRONT_a116_VEH_thsStatus "Front body controller: a116 VEH ths status";
CM_ SG_ 1332 VCFRONT_a116_VEH_doorStatus "Front body controller: a116 VEH door status";
CM_ SG_ 1332 VCFRONT_a116_VEH_seatHeatStatus "Front body controller: a116 VEH seat heat status";
CM_ SG_ 1332 VCFRONT_a116_VEH_restraintStatus "Front body controller: a116 VEH restraint status";
CM_ SG_ 1332 VCFRONT_a116_VEH_switchStatus "Front body controller: a116 VEH switch status";
CM_ SG_ 1332 VCFRONT_a116_VEH_logging1Hz "Front body controller: a116 VEH logging1 hz";
CM_ SG_ 1332 VCFRONT_a116_VEH_seatStatus2 "Front body controller: a116 VEH seat status2";
CM_ SG_ 1332 VCFRONT_a116_VEH_status "Front body controller: a116 VEH status";
CM_ SG_ 1332 VCFRONT_a116_VEH_thermalCommand "Front body controller: a116 VEH thermal command";
CM_ SG_ 1332 VCFRONT_a116_VEH_windowStatus "Front body controller: a116 VEH window status";
CM_ SG_ 1332 VCFRONT_a116_PARTY_restraintStat "Front body controller: a116 PARTY restraint status";
CM_ SG_ 1332 VCFRONT_a116_PARTY_doorStatus "Front body controller: a116 PARTY door status";
CM_ SG_ 1332 VCFRONT_a116_BDY_epbmStatus "Front body controller: a116 BDY epbm status";
CM_ SG_ 1332 VCFRONT_a116_BDY_restraintStatus "Front body controller: a116 BDY restraint status";
CM_ SG_ 1332 VCFRONT_a117_BDY_epbmStatus "Front body controller: a117 BDY epbm status";
CM_ SG_ 1332 VCFRONT_a117_BDY_restraintStatus "Front body controller: a117 BDY restraint status";
CM_ SG_ 1332 VCFRONT_a117_VEH_prndStatus "Front body controller: a117 VEH prnd status";
CM_ SG_ 1332 VCFRONT_a117_PARTY_epbmStatus "Front body controller: a117 PARTY epbm status";
CM_ SG_ 1332 VCFRONT_a117_VEH_vehNm "Front body controller: a117 VEH veh nm";
CM_ SG_ 1332 VCFRONT_a117_VEH_hvacBlowerFdb "Front body controller: a117 VEH hvac blower fdb";
CM_ SG_ 1332 VCFRONT_a117_VEH_LVPowerState "Front body controller: a117 VEH LV power state";
CM_ SG_ 1332 VCFRONT_a117_VEH_restraintStatus "Front body controller: a117 VEH restraint status";
CM_ SG_ 1332 VCFRONT_a117_VEH_lightStatus "Front body controller: a117 VEH light status";
CM_ SG_ 1332 VCFRONT_a117_VEH_seatStatus "Front body controller: a117 VEH seat status";
CM_ SG_ 1332 VCFRONT_a117_BDY_falconSwitchSta "Front body controller: a117 BDY falcon switch status";
CM_ SG_ 1332 VCFRONT_a117_VEH_doorStatus "Front body controller: a117 VEH door status";
CM_ SG_ 1332 VCFRONT_a117_VEH_doorStatus2 "Front body controller: a117 VEH door status2";
CM_ SG_ 1332 VCFRONT_a117_VEH_windowStatus "Front body controller: a117 VEH window status";
CM_ SG_ 1332 VCFRONT_a117_VEH_switchStatus "Front body controller: a117 VEH switch status";
CM_ SG_ 1332 VCFRONT_a117_VEH_intrusionSensor "Front body controller: a117 VEH intrusion sensor status";
CM_ SG_ 1332 VCFRONT_a117_VEH_liftgateStatus "Front body controller: a117 VEH liftgate status";
CM_ SG_ 1332 VCFRONT_a117_VEH_seatStatus2 "Front body controller: a117 VEH seat status2";
CM_ SG_ 1332 VCFRONT_a117_PARTY_restraintStat "Front body controller: a117 PARTY restraint status";
CM_ SG_ 1332 VCFRONT_a117_VEH_thermalStatus "Front body controller: a117 VEH thermal status";
CM_ SG_ 1332 VCFRONT_a117_PARTY_doorStatus "Front body controller: a117 PARTY door status";
CM_ SG_ 1332 VCFRONT_a117_VEH_status "Front body controller: a117 VEH status";
CM_ SG_ 1332 VCFRONT_a117_PARTY_prndStatus "Front body controller: a117 PARTY prnd status";
CM_ SG_ 1332 VCFRONT_a118_VEH_vehNm "Front body controller: a118 VEH veh nm";
CM_ SG_ 1332 VCFRONT_a118_VEH_lighting "Front body controller: a118 VEH lighting";
CM_ SG_ 1332 VCFRONT_a118_VEH_sensors "Front body controller: a118 VEH sensors";
CM_ SG_ 1332 VCFRONT_a118_VEH_status "Front body controller: a118 VEH status";
CM_ SG_ 1332 VCFRONT_a118_VEH_okToUseHighPwr "Front body controller: a118 VEH ok to use high pwr";
CM_ SG_ 1332 VCFRONT_a118_VEH_LVPowerState "Front body controller: a118 VEH LV power state";
CM_ SG_ 1332 VCFRONT_a118_VEH_coolant "Front body controller: a118 VEH coolant";
CM_ SG_ 1332 VCFRONT_a118_VEH_vehicleStatus "Front body controller: a118 VEH vehicle status";
CM_ SG_ 1332 VCFRONT_a118_VEH_12VBatteryStatu "Front body controller: a118 VEH 12 v battery status";
CM_ SG_ 1332 VCFRONT_a118_VEH_systemStatus "Front body controller: a118 VEH system status";
CM_ SG_ 1332 VCFRONT_a118_PARTY_LVPowerState "Front body controller: a118 PARTY LV power state";
CM_ SG_ 1332 VCFRONT_a118_PARTY_outputPowerSt "Front body controller: a118 PARTY output power status";
CM_ SG_ 1332 VCFRONT_a118_PARTY_vehicleTime "Front body controller: a118 PARTY vehicle time";
CM_ SG_ 1332 VCFRONT_a118_VEH_thermalCommand "Front body controller: a118 VEH thermal command";
CM_ SG_ 1332 VCFRONT_a118_CH_LVPowerState "Front body controller: a118 CH LV power state";
CM_ SG_ 1332 VCFRONT_a118_PARTY_sensors "Front body controller: a118 PARTY sensors";
CM_ SG_ 1332 VCFRONT_a118_CH_sensors "Front body controller: a118 CH sensors";
CM_ SG_ 1332 VCFRONT_a118_VEH_interNodeResist "Front body controller: a118 VEH inter node resistance";
CM_ SG_ 1332 VCFRONT_a118_CH_lighting "Front body controller: a118 CH lighting";
CM_ SG_ 1332 VCFRONT_a118_VEH_lightStatus "Front body controller: a118 VEH light status";
CM_ SG_ 1332 VCFRONT_a118_PARTY_vehNm "Front body controller: a118 PARTY veh nm";
CM_ SG_ 1332 VCFRONT_a118_CH_12VBatteryStatus "Front body controller: a118 CH 12 v battery status";
CM_ SG_ 1332 VCFRONT_a118_CH_LVBMS_statusHigh "Front body controller: a118 CH LVBMS status high";
CM_ SG_ 1332 VCFRONT_a118_CH_alertMatrix "Front body controller: a118 CH alert matrix";
CM_ SG_ 1332 VCFRONT_a118_BDY_outputPowerStat "Front body controller: a118 BDY output power status";
CM_ SG_ 1332 VCFRONT_a118_BDY_vehicleTime "Front body controller: a118 BDY vehicle time";
CM_ SG_ 1332 VCFRONT_a118_PARTY_AP_vehicleSta "Front body controller: a118 PARTY AP vehicle state1 hz muxed";
CM_ SG_ 1332 VCFRONT_a118_BDY_AP_vehicleState "Front body controller: a118 BDY AP vehicle state1 hz muxed";
CM_ SG_ 1332 VCFRONT_a119_VEH_steerAngle "Front body controller: a119 VEH steer angle";
CM_ SG_ 1332 VCFRONT_a119_VEH_leftStalk "Front body controller: a119 VEH left stalk";
CM_ SG_ 1332 VCFRONT_a119_VEH_rightStalk "Front body controller: a119 VEH right stalk";
CM_ SG_ 1332 VCFRONT_a119_PARTY_rightStalk "Front body controller: a119 PARTY right stalk";
CM_ SG_ 1332 VCFRONT_a119_CH_steerAngle "Front body controller: a119 CH steer angle";
CM_ SG_ 1332 VCFRONT_a119_PARTY_steerAngle "Front body controller: a119 PARTY steer angle";
CM_ SG_ 1332 VCFRONT_a120_PARTY_chassisCntl "Front body controller: a120 PARTY chassis cntl";
CM_ SG_ 1332 VCFRONT_a120_VEH_systemStatus "Front body controller: a120 VEH system status";
CM_ SG_ 1332 VCFRONT_a120_CH_chassisCntl "Front body controller: a120 CH chassis cntl";
CM_ SG_ 1332 VCFRONT_a120_PARTY_systemStatus "Front body controller: a120 PARTY system status";
CM_ SG_ 1332 VCFRONT_a120_PARTY_torque "Front body controller: a120 PARTY torque";
CM_ SG_ 1332 VCFRONT_a120_VEH_torque "Front body controller: a120 VEH torque";
CM_ SG_ 1332 VCFRONT_a120_PARTY_locStatus "Front body controller: a120 PARTY loc status";
CM_ SG_ 1332 VCFRONT_a120_PARTY_speed "Front body controller: a120 PARTY speed";
CM_ SG_ 1332 VCFRONT_a120_VEH_speed "Front body controller: a120 VEH speed";
CM_ SG_ 1332 VCFRONT_a120_PARTY_status "Front body controller: a120 PARTY status";
CM_ SG_ 1332 VCFRONT_a120_PT_speed "Front body controller: a120 PT speed";
CM_ SG_ 1332 VCFRONT_a120_PT_systemStatus "Front body controller: a120 PT system status";
CM_ SG_ 1332 VCFRONT_a120_PARTY_vehicleEstima "Front body controller: a120 PARTY vehicle estimates";
CM_ SG_ 1332 VCFRONT_a120_VEH_aggregatedAxleS "Front body controller: a120 VEH aggregated axle speed";
CM_ SG_ 1332 VCFRONT_a120_PARTY_aggregatedAxl "Front body controller: a120 PARTY aggregated axle speed";
CM_ SG_ 1332 VCFRONT_a120_VEH_systemPower "Front body controller: a120 VEH system power";
CM_ SG_ 1332 VCFRONT_a120_PT_systemPower "Front body controller: a120 PT system power";
CM_ SG_ 1332 VCFRONT_a120_PARTY_stalklessInte "Front body controller: a120 PARTY stalkless interfaces";
CM_ SG_ 1332 VCFRONT_a120_CH_speed "Front body controller: a120 CH speed";
CM_ SG_ 1332 VCFRONT_a120_VEH_estimatedBrakeT "Front body controller: a120 VEH estimated brake temp";
CM_ SG_ 1332 VCFRONT_a120_PARTY_prndControl "Front body controller: a120 PARTY prnd control";
CM_ SG_ 1332 VCFRONT_a120_PARTY_locStatus2 "Front body controller: a120 PARTY loc status2";
CM_ SG_ 1332 VCFRONT_a120_VEH_chassisCntl "Front body controller: a120 VEH chassis cntl";
CM_ SG_ 1332 VCFRONT_a120_VEH_locStatus "Front body controller: a120 VEH loc status";
CM_ SG_ 1332 VCFRONT_a120_VEH_locStatus2 "Front body controller: a120 VEH loc status2";
CM_ SG_ 1332 VCFRONT_a120_VEH_prndControl "Front body controller: a120 VEH prnd control";
CM_ SG_ 1332 VCFRONT_a120_VEH_vehicleEstimate "Front body controller: a120 VEH vehicle estimates";
CM_ SG_ 1332 VCFRONT_a121_overCurrentError "Front body controller: a121 over current error";
CM_ SG_ 1332 VCFRONT_a121_fetShortCircuit "Front body controller: a121 fet short circuit";
CM_ SG_ 1332 VCFRONT_a121_lockedRotor "Front body controller: a121 locked rotor";
CM_ SG_ 1332 VCFRONT_a122_junctionTempWarning "Front body controller: a122 junction temp warning";
CM_ SG_ 1332 VCFRONT_a122_junctionOverTemp "Front body controller: a122 junction over temp";
CM_ SG_ 1332 VCFRONT_a122_startUpOperation "Front body controller: a122 start up operation";
CM_ SG_ 1332 VCFRONT_a122_lossOfSpeedLock "Front body controller: a122 loss of speed lock";
CM_ SG_ 1332 VCFRONT_a122_vccUnderVoltage "Front body controller: a122 vcc under voltage";
CM_ SG_ 1332 VCFRONT_a123_overCurrentError "Front body controller: a123 over current error";
CM_ SG_ 1332 VCFRONT_a123_fetShortCircuit "Front body controller: a123 fet short circuit";
CM_ SG_ 1332 VCFRONT_a123_lockedRotor "Front body controller: a123 locked rotor";
CM_ SG_ 1332 VCFRONT_a124_junctionTempWarning "Front body controller: a124 junction temp warning";
CM_ SG_ 1332 VCFRONT_a124_junctionOverTemp "Front body controller: a124 junction over temp";
CM_ SG_ 1332 VCFRONT_a124_startUpOperation "Front body controller: a124 start up operation";
CM_ SG_ 1332 VCFRONT_a124_lossOfSpeedLock "Front body controller: a124 loss of speed lock";
CM_ SG_ 1332 VCFRONT_a124_vccUnderVoltage "Front body controller: a124 vcc under voltage";
CM_ SG_ 1332 VCFRONT_a125_overCurrentError "Front body controller: a125 over current error";
CM_ SG_ 1332 VCFRONT_a125_fetShortCircuit "Front body controller: a125 fet short circuit";
CM_ SG_ 1332 VCFRONT_a125_lockedRotor "Front body controller: a125 locked rotor";
CM_ SG_ 1332 VCFRONT_a126_junctionTempWarning "Front body controller: a126 junction temp warning";
CM_ SG_ 1332 VCFRONT_a126_junctionOverTemp "Front body controller: a126 junction over temp";
CM_ SG_ 1332 VCFRONT_a126_startUpOperation "Front body controller: a126 start up operation";
CM_ SG_ 1332 VCFRONT_a126_lossOfSpeedLock "Front body controller: a126 loss of speed lock";
CM_ SG_ 1332 VCFRONT_a126_vccUnderVoltage "Front body controller: a126 vcc under voltage";
CM_ SG_ 1332 VCFRONT_a127_vcleftEFuseCurrent "Front body controller: a127 vcleft e fuse current";
CM_ SG_ 1332 VCFRONT_a127_vcleftEFuseVoltage "Front body controller: a127 vcleft e fuse voltage";
CM_ SG_ 1332 VCFRONT_a127_vcleftEFuseTemp "Front body controller: a127 vcleft e fuse temp";
CM_ SG_ 1332 VCFRONT_a127_vcleftEFuseRemainin "Front body controller: a127 vcleft e fuse remaining retries";
CM_ SG_ 1332 VCFRONT_a128_vcrightEFuseCurrent "Front body controller: a128 vcright e fuse current";
CM_ SG_ 1332 VCFRONT_a128_vcrightEFuseVoltage "Front body controller: a128 vcright e fuse voltage";
CM_ SG_ 1332 VCFRONT_a128_vcrightEFuseTemp "Front body controller: a128 vcright e fuse temp";
CM_ SG_ 1332 VCFRONT_a128_vcrightEFuseRemaini "Front body controller: a128 vcright e fuse remaining retries";
CM_ SG_ 1332 VCFRONT_a129_pcsEFuseCurrent "Front body controller: a129 pcs e fuse current";
CM_ SG_ 1332 VCFRONT_a129_pcsEFuseVoltage "Front body controller: a129 pcs e fuse voltage";
CM_ SG_ 1332 VCFRONT_a129_pcsEFuseTemp "Front body controller: a129 pcs e fuse temp";
CM_ SG_ 1332 VCFRONT_a129_pcsEFuseRemainingRe "Front body controller: a129 pcs e fuse remaining retries";
CM_ SG_ 1332 VCFRONT_a130_epas3pEFuseCurrent "Front body controller: a130 epas3p e fuse current";
CM_ SG_ 1332 VCFRONT_a130_epas3pEFuseVoltage "Front body controller: a130 epas3p e fuse voltage";
CM_ SG_ 1332 VCFRONT_a130_epas3pEFuseTemp "Front body controller: a130 epas3p e fuse temp";
CM_ SG_ 1332 VCFRONT_a131_epas3sEFuseCurrent "Front body controller: a131 epas3s e fuse current";
CM_ SG_ 1332 VCFRONT_a131_epas3sEFuseVoltage "Front body controller: a131 epas3s e fuse voltage";
CM_ SG_ 1332 VCFRONT_a131_epas3sEFuseTemp "Front body controller: a131 epas3s e fuse temp";
CM_ SG_ 1332 VCFRONT_a132_iBoosterCurrent "Front body controller: a132 i booster current";
CM_ SG_ 1332 VCFRONT_a132_iBoosterVoltage "Front body controller: a132 i booster voltage";
CM_ SG_ 1332 VCFRONT_a132_iBoosterEFuseTemp "Front body controller: a132 i booster e fuse temp";
CM_ SG_ 1332 VCFRONT_a133_espEFuseCurrent "Front body controller: a133 esp e fuse current";
CM_ SG_ 1332 VCFRONT_a133_espEFuseVoltage "Front body controller: a133 esp e fuse voltage";
CM_ SG_ 1332 VCFRONT_a133_espEFuseTemp "Front body controller: a133 esp e fuse temp";
CM_ SG_ 1332 VCFRONT_a134_fusedHighCurrent "Front body controller: a134 fused high current";
CM_ SG_ 1332 VCFRONT_a134_fusedHighVoltage "Front body controller: a134 fused high voltage";
CM_ SG_ 1332 VCFRONT_a134_fusedHighTemp "Front body controller: a134 fused high temp";
CM_ SG_ 1332 VCFRONT_a134_vbatFusedEFuseRemai "Front body controller: a134 vbat fused e fuse remaining retries";
CM_ SG_ 1332 VCFRONT_a136_snsShortCircuit "Front body controller: a136 sns short circuit";
CM_ SG_ 1332 VCFRONT_a136_snsDisconnect "Front body controller: a136 sns disconnect";
CM_ SG_ 1332 VCFRONT_a136_snsRateChangeUp "Front body controller: a136 sns rate change up";
CM_ SG_ 1332 VCFRONT_a136_snsRateChangeDown "Front body controller: a136 sns rate change down";
CM_ SG_ 1332 VCFRONT_a137_snsShortCircuit "Front body controller: a137 sns short circuit";
CM_ SG_ 1332 VCFRONT_a137_snsDisconnect "Front body controller: a137 sns disconnect";
CM_ SG_ 1332 VCFRONT_a137_snsRateChangeUp "Front body controller: a137 sns rate change up";
CM_ SG_ 1332 VCFRONT_a137_snsRateChangeDown "Front body controller: a137 sns rate change down";
CM_ SG_ 1332 VCFRONT_a138_snsShortCircuit "Front body controller: a138 sns short circuit";
CM_ SG_ 1332 VCFRONT_a138_snsDisconnect "Front body controller: a138 sns disconnect";
CM_ SG_ 1332 VCFRONT_a138_snsRateChangeUp "Front body controller: a138 sns rate change up";
CM_ SG_ 1332 VCFRONT_a138_snsRateChangeDown "Front body controller: a138 sns rate change down";
CM_ SG_ 1332 VCFRONT_a139_snsShortCircuit "Front body controller: a139 sns short circuit";
CM_ SG_ 1332 VCFRONT_a139_snsDisconnect "Front body controller: a139 sns disconnect";
CM_ SG_ 1332 VCFRONT_a139_snsRateChangeUp "Front body controller: a139 sns rate change up";
CM_ SG_ 1332 VCFRONT_a139_snsRateChangeDown "Front body controller: a139 sns rate change down";
CM_ SG_ 1332 VCFRONT_a140_snsShortCircuit "Front body controller: a140 sns short circuit";
CM_ SG_ 1332 VCFRONT_a140_snsDisconnect "Front body controller: a140 sns disconnect";
CM_ SG_ 1332 VCFRONT_a140_snsRateChangeUp "Front body controller: a140 sns rate change up";
CM_ SG_ 1332 VCFRONT_a140_snsRateChangeDown "Front body controller: a140 sns rate change down";
CM_ SG_ 1332 VCFRONT_a141_snsShortCircuit "Front body controller: a141 sns short circuit";
CM_ SG_ 1332 VCFRONT_a141_snsDisconnect "Front body controller: a141 sns disconnect";
CM_ SG_ 1332 VCFRONT_a141_snsRateChangeUp "Front body controller: a141 sns rate change up";
CM_ SG_ 1332 VCFRONT_a141_snsRateChangeDown "Front body controller: a141 sns rate change down";
CM_ SG_ 1332 VCFRONT_a142_driverState "Front body controller: a142 driver state";
CM_ SG_ 1332 VCFRONT_a142_driverThermWarn "Front body controller: a142 driver therm warn";
CM_ SG_ 1332 VCFRONT_a142_driverThermShutdown "Front body controller: a142 driver therm shutdown";
CM_ SG_ 1332 VCFRONT_a142_undervoltage "Front body controller: a142 undervoltage";
CM_ SG_ 1332 VCFRONT_a142_chargePumpUndervolt "Front body controller: a142 charge pump undervoltage";
CM_ SG_ 1332 VCFRONT_a142_isCoilOpenX "Front body controller: a142 is coil open x";
CM_ SG_ 1332 VCFRONT_a142_isCoilOpenY "Front body controller: a142 is coil open y";
CM_ SG_ 1332 VCFRONT_a142_isCoilShortXPGnd "Front body controller: a142 is coil short XP gnd";
CM_ SG_ 1332 VCFRONT_a142_isCoilShortXPVbb "Front body controller: a142 is coil short XP vbb";
CM_ SG_ 1332 VCFRONT_a142_isCoilShortXNGnd "Front body controller: a142 is coil short XN gnd";
CM_ SG_ 1332 VCFRONT_a142_isCoilShortXNVbb "Front body controller: a142 is coil short XN vbb";
CM_ SG_ 1332 VCFRONT_a142_isCoilShortYPGnd "Front body controller: a142 is coil short YP gnd";
CM_ SG_ 1332 VCFRONT_a142_isCoilShortYPVbb "Front body controller: a142 is coil short YP vbb";
CM_ SG_ 1332 VCFRONT_a142_isCoilShortYNGnd "Front body controller: a142 is coil short YN gnd";
CM_ SG_ 1332 VCFRONT_a142_isCoilShortYNVbb "Front body controller: a142 is coil short YN vbb";
CM_ SG_ 1332 VCFRONT_a142_driverHasCommError "Front body controller: a142 driver has comm error";
CM_ SG_ 1332 VCFRONT_a143_vsUnderVoltage "Front body controller: a143 vs under voltage";
CM_ SG_ 1332 VCFRONT_a143_vsOverVoltage "Front body controller: a143 vs over voltage";
CM_ SG_ 1332 VCFRONT_a143_chpUnderVoltage "Front body controller: a143 chp under voltage";
CM_ SG_ 1332 VCFRONT_a143_vglUnderVoltage "Front body controller: a143 vgl under voltage";
CM_ SG_ 1332 VCFRONT_a143_thOverTemperature "Front body controller: a143 th over temperature";
CM_ SG_ 1332 VCFRONT_a144_vsUnderVoltage "Front body controller: a144 vs under voltage";
CM_ SG_ 1332 VCFRONT_a144_vsOverVoltage "Front body controller: a144 vs over voltage";
CM_ SG_ 1332 VCFRONT_a144_chpUnderVoltage "Front body controller: a144 chp under voltage";
CM_ SG_ 1332 VCFRONT_a144_vglUnderVoltage "Front body controller: a144 vgl under voltage";
CM_ SG_ 1332 VCFRONT_a144_thOverTemperature "Front body controller: a144 th over temperature";
CM_ SG_ 1332 VCFRONT_a145_vsUnderVoltage "Front body controller: a145 vs under voltage";
CM_ SG_ 1332 VCFRONT_a145_vsOverVoltage "Front body controller: a145 vs over voltage";
CM_ SG_ 1332 VCFRONT_a145_chpUnderVoltage "Front body controller: a145 chp under voltage";
CM_ SG_ 1332 VCFRONT_a145_vglUnderVoltage "Front body controller: a145 vgl under voltage";
CM_ SG_ 1332 VCFRONT_a145_thOverTemperature "Front body controller: a145 th over temperature";
CM_ SG_ 1332 VCFRONT_a146_RPMActual "Front body controller: a146 RPM actual";
CM_ SG_ 1332 VCFRONT_a146_RPMTarget "Front body controller: a146 RPM target";
CM_ SG_ 1332 VCFRONT_a147_RPMActual "Front body controller: a147 RPM actual";
CM_ SG_ 1332 VCFRONT_a147_RPMTarget "Front body controller: a147 RPM target";
CM_ SG_ 1332 VCFRONT_a148_RPMActual "Front body controller: a148 RPM actual";
CM_ SG_ 1332 VCFRONT_a148_RPMTarget "Front body controller: a148 RPM target";
CM_ SG_ 1332 VCFRONT_a150_RPMActual "Front body controller: a150 RPM actual";
CM_ SG_ 1332 VCFRONT_a150_RPMTarget "Front body controller: a150 RPM target";
CM_ SG_ 1332 VCFRONT_a151_RPMActual "Front body controller: a151 RPM actual";
CM_ SG_ 1332 VCFRONT_a151_RPMTarget "Front body controller: a151 RPM target";
CM_ SG_ 1332 VCFRONT_a152_RPMActual "Front body controller: a152 RPM actual";
CM_ SG_ 1332 VCFRONT_a152_RPMTarget "Front body controller: a152 RPM target";
CM_ SG_ 1332 VCFRONT_a156_motorCounts "Front body controller: a156 motor counts";
CM_ SG_ 1332 VCFRONT_a157_motorCounts "Front body controller: a157 motor counts";
CM_ SG_ 1332 VCFRONT_a159_stall "Front body controller: a159 stall";
CM_ SG_ 1332 VCFRONT_a159_angleActual "Front body controller: a159 angle actual";
CM_ SG_ 1332 VCFRONT_a159_angleTarget "Front body controller: a159 angle target";
CM_ SG_ 1332 VCFRONT_a160_highDischTemp "Front body controller: a160 high disch temp";
CM_ SG_ 1332 VCFRONT_a160_lowDischPressure "Front body controller: a160 low disch pressure";
CM_ SG_ 1332 VCFRONT_a160_highDischPressure "Front body controller: a160 high disch pressure";
CM_ SG_ 1332 VCFRONT_a160_lowSuctionPressure "Front body controller: a160 low suction pressure";
CM_ SG_ 1332 VCFRONT_a160_faultSnsDischPress "Front body controller: a160 fault sns disch press";
CM_ SG_ 1332 VCFRONT_a160_faultSnsDischTemp "Front body controller: a160 fault sns disch temp";
CM_ SG_ 1332 VCFRONT_a160_faultSnsSuctPress "Front body controller: a160 fault sns suct press";
CM_ SG_ 1332 VCFRONT_a160_faultSnsSuctTemp "Front body controller: a160 fault sns suct temp";
CM_ SG_ 1332 VCFRONT_a160_faultSnsAmbientTemp "Front body controller: a160 fault sns ambient temp";
CM_ SG_ 1332 VCFRONT_a160_faultValveEXV "Front body controller: a160 fault valve EXV";
CM_ SG_ 1332 VCFRONT_a160_faultValveEvapSol "Front body controller: a160 fault valve evap sol";
CM_ SG_ 1332 VCFRONT_a160_highDischargePressu "Front body controller: a160 high discharge pressure cutouts";
CM_ SG_ 1332 VCFRONT_a160_highDischargeTempCu "Front body controller: a160 high discharge temp cutouts";
CM_ SG_ 1332 VCFRONT_a160_compressorRpm "Front body controller: a160 compressor rpm";
CM_ SG_ 1332 VCFRONT_a161_failedStart "Front body controller: a161 failed start";
CM_ SG_ 1332 VCFRONT_a161_HVOverVoltage "Front body controller: a161 HV over voltage";
CM_ SG_ 1332 VCFRONT_a161_HVUnderVoltage "Front body controller: a161 HV under voltage";
CM_ SG_ 1332 VCFRONT_a161_overCurrent "Front body controller: a161 over current";
CM_ SG_ 1332 VCFRONT_a161_overTemperature "Front body controller: a161 over temperature";
CM_ SG_ 1332 VCFRONT_a161_shortCircuit "Front body controller: a161 short circuit";
CM_ SG_ 1332 VCFRONT_a161_underTemperature "Front body controller: a161 under temperature";
CM_ SG_ 1332 VCFRONT_a161_LVUnderVoltage "Front body controller: a161 LV under voltage";
CM_ SG_ 1332 VCFRONT_a161_LVOverVoltage "Front body controller: a161 LV over voltage";
CM_ SG_ 1332 VCFRONT_a161_tempSnsFaultIPM1 "Front body controller: a161 temp sns fault IPM1";
CM_ SG_ 1332 VCFRONT_a161_tempSnsFaultIPM2 "Front body controller: a161 temp sns fault IPM2";
CM_ SG_ 1332 VCFRONT_a161_tempSnsFaultCPU "Front body controller: a161 temp sns fault CPU";
CM_ SG_ 1332 VCFRONT_a161_currentSnsError "Front body controller: a161 current sns error";
CM_ SG_ 1332 VCFRONT_a161_selfTestFailCPU "Front body controller: a161 self test fail CPU";
CM_ SG_ 1332 VCFRONT_a161_internalPowerSupply "Front body controller: a161 internal power supply fault";
CM_ SG_ 1332 VCFRONT_a161_inverterOpenCircuit "Front body controller: a161 inverter open circuit";
CM_ SG_ 1332 VCFRONT_a161_warnOverTemperature "Front body controller: a161 warn over temperature";
CM_ SG_ 1332 VCFRONT_a161_failedStartRepeated "Front body controller: a161 failed start repeated";
CM_ SG_ 1332 VCFRONT_a161_overload "Front body controller: a161 overload";
CM_ SG_ 1332 VCFRONT_a162_dischargePressure "Front body controller: a162 discharge pressure";
CM_ SG_ 1332 VCFRONT_a162_chillerExvFlow "Front body controller: a162 chiller exv flow";
CM_ SG_ 1332 VCFRONT_a162_lccExvFlow "Front body controller: a162 lcc exv flow";
CM_ SG_ 1332 VCFRONT_a162_ccLeftExvFlow "Front body controller: a162 cc left exv flow";
CM_ SG_ 1332 VCFRONT_a162_ccRightExvFlow "Front body controller: a162 cc right exv flow";
CM_ SG_ 1332 VCFRONT_a162_evapExvFlow "Front body controller: a162 evap exv flow";
CM_ SG_ 1332 VCFRONT_a162_recircExvFlow "Front body controller: a162 recirc exv flow";
CM_ SG_ 1332 VCFRONT_a164_lockoutVoltage "Front body controller: a164 lockout voltage";
CM_ SG_ 1332 VCFRONT_a165_lockoutVoltage "Front body controller: a165 lockout voltage";
CM_ SG_ 1332 VCFRONT_a168_leftECU "Front body controller: a168 left ECU";
CM_ SG_ 1332 VCFRONT_a168_rightECU "Front body controller: a168 right ECU";
CM_ SG_ 1332 VCFRONT_a169_leftECU "Front body controller: a169 left ECU";
CM_ SG_ 1332 VCFRONT_a169_rightECU "Front body controller: a169 right ECU";
CM_ SG_ 1332 VCFRONT_a170_leftECU "Front body controller: a170 left ECU";
CM_ SG_ 1332 VCFRONT_a170_rightECU "Front body controller: a170 right ECU";
CM_ SG_ 1332 VCFRONT_a171_VCFRONT "Front body controller: a171 VCFRONT";
CM_ SG_ 1332 VCFRONT_a171_VCRIGHT "Front body controller: a171 VCRIGHT";
CM_ SG_ 1332 VCFRONT_a171_VCLEFT "Front body controller: a171 VCLEFT";
CM_ SG_ 1332 VCFRONT_a171_BMS "Front body controller: a171 BMS";
CM_ SG_ 1332 VCFRONT_a171_HVP "Front body controller: a171 HVP";
CM_ SG_ 1332 VCFRONT_a171_GTW "Front body controller: a171 GTW";
CM_ SG_ 1332 VCFRONT_a171_CP "Front body controller: a171 CP";
CM_ SG_ 1332 VCFRONT_a171_PCS "Front body controller: a171 PCS";
CM_ SG_ 1332 VCFRONT_a171_PCSCPU2 "Front body controller: a171 PCSCPU2";
CM_ SG_ 1332 VCFRONT_a171_DI "Front body controller: a171 DI";
CM_ SG_ 1332 VCFRONT_a171_DIS "Front body controller: a171 DIS";
CM_ SG_ 1332 VCFRONT_a171_PM "Front body controller: a171 PM";
CM_ SG_ 1332 VCFRONT_a171_PMS "Front body controller: a171 PMS";
CM_ SG_ 1332 VCFRONT_a171_EPBR "Front body controller: a171 EPBR";
CM_ SG_ 1332 VCFRONT_a171_EPBL "Front body controller: a171 EPBL";
CM_ SG_ 1332 VCFRONT_a171_IBST "Front body controller: a171 IBST";
CM_ SG_ 1332 VCFRONT_a171_IBSTCAL "Front body controller: a171 IBSTCAL";
CM_ SG_ 1332 VCFRONT_a171_ESP "Front body controller: a171 ESP";
CM_ SG_ 1332 VCFRONT_a171_ESPCAL "Front body controller: a171 ESPCAL";
CM_ SG_ 1332 VCFRONT_a171_OPC "Front body controller: a171 OPC";
CM_ SG_ 1332 VCFRONT_a171_OPCS "Front body controller: a171 OPCS";
CM_ SG_ 1332 VCFRONT_a171_SCCM "Front body controller: a171 SCCM";
CM_ SG_ 1332 VCFRONT_a171_LVBMS "Front body controller: a171 LVBMS";
CM_ SG_ 1332 VCFRONT_a171_IDB "Front body controller: a171 IDB";
CM_ SG_ 1332 VCFRONT_a171_IDB1 "Front body controller: a171 IDB1";
CM_ SG_ 1332 VCFRONT_a171_IDBCAL "Front body controller: a171 IDBCAL";
CM_ SG_ 1332 VCFRONT_a171_RCU "Front body controller: a171 RCU";
CM_ SG_ 1332 VCFRONT_a171_RCUCAL "Front body controller: a171 RCUCAL";
CM_ SG_ 1332 VCFRONT_a171_DPB "Front body controller: a171 DPB";
CM_ SG_ 1332 VCFRONT_a171_DPBCAL "Front body controller: a171 DPBCAL";
CM_ SG_ 1332 VCFRONT_a171_serviceMode "Signal reported by Front body controller";
CM_ SG_ 1332 VCFRONT_a172_ECUMismatchBits "Front body controller: a172 ECU mismatch bits";
CM_ SG_ 1332 VCFRONT_a172_serviceMode "Signal reported by Front body controller";
CM_ SG_ 1332 VCFRONT_a173_ECUMismatchBits "Front body controller: a173 ECU mismatch bits";
CM_ SG_ 1332 VCFRONT_a173_serviceMode "Signal reported by Front body controller";
CM_ SG_ 1332 VCFRONT_a175_snsShortCircuit "Front body controller: a175 sns short circuit";
CM_ SG_ 1332 VCFRONT_a175_snsDisconnect "Front body controller: a175 sns disconnect";
CM_ SG_ 1332 VCFRONT_a175_snsRateChangeUp "Front body controller: a175 sns rate change up";
CM_ SG_ 1332 VCFRONT_a175_snsRateChangeDown "Front body controller: a175 sns rate change down";
CM_ SG_ 1332 VCFRONT_a176_vehicleState "Front body controller: a176 vehicle state";
CM_ SG_ 1332 VCFRONT_a177_mcuAudioCurrent "Front body controller: a177 mcu audio current";
CM_ SG_ 1332 VCFRONT_a179_highLVAmpsIntoPCSLo "Front body controller: a179 high LV amps into PCS log";
CM_ SG_ 1332 VCFRONT_a180_vehiclePowerState "Front body controller: a180 vehicle power state";
CM_ SG_ 1332 VCFRONT_a180_hvState "Front body controller: a180 hv state";
CM_ SG_ 1332 VCFRONT_a180_bmsState "Front body controller: a180 bms state; raw 9 = signal not available (SNA)";
CM_ SG_ 1332 VCFRONT_a180_notEnoughPowerForSu "Front body controller: a180 not enough power for support";
CM_ SG_ 1332 VCFRONT_a180_pcsEFuseStable "Front body controller: a180 pcs e fuse stable";
CM_ SG_ 1332 VCFRONT_a180_vcrightEFuseStable "Front body controller: a180 vcright e fuse stable";
CM_ SG_ 1332 VCFRONT_a180_contactorEFuseStabl "Front body controller: a180 contactor e fuse stable";
CM_ SG_ 1332 VCFRONT_a180_hvcEFuseStable "Front body controller: a180 hvc e fuse stable";
CM_ SG_ 1332 VCFRONT_a180_replaceLVBattery "Front body controller: a180 replace LV battery";
CM_ SG_ 1332 VCFRONT_a180_BMS_MIA "Front body controller: a180 BMS MIA";
CM_ SG_ 1332 VCFRONT_a180_PCS_MIA "Front body controller: a180 PCS MIA";
CM_ SG_ 1332 VCFRONT_a180_HVBlockingMismatch "Front body controller: a180 HV blocking mismatch";
CM_ SG_ 1332 VCFRONT_a180_serviceMode "Signal reported by Front body controller";
CM_ SG_ 1332 VCFRONT_a180_transportMode "Front body controller: a180 transport mode";
CM_ SG_ 1332 VCFRONT_a180_frunkOpen "Front body controller: a180 frunk open";
CM_ SG_ 1332 VCFRONT_a180_dcdcLVSupportStatus "Front body controller: a180 dcdc LV support status";
CM_ SG_ 1332 VCFRONT_a181_vehicleState "Front body controller: a181 vehicle state";
CM_ SG_ 1332 VCFRONT_a182_deadLV "Front body controller: a182 dead LV";
CM_ SG_ 1332 VCFRONT_a182_voltageDrop "Front body controller: a182 voltage drop";
CM_ SG_ 1332 VCFRONT_a182_overcharge "Front body controller: a182 overcharge";
CM_ SG_ 1332 VCFRONT_a182_LVFloorReached "Front body controller: a182 LV floor reached";
CM_ SG_ 1332 VCFRONT_a182_shortedCell "Front body controller: a182 shorted cell";
CM_ SG_ 1332 VCFRONT_a182_postPORExcessiveAh "Front body controller: a182 post POR excessive ah";
CM_ SG_ 1332 VCFRONT_a182_resistanceEstimatio "Front body controller: a182 resistance estimation hard failure";
CM_ SG_ 1332 VCFRONT_a182_dcrMilliOhmsAboveTh "Front body controller: a182 dcr milli ohms above threshold";
CM_ SG_ 1332 VCFRONT_a182_prechargeLVLoadRedu "Front body controller: a182 precharge LV load reduction";
CM_ SG_ 1332 VCFRONT_a182_factoryMode "Front body controller: a182 factory mode";
CM_ SG_ 1332 VCFRONT_a182_serviceMode "Signal reported by Front body controller";
CM_ SG_ 1332 VCFRONT_a182_transportMode "Front body controller: a182 transport mode";
CM_ SG_ 1332 VCFRONT_a182_frunkOpen "Front body controller: a182 frunk open";
CM_ SG_ 1332 VCFRONT_a182_packOverDischarged "Front body controller: a182 pack over discharged";
CM_ SG_ 1332 VCFRONT_a182_cellImbalance "Front body controller: a182 cell imbalance";
CM_ SG_ 1332 VCFRONT_a182_instantPrechargeDCR "Front body controller: a182 instant precharge DCR too high";
CM_ SG_ 1332 VCFRONT_a182_ambientTemp "Front body controller: a182 ambient temp; raw 0 = signal not available (SNA)";
CM_ SG_ 1332 VCFRONT_a182_dischargedAmpHours "Front body controller: a182 discharged amp hours";
CM_ SG_ 1332 VCFRONT_a182_chargedAmpHours "Front body controller: a182 charged amp hours";
CM_ SG_ 1332 VCFRONT_a182_calibrationLostFaul "Front body controller: a182 calibration lost fault";
CM_ SG_ 1332 VCFRONT_a182_samplingHWError "Front body controller: a182 sampling HW error";
CM_ SG_ 1332 VCFRONT_a182_brickOverDischarged "Front body controller: a182 brick over discharged";
CM_ SG_ 1332 VCFRONT_a182_batteryType "Front body controller: a182 battery type";
CM_ SG_ 1332 VCFRONT_a186_noDriveChgCableConX "Front body controller: a186 no drive chg cable con x";
CM_ SG_ 1332 VCFRONT_a187_vehBusRetryCount "Front body controller: a187 veh bus retry count";
CM_ SG_ 1332 VCFRONT_a187_partyBusRetryCount "Front body controller: a187 party bus retry count";
CM_ SG_ 1332 VCFRONT_a187_hvsBusRetryCount "Front body controller: a187 hvs bus retry count";
CM_ SG_ 1332 VCFRONT_a187_ethBusRetryCount "Front body controller: a187 eth bus retry count";
CM_ SG_ 1332 VCFRONT_a187_chBusRetryCount "Front body controller: a187 ch bus retry count";
CM_ SG_ 1332 VCFRONT_a188_sleepBypassCurrent "Front body controller: a188 sleep bypass current";
CM_ SG_ 1332 VCFRONT_a188_IBSCurrent "Front body controller: a188 IBS current";
CM_ SG_ 1332 VCFRONT_a188_vehicleState "Front body controller: a188 vehicle state; raw 18 = signal not available (SNA)";
CM_ SG_ 1332 VCFRONT_a188_timeNotSleeping "Front body controller: a188 time not sleeping";
CM_ SG_ 1332 VCFRONT_a188_chargeRequest "Front body controller: a188 charge request";
CM_ SG_ 1332 VCFRONT_a188_12VSupport "Front body controller: a188 12 v support";
CM_ SG_ 1332 VCFRONT_a188_ThermalSupport "Front body controller: a188 thermal support";
CM_ SG_ 1332 VCFRONT_a188_accessoryRequest "Front body controller: a188 accessory request";
CM_ SG_ 1332 VCFRONT_a188_CANAfterQuiet "Front body controller: a188 CAN after quiet";
CM_ SG_ 1332 VCFRONT_a188_SleepRequestTimeout "Front body controller: a188 sleep request timeout";
CM_ SG_ 1332 VCFRONT_a188_wakeUpMsgID "Front body controller: a188 wake up msg ID";
CM_ SG_ 1332 VCFRONT_a191_vehiclePowerState "Front body controller: a191 vehicle power state";
CM_ SG_ 1332 VCFRONT_a191_hvState "Front body controller: a191 hv state";
CM_ SG_ 1332 VCFRONT_a191_reverseBatteryEFuse "Front body controller: a191 reverse battery e fuse fault";
CM_ SG_ 1332 VCFRONT_a191_vehicleLoadShedActi "Front body controller: a191 vehicle load shed active";
CM_ SG_ 1332 VCFRONT_a191_vehicleLoadShedHvFa "Front body controller: a191 vehicle load shed hv fault active";
CM_ SG_ 1332 VCFRONT_a191_vehicleLoadShedPost "Front body controller: a191 vehicle load shed post crash active";
CM_ SG_ 1332 VCFRONT_a191_IBSVoltage "Front body controller: a191 IBS voltage";
CM_ SG_ 1332 VCFRONT_a191_a180_DCDCNotSupport "Front body controller: a191 a180 DCDC not supporting LV bus";
CM_ SG_ 1332 VCFRONT_a191_MOSState "Front body controller: a191 MOS state; raw 3 = signal not available (SNA)";
CM_ SG_ 1332 VCFRONT_a191_LVBMSVoltage "Front body controller: a191 LVBMS voltage";
CM_ SG_ 1332 VCFRONT_a191_ECPAState "Front body controller: a191 ECPA state; raw 3 = signal not available (SNA)";
CM_ SG_ 1332 VCFRONT_a191_LVBMSCurrentTargetV "Front body controller: a191 LVBMS current target valid";
CM_ SG_ 1332 VCFRONT_a191_LVBMSVoltageTargetV "Front body controller: a191 LVBMS voltage target valid";
CM_ SG_ 1332 VCFRONT_a191_serviceMode "Signal reported by Front body controller";
CM_ SG_ 1332 VCFRONT_a191_frunkOpen "Front body controller: a191 frunk open";
CM_ SG_ 1332 VCFRONT_a191_vehicleLoadShedStag "Front body controller: a191 vehicle load shed stage";
CM_ SG_ 1332 VCFRONT_a191_exitDriveWarningTim "Front body controller: a191 exit drive warning timer expired";
CM_ SG_ 1332 VCFRONT_a191_LVBMSMIA "Front body controller: a191 LVBMSMIA";
CM_ SG_ 1332 VCFRONT_a191_PCS_MIA "Front body controller: a191 PCS MIA";
CM_ SG_ 1332 VCFRONT_a191_NotEnoughPowerForSu "Front body controller: a191 not enough power for support";
CM_ SG_ 1332 VCFRONT_a191_bmsState "Front body controller: a191 bms state; raw 9 = signal not available (SNA)";
CM_ SG_ 1332 VCFRONT_a192_vehiclePowerState "Front body controller: a192 vehicle power state";
CM_ SG_ 1332 VCFRONT_a192_hvState "Front body controller: a192 hv state";
CM_ SG_ 1332 VCFRONT_a192_notEnoughPowerForSu "Front body controller: a192 not enough power for support";
CM_ SG_ 1332 VCFRONT_a192_pcsEFuseStable "Front body controller: a192 pcs e fuse stable";
CM_ SG_ 1332 VCFRONT_a192_vcrightEFuseStable "Front body controller: a192 vcright e fuse stable";
CM_ SG_ 1332 VCFRONT_a192_contactorEFuseStabl "Front body controller: a192 contactor e fuse stable";
CM_ SG_ 1332 VCFRONT_a192_hvcEFuseStable "Front body controller: a192 hvc e fuse stable";
CM_ SG_ 1332 VCFRONT_a192_replaceLVBattery "Front body controller: a192 replace LV battery";
CM_ SG_ 1332 VCFRONT_a192_BMS_MIA "Front body controller: a192 BMS MIA";
CM_ SG_ 1332 VCFRONT_a192_PCS_MIA "Front body controller: a192 PCS MIA";
CM_ SG_ 1332 VCFRONT_a192_HVBlockingMismatch "Front body controller: a192 HV blocking mismatch";
CM_ SG_ 1332 VCFRONT_a192_disconnected12V "Front body controller: a192 disconnected12 v";
CM_ SG_ 1332 VCFRONT_a192_LVBatteryCannotSupp "Front body controller: a192 LV battery cannot support vehicle";
CM_ SG_ 1332 VCFRONT_a192_DI_gear "Front body controller: a192 DI gear; raw 7 = signal not available (SNA)";
CM_ SG_ 1332 VCFRONT_a192_GTW_factoryGated "Front body controller: a192 GTW factory gated";
CM_ SG_ 1332 VCFRONT_a192_GTW_updateStarted "Front body controller: a192 GTW update started";
CM_ SG_ 1332 VCFRONT_a192_serviceMode "Signal reported by Front body controller";
CM_ SG_ 1332 VCFRONT_a192_frunkOpen "Front body controller: a192 frunk open";
CM_ SG_ 1332 VCFRONT_a192_IBSCurrent "Front body controller: a192 IBS current";
CM_ SG_ 1332 VCFRONT_a192_PCSCurrent "Front body controller: a192 PCS current";
CM_ SG_ 1332 VCFRONT_a192_HVFaultLoadShedActi "Front body controller: a192 HV fault load shed active";
CM_ SG_ 1332 VCFRONT_a192_postCrashLoadShedAc "Front body controller: a192 post crash load shed active";
CM_ SG_ 1332 VCFRONT_a195_IBSVoltage "Front body controller: a195 IBS voltage";
CM_ SG_ 1332 VCFRONT_a195_serviceMode "Signal reported by Front body controller";
CM_ SG_ 1332 VCFRONT_a195_frunkOpen "Front body controller: a195 frunk open";
CM_ SG_ 1332 VCFRONT_a196_factoryMode "Front body controller: a196 factory mode";
CM_ SG_ 1332 VCFRONT_a196_serviceMode "Signal reported by Front body controller";
CM_ SG_ 1332 VCFRONT_a196_transportMode "Front body controller: a196 transport mode";
CM_ SG_ 1332 VCFRONT_a196_frunkOpen "Front body controller: a196 frunk open";
CM_ SG_ 1332 VCFRONT_a196_vehiclePowerState "Front body controller: a196 vehicle power state";
CM_ SG_ 1332 VCFRONT_a196_batterySMState "Front body controller: a196 battery SM state";
CM_ SG_ 1332 VCFRONT_a196_disconnectedBattery "Front body controller: a196 disconnected battery test current";
CM_ SG_ 1332 VCFRONT_a196_disconnectedBa_0002 "Front body controller: a196 disconnected battery test voltage";
CM_ SG_ 1332 VCFRONT_a196_disconnectedBa_0001 "Front body controller: a196 disconnected battery test prev voltage";
CM_ SG_ 1332 VCFRONT_a196_ECPAState "Front body controller: a196 ECPA state; raw 3 = signal not available (SNA)";
CM_ SG_ 1332 VCFRONT_a198_outputState "Front body controller: a198 output state";
CM_ SG_ 1332 VCFRONT_a198_NVRAMState "Front body controller: a198 NVRAM state";
CM_ SG_ 1332 VCFRONT_a198_lockoutState "Front body controller: a198 lockout state";
CM_ SG_ 1332 VCFRONT_a199_outputState "Front body controller: a199 output state";
CM_ SG_ 1332 VCFRONT_a199_NVRAMState "Front body controller: a199 NVRAM state";
CM_ SG_ 1332 VCFRONT_a199_lockoutState "Front body controller: a199 lockout state";
CM_ SG_ 1332 VCFRONT_a200_vcleftSelfTest "Front body controller: a200 vcleft self test; raw 12 = signal not available (SNA)";
CM_ SG_ 1332 VCFRONT_a201_vcrightSelfTest "Front body controller: a201 vcright self test; raw 12 = signal not available (SNA)";
CM_ SG_ 1332 VCFRONT_a202_pcsSelfTest "Front body controller: a202 pcs self test; raw 12 = signal not available (SNA)";
CM_ SG_ 1332 VCFRONT_a207_vbatFusedSelfTest "Front body controller: a207 vbat fused self test; raw 12 = signal not available (SNA)";
CM_ SG_ 1332 VCFRONT_a210_valveUnderTravel "Front body controller: a210 valve under travel";
CM_ SG_ 1332 VCFRONT_a210_valveOverTravel "Front body controller: a210 valve over travel";
CM_ SG_ 1332 VCFRONT_a210_valveNoTravel "Front body controller: a210 valve no travel";
CM_ SG_ 1332 VCFRONT_a212_IBSTemp "Front body controller: a212 IBS temp";
CM_ SG_ 1332 VCFRONT_a213_IBSVolts "Front body controller: a213 IBS volts";
CM_ SG_ 1332 VCFRONT_a213_IBSAh "Front body controller: a213 IBS ah";
CM_ SG_ 1332 VCFRONT_a213_LVBatteryTemp "Front body controller: a213 LV battery temp; raw 32768 = signal not available (SNA)";
CM_ SG_ 1332 VCFRONT_a214_motorFaulted "Front body controller: a214 motor faulted";
CM_ SG_ 1332 VCFRONT_a214_motorLocked "Front body controller: a214 motor locked";
CM_ SG_ 1332 VCFRONT_a214_ecuReset "Front body controller: a214 ecu reset";
CM_ SG_ 1332 VCFRONT_a214_fetTempIrrational "Front body controller: a214 fet temp irrational";
CM_ SG_ 1332 VCFRONT_a214_motorControlError "Front body controller: a214 motor control error";
CM_ SG_ 1332 VCFRONT_a214_underVoltage "Front body controller: a214 under voltage";
CM_ SG_ 1332 VCFRONT_a214_overVoltage "Front body controller: a214 over voltage";
CM_ SG_ 1332 VCFRONT_a214_hardwareOvercurrent "Front body controller: a214 hardware overcurrent";
CM_ SG_ 1332 VCFRONT_a214_motorOpenPhase "Front body controller: a214 motor open phase";
CM_ SG_ 1332 VCFRONT_a214_motorSoftOpenPhase "Front body controller: a214 motor soft open phase";
CM_ SG_ 1332 VCFRONT_a214_motorOvertemp "Front body controller: a214 motor overtemp";
CM_ SG_ 1332 VCFRONT_a214_dcOvercurrent "Front body controller: a214 dc overcurrent";
CM_ SG_ 1332 VCFRONT_a214_motorStalled "Front body controller: a214 motor stalled";
CM_ SG_ 1332 VCFRONT_a214_selfTestFailed "Front body controller: a214 self test failed";
CM_ SG_ 1332 VCFRONT_a214_selfTestResult "Front body controller: a214 self test result";
CM_ SG_ 1332 VCFRONT_a214_linChecksumError "Front body controller: a214 lin checksum error";
CM_ SG_ 1332 VCFRONT_a214_linFramingError "Front body controller: a214 lin framing error";
CM_ SG_ 1332 VCFRONT_a214_phaseShorted "Front body controller: a214 phase shorted";
CM_ SG_ 1332 VCFRONT_a214_busVoltageIrrationa "Front body controller: a214 bus voltage irrational";
CM_ SG_ 1332 VCFRONT_a214_dcCurrentIrrational "Front body controller: a214 dc current irrational";
CM_ SG_ 1332 VCFRONT_a214_motorSpeedIrrationa "Front body controller: a214 motor speed irrational";
CM_ SG_ 1332 VCFRONT_a214_supplyVoltageIrrati "Front body controller: a214 supply voltage irrational";
CM_ SG_ 1332 VCFRONT_a214_motorPhaseCurrentIr "Front body controller: a214 motor phase current irrational";
CM_ SG_ 1332 VCFRONT_a214_chipOvertemp "Front body controller: a214 chip overtemp";
CM_ SG_ 1332 VCFRONT_a214_motorSpeedTooHigh "Front body controller: a214 motor speed too high";
CM_ SG_ 1332 VCFRONT_a214_phaseOvercurrent "Front body controller: a214 phase overcurrent";
CM_ SG_ 1332 VCFRONT_a214_vddaOvercurrent "Front body controller: a214 vdda overcurrent";
CM_ SG_ 1332 VCFRONT_a214_busVoltageUnhealthy "Front body controller: a214 bus voltage unhealthy";
CM_ SG_ 1332 VCFRONT_a214_hsVdsOvervoltage "Front body controller: a214 hs vds overvoltage";
CM_ SG_ 1332 VCFRONT_a214_hsVdsOvervoltageMas "Front body controller: a214 hs vds overvoltage mask";
CM_ SG_ 1332 VCFRONT_a214_lsVdsOvervoltage "Front body controller: a214 ls vds overvoltage";
CM_ SG_ 1332 VCFRONT_a214_lsVdsOvervoltageMas "Front body controller: a214 ls vds overvoltage mask";
CM_ SG_ 1332 VCFRONT_a214_payloadBitsNotSet "Front body controller: a214 payload bits not set";
CM_ SG_ 1332 VCFRONT_a216_inDrive "Front body controller: a216 in drive";
CM_ SG_ 1332 VCFRONT_a216_hvState "Front body controller: a216 hv state";
CM_ SG_ 1332 VCFRONT_a216_vcleftFastBlowImmin "Front body controller: a216 vcleft fast blow imminent";
CM_ SG_ 1332 VCFRONT_a216_vcleftFastBlowDebou "Front body controller: a216 vcleft fast blow debounce imminent";
CM_ SG_ 1332 VCFRONT_a216_vcleftStaticImminen "Front body controller: a216 vcleft static imminent";
CM_ SG_ 1332 VCFRONT_a216_vcleftDynamicImmine "Front body controller: a216 vcleft dynamic imminent";
CM_ SG_ 1332 VCFRONT_a216_vcrightFastBlowImmi "Front body controller: a216 vcright fast blow imminent";
CM_ SG_ 1332 VCFRONT_a216_vcrightFastBlowDebo "Front body controller: a216 vcright fast blow debounce imminent";
CM_ SG_ 1332 VCFRONT_a216_vcrightStaticImmine "Front body controller: a216 vcright static imminent";
CM_ SG_ 1332 VCFRONT_a216_vcrightDynamicImmin "Front body controller: a216 vcright dynamic imminent";
CM_ SG_ 1332 VCFRONT_a217_motorFaulted "Front body controller: a217 motor faulted";
CM_ SG_ 1332 VCFRONT_a217_motorLocked "Front body controller: a217 motor locked";
CM_ SG_ 1332 VCFRONT_a217_ecuReset "Front body controller: a217 ecu reset";
CM_ SG_ 1332 VCFRONT_a217_fetTempIrrational "Front body controller: a217 fet temp irrational";
CM_ SG_ 1332 VCFRONT_a217_motorControlError "Front body controller: a217 motor control error";
CM_ SG_ 1332 VCFRONT_a217_underVoltage "Front body controller: a217 under voltage";
CM_ SG_ 1332 VCFRONT_a217_overVoltage "Front body controller: a217 over voltage";
CM_ SG_ 1332 VCFRONT_a217_hardwareOvercurrent "Front body controller: a217 hardware overcurrent";
CM_ SG_ 1332 VCFRONT_a217_motorOpenPhase "Front body controller: a217 motor open phase";
CM_ SG_ 1332 VCFRONT_a217_motorSoftOpenPhase "Front body controller: a217 motor soft open phase";
CM_ SG_ 1332 VCFRONT_a217_motorOvertemp "Front body controller: a217 motor overtemp";
CM_ SG_ 1332 VCFRONT_a217_dcOvercurrent "Front body controller: a217 dc overcurrent";
CM_ SG_ 1332 VCFRONT_a217_motorStalled "Front body controller: a217 motor stalled";
CM_ SG_ 1332 VCFRONT_a217_selfTestFailed "Front body controller: a217 self test failed";
CM_ SG_ 1332 VCFRONT_a217_selfTestResult "Front body controller: a217 self test result";
CM_ SG_ 1332 VCFRONT_a217_linChecksumError "Front body controller: a217 lin checksum error";
CM_ SG_ 1332 VCFRONT_a217_linFramingError "Front body controller: a217 lin framing error";
CM_ SG_ 1332 VCFRONT_a217_phaseShorted "Front body controller: a217 phase shorted";
CM_ SG_ 1332 VCFRONT_a217_busVoltageIrrationa "Front body controller: a217 bus voltage irrational";
CM_ SG_ 1332 VCFRONT_a217_dcCurrentIrrational "Front body controller: a217 dc current irrational";
CM_ SG_ 1332 VCFRONT_a217_motorSpeedIrrationa "Front body controller: a217 motor speed irrational";
CM_ SG_ 1332 VCFRONT_a217_supplyVoltageIrrati "Front body controller: a217 supply voltage irrational";
CM_ SG_ 1332 VCFRONT_a217_motorPhaseCurrentIr "Front body controller: a217 motor phase current irrational";
CM_ SG_ 1332 VCFRONT_a217_chipOvertemp "Front body controller: a217 chip overtemp";
CM_ SG_ 1332 VCFRONT_a217_motorSpeedTooHigh "Front body controller: a217 motor speed too high";
CM_ SG_ 1332 VCFRONT_a217_phaseOvercurrent "Front body controller: a217 phase overcurrent";
CM_ SG_ 1332 VCFRONT_a217_vddaOvercurrent "Front body controller: a217 vdda overcurrent";
CM_ SG_ 1332 VCFRONT_a217_busVoltageUnhealthy "Front body controller: a217 bus voltage unhealthy";
CM_ SG_ 1332 VCFRONT_a217_hsVdsOvervoltage "Front body controller: a217 hs vds overvoltage";
CM_ SG_ 1332 VCFRONT_a217_hsVdsOvervoltageMas "Front body controller: a217 hs vds overvoltage mask";
CM_ SG_ 1332 VCFRONT_a217_lsVdsOvervoltage "Front body controller: a217 ls vds overvoltage";
CM_ SG_ 1332 VCFRONT_a217_lsVdsOvervoltageMas "Front body controller: a217 ls vds overvoltage mask";
CM_ SG_ 1332 VCFRONT_a217_payloadBitsNotSet "Front body controller: a217 payload bits not set";
CM_ SG_ 1332 VCFRONT_a219_IBSVolts "Front body controller: a219 IBS volts";
CM_ SG_ 1332 VCFRONT_a219_IBSAh "Front body controller: a219 IBS ah";
CM_ SG_ 1332 VCFRONT_a219_IBSCurrent "Front body controller: a219 IBS current";
CM_ SG_ 1332 VCFRONT_a220_IBSCurrent "Front body controller: a220 IBS current";
CM_ SG_ 1332 VCFRONT_a220_PCSCurrent "Front body controller: a220 PCS current";
CM_ SG_ 1332 VCFRONT_a220_serviceMode "Signal reported by Front body controller";
CM_ SG_ 1332 VCFRONT_a220_frunkOpen "Front body controller: a220 frunk open";
CM_ SG_ 1332 VCFRONT_a221_outputFaulted "Front body controller: a221 output faulted";
CM_ SG_ 1332 VCFRONT_a221_currentSenseFaulted "Front body controller: a221 current sense faulted";
CM_ SG_ 1332 VCFRONT_a221_tempSenseFaulted "Front body controller: a221 temp sense faulted";
CM_ SG_ 1332 VCFRONT_a221_underCurrent "Front body controller: a221 under current";
CM_ SG_ 1332 VCFRONT_a221_overCurrent "Front body controller: a221 over current";
CM_ SG_ 1332 VCFRONT_a221_overTemperature "Front body controller: a221 over temperature";
CM_ SG_ 1332 VCFRONT_a222_outputFaulted "Front body controller: a222 output faulted";
CM_ SG_ 1332 VCFRONT_a222_currentSenseFaulted "Front body controller: a222 current sense faulted";
CM_ SG_ 1332 VCFRONT_a222_tempSenseFaulted "Front body controller: a222 temp sense faulted";
CM_ SG_ 1332 VCFRONT_a222_underCurrent "Front body controller: a222 under current";
CM_ SG_ 1332 VCFRONT_a222_overCurrent "Front body controller: a222 over current";
CM_ SG_ 1332 VCFRONT_a222_overTemperature "Front body controller: a222 over temperature";
CM_ SG_ 1332 VCFRONT_a223_12VTemperature "Front body controller: a223 12 v temperature";
CM_ SG_ 1332 VCFRONT_a227_motorFaulted "Front body controller: a227 motor faulted";
CM_ SG_ 1332 VCFRONT_a227_motorLocked "Front body controller: a227 motor locked";
CM_ SG_ 1332 VCFRONT_a227_ecuReset "Front body controller: a227 ecu reset";
CM_ SG_ 1332 VCFRONT_a227_fetTempIrrational "Front body controller: a227 fet temp irrational";
CM_ SG_ 1332 VCFRONT_a227_motorControlError "Front body controller: a227 motor control error";
CM_ SG_ 1332 VCFRONT_a227_underVoltage "Front body controller: a227 under voltage";
CM_ SG_ 1332 VCFRONT_a227_overVoltage "Front body controller: a227 over voltage";
CM_ SG_ 1332 VCFRONT_a227_hardwareOvercurrent "Front body controller: a227 hardware overcurrent";
CM_ SG_ 1332 VCFRONT_a227_motorOpenPhase "Front body controller: a227 motor open phase";
CM_ SG_ 1332 VCFRONT_a227_motorSoftOpenPhase "Front body controller: a227 motor soft open phase";
CM_ SG_ 1332 VCFRONT_a227_motorOvertemp "Front body controller: a227 motor overtemp";
CM_ SG_ 1332 VCFRONT_a227_dcOvercurrent "Front body controller: a227 dc overcurrent";
CM_ SG_ 1332 VCFRONT_a227_motorStalled "Front body controller: a227 motor stalled";
CM_ SG_ 1332 VCFRONT_a227_selfTestFailed "Front body controller: a227 self test failed";
CM_ SG_ 1332 VCFRONT_a227_selfTestResult "Front body controller: a227 self test result";
CM_ SG_ 1332 VCFRONT_a227_linChecksumError "Front body controller: a227 lin checksum error";
CM_ SG_ 1332 VCFRONT_a227_linFramingError "Front body controller: a227 lin framing error";
CM_ SG_ 1332 VCFRONT_a227_phaseShorted "Front body controller: a227 phase shorted";
CM_ SG_ 1332 VCFRONT_a227_busVoltageIrrationa "Front body controller: a227 bus voltage irrational";
CM_ SG_ 1332 VCFRONT_a227_dcCurrentIrrational "Front body controller: a227 dc current irrational";
CM_ SG_ 1332 VCFRONT_a227_motorSpeedIrrationa "Front body controller: a227 motor speed irrational";
CM_ SG_ 1332 VCFRONT_a227_supplyVoltageIrrati "Front body controller: a227 supply voltage irrational";
CM_ SG_ 1332 VCFRONT_a227_motorPhaseCurrentIr "Front body controller: a227 motor phase current irrational";
CM_ SG_ 1332 VCFRONT_a227_chipOvertemp "Front body controller: a227 chip overtemp";
CM_ SG_ 1332 VCFRONT_a227_motorSpeedTooHigh "Front body controller: a227 motor speed too high";
CM_ SG_ 1332 VCFRONT_a227_phaseOvercurrent "Front body controller: a227 phase overcurrent";
CM_ SG_ 1332 VCFRONT_a227_vddaOvercurrent "Front body controller: a227 vdda overcurrent";
CM_ SG_ 1332 VCFRONT_a227_busVoltageUnhealthy "Front body controller: a227 bus voltage unhealthy";
CM_ SG_ 1332 VCFRONT_a227_hsVdsOvervoltage "Front body controller: a227 hs vds overvoltage";
CM_ SG_ 1332 VCFRONT_a227_hsVdsOvervoltageMas "Front body controller: a227 hs vds overvoltage mask";
CM_ SG_ 1332 VCFRONT_a227_lsVdsOvervoltage "Front body controller: a227 ls vds overvoltage";
CM_ SG_ 1332 VCFRONT_a227_lsVdsOvervoltageMas "Front body controller: a227 ls vds overvoltage mask";
CM_ SG_ 1332 VCFRONT_a227_payloadBitsNotSet "Front body controller: a227 payload bits not set";
CM_ SG_ 1332 VCFRONT_a231_12VTemperature "Front body controller: a231 12 v temperature";
CM_ SG_ 1332 VCFRONT_a233_current "Front body controller: a233 current";
CM_ SG_ 1332 VCFRONT_a234_current "Front body controller: a234 current";
CM_ SG_ 1332 VCFRONT_a235_ptSensorTemp "Front body controller: a235 pt sensor temp";
CM_ SG_ 1332 VCFRONT_a236_batSensorTemp "Front body controller: a236 bat sensor temp";
CM_ SG_ 1332 VCFRONT_a242_LVBatteryTemp "Front body controller: a242 LV battery temp; raw 127 = signal not available (SNA)";
CM_ SG_ 1332 VCFRONT_a242_IBSCurrent "Front body controller: a242 IBS current";
CM_ SG_ 1332 VCFRONT_a242_IBSVoltage "Front body controller: a242 IBS voltage";
CM_ SG_ 1332 VCFRONT_a242_IBSAmpHours "Front body controller: a242 IBS amp hours";
CM_ SG_ 1332 VCFRONT_a242_vehiclePowerState "Front body controller: a242 vehicle power state";
CM_ SG_ 1332 VCFRONT_a243_IBSVolts "Front body controller: a243 IBS volts";
CM_ SG_ 1332 VCFRONT_a243_IBSCurrent "Front body controller: a243 IBS current";
CM_ SG_ 1332 VCFRONT_a243_LVBatteryTemp "Front body controller: a243 LV battery temp; raw 32768 = signal not available (SNA)";
CM_ SG_ 1332 VCFRONT_a244_current "Front body controller: a244 current";
CM_ SG_ 1332 VCFRONT_a244_voltage "Front body controller: a244 voltage";
CM_ SG_ 1332 VCFRONT_a244_vbatProtVoltage "Front body controller: a244 vbat prot voltage";
CM_ SG_ 1332 VCFRONT_a245_current "Front body controller: a245 current";
CM_ SG_ 1332 VCFRONT_a245_voltage "Front body controller: a245 voltage";
CM_ SG_ 1332 VCFRONT_a245_eFuseRemainingRetri "Front body controller: a245 e fuse remaining retries";
CM_ SG_ 1332 VCFRONT_a246_current "Front body controller: a246 current";
CM_ SG_ 1332 VCFRONT_a246_voltage "Front body controller: a246 voltage";
CM_ SG_ 1332 VCFRONT_a246_eFuseRemainingRetri "Front body controller: a246 e fuse remaining retries";
CM_ SG_ 1332 VCFRONT_a247_solenoidISense "Front body controller: a247 solenoid i sense";
CM_ SG_ 1332 VCFRONT_a248_AS8510Voltage "Front body controller: a248 AS8510 voltage";
CM_ SG_ 1332 VCFRONT_a248_IBSVoltage "Front body controller: a248 IBS voltage";
CM_ SG_ 1332 VCFRONT_a248_vbatMonitor "Front body controller: a248 vbat monitor";
CM_ SG_ 1332 VCFRONT_a248_voltageCalScaling "Front body controller: a248 voltage cal scaling";
CM_ SG_ 1332 VCFRONT_a249_tempCoolantBatInlet "Front body controller: a249 temp coolant bat inlet";
CM_ SG_ 1332 VCFRONT_a249_tempCoolantPTInlet "Front body controller: a249 temp coolant PT inlet";
CM_ SG_ 1332 VCFRONT_a250_isGlobalHeadlamps "Front body controller: a250 is global headlamps";
CM_ SG_ 1332 VCFRONT_a250_isVirtualPitchSenso "Front body controller: a250 is virtual pitch sensor";
CM_ SG_ 1332 VCFRONT_a250_isAimedHCML "Front body controller: a250 is aimed HCML";
CM_ SG_ 1332 VCFRONT_a250_isAimedHCMR "Front body controller: a250 is aimed HCMR";
CM_ SG_ 1332 VCFRONT_a250_calibratedVerticalP "Front body controller: a250 calibrated vertical position HCML; raw 1023 = signal not available (SNA)";
CM_ SG_ 1332 VCFRONT_a250_calibratedVert_0001 "Front body controller: a250 calibrated vertical position HCMR; raw 1023 = signal not available (SNA)";
CM_ SG_ 1332 VCFRONT_a250_calibratedHorizonta "Front body controller: a250 calibrated horizontal position HCML; raw 1023 = signal not available (SNA)";
CM_ SG_ 1332 VCFRONT_a250_calibratedHori_0001 "Front body controller: a250 calibrated horizontal position HCMR; raw 1023 = signal not available (SNA)";
CM_ SG_ 1332 VCFRONT_a253_currentNotTapered "Front body controller: a253 current not tapered";
CM_ SG_ 1332 VCFRONT_a253_ampHourTargetNotRea "Front body controller: a253 amp hour target not reached";
CM_ SG_ 1332 VCFRONT_a253_IBSCurrent "Front body controller: a253 IBS current";
CM_ SG_ 1332 VCFRONT_a253_IBSAmpHours "Front body controller: a253 IBS amp hours";
CM_ SG_ 1332 VCFRONT_a253_LVBatteryTemp "Front body controller: a253 LV battery temp; raw 127 = signal not available (SNA)";
CM_ SG_ 1332 VCFRONT_a253_firstChargeOTA "Front body controller: a253 first charge OTA";
CM_ SG_ 1332 VCFRONT_a253_firstChargePOR "Front body controller: a253 first charge POR";
CM_ SG_ 1332 VCFRONT_a253_serviceMode "Signal reported by Front body controller";
CM_ SG_ 1332 VCFRONT_a253_frunkOpen "Front body controller: a253 frunk open";
CM_ SG_ 1332 VCFRONT_a254_RPMActual "Front body controller: a254 RPM actual";
CM_ SG_ 1332 VCFRONT_a254_RPMTarget "Front body controller: a254 RPM target";
CM_ SG_ 1332 VCFRONT_a255_RPMActual "Front body controller: a255 RPM actual";
CM_ SG_ 1332 VCFRONT_a255_RPMTarget "Front body controller: a255 RPM target";
CM_ SG_ 1332 VCFRONT_a257_lockoutVoltage "Front body controller: a257 lockout voltage";
CM_ SG_ 1332 VCFRONT_a257_vcrightLockoutStatu "Front body controller: a257 vcright lockout status";
CM_ SG_ 1332 VCFRONT_a257_vcleftFault "Front body controller: a257 vcleft fault";
CM_ SG_ 1332 VCFRONT_a257_vcrightFault "Front body controller: a257 vcright fault";
CM_ SG_ 1332 VCFRONT_a257_pcsFault "Front body controller: a257 pcs fault";
CM_ SG_ 1332 VCFRONT_a257_vbatFusedFault "Front body controller: a257 vbat fused fault";
CM_ SG_ 1332 VCFRONT_a257_iBoosterFault "Front body controller: a257 i booster fault";
CM_ SG_ 1332 VCFRONT_a257_espFault "Front body controller: a257 esp fault";
CM_ SG_ 1332 VCFRONT_a257_epas3pFault "Front body controller: a257 epas3p fault";
CM_ SG_ 1332 VCFRONT_a257_epas3sFault "Front body controller: a257 epas3s fault";
CM_ SG_ 1332 VCFRONT_a257_revBattFault "Front body controller: a257 rev batt fault";
CM_ SG_ 1332 VCFRONT_a257_vehicleState "Front body controller: a257 vehicle state; raw 18 = signal not available (SNA)";
CM_ SG_ 1332 VCFRONT_a259_serviceMode "Signal reported by Front body controller";
CM_ SG_ 1332 VCFRONT_a259_voltageDropCounter "Front body controller: a259 voltage drop counter";
CM_ SG_ 1332 VCFRONT_a259_minVoltageReached "Front body controller: a259 min voltage reached";
CM_ SG_ 1332 VCFRONT_a259_IBSTemp "Front body controller: a259 IBS temp";
CM_ SG_ 1332 VCFRONT_a259_maxCurrentReached "Front body controller: a259 max current reached";
CM_ SG_ 1332 VCFRONT_a260_IBSVolts "Front body controller: a260 IBS volts";
CM_ SG_ 1332 VCFRONT_a260_IBSAh "Front body controller: a260 IBS ah";
CM_ SG_ 1332 VCFRONT_a260_vehiclePowerState "Front body controller: a260 vehicle power state";
CM_ SG_ 1332 VCFRONT_a260_batterySMState "Front body controller: a260 battery SM state";
CM_ SG_ 1332 VCFRONT_a260_HV_UP "Front body controller: a260 HV UP";
CM_ SG_ 1332 VCFRONT_a260_notEnoughPowerForSu "Front body controller: a260 not enough power for support";
CM_ SG_ 1332 VCFRONT_a260_coolantHasBeenFille "Front body controller: a260 coolant has been filled";
CM_ SG_ 1332 VCFRONT_a260_ampHourTrigger "Front body controller: a260 amp hour trigger";
CM_ SG_ 1332 VCFRONT_a260_voltageTrigger "Front body controller: a260 voltage trigger";
CM_ SG_ 1332 VCFRONT_a260_crashDetected "Front body controller: a260 crash detected";
CM_ SG_ 1332 VCFRONT_a260_BMS_MIA "Front body controller: a260 BMS MIA";
CM_ SG_ 1332 VCFRONT_a260_PCS_MIA "Front body controller: a260 PCS MIA";
CM_ SG_ 1332 VCFRONT_a260_HVBlockingMismatch "Front body controller: a260 HV blocking mismatch";
CM_ SG_ 1332 VCFRONT_a260_serviceMode "Signal reported by Front body controller";
CM_ SG_ 1332 VCFRONT_a260_dcdcLVSupportStatus "Front body controller: a260 dcdc LV support status";
CM_ SG_ 1332 VCFRONT_a260_PCSAndVCREFuseStabl "Front body controller: a260 PCS and VCRE fuse stable";
CM_ SG_ 1332 VCFRONT_a260_bmsState "Front body controller: a260 bms state; raw 9 = signal not available (SNA)";
CM_ SG_ 1332 VCFRONT_a261_eFuseVoltage "Front body controller: a261 e fuse voltage";
CM_ SG_ 1332 VCFRONT_a261_vbatProtVoltage "Front body controller: a261 vbat prot voltage";
CM_ SG_ 1332 VCFRONT_a262_eFuseVoltage "Front body controller: a262 e fuse voltage";
CM_ SG_ 1332 VCFRONT_a262_vbatProtVoltage "Front body controller: a262 vbat prot voltage";
CM_ SG_ 1332 VCFRONT_a263_eFuseVoltage "Front body controller: a263 e fuse voltage";
CM_ SG_ 1332 VCFRONT_a263_vbatProtVoltage "Front body controller: a263 vbat prot voltage";
CM_ SG_ 1332 VCFRONT_a264_eFuseVoltage "Front body controller: a264 e fuse voltage";
CM_ SG_ 1332 VCFRONT_a264_vbatProtVoltage "Front body controller: a264 vbat prot voltage";
CM_ SG_ 1332 VCFRONT_a265_eFuseVoltage "Front body controller: a265 e fuse voltage";
CM_ SG_ 1332 VCFRONT_a265_vbatProtVoltage "Front body controller: a265 vbat prot voltage";
CM_ SG_ 1332 VCFRONT_a266_eFuseVoltage "Front body controller: a266 e fuse voltage";
CM_ SG_ 1332 VCFRONT_a266_vbatProtVoltage "Front body controller: a266 vbat prot voltage";
CM_ SG_ 1332 VCFRONT_a267_eFuseVoltage "Front body controller: a267 e fuse voltage";
CM_ SG_ 1332 VCFRONT_a267_vbatProtVoltage "Front body controller: a267 vbat prot voltage";
CM_ SG_ 1332 VCFRONT_a268_eFuseVoltage "Front body controller: a268 e fuse voltage";
CM_ SG_ 1332 VCFRONT_a268_vbatProtVoltage "Front body controller: a268 vbat prot voltage";
CM_ SG_ 1332 VCFRONT_a269_LVBatteryTemp "Front body controller: a269 LV battery temp; raw 127 = signal not available (SNA)";
CM_ SG_ 1332 VCFRONT_a269_IBSCurrent "Front body controller: a269 IBS current";
CM_ SG_ 1332 VCFRONT_a269_IBSVoltage "Front body controller: a269 IBS voltage";
CM_ SG_ 1332 VCFRONT_a269_IBSAmpHours "Front body controller: a269 IBS amp hours";
CM_ SG_ 1332 VCFRONT_a269_vehiclePowerState "Front body controller: a269 vehicle power state";
CM_ SG_ 1332 VCFRONT_a270_prechargeChannel "Front body controller: a270 precharge channel";
CM_ SG_ 1332 VCFRONT_a270_sourceVoltage "Front body controller: a270 source voltage";
CM_ SG_ 1332 VCFRONT_a270_loadVoltage "Front body controller: a270 load voltage";
CM_ SG_ 1332 VCFRONT_a270_timeout "Front body controller: a270 timeout";
CM_ SG_ 1332 VCFRONT_a271_shortedCellTestTrig "Front body controller: a271 shorted cell test trigger";
CM_ SG_ 1332 VCFRONT_a271_voltDropOnHighCurre "Front body controller: a271 volt drop on high current trigger";
CM_ SG_ 1332 VCFRONT_a271_deadLVMinimalAhDisc "Front body controller: a271 dead LV minimal ah discharged trigger";
CM_ SG_ 1332 VCFRONT_a271_resistanceEstimatio "Front body controller: a271 resistance estimation hard fail trigger";
CM_ SG_ 1332 VCFRONT_a271_dcrMilliOhmsAboveTh "Front body controller: a271 dcr milli ohms above threshold trigger";
CM_ SG_ 1332 VCFRONT_a271_prechargeLVLoadRedu "Front body controller: a271 precharge LV load reduction trigger";
CM_ SG_ 1332 VCFRONT_a271_instantPrechargeDCR "Front body controller: a271 instant precharge DCR too high trigger";
CM_ SG_ 1332 VCFRONT_a279_snsShortCircuit "Front body controller: a279 sns short circuit";
CM_ SG_ 1332 VCFRONT_a279_snsDisconnect "Front body controller: a279 sns disconnect";
CM_ SG_ 1332 VCFRONT_a279_snsRateChangeUp "Front body controller: a279 sns rate change up";
CM_ SG_ 1332 VCFRONT_a279_snsRateChangeDown "Front body controller: a279 sns rate change down";
CM_ SG_ 1332 VCFRONT_a280_snsShortCircuit "Front body controller: a280 sns short circuit";
CM_ SG_ 1332 VCFRONT_a280_snsDisconnect "Front body controller: a280 sns disconnect";
CM_ SG_ 1332 VCFRONT_a280_snsRateChangeUp "Front body controller: a280 sns rate change up";
CM_ SG_ 1332 VCFRONT_a280_snsRateChangeDown "Front body controller: a280 sns rate change down";
CM_ SG_ 1332 VCFRONT_a283_thmlFanDisabled "Front body controller: a283 thml fan disabled";
CM_ SG_ 1332 VCFRONT_a283_thmlFanLimited "Front body controller: a283 thml fan limited";
CM_ SG_ 1332 VCFRONT_a283_thmlFanDemand "Front body controller: a283 thml fan demand";
CM_ SG_ 1332 VCFRONT_a283_thmlFanDemandLimit "Front body controller: a283 thml fan demand limit";
CM_ SG_ 1332 VCFRONT_a283_thmlFanPhaseI "Front body controller: a283 thml fan phase i";
CM_ SG_ 1332 VCFRONT_a283_thmlFanPhaseILimit "Front body controller: a283 thml fan phase i limit";
CM_ SG_ 1332 VCFRONT_a284_driverState "Front body controller: a284 driver state";
CM_ SG_ 1332 VCFRONT_a284_driverThermWarn "Front body controller: a284 driver therm warn";
CM_ SG_ 1332 VCFRONT_a284_driverThermShutdown "Front body controller: a284 driver therm shutdown";
CM_ SG_ 1332 VCFRONT_a284_undervoltage "Front body controller: a284 undervoltage";
CM_ SG_ 1332 VCFRONT_a284_chargePumpUndervolt "Front body controller: a284 charge pump undervoltage";
CM_ SG_ 1332 VCFRONT_a284_isCoilOpenX "Front body controller: a284 is coil open x";
CM_ SG_ 1332 VCFRONT_a284_isCoilOpenY "Front body controller: a284 is coil open y";
CM_ SG_ 1332 VCFRONT_a284_isCoilShortXPGnd "Front body controller: a284 is coil short XP gnd";
CM_ SG_ 1332 VCFRONT_a284_isCoilShortXPVbb "Front body controller: a284 is coil short XP vbb";
CM_ SG_ 1332 VCFRONT_a284_isCoilShortXNGnd "Front body controller: a284 is coil short XN gnd";
CM_ SG_ 1332 VCFRONT_a284_isCoilShortXNVbb "Front body controller: a284 is coil short XN vbb";
CM_ SG_ 1332 VCFRONT_a284_isCoilShortYPGnd "Front body controller: a284 is coil short YP gnd";
CM_ SG_ 1332 VCFRONT_a284_isCoilShortYPVbb "Front body controller: a284 is coil short YP vbb";
CM_ SG_ 1332 VCFRONT_a284_isCoilShortYNGnd "Front body controller: a284 is coil short YN gnd";
CM_ SG_ 1332 VCFRONT_a284_isCoilShortYNVbb "Front body controller: a284 is coil short YN vbb";
CM_ SG_ 1332 VCFRONT_a284_driverHasCommError "Front body controller: a284 driver has comm error";
CM_ SG_ 1332 VCFRONT_a285_driverState "Front body controller: a285 driver state";
CM_ SG_ 1332 VCFRONT_a285_driverThermWarn "Front body controller: a285 driver therm warn";
CM_ SG_ 1332 VCFRONT_a285_driverThermShutdown "Front body controller: a285 driver therm shutdown";
CM_ SG_ 1332 VCFRONT_a285_undervoltage "Front body controller: a285 undervoltage";
CM_ SG_ 1332 VCFRONT_a285_chargePumpUndervolt "Front body controller: a285 charge pump undervoltage";
CM_ SG_ 1332 VCFRONT_a285_isCoilOpenX "Front body controller: a285 is coil open x";
CM_ SG_ 1332 VCFRONT_a285_isCoilOpenY "Front body controller: a285 is coil open y";
CM_ SG_ 1332 VCFRONT_a285_isCoilShortXPGnd "Front body controller: a285 is coil short XP gnd";
CM_ SG_ 1332 VCFRONT_a285_isCoilShortXPVbb "Front body controller: a285 is coil short XP vbb";
CM_ SG_ 1332 VCFRONT_a285_isCoilShortXNGnd "Front body controller: a285 is coil short XN gnd";
CM_ SG_ 1332 VCFRONT_a285_isCoilShortXNVbb "Front body controller: a285 is coil short XN vbb";
CM_ SG_ 1332 VCFRONT_a285_isCoilShortYPGnd "Front body controller: a285 is coil short YP gnd";
CM_ SG_ 1332 VCFRONT_a285_isCoilShortYPVbb "Front body controller: a285 is coil short YP vbb";
CM_ SG_ 1332 VCFRONT_a285_isCoilShortYNGnd "Front body controller: a285 is coil short YN gnd";
CM_ SG_ 1332 VCFRONT_a285_isCoilShortYNVbb "Front body controller: a285 is coil short YN vbb";
CM_ SG_ 1332 VCFRONT_a285_driverHasCommError "Front body controller: a285 driver has comm error";
CM_ SG_ 1332 VCFRONT_a286_driverState "Front body controller: a286 driver state";
CM_ SG_ 1332 VCFRONT_a286_driverThermWarn "Front body controller: a286 driver therm warn";
CM_ SG_ 1332 VCFRONT_a286_driverThermShutdown "Front body controller: a286 driver therm shutdown";
CM_ SG_ 1332 VCFRONT_a286_undervoltage "Front body controller: a286 undervoltage";
CM_ SG_ 1332 VCFRONT_a286_chargePumpUndervolt "Front body controller: a286 charge pump undervoltage";
CM_ SG_ 1332 VCFRONT_a286_isCoilOpenX "Front body controller: a286 is coil open x";
CM_ SG_ 1332 VCFRONT_a286_isCoilOpenY "Front body controller: a286 is coil open y";
CM_ SG_ 1332 VCFRONT_a286_isCoilShortXPGnd "Front body controller: a286 is coil short XP gnd";
CM_ SG_ 1332 VCFRONT_a286_isCoilShortXPVbb "Front body controller: a286 is coil short XP vbb";
CM_ SG_ 1332 VCFRONT_a286_isCoilShortXNGnd "Front body controller: a286 is coil short XN gnd";
CM_ SG_ 1332 VCFRONT_a286_isCoilShortXNVbb "Front body controller: a286 is coil short XN vbb";
CM_ SG_ 1332 VCFRONT_a286_isCoilShortYPGnd "Front body controller: a286 is coil short YP gnd";
CM_ SG_ 1332 VCFRONT_a286_isCoilShortYPVbb "Front body controller: a286 is coil short YP vbb";
CM_ SG_ 1332 VCFRONT_a286_isCoilShortYNGnd "Front body controller: a286 is coil short YN gnd";
CM_ SG_ 1332 VCFRONT_a286_isCoilShortYNVbb "Front body controller: a286 is coil short YN vbb";
CM_ SG_ 1332 VCFRONT_a286_driverHasCommError "Front body controller: a286 driver has comm error";
CM_ SG_ 1332 VCFRONT_a287_driverState "Front body controller: a287 driver state";
CM_ SG_ 1332 VCFRONT_a287_driverThermWarn "Front body controller: a287 driver therm warn";
CM_ SG_ 1332 VCFRONT_a287_driverThermShutdown "Front body controller: a287 driver therm shutdown";
CM_ SG_ 1332 VCFRONT_a287_undervoltage "Front body controller: a287 undervoltage";
CM_ SG_ 1332 VCFRONT_a287_chargePumpUndervolt "Front body controller: a287 charge pump undervoltage";
CM_ SG_ 1332 VCFRONT_a287_isCoilOpenX "Front body controller: a287 is coil open x";
CM_ SG_ 1332 VCFRONT_a287_isCoilOpenY "Front body controller: a287 is coil open y";
CM_ SG_ 1332 VCFRONT_a287_isCoilShortXPGnd "Front body controller: a287 is coil short XP gnd";
CM_ SG_ 1332 VCFRONT_a287_isCoilShortXPVbb "Front body controller: a287 is coil short XP vbb";
CM_ SG_ 1332 VCFRONT_a287_isCoilShortXNGnd "Front body controller: a287 is coil short XN gnd";
CM_ SG_ 1332 VCFRONT_a287_isCoilShortXNVbb "Front body controller: a287 is coil short XN vbb";
CM_ SG_ 1332 VCFRONT_a287_isCoilShortYPGnd "Front body controller: a287 is coil short YP gnd";
CM_ SG_ 1332 VCFRONT_a287_isCoilShortYPVbb "Front body controller: a287 is coil short YP vbb";
CM_ SG_ 1332 VCFRONT_a287_isCoilShortYNGnd "Front body controller: a287 is coil short YN gnd";
CM_ SG_ 1332 VCFRONT_a287_isCoilShortYNVbb "Front body controller: a287 is coil short YN vbb";
CM_ SG_ 1332 VCFRONT_a287_driverHasCommError "Front body controller: a287 driver has comm error";
CM_ SG_ 1332 VCFRONT_a288_driverState "Front body controller: a288 driver state";
CM_ SG_ 1332 VCFRONT_a288_driverThermWarn "Front body controller: a288 driver therm warn";
CM_ SG_ 1332 VCFRONT_a288_driverThermShutdown "Front body controller: a288 driver therm shutdown";
CM_ SG_ 1332 VCFRONT_a288_undervoltage "Front body controller: a288 undervoltage";
CM_ SG_ 1332 VCFRONT_a288_chargePumpUndervolt "Front body controller: a288 charge pump undervoltage";
CM_ SG_ 1332 VCFRONT_a288_isCoilOpenX "Front body controller: a288 is coil open x";
CM_ SG_ 1332 VCFRONT_a288_isCoilOpenY "Front body controller: a288 is coil open y";
CM_ SG_ 1332 VCFRONT_a288_isCoilShortXPGnd "Front body controller: a288 is coil short XP gnd";
CM_ SG_ 1332 VCFRONT_a288_isCoilShortXPVbb "Front body controller: a288 is coil short XP vbb";
CM_ SG_ 1332 VCFRONT_a288_isCoilShortXNGnd "Front body controller: a288 is coil short XN gnd";
CM_ SG_ 1332 VCFRONT_a288_isCoilShortXNVbb "Front body controller: a288 is coil short XN vbb";
CM_ SG_ 1332 VCFRONT_a288_isCoilShortYPGnd "Front body controller: a288 is coil short YP gnd";
CM_ SG_ 1332 VCFRONT_a288_isCoilShortYPVbb "Front body controller: a288 is coil short YP vbb";
CM_ SG_ 1332 VCFRONT_a288_isCoilShortYNGnd "Front body controller: a288 is coil short YN gnd";
CM_ SG_ 1332 VCFRONT_a288_isCoilShortYNVbb "Front body controller: a288 is coil short YN vbb";
CM_ SG_ 1332 VCFRONT_a288_driverHasCommError "Front body controller: a288 driver has comm error";
CM_ SG_ 1332 VCFRONT_a289_driverState "Front body controller: a289 driver state";
CM_ SG_ 1332 VCFRONT_a289_driverThermWarn "Front body controller: a289 driver therm warn";
CM_ SG_ 1332 VCFRONT_a289_driverThermShutdown "Front body controller: a289 driver therm shutdown";
CM_ SG_ 1332 VCFRONT_a289_undervoltage "Front body controller: a289 undervoltage";
BA_DEF_ BO_ "GenMsgCycleTime" INT 0 3600000;
BA_DEF_ BO_ "GenMsgSendType" ENUM "Cyclic","NotUsed","NotUsed","NotUsed","NotUsed","NotUsed","NotUsed","IfActive","NoMsgSendType","NotUsed";
BA_DEF_ BO_ "VFrameFormat" ENUM "StandardCAN","ExtendedCAN","reserved","J1939PG","reserved","reserved","reserved","reserved","reserved","reserved","reserved","reserved","reserved","reserved","StandardCAN_FD","ExtendedCAN_FD";
BA_DEF_ BO_ "CANFD_BRS" ENUM "0","1";
BA_DEF_ SG_ "GenSigSNA" STRING;
BA_DEF_ SG_ "SystemSignalLongSymbol" STRING;
BA_DEF_ SG_ "Confidence" ENUM "validated","plausible","layout-only","contradicted";
BA_DEF_DEF_ "GenMsgCycleTime" 0;
BA_DEF_DEF_ "GenMsgSendType" "NoMsgSendType";
BA_DEF_DEF_ "VFrameFormat" "StandardCAN";
BA_DEF_DEF_ "CANFD_BRS" "1";
BA_DEF_DEF_ "GenSigSNA" "";
BA_DEF_DEF_ "SystemSignalLongSymbol" "";
BA_DEF_DEF_ "Confidence" "layout-only";
BA_ "SystemSignalLongSymbol" SG_ 1332 VCFRONT_a098_PARTY_thermalContro "VCFRONT_a098_PARTY_thermalControl";
BA_ "SystemSignalLongSymbol" SG_ 1332 VCFRONT_a101_LIPC_externalWatchd "VCFRONT_a101_LIPC_externalWatchdogHeartBeat";
BA_ "SystemSignalLongSymbol" SG_ 1332 VCFRONT_a106_VEH_thermalInterfac "VCFRONT_a106_VEH_thermalInterface";
BA_ "SystemSignalLongSymbol" SG_ 1332 VCFRONT_a108_PARTY_thermalContro "VCFRONT_a108_PARTY_thermalControl";
BA_ "SystemSignalLongSymbol" SG_ 1332 VCFRONT_a110_VEH_canLogAvailabil "VCFRONT_a110_VEH_canLogAvailability";
BA_ "SystemSignalLongSymbol" SG_ 1332 VCFRONT_a110_CH_airbagCutoffStat "VCFRONT_a110_CH_airbagCutoffStatus";
BA_ "SystemSignalLongSymbol" SG_ 1332 VCFRONT_a111_RIPC_epbPrivateStat "VCFRONT_a111_RIPC_epbPrivateState";
BA_ "SystemSignalLongSymbol" SG_ 1332 VCFRONT_a112_LIPC_epbPrivateStat "VCFRONT_a112_LIPC_epbPrivateState";
BA_ "SystemSignalLongSymbol" SG_ 1332 VCFRONT_a115_UI_corianderVehicle "VCFRONT_a115_UI_corianderVehicleControl";
BA_ "SystemSignalLongSymbol" SG_ 1332 VCFRONT_a116_PARTY_restraintStat "VCFRONT_a116_PARTY_restraintStatus";
BA_ "SystemSignalLongSymbol" SG_ 1332 VCFRONT_a117_BDY_falconSwitchSta "VCFRONT_a117_BDY_falconSwitchStatus";
BA_ "SystemSignalLongSymbol" SG_ 1332 VCFRONT_a117_VEH_intrusionSensor "VCFRONT_a117_VEH_intrusionSensorStatus";
BA_ "SystemSignalLongSymbol" SG_ 1332 VCFRONT_a117_PARTY_restraintStat "VCFRONT_a117_PARTY_restraintStatus";
BA_ "SystemSignalLongSymbol" SG_ 1332 VCFRONT_a118_VEH_12VBatteryStatu "VCFRONT_a118_VEH_12VBatteryStatus";
BA_ "SystemSignalLongSymbol" SG_ 1332 VCFRONT_a118_PARTY_outputPowerSt "VCFRONT_a118_PARTY_outputPowerStatus";
BA_ "SystemSignalLongSymbol" SG_ 1332 VCFRONT_a118_VEH_interNodeResist "VCFRONT_a118_VEH_interNodeResistance";
BA_ "SystemSignalLongSymbol" SG_ 1332 VCFRONT_a118_BDY_outputPowerStat "VCFRONT_a118_BDY_outputPowerStatus";
BA_ "SystemSignalLongSymbol" SG_ 1332 VCFRONT_a118_PARTY_AP_vehicleSta "VCFRONT_a118_PARTY_AP_vehicleState1HzMuxed";
BA_ "SystemSignalLongSymbol" SG_ 1332 VCFRONT_a118_BDY_AP_vehicleState "VCFRONT_a118_BDY_AP_vehicleState1HzMuxed";
BA_ "SystemSignalLongSymbol" SG_ 1332 VCFRONT_a120_PARTY_vehicleEstima "VCFRONT_a120_PARTY_vehicleEstimates";
BA_ "SystemSignalLongSymbol" SG_ 1332 VCFRONT_a120_VEH_aggregatedAxleS "VCFRONT_a120_VEH_aggregatedAxleSpeed";
BA_ "SystemSignalLongSymbol" SG_ 1332 VCFRONT_a120_PARTY_aggregatedAxl "VCFRONT_a120_PARTY_aggregatedAxleSpeed";
BA_ "SystemSignalLongSymbol" SG_ 1332 VCFRONT_a120_PARTY_stalklessInte "VCFRONT_a120_PARTY_stalklessInterfaces";
BA_ "SystemSignalLongSymbol" SG_ 1332 VCFRONT_a120_VEH_estimatedBrakeT "VCFRONT_a120_VEH_estimatedBrakeTemp";
BA_ "SystemSignalLongSymbol" SG_ 1332 VCFRONT_a120_VEH_vehicleEstimate "VCFRONT_a120_VEH_vehicleEstimates";
BA_ "Confidence" SG_ 1332 VCFRONT_a127_vcleftEFuseCurrent 1;
BA_ "Confidence" SG_ 1332 VCFRONT_a127_vcleftEFuseVoltage 1;
BA_ "Confidence" SG_ 1332 VCFRONT_a127_vcleftEFuseTemp 1;
BA_ "SystemSignalLongSymbol" SG_ 1332 VCFRONT_a127_vcleftEFuseRemainin "VCFRONT_a127_vcleftEFuseRemainingRetries";
BA_ "Confidence" SG_ 1332 VCFRONT_a128_vcrightEFuseCurrent 1;
BA_ "Confidence" SG_ 1332 VCFRONT_a128_vcrightEFuseVoltage 1;
BA_ "Confidence" SG_ 1332 VCFRONT_a128_vcrightEFuseTemp 1;
BA_ "SystemSignalLongSymbol" SG_ 1332 VCFRONT_a128_vcrightEFuseRemaini "VCFRONT_a128_vcrightEFuseRemainingRetries";
BA_ "Confidence" SG_ 1332 VCFRONT_a129_pcsEFuseCurrent 1;
BA_ "Confidence" SG_ 1332 VCFRONT_a129_pcsEFuseVoltage 1;
BA_ "Confidence" SG_ 1332 VCFRONT_a129_pcsEFuseTemp 1;
BA_ "SystemSignalLongSymbol" SG_ 1332 VCFRONT_a129_pcsEFuseRemainingRe "VCFRONT_a129_pcsEFuseRemainingRetries";
BA_ "Confidence" SG_ 1332 VCFRONT_a130_epas3pEFuseCurrent 1;
BA_ "Confidence" SG_ 1332 VCFRONT_a130_epas3pEFuseVoltage 1;
BA_ "Confidence" SG_ 1332 VCFRONT_a130_epas3pEFuseTemp 1;
BA_ "Confidence" SG_ 1332 VCFRONT_a131_epas3sEFuseCurrent 1;
BA_ "Confidence" SG_ 1332 VCFRONT_a131_epas3sEFuseVoltage 1;
BA_ "Confidence" SG_ 1332 VCFRONT_a131_epas3sEFuseTemp 1;
BA_ "Confidence" SG_ 1332 VCFRONT_a132_iBoosterCurrent 1;
BA_ "Confidence" SG_ 1332 VCFRONT_a132_iBoosterVoltage 1;
BA_ "Confidence" SG_ 1332 VCFRONT_a132_iBoosterEFuseTemp 1;
BA_ "Confidence" SG_ 1332 VCFRONT_a133_espEFuseCurrent 1;
BA_ "Confidence" SG_ 1332 VCFRONT_a133_espEFuseVoltage 1;
BA_ "Confidence" SG_ 1332 VCFRONT_a133_espEFuseTemp 1;
BA_ "Confidence" SG_ 1332 VCFRONT_a134_fusedHighCurrent 1;
BA_ "Confidence" SG_ 1332 VCFRONT_a134_fusedHighVoltage 1;
BA_ "Confidence" SG_ 1332 VCFRONT_a134_fusedHighTemp 1;
BA_ "SystemSignalLongSymbol" SG_ 1332 VCFRONT_a134_vbatFusedEFuseRemai "VCFRONT_a134_vbatFusedEFuseRemainingRetries";
BA_ "Confidence" SG_ 1332 VCFRONT_a142_driverState 1;
BA_ "SystemSignalLongSymbol" SG_ 1332 VCFRONT_a142_chargePumpUndervolt "VCFRONT_a142_chargePumpUndervoltage";
BA_ "Confidence" SG_ 1332 VCFRONT_a146_RPMActual 1;
BA_ "Confidence" SG_ 1332 VCFRONT_a146_RPMTarget 1;
BA_ "Confidence" SG_ 1332 VCFRONT_a147_RPMActual 1;
BA_ "Confidence" SG_ 1332 VCFRONT_a147_RPMTarget 1;
BA_ "Confidence" SG_ 1332 VCFRONT_a148_RPMActual 1;
BA_ "Confidence" SG_ 1332 VCFRONT_a148_RPMTarget 1;
BA_ "Confidence" SG_ 1332 VCFRONT_a150_RPMActual 1;
BA_ "Confidence" SG_ 1332 VCFRONT_a150_RPMTarget 1;
BA_ "Confidence" SG_ 1332 VCFRONT_a151_RPMActual 1;
BA_ "Confidence" SG_ 1332 VCFRONT_a151_RPMTarget 1;
BA_ "Confidence" SG_ 1332 VCFRONT_a152_RPMActual 1;
BA_ "Confidence" SG_ 1332 VCFRONT_a152_RPMTarget 1;
BA_ "Confidence" SG_ 1332 VCFRONT_a156_motorCounts 1;
BA_ "Confidence" SG_ 1332 VCFRONT_a157_motorCounts 1;
BA_ "Confidence" SG_ 1332 VCFRONT_a159_angleActual 1;
BA_ "Confidence" SG_ 1332 VCFRONT_a159_angleTarget 1;
BA_ "SystemSignalLongSymbol" SG_ 1332 VCFRONT_a160_highDischargePressu "VCFRONT_a160_highDischargePressureCutouts";
BA_ "SystemSignalLongSymbol" SG_ 1332 VCFRONT_a160_highDischargeTempCu "VCFRONT_a160_highDischargeTempCutouts";
BA_ "Confidence" SG_ 1332 VCFRONT_a160_compressorRpm 1;
BA_ "SystemSignalLongSymbol" SG_ 1332 VCFRONT_a161_internalPowerSupply "VCFRONT_a161_internalPowerSupplyFault";
BA_ "Confidence" SG_ 1332 VCFRONT_a162_dischargePressure 1;
BA_ "Confidence" SG_ 1332 VCFRONT_a162_chillerExvFlow 1;
BA_ "Confidence" SG_ 1332 VCFRONT_a162_lccExvFlow 1;
BA_ "Confidence" SG_ 1332 VCFRONT_a162_ccLeftExvFlow 1;
BA_ "Confidence" SG_ 1332 VCFRONT_a162_ccRightExvFlow 1;
BA_ "Confidence" SG_ 1332 VCFRONT_a162_evapExvFlow 1;
BA_ "Confidence" SG_ 1332 VCFRONT_a162_recircExvFlow 1;
BA_ "Confidence" SG_ 1332 VCFRONT_a164_lockoutVoltage 1;
BA_ "Confidence" SG_ 1332 VCFRONT_a165_lockoutVoltage 1;
BA_ "Confidence" SG_ 1332 VCFRONT_a176_vehicleState 1;
BA_ "Confidence" SG_ 1332 VCFRONT_a177_mcuAudioCurrent 1;
BA_ "SystemSignalLongSymbol" SG_ 1332 VCFRONT_a179_highLVAmpsIntoPCSLo "VCFRONT_a179_highLVAmpsIntoPCSLog";
BA_ "Confidence" SG_ 1332 VCFRONT_a180_vehiclePowerState 1;
BA_ "Confidence" SG_ 1332 VCFRONT_a180_hvState 1;
BA_ "Confidence" SG_ 1332 VCFRONT_a180_bmsState 1;
BA_ "GenSigSNA" SG_ 1332 VCFRONT_a180_bmsState "9";
BA_ "SystemSignalLongSymbol" SG_ 1332 VCFRONT_a180_notEnoughPowerForSu "VCFRONT_a180_notEnoughPowerForSupport";
BA_ "SystemSignalLongSymbol" SG_ 1332 VCFRONT_a180_contactorEFuseStabl "VCFRONT_a180_contactorEFuseStable";
BA_ "Confidence" SG_ 1332 VCFRONT_a180_dcdcLVSupportStatus 1;
BA_ "Confidence" SG_ 1332 VCFRONT_a181_vehicleState 1;
BA_ "SystemSignalLongSymbol" SG_ 1332 VCFRONT_a182_resistanceEstimatio "VCFRONT_a182_resistanceEstimationHardFailure";
BA_ "SystemSignalLongSymbol" SG_ 1332 VCFRONT_a182_dcrMilliOhmsAboveTh "VCFRONT_a182_dcrMilliOhmsAboveThreshold";
BA_ "SystemSignalLongSymbol" SG_ 1332 VCFRONT_a182_prechargeLVLoadRedu "VCFRONT_a182_prechargeLVLoadReduction";
BA_ "SystemSignalLongSymbol" SG_ 1332 VCFRONT_a182_instantPrechargeDCR "VCFRONT_a182_instantPrechargeDCRTooHigh";
BA_ "Confidence" SG_ 1332 VCFRONT_a182_ambientTemp 1;
BA_ "GenSigSNA" SG_ 1332 VCFRONT_a182_ambientTemp "0";
BA_ "Confidence" SG_ 1332 VCFRONT_a182_dischargedAmpHours 1;
BA_ "Confidence" SG_ 1332 VCFRONT_a182_chargedAmpHours 1;
BA_ "SystemSignalLongSymbol" SG_ 1332 VCFRONT_a182_calibrationLostFaul "VCFRONT_a182_calibrationLostFault";
BA_ "Confidence" SG_ 1332 VCFRONT_a182_batteryType 1;
BA_ "Confidence" SG_ 1332 VCFRONT_a188_sleepBypassCurrent 1;
BA_ "Confidence" SG_ 1332 VCFRONT_a188_IBSCurrent 1;
BA_ "Confidence" SG_ 1332 VCFRONT_a188_vehicleState 1;
BA_ "GenSigSNA" SG_ 1332 VCFRONT_a188_vehicleState "18";
BA_ "Confidence" SG_ 1332 VCFRONT_a188_timeNotSleeping 1;
BA_ "Confidence" SG_ 1332 VCFRONT_a191_vehiclePowerState 1;
BA_ "Confidence" SG_ 1332 VCFRONT_a191_hvState 1;
BA_ "SystemSignalLongSymbol" SG_ 1332 VCFRONT_a191_reverseBatteryEFuse "VCFRONT_a191_reverseBatteryEFuseFault";
BA_ "SystemSignalLongSymbol" SG_ 1332 VCFRONT_a191_vehicleLoadShedActi "VCFRONT_a191_vehicleLoadShedActive";
BA_ "SystemSignalLongSymbol" SG_ 1332 VCFRONT_a191_vehicleLoadShedHvFa "VCFRONT_a191_vehicleLoadShedHvFaultActive";
BA_ "SystemSignalLongSymbol" SG_ 1332 VCFRONT_a191_vehicleLoadShedPost "VCFRONT_a191_vehicleLoadShedPostCrashActive";
BA_ "Confidence" SG_ 1332 VCFRONT_a191_IBSVoltage 1;
BA_ "SystemSignalLongSymbol" SG_ 1332 VCFRONT_a191_a180_DCDCNotSupport "VCFRONT_a191_a180_DCDCNotSupportingLVBus";
BA_ "Confidence" SG_ 1332 VCFRONT_a191_MOSState 1;
BA_ "GenSigSNA" SG_ 1332 VCFRONT_a191_MOSState "3";
BA_ "Confidence" SG_ 1332 VCFRONT_a191_LVBMSVoltage 1;
BA_ "Confidence" SG_ 1332 VCFRONT_a191_ECPAState 1;
BA_ "GenSigSNA" SG_ 1332 VCFRONT_a191_ECPAState "3";
BA_ "SystemSignalLongSymbol" SG_ 1332 VCFRONT_a191_LVBMSCurrentTargetV "VCFRONT_a191_LVBMSCurrentTargetValid";
BA_ "SystemSignalLongSymbol" SG_ 1332 VCFRONT_a191_LVBMSVoltageTargetV "VCFRONT_a191_LVBMSVoltageTargetValid";
BA_ "Confidence" SG_ 1332 VCFRONT_a191_vehicleLoadShedStag 1;
BA_ "SystemSignalLongSymbol" SG_ 1332 VCFRONT_a191_vehicleLoadShedStag "VCFRONT_a191_vehicleLoadShedStage";
BA_ "SystemSignalLongSymbol" SG_ 1332 VCFRONT_a191_exitDriveWarningTim "VCFRONT_a191_exitDriveWarningTimerExpired";
BA_ "SystemSignalLongSymbol" SG_ 1332 VCFRONT_a191_NotEnoughPowerForSu "VCFRONT_a191_NotEnoughPowerForSupport";
BA_ "Confidence" SG_ 1332 VCFRONT_a191_bmsState 1;
BA_ "GenSigSNA" SG_ 1332 VCFRONT_a191_bmsState "9";
BA_ "Confidence" SG_ 1332 VCFRONT_a192_vehiclePowerState 1;
BA_ "Confidence" SG_ 1332 VCFRONT_a192_hvState 1;
BA_ "SystemSignalLongSymbol" SG_ 1332 VCFRONT_a192_notEnoughPowerForSu "VCFRONT_a192_notEnoughPowerForSupport";
BA_ "SystemSignalLongSymbol" SG_ 1332 VCFRONT_a192_contactorEFuseStabl "VCFRONT_a192_contactorEFuseStable";
BA_ "SystemSignalLongSymbol" SG_ 1332 VCFRONT_a192_LVBatteryCannotSupp "VCFRONT_a192_LVBatteryCannotSupportVehicle";
BA_ "Confidence" SG_ 1332 VCFRONT_a192_DI_gear 1;
BA_ "GenSigSNA" SG_ 1332 VCFRONT_a192_DI_gear "7";
BA_ "Confidence" SG_ 1332 VCFRONT_a192_IBSCurrent 1;
BA_ "Confidence" SG_ 1332 VCFRONT_a192_PCSCurrent 1;
BA_ "SystemSignalLongSymbol" SG_ 1332 VCFRONT_a192_HVFaultLoadShedActi "VCFRONT_a192_HVFaultLoadShedActive";
BA_ "SystemSignalLongSymbol" SG_ 1332 VCFRONT_a192_postCrashLoadShedAc "VCFRONT_a192_postCrashLoadShedActive";
BA_ "Confidence" SG_ 1332 VCFRONT_a195_IBSVoltage 1;
BA_ "Confidence" SG_ 1332 VCFRONT_a196_vehiclePowerState 1;
BA_ "Confidence" SG_ 1332 VCFRONT_a196_batterySMState 1;
BA_ "Confidence" SG_ 1332 VCFRONT_a196_disconnectedBattery 1;
BA_ "SystemSignalLongSymbol" SG_ 1332 VCFRONT_a196_disconnectedBattery "VCFRONT_a196_disconnectedBatteryTestCurrent";
BA_ "Confidence" SG_ 1332 VCFRONT_a196_disconnectedBa_0002 1;
BA_ "SystemSignalLongSymbol" SG_ 1332 VCFRONT_a196_disconnectedBa_0002 "VCFRONT_a196_disconnectedBatteryTestVoltage";
BA_ "Confidence" SG_ 1332 VCFRONT_a196_disconnectedBa_0001 1;
BA_ "SystemSignalLongSymbol" SG_ 1332 VCFRONT_a196_disconnectedBa_0001 "VCFRONT_a196_disconnectedBatteryTestPrevVoltage";
BA_ "Confidence" SG_ 1332 VCFRONT_a196_ECPAState 1;
BA_ "GenSigSNA" SG_ 1332 VCFRONT_a196_ECPAState "3";
BA_ "Confidence" SG_ 1332 VCFRONT_a200_vcleftSelfTest 1;
BA_ "GenSigSNA" SG_ 1332 VCFRONT_a200_vcleftSelfTest "12";
BA_ "Confidence" SG_ 1332 VCFRONT_a201_vcrightSelfTest 1;
BA_ "GenSigSNA" SG_ 1332 VCFRONT_a201_vcrightSelfTest "12";
BA_ "Confidence" SG_ 1332 VCFRONT_a202_pcsSelfTest 1;
BA_ "GenSigSNA" SG_ 1332 VCFRONT_a202_pcsSelfTest "12";
BA_ "Confidence" SG_ 1332 VCFRONT_a207_vbatFusedSelfTest 1;
BA_ "GenSigSNA" SG_ 1332 VCFRONT_a207_vbatFusedSelfTest "12";
BA_ "Confidence" SG_ 1332 VCFRONT_a212_IBSTemp 1;
BA_ "Confidence" SG_ 1332 VCFRONT_a213_IBSVolts 1;
BA_ "Confidence" SG_ 1332 VCFRONT_a213_IBSAh 1;
BA_ "Confidence" SG_ 1332 VCFRONT_a213_LVBatteryTemp 1;
BA_ "GenSigSNA" SG_ 1332 VCFRONT_a213_LVBatteryTemp "32768";
BA_ "Confidence" SG_ 1332 VCFRONT_a214_selfTestResult 1;
BA_ "SystemSignalLongSymbol" SG_ 1332 VCFRONT_a214_busVoltageIrrationa "VCFRONT_a214_busVoltageIrrational";
BA_ "SystemSignalLongSymbol" SG_ 1332 VCFRONT_a214_motorSpeedIrrationa "VCFRONT_a214_motorSpeedIrrational";
BA_ "SystemSignalLongSymbol" SG_ 1332 VCFRONT_a214_supplyVoltageIrrati "VCFRONT_a214_supplyVoltageIrrational";
BA_ "SystemSignalLongSymbol" SG_ 1332 VCFRONT_a214_motorPhaseCurrentIr "VCFRONT_a214_motorPhaseCurrentIrrational";
BA_ "SystemSignalLongSymbol" SG_ 1332 VCFRONT_a214_hsVdsOvervoltageMas "VCFRONT_a214_hsVdsOvervoltageMask";
BA_ "SystemSignalLongSymbol" SG_ 1332 VCFRONT_a214_lsVdsOvervoltageMas "VCFRONT_a214_lsVdsOvervoltageMask";
BA_ "Confidence" SG_ 1332 VCFRONT_a216_hvState 1;
BA_ "SystemSignalLongSymbol" SG_ 1332 VCFRONT_a216_vcleftFastBlowImmin "VCFRONT_a216_vcleftFastBlowImminent";
BA_ "SystemSignalLongSymbol" SG_ 1332 VCFRONT_a216_vcleftFastBlowDebou "VCFRONT_a216_vcleftFastBlowDebounceImminent";
BA_ "SystemSignalLongSymbol" SG_ 1332 VCFRONT_a216_vcleftStaticImminen "VCFRONT_a216_vcleftStaticImminent";
BA_ "SystemSignalLongSymbol" SG_ 1332 VCFRONT_a216_vcleftDynamicImmine "VCFRONT_a216_vcleftDynamicImminent";
BA_ "SystemSignalLongSymbol" SG_ 1332 VCFRONT_a216_vcrightFastBlowImmi "VCFRONT_a216_vcrightFastBlowImminent";
BA_ "SystemSignalLongSymbol" SG_ 1332 VCFRONT_a216_vcrightFastBlowDebo "VCFRONT_a216_vcrightFastBlowDebounceImminent";
BA_ "SystemSignalLongSymbol" SG_ 1332 VCFRONT_a216_vcrightStaticImmine "VCFRONT_a216_vcrightStaticImminent";
BA_ "SystemSignalLongSymbol" SG_ 1332 VCFRONT_a216_vcrightDynamicImmin "VCFRONT_a216_vcrightDynamicImminent";
BA_ "Confidence" SG_ 1332 VCFRONT_a217_selfTestResult 1;
BA_ "SystemSignalLongSymbol" SG_ 1332 VCFRONT_a217_busVoltageIrrationa "VCFRONT_a217_busVoltageIrrational";
BA_ "SystemSignalLongSymbol" SG_ 1332 VCFRONT_a217_motorSpeedIrrationa "VCFRONT_a217_motorSpeedIrrational";
BA_ "SystemSignalLongSymbol" SG_ 1332 VCFRONT_a217_supplyVoltageIrrati "VCFRONT_a217_supplyVoltageIrrational";
BA_ "SystemSignalLongSymbol" SG_ 1332 VCFRONT_a217_motorPhaseCurrentIr "VCFRONT_a217_motorPhaseCurrentIrrational";
BA_ "SystemSignalLongSymbol" SG_ 1332 VCFRONT_a217_hsVdsOvervoltageMas "VCFRONT_a217_hsVdsOvervoltageMask";
BA_ "SystemSignalLongSymbol" SG_ 1332 VCFRONT_a217_lsVdsOvervoltageMas "VCFRONT_a217_lsVdsOvervoltageMask";
BA_ "Confidence" SG_ 1332 VCFRONT_a219_IBSVolts 1;
BA_ "Confidence" SG_ 1332 VCFRONT_a219_IBSAh 1;
BA_ "Confidence" SG_ 1332 VCFRONT_a219_IBSCurrent 1;
BA_ "Confidence" SG_ 1332 VCFRONT_a220_IBSCurrent 1;
BA_ "Confidence" SG_ 1332 VCFRONT_a220_PCSCurrent 1;
BA_ "Confidence" SG_ 1332 VCFRONT_a223_12VTemperature 1;
BA_ "Confidence" SG_ 1332 VCFRONT_a227_selfTestResult 1;
BA_ "SystemSignalLongSymbol" SG_ 1332 VCFRONT_a227_busVoltageIrrationa "VCFRONT_a227_busVoltageIrrational";
BA_ "SystemSignalLongSymbol" SG_ 1332 VCFRONT_a227_motorSpeedIrrationa "VCFRONT_a227_motorSpeedIrrational";
BA_ "SystemSignalLongSymbol" SG_ 1332 VCFRONT_a227_supplyVoltageIrrati "VCFRONT_a227_supplyVoltageIrrational";
BA_ "SystemSignalLongSymbol" SG_ 1332 VCFRONT_a227_motorPhaseCurrentIr "VCFRONT_a227_motorPhaseCurrentIrrational";
BA_ "SystemSignalLongSymbol" SG_ 1332 VCFRONT_a227_hsVdsOvervoltageMas "VCFRONT_a227_hsVdsOvervoltageMask";
BA_ "SystemSignalLongSymbol" SG_ 1332 VCFRONT_a227_lsVdsOvervoltageMas "VCFRONT_a227_lsVdsOvervoltageMask";
BA_ "Confidence" SG_ 1332 VCFRONT_a231_12VTemperature 1;
BA_ "Confidence" SG_ 1332 VCFRONT_a233_current 1;
BA_ "Confidence" SG_ 1332 VCFRONT_a234_current 1;
BA_ "Confidence" SG_ 1332 VCFRONT_a235_ptSensorTemp 1;
BA_ "Confidence" SG_ 1332 VCFRONT_a236_batSensorTemp 1;
BA_ "Confidence" SG_ 1332 VCFRONT_a242_LVBatteryTemp 1;
BA_ "GenSigSNA" SG_ 1332 VCFRONT_a242_LVBatteryTemp "127";
BA_ "Confidence" SG_ 1332 VCFRONT_a242_IBSCurrent 1;
BA_ "Confidence" SG_ 1332 VCFRONT_a242_IBSVoltage 1;
BA_ "Confidence" SG_ 1332 VCFRONT_a242_IBSAmpHours 1;
BA_ "Confidence" SG_ 1332 VCFRONT_a242_vehiclePowerState 1;
BA_ "Confidence" SG_ 1332 VCFRONT_a243_IBSVolts 1;
BA_ "Confidence" SG_ 1332 VCFRONT_a243_IBSCurrent 1;
BA_ "Confidence" SG_ 1332 VCFRONT_a243_LVBatteryTemp 1;
BA_ "GenSigSNA" SG_ 1332 VCFRONT_a243_LVBatteryTemp "32768";
BA_ "Confidence" SG_ 1332 VCFRONT_a244_current 1;
BA_ "Confidence" SG_ 1332 VCFRONT_a244_voltage 1;
BA_ "Confidence" SG_ 1332 VCFRONT_a244_vbatProtVoltage 1;
BA_ "Confidence" SG_ 1332 VCFRONT_a245_current 1;
BA_ "Confidence" SG_ 1332 VCFRONT_a245_voltage 1;
BA_ "SystemSignalLongSymbol" SG_ 1332 VCFRONT_a245_eFuseRemainingRetri "VCFRONT_a245_eFuseRemainingRetries";
BA_ "Confidence" SG_ 1332 VCFRONT_a246_current 1;
BA_ "Confidence" SG_ 1332 VCFRONT_a246_voltage 1;
BA_ "SystemSignalLongSymbol" SG_ 1332 VCFRONT_a246_eFuseRemainingRetri "VCFRONT_a246_eFuseRemainingRetries";
BA_ "Confidence" SG_ 1332 VCFRONT_a247_solenoidISense 1;
BA_ "Confidence" SG_ 1332 VCFRONT_a248_AS8510Voltage 1;
BA_ "Confidence" SG_ 1332 VCFRONT_a248_IBSVoltage 1;
BA_ "Confidence" SG_ 1332 VCFRONT_a248_vbatMonitor 1;
BA_ "Confidence" SG_ 1332 VCFRONT_a248_voltageCalScaling 1;
BA_ "Confidence" SG_ 1332 VCFRONT_a249_tempCoolantBatInlet 1;
BA_ "Confidence" SG_ 1332 VCFRONT_a249_tempCoolantPTInlet 1;
BA_ "SystemSignalLongSymbol" SG_ 1332 VCFRONT_a250_isVirtualPitchSenso "VCFRONT_a250_isVirtualPitchSensor";
BA_ "Confidence" SG_ 1332 VCFRONT_a250_calibratedVerticalP 1;
BA_ "GenSigSNA" SG_ 1332 VCFRONT_a250_calibratedVerticalP "1023";
BA_ "SystemSignalLongSymbol" SG_ 1332 VCFRONT_a250_calibratedVerticalP "VCFRONT_a250_calibratedVerticalPositionHCML";
BA_ "Confidence" SG_ 1332 VCFRONT_a250_calibratedVert_0001 1;
BA_ "GenSigSNA" SG_ 1332 VCFRONT_a250_calibratedVert_0001 "1023";
BA_ "SystemSignalLongSymbol" SG_ 1332 VCFRONT_a250_calibratedVert_0001 "VCFRONT_a250_calibratedVerticalPositionHCMR";
BA_ "Confidence" SG_ 1332 VCFRONT_a250_calibratedHorizonta 1;
BA_ "GenSigSNA" SG_ 1332 VCFRONT_a250_calibratedHorizonta "1023";
BA_ "SystemSignalLongSymbol" SG_ 1332 VCFRONT_a250_calibratedHorizonta "VCFRONT_a250_calibratedHorizontalPositionHCML";
BA_ "Confidence" SG_ 1332 VCFRONT_a250_calibratedHori_0001 1;
BA_ "GenSigSNA" SG_ 1332 VCFRONT_a250_calibratedHori_0001 "1023";
BA_ "SystemSignalLongSymbol" SG_ 1332 VCFRONT_a250_calibratedHori_0001 "VCFRONT_a250_calibratedHorizontalPositionHCMR";
BA_ "SystemSignalLongSymbol" SG_ 1332 VCFRONT_a253_ampHourTargetNotRea "VCFRONT_a253_ampHourTargetNotReached";
BA_ "Confidence" SG_ 1332 VCFRONT_a253_IBSCurrent 1;
BA_ "Confidence" SG_ 1332 VCFRONT_a253_IBSAmpHours 1;
BA_ "Confidence" SG_ 1332 VCFRONT_a253_LVBatteryTemp 1;
BA_ "GenSigSNA" SG_ 1332 VCFRONT_a253_LVBatteryTemp "127";
BA_ "Confidence" SG_ 1332 VCFRONT_a254_RPMActual 1;
BA_ "Confidence" SG_ 1332 VCFRONT_a254_RPMTarget 1;
BA_ "Confidence" SG_ 1332 VCFRONT_a255_RPMActual 1;
BA_ "Confidence" SG_ 1332 VCFRONT_a255_RPMTarget 1;
BA_ "Confidence" SG_ 1332 VCFRONT_a257_lockoutVoltage 1;
BA_ "Confidence" SG_ 1332 VCFRONT_a257_vcrightLockoutStatu 1;
BA_ "SystemSignalLongSymbol" SG_ 1332 VCFRONT_a257_vcrightLockoutStatu "VCFRONT_a257_vcrightLockoutStatus";
BA_ "Confidence" SG_ 1332 VCFRONT_a257_vehicleState 1;
BA_ "GenSigSNA" SG_ 1332 VCFRONT_a257_vehicleState "18";
BA_ "Confidence" SG_ 1332 VCFRONT_a259_voltageDropCounter 1;
BA_ "Confidence" SG_ 1332 VCFRONT_a259_minVoltageReached 1;
BA_ "Confidence" SG_ 1332 VCFRONT_a259_IBSTemp 1;
BA_ "Confidence" SG_ 1332 VCFRONT_a259_maxCurrentReached 1;
BA_ "Confidence" SG_ 1332 VCFRONT_a260_IBSVolts 1;
BA_ "Confidence" SG_ 1332 VCFRONT_a260_IBSAh 1;
BA_ "Confidence" SG_ 1332 VCFRONT_a260_vehiclePowerState 1;
BA_ "Confidence" SG_ 1332 VCFRONT_a260_batterySMState 1;
BA_ "SystemSignalLongSymbol" SG_ 1332 VCFRONT_a260_notEnoughPowerForSu "VCFRONT_a260_notEnoughPowerForSupport";
BA_ "SystemSignalLongSymbol" SG_ 1332 VCFRONT_a260_coolantHasBeenFille "VCFRONT_a260_coolantHasBeenFilled";
BA_ "Confidence" SG_ 1332 VCFRONT_a260_dcdcLVSupportStatus 1;
BA_ "SystemSignalLongSymbol" SG_ 1332 VCFRONT_a260_PCSAndVCREFuseStabl "VCFRONT_a260_PCSAndVCREFuseStable";
BA_ "Confidence" SG_ 1332 VCFRONT_a260_bmsState 1;
BA_ "GenSigSNA" SG_ 1332 VCFRONT_a260_bmsState "9";
BA_ "Confidence" SG_ 1332 VCFRONT_a261_eFuseVoltage 1;
BA_ "Confidence" SG_ 1332 VCFRONT_a261_vbatProtVoltage 1;
BA_ "Confidence" SG_ 1332 VCFRONT_a262_eFuseVoltage 1;
BA_ "Confidence" SG_ 1332 VCFRONT_a262_vbatProtVoltage 1;
BA_ "Confidence" SG_ 1332 VCFRONT_a263_eFuseVoltage 1;
BA_ "Confidence" SG_ 1332 VCFRONT_a263_vbatProtVoltage 1;
BA_ "Confidence" SG_ 1332 VCFRONT_a264_eFuseVoltage 1;
BA_ "Confidence" SG_ 1332 VCFRONT_a264_vbatProtVoltage 1;
BA_ "Confidence" SG_ 1332 VCFRONT_a265_eFuseVoltage 1;
BA_ "Confidence" SG_ 1332 VCFRONT_a265_vbatProtVoltage 1;
BA_ "Confidence" SG_ 1332 VCFRONT_a266_eFuseVoltage 1;
BA_ "Confidence" SG_ 1332 VCFRONT_a266_vbatProtVoltage 1;
BA_ "Confidence" SG_ 1332 VCFRONT_a267_eFuseVoltage 1;
BA_ "Confidence" SG_ 1332 VCFRONT_a267_vbatProtVoltage 1;
BA_ "Confidence" SG_ 1332 VCFRONT_a268_eFuseVoltage 1;
BA_ "Confidence" SG_ 1332 VCFRONT_a268_vbatProtVoltage 1;
BA_ "Confidence" SG_ 1332 VCFRONT_a269_LVBatteryTemp 1;
BA_ "GenSigSNA" SG_ 1332 VCFRONT_a269_LVBatteryTemp "127";
BA_ "Confidence" SG_ 1332 VCFRONT_a269_IBSCurrent 1;
BA_ "Confidence" SG_ 1332 VCFRONT_a269_IBSVoltage 1;
BA_ "Confidence" SG_ 1332 VCFRONT_a269_IBSAmpHours 1;
BA_ "Confidence" SG_ 1332 VCFRONT_a269_vehiclePowerState 1;
BA_ "Confidence" SG_ 1332 VCFRONT_a270_prechargeChannel 1;
BA_ "Confidence" SG_ 1332 VCFRONT_a270_sourceVoltage 1;
BA_ "Confidence" SG_ 1332 VCFRONT_a270_loadVoltage 1;
BA_ "Confidence" SG_ 1332 VCFRONT_a270_timeout 1;
BA_ "SystemSignalLongSymbol" SG_ 1332 VCFRONT_a271_shortedCellTestTrig "VCFRONT_a271_shortedCellTestTrigger";
BA_ "SystemSignalLongSymbol" SG_ 1332 VCFRONT_a271_voltDropOnHighCurre "VCFRONT_a271_voltDropOnHighCurrentTrigger";
BA_ "SystemSignalLongSymbol" SG_ 1332 VCFRONT_a271_deadLVMinimalAhDisc "VCFRONT_a271_deadLVMinimalAhDischargedTrigger";
BA_ "SystemSignalLongSymbol" SG_ 1332 VCFRONT_a271_resistanceEstimatio "VCFRONT_a271_resistanceEstimationHardFailTrigger";
BA_ "SystemSignalLongSymbol" SG_ 1332 VCFRONT_a271_dcrMilliOhmsAboveTh "VCFRONT_a271_dcrMilliOhmsAboveThresholdTrigger";
BA_ "SystemSignalLongSymbol" SG_ 1332 VCFRONT_a271_prechargeLVLoadRedu "VCFRONT_a271_prechargeLVLoadReductionTrigger";
BA_ "SystemSignalLongSymbol" SG_ 1332 VCFRONT_a271_instantPrechargeDCR "VCFRONT_a271_instantPrechargeDCRTooHighTrigger";
BA_ "Confidence" SG_ 1332 VCFRONT_a283_thmlFanDemand 1;
BA_ "Confidence" SG_ 1332 VCFRONT_a283_thmlFanDemandLimit 1;
BA_ "Confidence" SG_ 1332 VCFRONT_a283_thmlFanPhaseI 1;
BA_ "Confidence" SG_ 1332 VCFRONT_a283_thmlFanPhaseILimit 1;
BA_ "Confidence" SG_ 1332 VCFRONT_a284_driverState 1;
BA_ "SystemSignalLongSymbol" SG_ 1332 VCFRONT_a284_chargePumpUndervolt "VCFRONT_a284_chargePumpUndervoltage";
BA_ "Confidence" SG_ 1332 VCFRONT_a285_driverState 1;
BA_ "SystemSignalLongSymbol" SG_ 1332 VCFRONT_a285_chargePumpUndervolt "VCFRONT_a285_chargePumpUndervoltage";
BA_ "Confidence" SG_ 1332 VCFRONT_a286_driverState 1;
BA_ "SystemSignalLongSymbol" SG_ 1332 VCFRONT_a286_chargePumpUndervolt "VCFRONT_a286_chargePumpUndervoltage";
BA_ "Confidence" SG_ 1332 VCFRONT_a287_driverState 1;
BA_ "SystemSignalLongSymbol" SG_ 1332 VCFRONT_a287_chargePumpUndervolt "VCFRONT_a287_chargePumpUndervoltage";
BA_ "Confidence" SG_ 1332 VCFRONT_a288_driverState 1;
BA_ "SystemSignalLongSymbol" SG_ 1332 VCFRONT_a288_chargePumpUndervolt "VCFRONT_a288_chargePumpUndervoltage";
BA_ "Confidence" SG_ 1332 VCFRONT_a289_driverState 1;
VAL_ 1332 VCFRONT_a142_driverState 10 "DRIVER_FAULT" 9 "FAULT_OPEN_COIL" 8 "FAULT_SHORT_COIL" 7 "STALL" 6 "READY" 5 "ENABLE_MOTOR" 4 "COMM_ERROR" 3 "INIT_COMM" 2 "RESET" 1 "UNPOWERED" 0 "UNKNOWN" ;
VAL_ 1332 VCFRONT_a176_vehicleState 4 "DRIVE" 3 "ACCESSORY_PLUS" 2 "ACCESSORY" 1 "CONDITIONING" 0 "OFF" ;
VAL_ 1332 VCFRONT_a180_vehiclePowerState 3 "DRIVE" 2 "ACCESSORY" 1 "CONDITIONING" 0 "OFF" ;
VAL_ 1332 VCFRONT_a180_hvState 6 "UP" 5 "UP_FOR_DC_CHARGE" 4 "UP_FOR_CHARGE" 3 "UP_FOR_DRIVE" 2 "GOING_DOWN" 1 "COMING_UP" 0 "DOWN" ;
VAL_ 1332 VCFRONT_a180_bmsState 10 "DIAG" 9 "SNA" 8 "TEST" 7 "WELD" 6 "FAULT" 5 "CLEAR_FAULT" 4 "FEIM" 3 "CHARGE" 2 "SUPPORT" 1 "DRIVE" 0 "STANDBY" ;
VAL_ 1332 VCFRONT_a180_dcdcLVSupportStatus 2 "FAULTED" 1 "ACTIVE" 0 "IDLE" ;
VAL_ 1332 VCFRONT_a181_vehicleState 3 "DRIVE" 2 "ACCESSORY" 1 "CONDITIONING" 0 "OFF" ;
VAL_ 1332 VCFRONT_a182_ambientTemp 0 "SNA" ;
VAL_ 1332 VCFRONT_a182_batteryType 5 "TESLA_48V_LI_ION" 4 "TESLA_16V_LI_ION" 3 "CATL_LI_ION" 2 "CLARIOS_B24_FLOODED" 1 "ATLASBX_B24_FLOODED" 0 "UNKNOWN" ;
VAL_ 1332 VCFRONT_a188_vehicleState 18 "SNA" 17 "RESET" 16 "TURN_ON_RAILS" 15 "OTA" 14 "CRASH" 13 "DRIVE" 12 "CONDITIONING" 11 "ACCESSORY_PLUS" 10 "ACCESSORY" 9 "HV_UP_STANDBY" 8 "LV_AWAKE" 7 "LV_SHUTDOWN" 6 "SLEEP_STANDBY" 5 "SLEEP_SHUTDOWN" 4 "SYSTEM_CHECKS" 3 "BATTERY_POST_WAKE" 2 "SILENT_WAKE" 1 "LOW_POWER_STANDBY" 0 "INIT" ;
VAL_ 1332 VCFRONT_a191_vehiclePowerState 3 "DRIVE" 2 "ACCESSORY" 1 "CONDITIONING" 0 "OFF" ;
VAL_ 1332 VCFRONT_a191_hvState 6 "UP" 5 "UP_FOR_DC_CHARGE" 4 "UP_FOR_CHARGE" 3 "UP_FOR_DRIVE" 2 "GOING_DOWN" 1 "COMING_UP" 0 "DOWN" ;
VAL_ 1332 VCFRONT_a191_MOSState 3 "SNA" 2 "INVALID" 1 "CLOSED" 0 "OPEN" ;
VAL_ 1332 VCFRONT_a191_ECPAState 3 "SNA" 2 "INVALID" 1 "CLOSED" 0 "OPEN" ;
VAL_ 1332 VCFRONT_a191_vehicleLoadShedStag 3 "3" 2 "2" 1 "1" 0 "IDLE_OR_UNDEFINED" ;
VAL_ 1332 VCFRONT_a191_bmsState 10 "DIAG" 9 "SNA" 8 "TEST" 7 "WELD" 6 "FAULT" 5 "CLEAR_FAULT" 4 "FEIM" 3 "CHARGE" 2 "SUPPORT" 1 "DRIVE" 0 "STANDBY" ;
VAL_ 1332 VCFRONT_a192_vehiclePowerState 3 "DRIVE" 2 "ACCESSORY" 1 "CONDITIONING" 0 "OFF" ;
VAL_ 1332 VCFRONT_a192_hvState 6 "UP" 5 "UP_FOR_DC_CHARGE" 4 "UP_FOR_CHARGE" 3 "UP_FOR_DRIVE" 2 "GOING_DOWN" 1 "COMING_UP" 0 "DOWN" ;
VAL_ 1332 VCFRONT_a192_DI_gear 7 "SNA" 4 "D" 3 "N" 2 "R" 1 "P" 0 "INVALID" ;
VAL_ 1332 VCFRONT_a196_vehiclePowerState 3 "DRIVE" 2 "ACCESSORY" 1 "CONDITIONING" 0 "OFF" ;
VAL_ 1332 VCFRONT_a196_batterySMState 10 "EXTERNAL_LV_BUS_CONTROL" 9 "RECOVERY" 8 "FAULT" 7 "SHORTED_CELL_TEST" 6 "DISCONNECTED_BATTERY_TEST" 5 "OTA_STANDBY" 4 "RESISTANCE_ESTIMATION" 3 "STANDBY" 2 "DISCHARGE" 1 "CHARGE" 0 "INIT" ;
VAL_ 1332 VCFRONT_a196_ECPAState 3 "SNA" 2 "INVALID" 1 "CLOSED" 0 "OPEN" ;
VAL_ 1332 VCFRONT_a200_vcleftSelfTest 12 "SNA" 11 "SKIPPED" 10 "FAILED_NOT_LATCHED" 9 "FAILED_TURN_OFF_PATH_TOO_SLOW" 8 "FAILED_ENABLE_HIGH_MALFUNCTION" 7 "FAILED_POWER_FET_CHANNEL_OPEN" 6 "FAILED_ENABLE_LOW_MALFUNCTION" 5 "FAILED_POWER_FET_STUCK_ON" 4 "FAILED_EFUSE_OUTPUT_SHORT" 3 "FAILED_RAILS_UNSTABLE" 2 "PASSED" 1 "RUNNING" 0 "NOT_RUN" ;
VAL_ 1332 VCFRONT_a201_vcrightSelfTest 12 "SNA" 11 "SKIPPED" 10 "FAILED_NOT_LATCHED" 9 "FAILED_TURN_OFF_PATH_TOO_SLOW" 8 "FAILED_ENABLE_HIGH_MALFUNCTION" 7 "FAILED_POWER_FET_CHANNEL_OPEN" 6 "FAILED_ENABLE_LOW_MALFUNCTION" 5 "FAILED_POWER_FET_STUCK_ON" 4 "FAILED_EFUSE_OUTPUT_SHORT" 3 "FAILED_RAILS_UNSTABLE" 2 "PASSED" 1 "RUNNING" 0 "NOT_RUN" ;
VAL_ 1332 VCFRONT_a202_pcsSelfTest 12 "SNA" 11 "SKIPPED" 10 "FAILED_NOT_LATCHED" 9 "FAILED_TURN_OFF_PATH_TOO_SLOW" 8 "FAILED_ENABLE_HIGH_MALFUNCTION" 7 "FAILED_POWER_FET_CHANNEL_OPEN" 6 "FAILED_ENABLE_LOW_MALFUNCTION" 5 "FAILED_POWER_FET_STUCK_ON" 4 "FAILED_EFUSE_OUTPUT_SHORT" 3 "FAILED_RAILS_UNSTABLE" 2 "PASSED" 1 "RUNNING" 0 "NOT_RUN" ;
VAL_ 1332 VCFRONT_a207_vbatFusedSelfTest 12 "SNA" 11 "SKIPPED" 10 "FAILED_NOT_LATCHED" 9 "FAILED_TURN_OFF_PATH_TOO_SLOW" 8 "FAILED_ENABLE_HIGH_MALFUNCTION" 7 "FAILED_POWER_FET_CHANNEL_OPEN" 6 "FAILED_ENABLE_LOW_MALFUNCTION" 5 "FAILED_POWER_FET_STUCK_ON" 4 "FAILED_EFUSE_OUTPUT_SHORT" 3 "FAILED_RAILS_UNSTABLE" 2 "PASSED" 1 "RUNNING" 0 "NOT_RUN" ;
VAL_ 1332 VCFRONT_a213_LVBatteryTemp -32768 "SNA" ;
VAL_ 1332 VCFRONT_a214_selfTestResult 7 "PASSED" 6 "UNKNOWN" 5 "OPEN_PHASE_W" 4 "OPEN_PHASE_V" 3 "OPEN_PHASE_U" 2 "SHORT_GROUND" 1 "SHORT_SUPPLY" 0 "NOT_TESTED" ;
VAL_ 1332 VCFRONT_a216_hvState 6 "UP" 5 "UP_FOR_DC_CHARGE" 4 "UP_FOR_CHARGE" 3 "UP_FOR_DRIVE" 2 "GOING_DOWN" 1 "COMING_UP" 0 "DOWN" ;
VAL_ 1332 VCFRONT_a217_selfTestResult 7 "PASSED" 6 "UNKNOWN" 5 "OPEN_PHASE_W" 4 "OPEN_PHASE_V" 3 "OPEN_PHASE_U" 2 "SHORT_GROUND" 1 "SHORT_SUPPLY" 0 "NOT_TESTED" ;
VAL_ 1332 VCFRONT_a227_selfTestResult 7 "PASSED" 6 "UNKNOWN" 5 "OPEN_PHASE_W" 4 "OPEN_PHASE_V" 3 "OPEN_PHASE_U" 2 "SHORT_GROUND" 1 "SHORT_SUPPLY" 0 "NOT_TESTED" ;
VAL_ 1332 VCFRONT_a242_LVBatteryTemp 127 "SNA" ;
VAL_ 1332 VCFRONT_a242_vehiclePowerState 3 "DRIVE" 2 "ACCESSORY" 1 "CONDITIONING" 0 "OFF" ;
VAL_ 1332 VCFRONT_a243_LVBatteryTemp -32768 "SNA" ;
VAL_ 1332 VCFRONT_a250_calibratedVerticalP 1023 "SNA" 1022 "INVALID_POSITION" ;
VAL_ 1332 VCFRONT_a250_calibratedVert_0001 1023 "SNA" 1022 "INVALID_POSITION" ;
VAL_ 1332 VCFRONT_a250_calibratedHorizonta 1023 "SNA" 1022 "INVALID_POSITION" ;
VAL_ 1332 VCFRONT_a250_calibratedHori_0001 1023 "SNA" 1022 "INVALID_POSITION" ;
VAL_ 1332 VCFRONT_a253_LVBatteryTemp 127 "SNA" ;
VAL_ 1332 VCFRONT_a257_vcrightLockoutStatu 2 "ACTIVE" 1 "PENDING" 0 "IDLE" ;
VAL_ 1332 VCFRONT_a257_vehicleState 18 "SNA" 17 "RESET" 16 "TURN_ON_RAILS" 15 "OTA" 14 "CRASH" 13 "DRIVE" 12 "CONDITIONING" 11 "ACCESSORY_PLUS" 10 "ACCESSORY" 9 "HV_UP_STANDBY" 8 "LV_AWAKE" 7 "LV_SHUTDOWN" 6 "SLEEP_STANDBY" 5 "SLEEP_SHUTDOWN" 4 "SYSTEM_CHECKS" 3 "BATTERY_POST_WAKE" 2 "SILENT_WAKE" 1 "LOW_POWER_STANDBY" 0 "INIT" ;
VAL_ 1332 VCFRONT_a260_vehiclePowerState 3 "DRIVE" 2 "ACCESSORY" 1 "CONDITIONING" 0 "OFF" ;
VAL_ 1332 VCFRONT_a260_batterySMState 10 "EXTERNAL_LV_BUS_CONTROL" 9 "RECOVERY" 8 "FAULT" 7 "SHORTED_CELL_TEST" 6 "DISCONNECTED_BATTERY_TEST" 5 "OTA_STANDBY" 4 "RESISTANCE_ESTIMATION" 3 "STANDBY" 2 "DISCHARGE" 1 "CHARGE" 0 "INIT" ;
VAL_ 1332 VCFRONT_a260_dcdcLVSupportStatus 2 "FAULTED" 1 "ACTIVE" 0 "IDLE" ;
VAL_ 1332 VCFRONT_a260_bmsState 10 "DIAG" 9 "SNA" 8 "TEST" 7 "WELD" 6 "FAULT" 5 "CLEAR_FAULT" 4 "FEIM" 3 "CHARGE" 2 "SUPPORT" 1 "DRIVE" 0 "STANDBY" ;
VAL_ 1332 VCFRONT_a269_LVBatteryTemp 127 "SNA" ;
VAL_ 1332 VCFRONT_a269_vehiclePowerState 3 "DRIVE" 2 "ACCESSORY" 1 "CONDITIONING" 0 "OFF" ;
VAL_ 1332 VCFRONT_a270_prechargeChannel 5 "MCU_LOGIC" 4 "RIGHT_CONTROLLER" 3 "AUTOPILOT_2" 2 "AUTOPILOT_1" 1 "LEFT_CONTROLLER" 0 "UNKNOWN" ;
VAL_ 1332 VCFRONT_a284_driverState 10 "DRIVER_FAULT" 9 "FAULT_OPEN_COIL" 8 "FAULT_SHORT_COIL" 7 "STALL" 6 "READY" 5 "ENABLE_MOTOR" 4 "COMM_ERROR" 3 "INIT_COMM" 2 "RESET" 1 "UNPOWERED" 0 "UNKNOWN" ;
VAL_ 1332 VCFRONT_a285_driverState 10 "DRIVER_FAULT" 9 "FAULT_OPEN_COIL" 8 "FAULT_SHORT_COIL" 7 "STALL" 6 "READY" 5 "ENABLE_MOTOR" 4 "COMM_ERROR" 3 "INIT_COMM" 2 "RESET" 1 "UNPOWERED" 0 "UNKNOWN" ;
VAL_ 1332 VCFRONT_a286_driverState 10 "DRIVER_FAULT" 9 "FAULT_OPEN_COIL" 8 "FAULT_SHORT_COIL" 7 "STALL" 6 "READY" 5 "ENABLE_MOTOR" 4 "COMM_ERROR" 3 "INIT_COMM" 2 "RESET" 1 "UNPOWERED" 0 "UNKNOWN" ;
VAL_ 1332 VCFRONT_a287_driverState 10 "DRIVER_FAULT" 9 "FAULT_OPEN_COIL" 8 "FAULT_SHORT_COIL" 7 "STALL" 6 "READY" 5 "ENABLE_MOTOR" 4 "COMM_ERROR" 3 "INIT_COMM" 2 "RESET" 1 "UNPOWERED" 0 "UNKNOWN" ;
VAL_ 1332 VCFRONT_a288_driverState 10 "DRIVER_FAULT" 9 "FAULT_OPEN_COIL" 8 "FAULT_SHORT_COIL" 7 "STALL" 6 "READY" 5 "ENABLE_MOTOR" 4 "COMM_ERROR" 3 "INIT_COMM" 2 "RESET" 1 "UNPOWERED" 0 "UNKNOWN" ;
VAL_ 1332 VCFRONT_a289_driverState 10 "DRIVER_FAULT" 9 "FAULT_OPEN_COIL" 8 "FAULT_SHORT_COIL" 7 "STALL" 6 "READY" 5 "ENABLE_MOTOR" 4 "COMM_ERROR" 3 "INIT_COMM" 2 "RESET" 1 "UNPOWERED" 0 "UNKNOWN" ;
