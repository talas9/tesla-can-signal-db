VERSION "dbc-export 1 2025.20.8"

NS_ :

BS_:

BU_: APP BMS CC CMP CMPD CP DAS DI DIF DIR EPBL EPBR EVSE FC GTW HCML HCMR HVP ICR PCS PM PMF PMR PTC SCCM SCM SCS SDCR TAS UMC VC VCFRONT VCLEFT VCRIGHT VCSEC

BO_ 1332 VCFRONT_alertLog: 8 VCFRONT
 SG_ VCFRONT_alertID M : 0|10@1+ (1,0) [0|1023] "" Vector__XXX
 SG_ VCFRONT_a289_chargePumpUndervolt m289 : 23|1@1+ (1,0) [0|1] "" Vector__XXX
 SG_ VCFRONT_a289_isCoilOpenX m289 : 24|1@1+ (1,0) [0|1] "" Vector__XXX
 SG_ VCFRONT_a289_isCoilOpenY m289 : 25|1@1+ (1,0) [0|1] "" Vector__XXX
 SG_ VCFRONT_a289_isCoilShortXPGnd m289 : 26|1@1+ (1,0) [0|1] "" Vector__XXX
 SG_ VCFRONT_a289_isCoilShortXPVbb m289 : 27|1@1+ (1,0) [0|1] "" Vector__XXX
 SG_ VCFRONT_a289_isCoilShortXNGnd m289 : 28|1@1+ (1,0) [0|1] "" Vector__XXX
 SG_ VCFRONT_a289_isCoilShortXNVbb m289 : 29|1@1+ (1,0) [0|1] "" Vector__XXX
 SG_ VCFRONT_a289_isCoilShortYPGnd m289 : 30|1@1+ (1,0) [0|1] "" Vector__XXX
 SG_ VCFRONT_a289_isCoilShortYPVbb m289 : 31|1@1+ (1,0) [0|1] "" Vector__XXX
 SG_ VCFRONT_a289_isCoilShortYNGnd m289 : 32|1@1+ (1,0) [0|1] "" Vector__XXX
 SG_ VCFRONT_a289_isCoilShortYNVbb m289 : 33|1@1+ (1,0) [0|1] "" Vector__XXX
 SG_ VCFRONT_a289_driverHasCommError m289 : 34|1@1+ (1,0) [0|1] "" Vector__XXX
 SG_ VCFRONT_a290_outputFaulted m290 : 16|1@1+ (1,0) [0|1] "" Vector__XXX
 SG_ VCFRONT_a290_currentSenseFaulted m290 : 17|1@1+ (1,0) [0|1] "" Vector__XXX
 SG_ VCFRONT_a290_tempSenseFaulted m290 : 18|1@1+ (1,0) [0|1] "" Vector__XXX
 SG_ VCFRONT_a290_underCurrent m290 : 19|1@1+ (1,0) [0|1] "" Vector__XXX
 SG_ VCFRONT_a290_overCurrent m290 : 20|1@1+ (1,0) [0|1] "" Vector__XXX
 SG_ VCFRONT_a290_overTemperature m290 : 21|1@1+ (1,0) [0|1] "" Vector__XXX
 SG_ VCFRONT_a291_outputFaulted m291 : 16|1@1+ (1,0) [0|1] "" Vector__XXX
 SG_ VCFRONT_a291_currentSenseFaulted m291 : 17|1@1+ (1,0) [0|1] "" Vector__XXX
 SG_ VCFRONT_a291_tempSenseFaulted m291 : 18|1@1+ (1,0) [0|1] "" Vector__XXX
 SG_ VCFRONT_a291_underCurrent m291 : 19|1@1+ (1,0) [0|1] "" Vector__XXX
 SG_ VCFRONT_a291_overCurrent m291 : 20|1@1+ (1,0) [0|1] "" Vector__XXX
 SG_ VCFRONT_a291_overTemperature m291 : 21|1@1+ (1,0) [0|1] "" Vector__XXX
 SG_ VCFRONT_a292_outputFaulted m292 : 16|1@1+ (1,0) [0|1] "" Vector__XXX
 SG_ VCFRONT_a292_currentSenseFaulted m292 : 17|1@1+ (1,0) [0|1] "" Vector__XXX
 SG_ VCFRONT_a292_tempSenseFaulted m292 : 18|1@1+ (1,0) [0|1] "" Vector__XXX
 SG_ VCFRONT_a292_underCurrent m292 : 19|1@1+ (1,0) [0|1] "" Vector__XXX
 SG_ VCFRONT_a292_overCurrent m292 : 20|1@1+ (1,0) [0|1] "" Vector__XXX
 SG_ VCFRONT_a292_overTemperature m292 : 21|1@1+ (1,0) [0|1] "" Vector__XXX
 SG_ VCFRONT_a293_outputFaulted m293 : 16|1@1+ (1,0) [0|1] "" Vector__XXX
 SG_ VCFRONT_a293_currentSenseFaulted m293 : 17|1@1+ (1,0) [0|1] "" Vector__XXX
 SG_ VCFRONT_a293_tempSenseFaulted m293 : 18|1@1+ (1,0) [0|1] "" Vector__XXX
 SG_ VCFRONT_a293_underCurrent m293 : 19|1@1+ (1,0) [0|1] "" Vector__XXX
 SG_ VCFRONT_a293_overCurrent m293 : 20|1@1+ (1,0) [0|1] "" Vector__XXX
 SG_ VCFRONT_a293_overTemperature m293 : 21|1@1+ (1,0) [0|1] "" Vector__XXX
 SG_ VCFRONT_a294_outputFaulted m294 : 16|1@1+ (1,0) [0|1] "" Vector__XXX
 SG_ VCFRONT_a294_currentSenseFaulted m294 : 17|1@1+ (1,0) [0|1] "" Vector__XXX
 SG_ VCFRONT_a294_tempSenseFaulted m294 : 18|1@1+ (1,0) [0|1] "" Vector__XXX
 SG_ VCFRONT_a294_underCurrent m294 : 19|1@1+ (1,0) [0|1] "" Vector__XXX
 SG_ VCFRONT_a294_overCurrent m294 : 20|1@1+ (1,0) [0|1] "" Vector__XXX
 SG_ VCFRONT_a294_overTemperature m294 : 21|1@1+ (1,0) [0|1] "" Vector__XXX
 SG_ VCFRONT_a295_outputFaulted m295 : 16|1@1+ (1,0) [0|1] "" Vector__XXX
 SG_ VCFRONT_a295_currentSenseFaulted m295 : 17|1@1+ (1,0) [0|1] "" Vector__XXX
 SG_ VCFRONT_a295_tempSenseFaulted m295 : 18|1@1+ (1,0) [0|1] "" Vector__XXX
 SG_ VCFRONT_a295_underCurrent m295 : 19|1@1+ (1,0) [0|1] "" Vector__XXX
 SG_ VCFRONT_a295_overCurrent m295 : 20|1@1+ (1,0) [0|1] "" Vector__XXX
 SG_ VCFRONT_a295_overTemperature m295 : 21|1@1+ (1,0) [0|1] "" Vector__XXX
 SG_ VCFRONT_a297_bmbDeviceId m297 : 16|4@1+ (1,1) [1|16] "" Vector__XXX
 SG_ VCFRONT_a297_bmbDeviceFaultTempM m297 : 24|8@1+ (1,0) [0|255] "" Vector__XXX
 SG_ VCFRONT_a300_oldType m300 : 16|2@1+ (1,0) [0|3] "" Vector__XXX
 SG_ VCFRONT_a300_newType m300 : 18|2@1+ (1,0) [0|3] "" Vector__XXX
 SG_ VCFRONT_a302_LINFrameStatus m302 : 16|3@1+ (1,0) [0|7] "" Vector__XXX
 SG_ VCFRONT_a303_vehicleSpeed m303 : 16|12@1+ (0.08,-40) [-40|287.6] "kph" Vector__XXX
 SG_ VCFRONT_a303_postVoltage m303 : 32|16@1+ (0.1,0) [0|6553.5] "V" Vector__XXX
 SG_ VCFRONT_a303_lockStatus m303 : 48|2@1+ (1,0) [1|3] "" Vector__XXX
 SG_ VCFRONT_a304_voltage m304 : 16|7@1+ (0.15,0) [0|19.05] "V" Vector__XXX
 SG_ VCFRONT_a304_temperature m304 : 24|8@1+ (0.5,-40) [-40|87.5] "degC" Vector__XXX
 SG_ VCFRONT_a305_voltage m305 : 16|7@1+ (0.15,0) [0|19.05] "V" Vector__XXX
 SG_ VCFRONT_a305_temperature m305 : 24|8@1+ (0.5,-40) [-40|87.5] "degC" Vector__XXX
 SG_ VCFRONT_a305_actuatorCurrent m305 : 32|8@1+ (0.1,0) [0|25.5] "A" Vector__XXX
 SG_ VCFRONT_a306_voltage m306 : 16|7@1+ (0.15,0) [0|19.05] "V" Vector__XXX
 SG_ VCFRONT_a306_temperature m306 : 24|8@1+ (0.5,-40) [-40|87.5] "degC" Vector__XXX
 SG_ VCFRONT_a306_actuatorCurrent m306 : 32|8@1+ (0.1,0) [0|25.5] "A" Vector__XXX
 SG_ VCFRONT_a307_voltage m307 : 16|7@1+ (0.15,0) [0|19.05] "V" Vector__XXX
 SG_ VCFRONT_a307_temperature m307 : 24|8@1+ (0.5,-40) [-40|87.5] "degC" Vector__XXX
 SG_ VCFRONT_a307_actuatorCurrent m307 : 32|8@1+ (0.1,0) [0|25.5] "A" Vector__XXX
 SG_ VCFRONT_a308_voltage m308 : 16|7@1+ (0.15,0) [0|19.05] "V" Vector__XXX
 SG_ VCFRONT_a308_temperature m308 : 24|8@1+ (0.5,-40) [-40|87.5] "degC" Vector__XXX
 SG_ VCFRONT_a308_actuatorCurrent m308 : 32|8@1+ (0.1,0) [0|25.5] "A" Vector__XXX
 SG_ VCFRONT_a309_vehicleSpeed m309 : 16|12@1+ (0.08,-40) [-40|287.6] "kph" Vector__XXX
 SG_ VCFRONT_a309_switchVoltage m309 : 32|16@1+ (0.1,0) [0|6553.5] "V" Vector__XXX
 SG_ VCFRONT_a309_lockStatus m309 : 48|2@1+ (1,0) [1|3] "" Vector__XXX
 SG_ VCFRONT_a334_maxSlope m334 : 16|12@1+ (0.1,0) [0|409.5] "A/ms" Vector__XXX
 SG_ VCFRONT_a334_avgCurrent m334 : 28|12@1+ (0.1,0) [0|409.5] "A" Vector__XXX
 SG_ VCFRONT_a334_maxCurrent m334 : 40|12@1+ (0.1,0) [0|409.5] "A" Vector__XXX
 SG_ VCFRONT_a334_vehicleState m334 : 52|2@1+ (1,0) [0|3] "" Vector__XXX
 SG_ VCFRONT_a335_maxSlope m335 : 16|12@1+ (0.1,0) [0|409.5] "A/ms" Vector__XXX
 SG_ VCFRONT_a335_avgCurrent m335 : 28|12@1+ (0.1,0) [0|409.5] "A" Vector__XXX
 SG_ VCFRONT_a335_maxCurrent m335 : 40|12@1+ (0.1,0) [0|409.5] "A" Vector__XXX
 SG_ VCFRONT_a335_vehicleState m335 : 52|2@1+ (1,0) [0|3] "" Vector__XXX
 SG_ VCFRONT_a336_maxSlope m336 : 16|12@1+ (0.1,0) [0|409.5] "A/ms" Vector__XXX
 SG_ VCFRONT_a336_avgCurrent m336 : 28|12@1+ (0.1,0) [0|409.5] "A" Vector__XXX
 SG_ VCFRONT_a336_maxCurrent m336 : 40|12@1+ (0.1,0) [0|409.5] "A" Vector__XXX
 SG_ VCFRONT_a336_vehicleState m336 : 52|2@1+ (1,0) [0|3] "" Vector__XXX
 SG_ VCFRONT_a337_maxSlope m337 : 16|12@1+ (0.1,0) [0|409.5] "A/ms" Vector__XXX
 SG_ VCFRONT_a337_avgCurrent m337 : 28|12@1+ (0.1,0) [0|409.5] "A" Vector__XXX
 SG_ VCFRONT_a337_maxCurrent m337 : 40|12@1+ (0.1,0) [0|409.5] "A" Vector__XXX
 SG_ VCFRONT_a337_vehicleState m337 : 52|2@1+ (1,0) [0|3] "" Vector__XXX
 SG_ VCFRONT_a338_maxSlope m338 : 16|12@1+ (0.1,0) [0|409.5] "A/ms" Vector__XXX
 SG_ VCFRONT_a338_avgCurrent m338 : 28|12@1+ (0.1,0) [0|409.5] "A" Vector__XXX
 SG_ VCFRONT_a338_maxCurrent m338 : 40|12@1+ (0.1,0) [0|409.5] "A" Vector__XXX
 SG_ VCFRONT_a338_vehicleState m338 : 52|2@1+ (1,0) [0|3] "" Vector__XXX
 SG_ VCFRONT_a339_maxSlope m339 : 16|12@1+ (0.1,0) [0|409.5] "A/ms" Vector__XXX
 SG_ VCFRONT_a339_avgCurrent m339 : 28|12@1+ (0.1,0) [0|409.5] "A" Vector__XXX
 SG_ VCFRONT_a339_maxCurrent m339 : 40|12@1+ (0.1,0) [0|409.5] "A" Vector__XXX
 SG_ VCFRONT_a339_vehicleState m339 : 52|2@1+ (1,0) [0|3] "" Vector__XXX
 SG_ VCFRONT_a340_maxSlope m340 : 16|12@1+ (0.1,0) [0|409.5] "A/ms" Vector__XXX
 SG_ VCFRONT_a340_avgCurrent m340 : 28|12@1+ (0.1,0) [0|409.5] "A" Vector__XXX
 SG_ VCFRONT_a340_maxCurrent m340 : 40|12@1+ (0.1,0) [0|409.5] "A" Vector__XXX
 SG_ VCFRONT_a340_vehicleState m340 : 52|2@1+ (1,0) [0|3] "" Vector__XXX
 SG_ VCFRONT_a341_maxSlope m341 : 16|12@1+ (0.1,0) [0|409.5] "A/ms" Vector__XXX
 SG_ VCFRONT_a341_avgCurrent m341 : 28|12@1+ (0.1,0) [0|409.5] "A" Vector__XXX
 SG_ VCFRONT_a341_maxCurrent m341 : 40|12@1+ (0.1,0) [0|409.5] "A" Vector__XXX
 SG_ VCFRONT_a341_vehicleState m341 : 52|2@1+ (1,0) [0|3] "" Vector__XXX
 SG_ VCFRONT_a342_maxSlope m342 : 16|12@1+ (0.1,0) [0|409.5] "A/ms" Vector__XXX
 SG_ VCFRONT_a342_avgCurrent m342 : 28|12@1+ (0.1,0) [0|409.5] "A" Vector__XXX
 SG_ VCFRONT_a342_maxCurrent m342 : 40|12@1+ (0.1,0) [0|409.5] "A" Vector__XXX
 SG_ VCFRONT_a342_vehicleState m342 : 52|2@1+ (1,0) [0|3] "" Vector__XXX
 SG_ VCFRONT_a343_maxSlope m343 : 16|12@1+ (0.1,0) [0|409.5] "A/ms" Vector__XXX
 SG_ VCFRONT_a343_avgCurrent m343 : 28|12@1+ (0.1,0) [0|409.5] "A" Vector__XXX
 SG_ VCFRONT_a343_maxCurrent m343 : 40|12@1+ (0.1,0) [0|409.5] "A" Vector__XXX
 SG_ VCFRONT_a343_vehicleState m343 : 52|2@1+ (1,0) [0|3] "" Vector__XXX
 SG_ VCFRONT_a344_maxSlope m344 : 16|12@1+ (0.1,0) [0|409.5] "A/ms" Vector__XXX
 SG_ VCFRONT_a344_avgCurrent m344 : 28|12@1+ (0.1,0) [0|409.5] "A" Vector__XXX
 SG_ VCFRONT_a344_maxCurrent m344 : 40|12@1+ (0.1,0) [0|409.5] "A" Vector__XXX
 SG_ VCFRONT_a344_vehicleState m344 : 52|2@1+ (1,0) [0|3] "" Vector__XXX
 SG_ VCFRONT_a345_maxSlope m345 : 16|12@1+ (0.1,0) [0|409.5] "A/ms" Vector__XXX
 SG_ VCFRONT_a345_avgCurrent m345 : 28|12@1+ (0.1,0) [0|409.5] "A" Vector__XXX
 SG_ VCFRONT_a345_maxCurrent m345 : 40|12@1+ (0.1,0) [0|409.5] "A" Vector__XXX
 SG_ VCFRONT_a345_vehicleState m345 : 52|2@1+ (1,0) [0|3] "" Vector__XXX
 SG_ VCFRONT_a346_maxSlope m346 : 16|12@1+ (0.1,0) [0|409.5] "A/ms" Vector__XXX
 SG_ VCFRONT_a346_avgCurrent m346 : 28|12@1+ (0.1,0) [0|409.5] "A" Vector__XXX
 SG_ VCFRONT_a346_maxCurrent m346 : 40|12@1+ (0.1,0) [0|409.5] "A" Vector__XXX
 SG_ VCFRONT_a346_vehicleState m346 : 52|2@1+ (1,0) [0|3] "" Vector__XXX
 SG_ VCFRONT_a347_maxSlope m347 : 16|12@1+ (0.1,0) [0|409.5] "A/ms" Vector__XXX
 SG_ VCFRONT_a347_avgCurrent m347 : 28|12@1+ (0.1,0) [0|409.5] "A" Vector__XXX
 SG_ VCFRONT_a347_maxCurrent m347 : 40|12@1+ (0.1,0) [0|409.5] "A" Vector__XXX
 SG_ VCFRONT_a347_vehicleState m347 : 52|2@1+ (1,0) [0|3] "" Vector__XXX
 SG_ VCFRONT_a348_maxSlope m348 : 16|12@1+ (0.1,0) [0|409.5] "A/ms" Vector__XXX
 SG_ VCFRONT_a348_avgCurrent m348 : 28|12@1+ (0.1,0) [0|409.5] "A" Vector__XXX
 SG_ VCFRONT_a348_maxCurrent m348 : 40|12@1+ (0.1,0) [0|409.5] "A" Vector__XXX
 SG_ VCFRONT_a348_vehicleState m348 : 52|2@1+ (1,0) [0|3] "" Vector__XXX
 SG_ VCFRONT_a349_maxSlope m349 : 16|12@1+ (0.1,0) [0|409.5] "A/ms" Vector__XXX
 SG_ VCFRONT_a349_avgCurrent m349 : 28|12@1+ (0.1,0) [0|409.5] "A" Vector__XXX
 SG_ VCFRONT_a349_maxCurrent m349 : 40|12@1+ (0.1,0) [0|409.5] "A" Vector__XXX
 SG_ VCFRONT_a349_vehicleState m349 : 52|2@1+ (1,0) [0|3] "" Vector__XXX
 SG_ VCFRONT_a350_espValveCurrent m350 : 16|10@1+ (0.1,0) [0|102.3] "A" Vector__XXX
 SG_ VCFRONT_a353_wiperHeaterCurrent m353 : 16|8@1+ (0.1,0) [0|25.5] "A" Vector__XXX
 SG_ VCFRONT_a353_batteryVoltage m353 : 24|7@1+ (0.15,0) [0|19.05] "V" Vector__XXX
 SG_ VCFRONT_a353_ambientTemperature m353 : 32|8@1+ (0.5,-40) [-39.5|87.5] "degC" Vector__XXX
 SG_ VCFRONT_a354_windshieldCameraHea m354 : 16|8@1+ (0.1,0) [0|25.5] "A" Vector__XXX
 SG_ VCFRONT_a354_batteryVoltage m354 : 24|7@1+ (0.15,0) [0|19.05] "V" Vector__XXX
 SG_ VCFRONT_a354_ambientTemperature m354 : 32|8@1+ (0.5,-40) [-39.5|87.5] "degC" Vector__XXX
 SG_ VCFRONT_a355_fluidNotFilled m355 : 16|1@1+ (1,0) [0|1] "" Vector__XXX
 SG_ VCFRONT_a355_systemNotCommission m355 : 17|1@1+ (1,0) [0|1] "" Vector__XXX
 SG_ VCFRONT_a355_serviceLockout m355 : 18|1@1+ (1,0) [0|1] "" Vector__XXX
 SG_ VCFRONT_a355_factoryGated m355 : 19|1@1+ (1,0) [0|1] "" Vector__XXX
 SG_ VCFRONT_a356_fluidNotFilled m356 : 16|1@1+ (1,0) [0|1] "" Vector__XXX
 SG_ VCFRONT_a356_systemNotCommission m356 : 17|1@1+ (1,0) [0|1] "" Vector__XXX
 SG_ VCFRONT_a356_serviceLockout m356 : 18|1@1+ (1,0) [0|1] "" Vector__XXX
 SG_ VCFRONT_a356_factoryGated m356 : 19|1@1+ (1,0) [0|1] "" Vector__XXX
 SG_ VCFRONT_a356_refCommissionStatus m356 : 20|1@1+ (1,0) [0|1] "" Vector__XXX
 SG_ VCFRONT_a357_maxTransientCurrent m357 : 16|10@1+ (0.02,0) [0|20.46] "A" Vector__XXX
 SG_ VCFRONT_a358_maxTransientCurrent m358 : 16|10@1+ (0.05,0) [0|51.15] "A" Vector__XXX
 SG_ VCFRONT_a359_IBSVolts m359 : 16|12@1+ (0.005443676,0) [0|22.29185322] "V" Vector__XXX
 SG_ VCFRONT_a359_IBSAh m359 : 28|12@1- (0.1,0) [-204.8|204.7] "Ah" Vector__XXX
 SG_ VCFRONT_a359_vehiclePowerState m359 : 40|2@1+ (1,0) [0|3] "" Vector__XXX
 SG_ VCFRONT_a359_batterySMState m359 : 42|4@1+ (1,0) [0|15] "" Vector__XXX
 SG_ VCFRONT_a359_hvState m359 : 48|3@1+ (1,0) [0|7] "" Vector__XXX
 SG_ VCFRONT_a359_coolantHasBeenFille m359 : 51|1@1+ (1,0) [0|1] "" Vector__XXX
 SG_ VCFRONT_a359_crashDetected m359 : 52|1@1+ (1,0) [0|1] "" Vector__XXX
 SG_ VCFRONT_a359_BMS_MIA m359 : 53|1@1+ (1,0) [0|1] "" Vector__XXX
 SG_ VCFRONT_a359_PCS_MIA m359 : 54|1@1+ (1,0) [0|1] "" Vector__XXX
 SG_ VCFRONT_a359_serviceMode m359 : 55|1@1+ (1,0) [0|1] "" Vector__XXX
 SG_ VCFRONT_a359_dcdcLVSupportStatus m359 : 56|2@1+ (1,0) [0|3] "" Vector__XXX
 SG_ VCFRONT_a359_bmsState m359 : 58|4@1+ (1,0) [0|15] "" Vector__XXX
 SG_ VCFRONT_a360_vehicleLoadShedActi m360 : 16|1@1+ (1,0) [0|1] "" Vector__XXX
 SG_ VCFRONT_a360_notEnoughPowerForSu m360 : 17|1@1+ (1,0) [0|1] "" Vector__XXX
 SG_ VCFRONT_a367_bmsSoc m367 : 16|8@1+ (0.5,0) [0|127.5] "%" Vector__XXX
 SG_ VCFRONT_a368_bmsRequestRemoved m368 : 16|1@1+ (1,0) [0|1] "" Vector__XXX
 SG_ VCFRONT_a368_enteringState m368 : 17|3@1+ (1,0) [0|7] "" Vector__XXX
 SG_ VCFRONT_a368_exitingState m368 : 20|3@1+ (1,0) [0|7] "" Vector__XXX
 SG_ VCFRONT_a368_bmsSoc m368 : 24|8@1+ (0.5,0) [0|127.5] "%" Vector__XXX
 SG_ VCFRONT_a368_systemFaulted m368 : 32|1@1+ (1,0) [0|1] "" Vector__XXX
 SG_ VCFRONT_a368_coolantTempSensorsF m368 : 33|1@1+ (1,0) [0|1] "" Vector__XXX
 SG_ VCFRONT_a368_coolantValveFaulted m368 : 34|1@1+ (1,0) [0|1] "" Vector__XXX
 SG_ VCFRONT_a368_louverFaulted m368 : 35|1@1+ (1,0) [0|1] "" Vector__XXX
 SG_ VCFRONT_a368_fansFaulted m368 : 36|1@1+ (1,0) [0|1] "" Vector__XXX
 SG_ VCFRONT_a368_coolantNotFilled m368 : 37|1@1+ (1,0) [0|1] "" Vector__XXX
 SG_ VCFRONT_a368_coolantPumpsFaulted m368 : 38|1@1+ (1,0) [0|1] "" Vector__XXX
 SG_ VCFRONT_a368_preconditionsNotMet m368 : 39|1@1+ (1,0) [0|1] "" Vector__XXX
 SG_ VCFRONT_a368_belowSocMin m368 : 40|1@1+ (1,0) [0|1] "" Vector__XXX
 SG_ VCFRONT_a369_powerGenerationLimi m369 : 16|1@1+ (1,0) [0|1] "" Vector__XXX
 SG_ VCFRONT_a369_heatRejectionLimite m369 : 17|1@1+ (1,0) [0|1] "" Vector__XXX
 SG_ VCFRONT_a369_bmsSoc m369 : 24|8@1+ (0.5,0) [0|127.5] "%" Vector__XXX
 SG_ VCFRONT_a369_wasteHeatPower m369 : 32|7@1+ (100,0) [0|12700] "W" Vector__XXX
 SG_ VCFRONT_a370_IBSVolts m370 : 16|12@1+ (0.005443676,0) [0|22.29185322] "V" Vector__XXX
 SG_ VCFRONT_a370_IBSAh m370 : 28|12@1- (0.1,0) [-204.8|204.7] "Ah" Vector__XXX
 SG_ VCFRONT_a370_notEnoughPowerForSu m370 : 40|1@1+ (1,0) [0|1] "" Vector__XXX
 SG_ VCFRONT_a370_serviceMode m370 : 41|1@1+ (1,0) [0|1] "" Vector__XXX
 SG_ VCFRONT_a370_sleepCurrent m370 : 42|10@1+ (0.1,0) [0|102.3] "A" Vector__XXX
 SG_ VCFRONT_a370_SOC m370 : 52|3@1+ (2.5,5) [5|20] "PCT" Vector__XXX
 SG_ VCFRONT_a371_shortedCellTestTrig m371 : 16|1@1+ (1,0) [0|1] "" Vector__XXX
 SG_ VCFRONT_a371_voltDropOnHighCurre m371 : 17|1@1+ (1,0) [0|1] "" Vector__XXX
 SG_ VCFRONT_a371_deadLVMinimalAhDisc m371 : 18|1@1+ (1,0) [0|1] "" Vector__XXX
 SG_ VCFRONT_a371_resistanceEstimatio m371 : 19|1@1+ (1,0) [0|1] "" Vector__XXX
 SG_ VCFRONT_a371_dcrMilliOhmsAboveTh m371 : 20|1@1+ (1,0) [0|1] "" Vector__XXX
 SG_ VCFRONT_a371_prechargeLVLoadRedu m371 : 21|1@1+ (1,0) [0|1] "" Vector__XXX
 SG_ VCFRONT_a371_instantPrechargeDCR m371 : 22|1@1+ (1,0) [0|1] "" Vector__XXX
 SG_ VCFRONT_a372_bmbDeviceId m372 : 16|4@1+ (1,1) [1|16] "" Vector__XXX
 SG_ VCFRONT_a372_bmbDeviceFaultBrick m372 : 24|16@1+ (1,0) [0|65535] "" Vector__XXX
 SG_ VCFRONT_a373_tempSuperheatActual m373 : 16|10@1+ (0.1,-20) [-20|82.2] "degC" Vector__XXX
 SG_ VCFRONT_a373_tempSuperheatTarget m373 : 26|10@1+ (0.1,0) [0|102.3] "degC" Vector__XXX
 SG_ VCFRONT_a373_compDemandChiller m373 : 40|7@1+ (1,0) [0|127] "%" Vector__XXX
 SG_ VCFRONT_a374_lccInletSolenoidISe m374 : 16|8@1- (0.01,0) [-1.28|1.27] "A" Vector__XXX
 SG_ VCFRONT_a377_wiperStuckOutOfPark m377 : 16|1@1+ (1,0) [0|1] "" Vector__XXX
 SG_ VCFRONT_a377_wiperStuckInPark m377 : 17|1@1+ (1,0) [0|1] "" Vector__XXX
 SG_ VCFRONT_a378_wiperBlocked m378 : 16|1@1+ (1,0) [0|1] "" Vector__XXX
 SG_ VCFRONT_a378_wiperOverload m378 : 17|2@1+ (1,0) [0|3] "" Vector__XXX
 SG_ VCFRONT_a378_wiperFault m378 : 19|1@1+ (1,0) [0|1] "" Vector__XXX
 SG_ VCFRONT_a378_wiperOvertemperatur m378 : 20|2@1+ (1,0) [0|3] "" Vector__XXX
 SG_ VCFRONT_a378_wiperUndervoltage m378 : 22|1@1+ (1,0) [0|1] "" Vector__XXX
 SG_ VCFRONT_a378_wiperOvervoltage m378 : 23|1@1+ (1,0) [0|1] "" Vector__XXX
 SG_ VCFRONT_a378_wiperLINError m378 : 24|1@1+ (1,0) [0|1] "" Vector__XXX
 SG_ VCFRONT_a387_shortedCellFaultCou m387 : 16|3@1+ (1,0) [0|7] "-" Vector__XXX
 SG_ VCFRONT_a387_minVoltageReached m387 : 19|12@1+ (0.005443676,0) [0|22.29185322] "V" Vector__XXX
 SG_ VCFRONT_a387_opportunisticTest m387 : 31|1@1+ (1,0) [0|1] "" Vector__XXX
 SG_ VCFRONT_a387_IBSTemp m387 : 32|16@1- (0.01,0) [-327.68|327.67] "degC" Vector__XXX
 SG_ VCFRONT_a387_maxCurrentReached m387 : 48|16@1- (0.005,0) [-163.84|163.835] "A" Vector__XXX
 SG_ VCFRONT_a388_shortedCellFaultCou m388 : 16|3@1+ (1,0) [0|7] "-" Vector__XXX
 SG_ VCFRONT_a388_minVoltageReached m388 : 19|12@1+ (0.005443676,0) [0|22.29185322] "V" Vector__XXX
 SG_ VCFRONT_a388_opportunisticTest m388 : 31|1@1+ (1,0) [0|1] "" Vector__XXX
 SG_ VCFRONT_a388_IBSTemp m388 : 32|16@1- (0.01,0) [-327.68|327.67] "degC" Vector__XXX
 SG_ VCFRONT_a388_maxCurrentReached m388 : 48|16@1- (0.005,0) [-163.84|163.835] "A" Vector__XXX
 SG_ VCFRONT_a389_closedAtSpeed m389 : 16|1@1+ (1,0) [0|1] "" Vector__XXX
 SG_ VCFRONT_a389_faultedWhileOpenAtS m389 : 17|1@1+ (1,0) [0|1] "" Vector__XXX
 SG_ VCFRONT_a389_possiblyStuckClosed m389 : 18|1@1+ (1,0) [0|1] "" Vector__XXX
 SG_ VCFRONT_a389_vehicleSpeed m389 : 19|12@1+ (0.08,-40) [-40|287.6] "kph" Vector__XXX
 SG_ VCFRONT_a389_temperature m389 : 32|8@1+ (0.5,-40) [-40|87.5] "degC" Vector__XXX
 SG_ VCFRONT_a389_latchStatus m389 : 40|4@1+ (1,0) [1|15] "" Vector__XXX
 SG_ VCFRONT_a391_switchMismatch m391 : 16|1@1+ (1,0) [0|1] "" Vector__XXX
 SG_ VCFRONT_a391_switch1Shorted m391 : 17|1@1+ (1,0) [0|1] "" Vector__XXX
 SG_ VCFRONT_a391_switch1Disconnected m391 : 18|1@1+ (1,0) [0|1] "" Vector__XXX
 SG_ VCFRONT_a391_switch2Shorted m391 : 19|1@1+ (1,0) [0|1] "" Vector__XXX
 SG_ VCFRONT_a391_switch2Disconnected m391 : 20|1@1+ (1,0) [0|1] "" Vector__XXX
 SG_ VCFRONT_a391_switch1Voltage m391 : 21|10@1+ (5,0) [0|5115] "mV" Vector__XXX
 SG_ VCFRONT_a391_switch2Voltage m391 : 32|10@1+ (5,0) [0|5115] "mV" Vector__XXX
 SG_ VCFRONT_a392_bmbDeviceId m392 : 16|4@1+ (1,1) [1|16] "" Vector__XXX
 SG_ VCFRONT_a392_bmbDeviceFaultBrick m392 : 24|16@1+ (1,0) [0|65535] "" Vector__XXX
 SG_ VCFRONT_a397_discharge m397 : 16|1@1+ (1,0) [0|1] "" Vector__XXX
 SG_ VCFRONT_a397_suction m397 : 17|1@1+ (1,0) [0|1] "" Vector__XXX
 SG_ VCFRONT_a397_liquid m397 : 18|1@1+ (1,0) [0|1] "" Vector__XXX
 SG_ VCFRONT_a397_offsetError m397 : 19|10@1- (0.2,0) [-102.4|102.2] "C" Vector__XXX
 SG_ VCFRONT_a397_runTimeOffSetDetect m397 : 29|1@1+ (1,0) [0|1] "" Vector__XXX
 SG_ VCFRONT_a401_LVBatteryTemp m401 : 16|7@1+ (1,-40) [-40|86] "degC" Vector__XXX
 SG_ VCFRONT_a401_IBSCurrent m401 : 24|12@1- (0.1,0) [-204.8|204.7] "A" Vector__XXX
 SG_ VCFRONT_a401_IBSVoltage m401 : 36|11@1+ (0.0108873518184,0) [0|22.2864091723] "V" Vector__XXX
 SG_ VCFRONT_a401_IBSAmpHours m401 : 48|8@1+ (0.01,-2.55) [-2.55|4.4408920985e-16] "Ah" Vector__XXX
 SG_ VCFRONT_a402_LVBatteryTemp m402 : 16|7@1+ (1,-40) [-40|86] "degC" Vector__XXX
 SG_ VCFRONT_a402_batterySMState m402 : 24|4@1+ (1,0) [0|15] "" Vector__XXX
 SG_ VCFRONT_a402_failureToPrechargeR m402 : 28|1@1+ (1,0) [0|1] "" Vector__XXX
 SG_ VCFRONT_a402_electricalDisconnec m402 : 29|1@1+ (1,0) [0|1] "" Vector__XXX
 SG_ VCFRONT_a402_communicationDiscon m402 : 30|1@1+ (1,0) [0|1] "" Vector__XXX
 SG_ VCFRONT_a402_reverseBatteryFault m402 : 31|1@1+ (1,0) [0|1] "" Vector__XXX
 SG_ VCFRONT_a402_MOSOpen m402 : 32|1@1+ (1,0) [0|1] "" Vector__XXX
 SG_ VCFRONT_a402_serviceMode m402 : 33|1@1+ (1,0) [0|1] "" Vector__XXX
 SG_ VCFRONT_a402_frunkOpen m402 : 34|1@1+ (1,0) [0|1] "" Vector__XXX
 SG_ VCFRONT_a404_minVoltageReached m404 : 16|12@1+ (0.005443676,0) [0|22.29185322] "V" Vector__XXX
 SG_ VCFRONT_a404_IBSTemp m404 : 32|16@1- (0.01,0) [-327.68|327.67] "degC" Vector__XXX
 SG_ VCFRONT_a404_maxCurrentReached m404 : 48|16@1- (0.005,0) [-163.84|163.835] "A" Vector__XXX
 SG_ VCFRONT_a407_dcrMilliOhms m407 : 16|8@1+ (0.2,0) [0|51] "mOhms" Vector__XXX
 SG_ VCFRONT_a407_dcr12VThreshold m407 : 24|4@1+ (1,0) [0|15] "" Vector__XXX
 SG_ VCFRONT_a407_avgIntervalCurrent m407 : 28|5@1+ (1,-31) [-31|0] "A" Vector__XXX
 SG_ VCFRONT_a407_intervalCurrentVari m407 : 33|6@1+ (0.1,0) [0|6.3] "A" Vector__XXX
 SG_ VCFRONT_a407_avgPulseCurrent m407 : 39|7@1+ (1,-127) [-127|0] "A" Vector__XXX
 SG_ VCFRONT_a407_pulseCurrentVarianc m407 : 46|6@1+ (0.25,0) [0|15.75] "A" Vector__XXX
 SG_ VCFRONT_a407_IBSTemperature m407 : 52|8@1+ (0.5,-30) [-30|97.5] "degC" Vector__XXX
 SG_ VCFRONT_a407_testCounter m407 : 60|2@1+ (1,0) [0|3] "-" Vector__XXX
 SG_ VCFRONT_a407_testingExpended m407 : 62|1@1+ (1,0) [0|1] "" Vector__XXX
 SG_ VCFRONT_a407_opportunisticTest m407 : 63|1@1+ (1,0) [0|1] "" Vector__XXX
 SG_ VCFRONT_a409_brushlessMotorConfi m409 : 16|1@1+ (1,0) [0|1] "" Vector__XXX
 SG_ VCFRONT_a414_dcrMilliOhms m414 : 16|6@1+ (1,0) [0|63] "mOhms" Vector__XXX
 SG_ VCFRONT_a414_LVBatteryTemp m414 : 24|7@1+ (1,-40) [-40|86] "degC" Vector__XXX
 SG_ VCFRONT_a414_IBSCurrent m414 : 31|12@1- (0.1,0) [-204.8|204.7] "A" Vector__XXX
 SG_ VCFRONT_a414_IBSVoltage m414 : 43|11@1+ (0.0108873518184,0) [0|22.2864091723] "V" Vector__XXX
 SG_ VCFRONT_a414_IBSAmpHours m414 : 54|8@1+ (0.01,-2.55) [-2.55|4.4408920985e-16] "Ah" Vector__XXX
 SG_ VCFRONT_a414_vehiclePowerState m414 : 62|2@1+ (1,0) [0|3] "" Vector__XXX
 SG_ VCFRONT_a415_dcrMilliOhms m415 : 16|6@1+ (1,0) [0|63] "mOhms" Vector__XXX
 SG_ VCFRONT_a415_LVBatteryTemp m415 : 22|7@1+ (1,-40) [-40|86] "degC" Vector__XXX
 SG_ VCFRONT_a415_IBSCurrent m415 : 29|9@1- (0.5,0) [-128|127.5] "A" Vector__XXX
 SG_ VCFRONT_a415_IBSVoltage m415 : 38|9@1+ (0.04,0) [0|20.44] "V" Vector__XXX
 SG_ VCFRONT_a415_IBSAmpHours m415 : 47|7@1+ (0.02,-2.55) [-2.55|-0.01] "Ah" Vector__XXX
 SG_ VCFRONT_a415_vehiclePowerState m415 : 54|2@1+ (1,0) [0|3] "" Vector__XXX
 SG_ VCFRONT_a415_HV_UP m415 : 56|1@1+ (1,0) [0|1] "" Vector__XXX
 SG_ VCFRONT_a415_hvUpFirstTrigger m415 : 57|1@1+ (1,0) [0|1] "" Vector__XXX
 SG_ VCFRONT_a415_hvUpAnyTrigger m415 : 58|1@1+ (1,0) [0|1] "" Vector__XXX
 SG_ VCFRONT_a415_pcsEFuseUnstable m415 : 59|1@1+ (1,0) [0|1] "" Vector__XXX
 SG_ VCFRONT_a415_vcrightEfuseUnstabl m415 : 60|1@1+ (1,0) [0|1] "" Vector__XXX
 SG_ VCFRONT_a415_vcleftEfuseUnstable m415 : 61|1@1+ (1,0) [0|1] "" Vector__XXX
 SG_ VCFRONT_a415_contactorEFuseUnsta m415 : 62|1@1+ (1,0) [0|1] "" Vector__XXX
 SG_ VCFRONT_a415_hvcEFuseUnstable m415 : 63|1@1+ (1,0) [0|1] "" Vector__XXX
 SG_ VCFRONT_a416_brickVoltageMin m416 : 16|10@1+ (0.005,0) [0|5.115] "V" Vector__XXX
 SG_ VCFRONT_a416_brickVoltageMax m416 : 26|10@1+ (0.005,0) [0|5.115] "V" Vector__XXX
 SG_ VCFRONT_a416_packCurrent m416 : 36|10@1- (5,0) [-2560|2555] "A" Vector__XXX
 SG_ VCFRONT_a416_socMin m416 : 46|8@1+ (0.5,0) [0|127.5] "%" Vector__XXX
 SG_ VCFRONT_a416_brickId m416 : 54|8@1+ (1,1) [1|256] "" Vector__XXX
 SG_ VCFRONT_a417_brickVoltageMin m417 : 16|10@1+ (0.005,0) [0|5.115] "V" Vector__XXX
 SG_ VCFRONT_a417_brickVoltageMax m417 : 26|10@1+ (0.005,0) [0|5.115] "V" Vector__XXX
 SG_ VCFRONT_a417_packCurrent m417 : 36|10@1- (5,0) [-2560|2555] "A" Vector__XXX
 SG_ VCFRONT_a417_socMax m417 : 46|8@1+ (0.5,0) [0|127.5] "%" Vector__XXX
 SG_ VCFRONT_a417_brickId m417 : 54|8@1+ (1,1) [1|256] "" Vector__XXX
 SG_ VCFRONT_a418_brickVoltageMin m418 : 16|10@1+ (0.005,0) [0|5.115] "V" Vector__XXX
 SG_ VCFRONT_a418_brickVoltageMax m418 : 26|10@1+ (0.005,0) [0|5.115] "V" Vector__XXX
 SG_ VCFRONT_a418_packCurrent m418 : 36|10@1- (5,0) [-2560|2555] "A" Vector__XXX
 SG_ VCFRONT_a418_socMax m418 : 46|8@1+ (0.5,0) [0|127.5] "%" Vector__XXX
 SG_ VCFRONT_a418_brickId m418 : 54|8@1+ (1,1) [1|256] "" Vector__XXX
 SG_ VCFRONT_a419_brickVoltageMin m419 : 16|10@1+ (0.005,0) [0|5.115] "V" Vector__XXX
 SG_ VCFRONT_a419_brickVoltageMax m419 : 26|10@1+ (0.005,0) [0|5.115] "V" Vector__XXX
 SG_ VCFRONT_a419_packCurrent m419 : 36|10@1- (5,0) [-2560|2555] "A" Vector__XXX
 SG_ VCFRONT_a419_socMin m419 : 46|8@1+ (0.5,0) [0|127.5] "%" Vector__XXX
 SG_ VCFRONT_a419_brickId m419 : 54|8@1+ (1,1) [1|256] "" Vector__XXX
 SG_ VCFRONT_a423_brickVoltageMin m423 : 16|10@1+ (0.005,0) [0|5.115] "V" Vector__XXX
 SG_ VCFRONT_a423_brickVoltageMax m423 : 26|10@1+ (0.005,0) [0|5.115] "V" Vector__XXX
 SG_ VCFRONT_a423_packCurrent m423 : 36|10@1- (5,0) [-2560|2555] "A" Vector__XXX
 SG_ VCFRONT_a423_socMin m423 : 46|8@1+ (0.5,0) [0|127.5] "%" Vector__XXX
 SG_ VCFRONT_a423_brickId m423 : 54|8@1+ (1,1) [1|256] "" Vector__XXX
 SG_ VCFRONT_a424_brickVoltageMin m424 : 16|10@1+ (0.005,0) [0|5.115] "V" Vector__XXX
 SG_ VCFRONT_a424_brickVoltageMax m424 : 26|10@1+ (0.005,0) [0|5.115] "V" Vector__XXX
 SG_ VCFRONT_a424_packCurrent m424 : 36|10@1- (5,0) [-2560|2555] "A" Vector__XXX
 SG_ VCFRONT_a424_socMin m424 : 46|8@1+ (0.5,0) [0|127.5] "%" Vector__XXX
 SG_ VCFRONT_a424_brickId m424 : 54|8@1+ (1,1) [1|256] "" Vector__XXX
 SG_ VCFRONT_a431_netPackCurrent m431 : 16|16@1- (0.1,0) [-3276.8|3276.7] "A" Vector__XXX
 SG_ VCFRONT_a431_maxChargeCurrentLim m431 : 32|16@1- (0.1,0) [-3276.8|3276.7] "A" Vector__XXX
 SG_ VCFRONT_a431_hvjbCurrentLimit m431 : 48|16@1- (0.1,0) [-3276.8|3276.7] "A" Vector__XXX
 SG_ VCFRONT_a432_targetCurrent m432 : 16|16@1- (0.1,0) [-3276.8|3276.7] "A" Vector__XXX
 SG_ VCFRONT_a432_packCurrent m432 : 32|16@1- (0.1,0) [-3276.8|3276.7] "A" Vector__XXX
 SG_ VCFRONT_a433_bmbModuleId m433 : 16|16@1+ (1,0) [0|65535] "" Vector__XXX
 SG_ VCFRONT_a433_packTypeData m433 : 32|8@1+ (1,0) [0|255] "" Vector__XXX
 SG_ VCFRONT_a433_cellTypeData m433 : 40|8@1+ (1,0) [0|255] "" Vector__XXX
 SG_ VCFRONT_a433_bmbModuleIdValid m433 : 48|1@1+ (1,0) [0|1] "" Vector__XXX
 SG_ VCFRONT_a433_useBmbModuleId m433 : 49|1@1+ (1,0) [0|1] "" Vector__XXX
 SG_ VCFRONT_a434_bmbModuleId m434 : 16|16@1+ (1,0) [0|65535] "" Vector__XXX
 SG_ VCFRONT_a434_packTypeData m434 : 32|8@1+ (1,0) [0|255] "" Vector__XXX
 SG_ VCFRONT_a434_cellTypeData m434 : 40|8@1+ (1,0) [0|255] "" Vector__XXX
 SG_ VCFRONT_a434_bmbModuleIdValid m434 : 48|1@1+ (1,0) [0|1] "" Vector__XXX
 SG_ VCFRONT_a434_useBmbModuleId m434 : 49|1@1+ (1,0) [0|1] "" Vector__XXX
 SG_ VCFRONT_a436_netPackCurrent m436 : 16|16@1- (0.1,0) [-3276.8|3276.7] "A" Vector__XXX
 SG_ VCFRONT_a436_maxDischargeCurrent m436 : 32|16@1- (0.1,0) [-3276.8|3276.7] "A" Vector__XXX
 SG_ VCFRONT_a436_hvjbCurrentLimit m436 : 48|16@1- (0.1,0) [-3276.8|3276.7] "A" Vector__XXX
 SG_ VCFRONT_a437_nvmDataMissingA m437 : 16|1@1+ (1,0) [0|1] "" Vector__XXX
 SG_ VCFRONT_a437_nvmDataMissingB m437 : 17|1@1+ (1,0) [0|1] "" Vector__XXX
 SG_ VCFRONT_a438_temperature m438 : 16|16@1+ (0.01,0) [0|655.35] "C" Vector__XXX
 SG_ VCFRONT_a438_sensorId m438 : 32|6@1+ (1,1) [1|64] "" Vector__XXX
 SG_ VCFRONT_a439_temperature m439 : 16|16@1+ (0.01,0) [0|655.35] "C" Vector__XXX
 SG_ VCFRONT_a439_sensorId m439 : 32|6@1+ (1,1) [1|64] "" Vector__XXX
 SG_ VCFRONT_a441_bmbModuleId m441 : 16|16@1+ (1,0) [0|65535] "" Vector__XXX
 SG_ VCFRONT_a441_bmbModuleIdPrev m441 : 32|16@1+ (1,0) [0|65535] "" Vector__XXX
 SG_ VCFRONT_a444_retriesAvailable m444 : 16|8@1+ (1,0) [0|255] "" Vector__XXX
 SG_ VCFRONT_a444_channel m444 : 24|8@1+ (1,0) [0|255] "" Vector__XXX
 SG_ VCFRONT_a444_watchdog m444 : 32|1@1+ (1,0) [0|1] "" Vector__XXX
 SG_ VCFRONT_a444_gateDriver m444 : 33|1@1+ (1,0) [0|1] "" Vector__XXX
 SG_ VCFRONT_a444_overcurrent m444 : 34|1@1+ (1,0) [0|1] "" Vector__XXX
 SG_ VCFRONT_a444_supplyUndervoltage m444 : 35|1@1+ (1,0) [0|1] "" Vector__XXX
 SG_ VCFRONT_a444_cpUndervoltage m444 : 36|1@1+ (1,0) [0|1] "" Vector__XXX
 SG_ VCFRONT_a444_overTempShutdown m444 : 37|1@1+ (1,0) [0|1] "" Vector__XXX
 SG_ VCFRONT_a444_overTempWarning m444 : 38|1@1+ (1,0) [0|1] "" Vector__XXX
 SG_ VCFRONT_a444_highSide2GateDriver m444 : 39|1@1+ (1,0) [0|1] "" Vector__XXX
 SG_ VCFRONT_a444_lowSide2GateDriver m444 : 40|1@1+ (1,0) [0|1] "" Vector__XXX
 SG_ VCFRONT_a444_highSide1GateDriver m444 : 41|1@1+ (1,0) [0|1] "" Vector__XXX
 SG_ VCFRONT_a444_lowSide1GateDriver m444 : 42|1@1+ (1,0) [0|1] "" Vector__XXX
 SG_ VCFRONT_a444_highSide2OverCurent m444 : 43|1@1+ (1,0) [0|1] "" Vector__XXX
 SG_ VCFRONT_a444_lowSide2OverCurent m444 : 44|1@1+ (1,0) [0|1] "" Vector__XXX
 SG_ VCFRONT_a444_highSide1OverCurent m444 : 45|1@1+ (1,0) [0|1] "" Vector__XXX
 SG_ VCFRONT_a444_lowSide1OverCurent m444 : 46|1@1+ (1,0) [0|1] "" Vector__XXX
 SG_ VCFRONT_a444_spiInit m444 : 47|1@1+ (1,0) [0|1] "" Vector__XXX
 SG_ VCFRONT_a444_spiPeriodicCheck m444 : 48|1@1+ (1,0) [0|1] "" Vector__XXX
 SG_ VCFRONT_a444_spiFault m444 : 49|1@1+ (1,0) [0|1] "" Vector__XXX
 SG_ VCFRONT_a444_voltageMonitor m444 : 50|1@1+ (1,0) [0|1] "" Vector__XXX
 SG_ VCFRONT_a444_enableLow m444 : 51|1@1+ (1,0) [0|1] "" Vector__XXX
 SG_ VCFRONT_a446_compFaultRefrigeran m446 : 16|1@1+ (1,0) [0|1] "" Vector__XXX
 SG_ VCFRONT_a446_compFaultTdHigh m446 : 17|1@1+ (1,0) [0|1] "" Vector__XXX
 SG_ VCFRONT_a446_compFaultPdLow m446 : 18|1@1+ (1,0) [0|1] "" Vector__XXX
 SG_ VCFRONT_a446_compFaultPdHigh m446 : 19|1@1+ (1,0) [0|1] "" Vector__XXX
 SG_ VCFRONT_a446_compFaultPsLow m446 : 20|1@1+ (1,0) [0|1] "" Vector__XXX
 SG_ VCFRONT_a446_compStandbyLowAmbie m446 : 21|1@1+ (1,0) [0|1] "" Vector__XXX
 SG_ VCFRONT_a446_compStandbyLowDisch m446 : 22|1@1+ (1,0) [0|1] "" Vector__XXX
 SG_ VCFRONT_a446_compStandbyHVNotRea m446 : 23|1@1+ (1,0) [0|1] "" Vector__XXX
 SG_ VCFRONT_a446_compStandbyCommunic m446 : 24|1@1+ (1,0) [0|1] "" Vector__XXX
 SG_ VCFRONT_a446_compStandbySelfNotR m446 : 25|1@1+ (1,0) [0|1] "" Vector__XXX
 SG_ VCFRONT_a446_compStandbyRefrigNo m446 : 26|1@1+ (1,0) [0|1] "" Vector__XXX
 SG_ VCFRONT_a446_compStandbyCoastDow m446 : 27|1@1+ (1,0) [0|1] "" Vector__XXX
 SG_ VCFRONT_a446_compStandbyMultiple m446 : 28|1@1+ (1,0) [0|1] "" Vector__XXX
 SG_ VCFRONT_a446_compStandbyShowroom m446 : 29|1@1+ (1,0) [0|1] "" Vector__XXX
 SG_ VCFRONT_a446_compStandbyMul_0001 m446 : 30|1@1+ (1,0) [0|1] "" Vector__XXX
 SG_ VCFRONT_a446_hpCabinLoadType m446 : 31|2@1+ (1,0) [0|3] "" Vector__XXX
 SG_ VCFRONT_a446_hpBatteryLoadType m446 : 33|2@1+ (1,0) [0|3] "" Vector__XXX
 SG_ VCFRONT_a446_usingModeledPs m446 : 35|1@1+ (1,0) [0|1] "" Vector__XXX
 SG_ VCFRONT_a446_usingModeledPd m446 : 36|1@1+ (1,0) [0|1] "" Vector__XXX
 SG_ VCFRONT_a446_usingModeledPl m446 : 37|1@1+ (1,0) [0|1] "" Vector__XXX
 SG_ VCFRONT_a446_usingModeledTs m446 : 38|1@1+ (1,0) [0|1] "" Vector__XXX
 SG_ VCFRONT_a446_usingModeledTd m446 : 39|1@1+ (1,0) [0|1] "" Vector__XXX
 SG_ VCFRONT_a446_usingModeledTl m446 : 40|1@1+ (1,0) [0|1] "" Vector__XXX
 SG_ VCFRONT_a446_sensorHasOffsetTd m446 : 41|1@1+ (1,0) [0|1] "" Vector__XXX
 SG_ VCFRONT_a446_sensorHasOffsetPd m446 : 42|1@1+ (1,0) [0|1] "" Vector__XXX
 SG_ VCFRONT_a446_sensorDroopPd m446 : 43|1@1+ (1,0) [0|1] "" Vector__XXX
 SG_ VCFRONT_a446_sensorHasOffsetTl m446 : 44|1@1+ (1,0) [0|1] "" Vector__XXX
 SG_ VCFRONT_a446_sensorIntermit_0002 m446 : 45|1@1+ (1,0) [0|1] "" Vector__XXX
 SG_ VCFRONT_a446_sensorIntermittentP m446 : 46|1@1+ (1,0) [0|1] "" Vector__XXX
 SG_ VCFRONT_a446_sensorIntermit_0001 m446 : 47|1@1+ (1,0) [0|1] "" Vector__XXX
 SG_ VCFRONT_a446_sensorIntermit_0004 m446 : 48|1@1+ (1,0) [0|1] "" Vector__XXX
 SG_ VCFRONT_a446_sensorIntermittentT m446 : 49|1@1+ (1,0) [0|1] "" Vector__XXX
 SG_ VCFRONT_a446_sensorIntermit_0003 m446 : 50|1@1+ (1,0) [0|1] "" Vector__XXX
 SG_ VCFRONT_a446_highSuctionSuperhea m446 : 51|1@1+ (1,0) [0|1] "" Vector__XXX
 SG_ VCFRONT_a446_evapLowPsCutout m446 : 52|1@1+ (1,0) [0|1] "" Vector__XXX
 SG_ VCFRONT_a446_batteryOverTemp m446 : 53|1@1+ (1,0) [0|1] "" Vector__XXX
 SG_ VCFRONT_a446_hvacSystemFault m446 : 54|1@1+ (1,0) [0|1] "" Vector__XXX
 SG_ VCFRONT_a446_coolantSysLockedOut m446 : 55|1@1+ (1,0) [0|1] "" Vector__XXX
 SG_ VCFRONT_a446_refSysLockedOut m446 : 56|1@1+ (1,0) [0|1] "" Vector__XXX
 SG_ VCFRONT_a446_chillerEXVNotReady m446 : 57|1@1+ (1,0) [0|1] "" Vector__XXX
 SG_ VCFRONT_a446_CCLEXVNotReady m446 : 58|1@1+ (1,0) [0|1] "" Vector__XXX
 SG_ VCFRONT_a446_CCREXVNotReady m446 : 59|1@1+ (1,0) [0|1] "" Vector__XXX
 SG_ VCFRONT_a446_LCCEXVNotReady m446 : 60|1@1+ (1,0) [0|1] "" Vector__XXX
 SG_ VCFRONT_a446_evapEXVNotReady m446 : 61|1@1+ (1,0) [0|1] "" Vector__XXX
 SG_ VCFRONT_a446_recircEXVNotReady m446 : 62|1@1+ (1,0) [0|1] "" Vector__XXX
 SG_ VCFRONT_a446_checkA447Alert m446 : 63|1@1+ (1,0) [0|1] "" Vector__XXX
 SG_ VCFRONT_a447_caseHVACUnavailable m447 : 16|1@1+ (1,0) [0|1] "" Vector__XXX
 SG_ VCFRONT_a447_heatPumpHVACUnavail m447 : 17|1@1+ (1,0) [0|1] "" Vector__XXX
 SG_ VCFRONT_a447_activeLouverComprom m447 : 18|1@1+ (1,0) [0|1] "" Vector__XXX
 SG_ VCFRONT_a447_coolantValveComprom m447 : 19|1@1+ (1,0) [0|1] "" Vector__XXX
 SG_ VCFRONT_a447_ambientSourcingComp m447 : 20|1@1+ (1,0) [0|1] "" Vector__XXX
 SG_ VCFRONT_a447_scavengeLoopComprom m447 : 21|1@1+ (1,0) [0|1] "" Vector__XXX
 SG_ VCFRONT_a447_coolantSystemCompro m447 : 22|1@1+ (1,0) [0|1] "" Vector__XXX
 SG_ VCFRONT_a447_hvBattActiveDischgC m447 : 23|1@1+ (1,0) [0|1] "" Vector__XXX
 SG_ VCFRONT_a447_hvBatteryDischargin m447 : 24|1@1+ (1,0) [0|1] "" Vector__XXX
 SG_ VCFRONT_a447_lccSolenoidCompromi m447 : 25|1@1+ (1,0) [0|1] "" Vector__XXX
 SG_ VCFRONT_a447_refrigerantSystemCo m447 : 26|1@1+ (1,0) [0|1] "" Vector__XXX
 SG_ VCFRONT_a447_powertrainThermalFa m447 : 27|1@1+ (1,0) [0|1] "" Vector__XXX
 SG_ VCFRONT_a447_refrigDischargePres m447 : 28|1@1+ (1,0) [0|1] "" Vector__XXX
 SG_ VCFRONT_a447_refrigeDischargeTem m447 : 29|1@1+ (1,0) [0|1] "" Vector__XXX
 SG_ VCFRONT_a447_refrigSuctionPressC m447 : 30|1@1+ (1,0) [0|1] "" Vector__XXX
 SG_ VCFRONT_a447_refrigSuctionTempCo m447 : 31|1@1+ (1,0) [0|1] "" Vector__XXX
 SG_ VCFRONT_a447_refrigLiquidPressCo m447 : 32|1@1+ (1,0) [0|1] "" Vector__XXX
 SG_ VCFRONT_a447_refrigLiquidTempCom m447 : 33|1@1+ (1,0) [0|1] "" Vector__XXX
 SG_ VCFRONT_a459_coolantFillActive m459 : 16|1@1+ (1,0) [0|1] "" Vector__XXX
 SG_ VCFRONT_a459_refrigerantFillActi m459 : 17|1@1+ (1,0) [0|1] "" Vector__XXX
 SG_ VCFRONT_a462_CellOVLevel1 m462 : 16|1@1+ (1,0) [0|1] "" Vector__XXX
 SG_ VCFRONT_a462_CellOVLevel2 m462 : 17|1@1+ (1,0) [0|1] "" Vector__XXX
 SG_ VCFRONT_a462_CellOVLevel3 m462 : 18|1@1+ (1,0) [0|1] "" Vector__XXX
 SG_ VCFRONT_a462_CellUVLevel1 m462 : 19|1@1+ (1,0) [0|1] "" Vector__XXX
 SG_ VCFRONT_a462_CellUVLevel2 m462 : 20|1@1+ (1,0) [0|1] "" Vector__XXX
 SG_ VCFRONT_a462_ModuleOTLevel1 m462 : 21|1@1+ (1,0) [0|1] "" Vector__XXX
 SG_ VCFRONT_a462_PackOVLevel1 m462 : 22|1@1+ (1,0) [0|1] "" Vector__XXX
 SG_ VCFRONT_a462_PackOVLevel2 m462 : 23|1@1+ (1,0) [0|1] "" Vector__XXX
 SG_ VCFRONT_a462_DischrgOCLevel1 m462 : 24|1@1+ (1,0) [0|1] "" Vector__XXX
 SG_ VCFRONT_a462_HardwareOCLevel2 m462 : 25|1@1+ (1,0) [0|1] "" Vector__XXX
 SG_ VCFRONT_a462_ChrgOCLevel1 m462 : 26|1@1+ (1,0) [0|1] "" Vector__XXX
 SG_ VCFRONT_a462_ChrgOCLevel2 m462 : 27|1@1+ (1,0) [0|1] "" Vector__XXX
 SG_ VCFRONT_a462_MOSFETOTLevel1 m462 : 28|1@1+ (1,0) [0|1] "" Vector__XXX
 SG_ VCFRONT_a462_CPA_State m462 : 29|1@1+ (1,0) [0|1] "" Vector__XXX
 SG_ VCFRONT_a462_NTCTempDiffWarnLeve m462 : 30|1@1+ (1,0) [0|1] "" Vector__XXX
 SG_ VCFRONT_a462_KBValueLostFault m462 : 31|1@1+ (1,0) [0|1] "" Vector__XXX
 SG_ VCFRONT_a462_BalanceCircuitFault m462 : 32|1@1+ (1,0) [0|1] "" Vector__XXX
 SG_ VCFRONT_a462_MOSOpenFault m462 : 33|1@1+ (1,0) [0|1] "" Vector__XXX
 SG_ VCFRONT_a462_DeepDischarge m462 : 34|1@1+ (1,0) [0|1] "" Vector__XXX
 SG_ VCFRONT_a462_SamplingError m462 : 35|1@1+ (1,0) [0|1] "" Vector__XXX
 SG_ VCFRONT_a462_MOSFETStuckClose m462 : 36|1@1+ (1,0) [0|1] "" Vector__XXX
 SG_ VCFRONT_a462_MOSFETStuckOpen m462 : 37|1@1+ (1,0) [0|1] "" Vector__XXX
 SG_ VCFRONT_a462_Imbalance m462 : 38|1@1+ (1,0) [0|1] "" Vector__XXX
 SG_ VCFRONT_a462_serviceMode m462 : 39|1@1+ (1,0) [0|1] "" Vector__XXX
 SG_ VCFRONT_a462_frunkOpen m462 : 40|1@1+ (1,0) [0|1] "" Vector__XXX
 SG_ VCFRONT_a463_switchMismatch m463 : 16|1@1+ (1,0) [0|1] "" Vector__XXX
 SG_ VCFRONT_a463_switch1Shorted m463 : 17|1@1+ (1,0) [0|1] "" Vector__XXX
 SG_ VCFRONT_a463_switch1Disconnected m463 : 18|1@1+ (1,0) [0|1] "" Vector__XXX
 SG_ VCFRONT_a463_switch2Shorted m463 : 19|1@1+ (1,0) [0|1] "" Vector__XXX
 SG_ VCFRONT_a463_switch2Disconnected m463 : 20|1@1+ (1,0) [0|1] "" Vector__XXX
 SG_ VCFRONT_a463_switch1Voltage m463 : 21|10@1+ (5,0) [0|5115] "mV" Vector__XXX
 SG_ VCFRONT_a463_switch2Voltage m463 : 32|10@1+ (5,0) [0|5115] "mV" Vector__XXX
 SG_ VCFRONT_a464_flowIndex m464 : 16|8@1+ (1,0) [0|255] "-" Vector__XXX
 SG_ VCFRONT_a464_flowIndexFiltered m464 : 24|8@1+ (1,0) [0|255] "-" Vector__XXX
 SG_ VCFRONT_a464_subcool m464 : 32|7@1+ (0.4,-10) [-10|40.8] "degC" Vector__XXX
 SG_ VCFRONT_a464_subcoolFiltered m464 : 40|7@1+ (0.4,-10) [-10|40.8] "degC" Vector__XXX
 SG_ VCFRONT_a465_flowIndex m465 : 16|8@1+ (1,0) [0|255] "-" Vector__XXX
 SG_ VCFRONT_a465_flowIndexFiltered m465 : 24|8@1+ (1,0) [0|255] "-" Vector__XXX
 SG_ VCFRONT_a465_subcool m465 : 32|7@1+ (0.4,-10) [-10|40.8] "degC" Vector__XXX
 SG_ VCFRONT_a465_subcoolFiltered m465 : 40|7@1+ (0.4,-10) [-10|40.8] "degC" Vector__XXX
 SG_ VCFRONT_a465_flaggedAtSteadyStat m465 : 47|1@1+ (1,0) [0|1] "" Vector__XXX
 SG_ VCFRONT_a465_flaggedAtUnsteadySt m465 : 48|1@1+ (1,0) [0|1] "" Vector__XXX
 SG_ VCFRONT_a466_flowIndex m466 : 16|8@1+ (1,0) [0|255] "-" Vector__XXX
 SG_ VCFRONT_a466_flowIndexFiltered m466 : 24|8@1+ (1,0) [0|255] "-" Vector__XXX
 SG_ VCFRONT_a466_subcool m466 : 32|7@1+ (0.4,-10) [-10|40.8] "degC" Vector__XXX
 SG_ VCFRONT_a466_subcoolFiltered m466 : 40|7@1+ (0.4,-10) [-10|40.8] "degC" Vector__XXX
 SG_ VCFRONT_a467_powerIndexFiltered m467 : 16|7@1+ (1,0) [0|127] "-" Vector__XXX
 SG_ VCFRONT_a470_pressureLiquid m470 : 16|8@1+ (0.2,0) [0|51] "bar" Vector__XXX
 SG_ VCFRONT_a470_pressureDischarge m470 : 24|8@1+ (0.2,0) [0|51] "bar" Vector__XXX
 SG_ VCFRONT_a474_ssl100Bank1Status m474 : 16|2@1+ (1,0) [0|3] "" Vector__XXX
 SG_ VCFRONT_a474_ssl100Bank2Status m474 : 18|2@1+ (1,0) [0|3] "" Vector__XXX
 SG_ VCFRONT_a474_ssl100Bank3Status m474 : 20|2@1+ (1,0) [0|3] "" Vector__XXX
 SG_ VCFRONT_a474_ssl100Bank4Status m474 : 22|2@1+ (1,0) [0|3] "" Vector__XXX
 SG_ VCFRONT_a474_ssl100Bank5Status m474 : 24|2@1+ (1,0) [0|3] "" Vector__XXX
 SG_ VCFRONT_a474_ssl100Bank6Status m474 : 26|2@1+ (1,0) [0|3] "" Vector__XXX
 SG_ VCFRONT_a474_ssl100Bank7Status m474 : 28|2@1+ (1,0) [0|3] "" Vector__XXX
 SG_ VCFRONT_a474_ssl100Bank8Status m474 : 30|2@1+ (1,0) [0|3] "" Vector__XXX
 SG_ VCFRONT_a474_ssl100Bank9Status m474 : 32|2@1+ (1,0) [0|3] "" Vector__XXX
 SG_ VCFRONT_a474_lowBeamPrefieldStat m474 : 34|3@1+ (1,0) [0|7] "" Vector__XXX
 SG_ VCFRONT_a474_drl1Status m474 : 37|3@1+ (1,0) [0|7] "" Vector__XXX
 SG_ VCFRONT_a474_drl2Status m474 : 40|3@1+ (1,0) [0|7] "" Vector__XXX
 SG_ VCFRONT_a474_drl3Status m474 : 43|3@1+ (1,0) [0|7] "" Vector__XXX
 SG_ VCFRONT_a474_turnStatus m474 : 48|3@1+ (1,0) [0|7] "" Vector__XXX
 SG_ VCFRONT_a474_fanStatus m474 : 51|1@1+ (1,0) [0|1] "" Vector__XXX
 SG_ VCFRONT_a474_TPS92520_COMPOV m474 : 52|1@1+ (1,0) [0|1] "" Vector__XXX
 SG_ VCFRONT_a474_TPS92520_HSILIM m474 : 53|1@1+ (1,0) [0|1] "" Vector__XXX
 SG_ VCFRONT_a474_TPS92520_BSTUV m474 : 54|1@1+ (1,0) [0|1] "" Vector__XXX
 SG_ VCFRONT_a474_BoostRailStatus m474 : 55|1@1+ (1,0) [0|1] "" Vector__XXX
 SG_ VCFRONT_a474_EEPROM_DataStatus m474 : 56|1@1+ (1,0) [0|1] "" Vector__XXX
 SG_ VCFRONT_a474_LMMVariant m474 : 57|2@1+ (1,0) [1|3] "" Vector__XXX
 SG_ VCFRONT_a474_headlampECURevision m474 : 59|4@1+ (1,0) [0|15] "" Vector__XXX
 SG_ VCFRONT_a475_ssl100Bank1Status m475 : 16|2@1+ (1,0) [0|3] "" Vector__XXX
 SG_ VCFRONT_a475_ssl100Bank2Status m475 : 18|2@1+ (1,0) [0|3] "" Vector__XXX
 SG_ VCFRONT_a475_ssl100Bank3Status m475 : 20|2@1+ (1,0) [0|3] "" Vector__XXX
 SG_ VCFRONT_a475_ssl100Bank4Status m475 : 22|2@1+ (1,0) [0|3] "" Vector__XXX
 SG_ VCFRONT_a475_ssl100Bank5Status m475 : 24|2@1+ (1,0) [0|3] "" Vector__XXX
 SG_ VCFRONT_a475_ssl100Bank6Status m475 : 26|2@1+ (1,0) [0|3] "" Vector__XXX
 SG_ VCFRONT_a475_ssl100Bank7Status m475 : 28|2@1+ (1,0) [0|3] "" Vector__XXX
 SG_ VCFRONT_a475_ssl100Bank8Status m475 : 30|2@1+ (1,0) [0|3] "" Vector__XXX
 SG_ VCFRONT_a475_ssl100Bank9Status m475 : 32|2@1+ (1,0) [0|3] "" Vector__XXX
 SG_ VCFRONT_a475_lowBeamPrefieldStat m475 : 34|3@1+ (1,0) [0|7] "" Vector__XXX
 SG_ VCFRONT_a475_drl1Status m475 : 37|3@1+ (1,0) [0|7] "" Vector__XXX
 SG_ VCFRONT_a475_drl2Status m475 : 40|3@1+ (1,0) [0|7] "" Vector__XXX
 SG_ VCFRONT_a475_drl3Status m475 : 43|3@1+ (1,0) [0|7] "" Vector__XXX
 SG_ VCFRONT_a475_turnStatus m475 : 48|3@1+ (1,0) [0|7] "" Vector__XXX
 SG_ VCFRONT_a475_fanStatus m475 : 51|1@1+ (1,0) [0|1] "" Vector__XXX
 SG_ VCFRONT_a475_TPS92520_COMPOV m475 : 52|1@1+ (1,0) [0|1] "" Vector__XXX
 SG_ VCFRONT_a475_TPS92520_HSILIM m475 : 53|1@1+ (1,0) [0|1] "" Vector__XXX
 SG_ VCFRONT_a475_TPS92520_BSTUV m475 : 54|1@1+ (1,0) [0|1] "" Vector__XXX
 SG_ VCFRONT_a475_BoostRailStatus m475 : 55|1@1+ (1,0) [0|1] "" Vector__XXX
 SG_ VCFRONT_a475_EEPROM_DataStatus m475 : 56|1@1+ (1,0) [0|1] "" Vector__XXX
 SG_ VCFRONT_a475_LMMVariant m475 : 57|2@1+ (1,0) [1|3] "" Vector__XXX
 SG_ VCFRONT_a475_headlampECURevision m475 : 59|4@1+ (1,0) [0|15] "" Vector__XXX
 SG_ VCFRONT_a476_FRM1_timedOut m476 : 16|1@1+ (1,0) [0|1] "" Vector__XXX
 SG_ VCFRONT_a476_FRM2_timedOut m476 : 17|1@1+ (1,0) [0|1] "" Vector__XXX
 SG_ VCFRONT_a476_FRM3_timedOut m476 : 18|1@1+ (1,0) [0|1] "" Vector__XXX
 SG_ VCFRONT_a476_FRM4_timedOut m476 : 19|1@1+ (1,0) [0|1] "" Vector__XXX
 SG_ VCFRONT_a476_FRM5_timedOut m476 : 20|1@1+ (1,0) [0|1] "" Vector__XXX
 SG_ VCFRONT_a476_FRM6_timedOut m476 : 21|1@1+ (1,0) [0|1] "" Vector__XXX
 SG_ VCFRONT_a476_FRM7_timedOut m476 : 22|1@1+ (1,0) [0|1] "" Vector__XXX
 SG_ VCFRONT_a476_FRM8_timedOut m476 : 23|1@1+ (1,0) [0|1] "" Vector__XXX
 SG_ VCFRONT_a476_FRM9_timedOut m476 : 24|1@1+ (1,0) [0|1] "" Vector__XXX
 SG_ VCFRONT_a476_FRM10_timedOut m476 : 25|1@1+ (1,0) [0|1] "" Vector__XXX
 SG_ VCFRONT_a476_FRM11_timedOut m476 : 26|1@1+ (1,0) [0|1] "" Vector__XXX
 SG_ VCFRONT_a476_FRM12_timedOut m476 : 27|1@1+ (1,0) [0|1] "" Vector__XXX
 SG_ VCFRONT_a476_factoryMode m476 : 28|1@1+ (1,0) [0|1] "" Vector__XXX
 SG_ VCFRONT_a476_serviceMode m476 : 29|1@1+ (1,0) [0|1] "" Vector__XXX
 SG_ VCFRONT_a476_transportMode m476 : 30|1@1+ (1,0) [0|1] "" Vector__XXX
 SG_ VCFRONT_a476_frunkOpen m476 : 31|1@1+ (1,0) [0|1] "" Vector__XXX
 SG_ VCFRONT_a476_vehiclePowerState m476 : 32|2@1+ (1,0) [0|3] "" Vector__XXX
 SG_ VCFRONT_a476_batterySMState m476 : 34|4@1+ (1,0) [0|15] "" Vector__XXX
 SG_ VCFRONT_a476_ECPAState m476 : 38|2@1+ (1,0) [0|2] "" Vector__XXX
 SG_ VCFRONT_a477_cell1Voltage m477 : 16|9@1+ (0.01,0) [0|5.11] "V" Vector__XXX
 SG_ VCFRONT_a477_cell2Voltage m477 : 25|9@1+ (0.01,0) [0|5.11] "V" Vector__XXX
 SG_ VCFRONT_a477_cell3Voltage m477 : 34|9@1+ (0.01,0) [0|5.11] "V" Vector__XXX
 SG_ VCFRONT_a477_cell4Voltage m477 : 43|9@1+ (0.01,0) [0|5.11] "V" Vector__XXX
 SG_ VCFRONT_a477_sumCellVoltage m477 : 52|8@1+ (0.1,0) [0|25.5] "V" Vector__XXX
 SG_ VCFRONT_a477_deepDischargeFlag m477 : 60|1@1+ (1,0) [0|1] "" Vector__XXX
 SG_ VCFRONT_a477_serviceMode m477 : 61|1@1+ (1,0) [0|1] "" Vector__XXX
 SG_ VCFRONT_a477_frunkOpen m477 : 62|1@1+ (1,0) [0|1] "" Vector__XXX
 SG_ VCFRONT_a478_battFaultPackOverVo m478 : 16|1@1+ (1,0) [0|1] "" Vector__XXX
 SG_ VCFRONT_a478_battFaultHardwareOv m478 : 17|1@1+ (1,0) [0|1] "" Vector__XXX
 SG_ VCFRONT_a478_battFaultChargeOver m478 : 18|1@1+ (1,0) [0|1] "" Vector__XXX
 SG_ VCFRONT_a478_battFaultCellUnderV m478 : 19|1@1+ (1,0) [0|1] "" Vector__XXX
 SG_ VCFRONT_a478_battFaultCellOverVo m478 : 20|1@1+ (1,0) [0|1] "" Vector__XXX
 SG_ VCFRONT_a478_vehiclePowerState m478 : 21|2@1+ (1,0) [0|3] "" Vector__XXX
 SG_ VCFRONT_a478_batterySMState m478 : 24|4@1+ (1,0) [0|15] "" Vector__XXX
 SG_ VCFRONT_a478_bmsState m478 : 28|4@1+ (1,0) [0|15] "" Vector__XXX
 SG_ VCFRONT_a478_dcdcLVSupportStatus m478 : 32|2@1+ (1,0) [0|3] "" Vector__XXX
 SG_ VCFRONT_a478_factoryMode m478 : 34|1@1+ (1,0) [0|1] "" Vector__XXX
 SG_ VCFRONT_a478_serviceMode m478 : 35|1@1+ (1,0) [0|1] "" Vector__XXX
 SG_ VCFRONT_a478_transportMode m478 : 36|1@1+ (1,0) [0|1] "" Vector__XXX
 SG_ VCFRONT_a478_notEnoughPowerForSu m478 : 37|1@1+ (1,0) [0|1] "" Vector__XXX
 SG_ VCFRONT_a478_crashDetected m478 : 38|1@1+ (1,0) [0|1] "" Vector__XXX
 SG_ VCFRONT_a478_BMS_MIA m478 : 39|1@1+ (1,0) [0|1] "" Vector__XXX
 SG_ VCFRONT_a478_PCS_MIA m478 : 40|1@1+ (1,0) [0|1] "" Vector__XXX
 SG_ VCFRONT_a478_HVBlockingMismatch m478 : 41|1@1+ (1,0) [0|1] "" Vector__XXX
 SG_ VCFRONT_a478_HV_UP m478 : 42|1@1+ (1,0) [0|1] "" Vector__XXX
 SG_ VCFRONT_a478_pcsEFuseStable m478 : 43|1@1+ (1,0) [0|1] "" Vector__XXX
 SG_ VCFRONT_a478_vcrightEFuseStable m478 : 44|1@1+ (1,0) [0|1] "" Vector__XXX
 SG_ VCFRONT_a478_contactorEFuseStabl m478 : 45|1@1+ (1,0) [0|1] "" Vector__XXX
 SG_ VCFRONT_a478_hvcEFuseStable m478 : 46|1@1+ (1,0) [0|1] "" Vector__XXX
 SG_ VCFRONT_a478_frunkOpen m478 : 47|1@1+ (1,0) [0|1] "" Vector__XXX
 SG_ VCFRONT_a479_FRM3_timedOut m479 : 16|1@1+ (1,0) [0|1] "" Vector__XXX
 SG_ VCFRONT_a479_ECPAState m479 : 17|2@1+ (1,0) [0|2] "" Vector__XXX
 SG_ VCFRONT_a479_factoryMode m479 : 19|1@1+ (1,0) [0|1] "" Vector__XXX
 SG_ VCFRONT_a479_serviceMode m479 : 20|1@1+ (1,0) [0|1] "" Vector__XXX
 SG_ VCFRONT_a479_transportMode m479 : 21|1@1+ (1,0) [0|1] "" Vector__XXX
 SG_ VCFRONT_a479_frunkLatchStatus m479 : 24|4@1+ (1,0) [1|15] "" Vector__XXX
 SG_ VCFRONT_a479_vehiclePowerState m479 : 28|2@1+ (1,0) [0|3] "" Vector__XXX
 SG_ VCFRONT_a479_batterySMState m479 : 32|4@1+ (1,0) [0|15] "" Vector__XXX
 SG_ VCFRONT_a480_channel m480 : 16|3@1+ (1,0) [0|7] "" Vector__XXX
 SG_ VCFRONT_a480_reset m480 : 19|1@1+ (1,0) [0|1] "" Vector__XXX
 SG_ VCFRONT_a480_spiError m480 : 20|1@1+ (1,0) [0|1] "" Vector__XXX
 SG_ VCFRONT_a480_autoOn m480 : 21|1@1+ (1,0) [0|1] "" Vector__XXX
 SG_ VCFRONT_a480_diagnosticBit m480 : 22|1@1+ (1,0) [0|1] "" Vector__XXX
 SG_ VCFRONT_a480_deviceError m480 : 23|1@1+ (1,0) [0|1] "" Vector__XXX
 SG_ VCFRONT_a480_overcurrent m480 : 24|1@1+ (1,0) [0|1] "" Vector__XXX
 SG_ VCFRONT_a480_unexpectedLock m480 : 25|1@1+ (1,0) [0|1] "" Vector__XXX
 SG_ VCFRONT_a480_disableOutputFault m480 : 26|1@1+ (1,0) [0|1] "" Vector__XXX
 SG_ VCFRONT_a480_vsUndervoltage m480 : 27|1@1+ (1,0) [0|1] "" Vector__XXX
 SG_ VCFRONT_a480_hardShort m480 : 28|1@1+ (1,0) [0|1] "" Vector__XXX
 SG_ VCFRONT_a480_vdsMax m480 : 29|1@1+ (1,0) [0|1] "" Vector__XXX
 SG_ VCFRONT_a480_bypassSaturation m480 : 30|1@1+ (1,0) [0|1] "" Vector__XXX
 SG_ VCFRONT_a480_fuseLatch m480 : 31|1@1+ (1,0) [0|1] "" Vector__XXX
 SG_ VCFRONT_a480_deviceOvertemperatu m480 : 32|1@1+ (1,0) [0|1] "" Vector__XXX
 SG_ VCFRONT_a480_ntcOvertemperature m480 : 33|1@1+ (1,0) [0|1] "" Vector__XXX
 SG_ VCFRONT_a480_vgsLow m480 : 34|1@1+ (1,0) [0|1] "" Vector__XXX
 SG_ VCFRONT_a480_chargePumpLow m480 : 35|1@1+ (1,0) [0|1] "" Vector__XXX
 SG_ VCFRONT_a480_watchdog m480 : 36|1@1+ (1,0) [0|1] "" Vector__XXX
 SG_ VCFRONT_a480_spiNotDone m480 : 37|1@1+ (1,0) [0|1] "" Vector__XXX
 SG_ VCFRONT_a480_configIncorrect m480 : 38|1@1+ (1,0) [0|1] "" Vector__XXX
 SG_ VCFRONT_a480_bufferFull m480 : 39|1@1+ (1,0) [0|1] "" Vector__XXX
 SG_ VCFRONT_a480_hitAlertRateLimit m480 : 40|1@1+ (1,0) [0|1] "" Vector__XXX
 SG_ VCFRONT_a480_hwlo m480 : 41|1@1+ (1,0) [0|1] "" Vector__XXX
 SG_ VCFRONT_a480_enable m480 : 42|1@1+ (1,0) [0|1] "" Vector__XXX
 SG_ VCFRONT_a486_mcuGraphicsEFuseCur m486 : 16|10@1+ (0.1,0) [0|102.3] "A" Vector__XXX
 SG_ VCFRONT_a490_coolantPumpType m490 : 16|3@1+ (1,0) [0|7] "" Vector__XXX
 SG_ VCFRONT_a493_minBrickSocId m493 : 16|7@1+ (1,1) [1|128] "" Vector__XXX
 SG_ VCFRONT_a493_minBrickSocByOcvMax m493 : 24|8@1+ (0.5,0) [0|127.5] "PCT" Vector__XXX
 SG_ VCFRONT_a493_maxBrickSocId m493 : 32|7@1+ (1,1) [1|128] "" Vector__XXX
 SG_ VCFRONT_a493_maxBrickSocByOcvMin m493 : 40|8@1+ (0.5,0) [0|127.5] "PCT" Vector__XXX
 SG_ VCFRONT_a493_maxBrickSoc m493 : 48|7@1+ (1,0) [0|127] "PCT" Vector__XXX
 SG_ VCFRONT_a493_avgBrickSoc m493 : 56|7@1+ (1,0) [0|127] "PCT" Vector__XXX
 SG_ VCFRONT_a495_SoCUnrecoverable m495 : 16|1@1+ (1,0) [0|1] "" Vector__XXX
 SG_ VCFRONT_a495_SocTooLow m495 : 17|1@1+ (1,0) [0|1] "" Vector__XXX
 SG_ VCFRONT_a495_retryExpended m495 : 18|1@1+ (1,0) [0|1] "" Vector__XXX
 SG_ VCFRONT_a495_LVBMSMIA m495 : 19|1@1+ (1,0) [0|1] "" Vector__XXX
 SG_ VCFRONT_a495_reverseBatteryEFuse m495 : 20|1@1+ (1,0) [0|1] "" Vector__XXX
 SG_ VCFRONT_a495_DCDCOff m495 : 21|1@1+ (1,0) [0|1] "" Vector__XXX
 SG_ VCFRONT_a495_HVOff m495 : 22|1@1+ (1,0) [0|1] "" Vector__XXX
 SG_ VCFRONT_a495_externalInteraction m495 : 23|1@1+ (1,0) [0|1] "" Vector__XXX
 SG_ VCFRONT_a495_serviceMode m495 : 24|1@1+ (1,0) [0|1] "" Vector__XXX
 SG_ VCFRONT_a495_frunkOpen m495 : 25|1@1+ (1,0) [0|1] "" Vector__XXX
 SG_ VCFRONT_a495_externalPowerSupply m495 : 26|1@1+ (1,0) [0|1] "" Vector__XXX
 SG_ VCFRONT_a496_reverseBatteryEFuse m496 : 16|1@1+ (1,0) [0|1] "" Vector__XXX
 SG_ VCFRONT_a496_vehicleLoadShedActi m496 : 17|1@1+ (1,0) [0|1] "" Vector__XXX
 SG_ VCFRONT_a496_MOSState m496 : 18|2@1+ (1,0) [0|2] "" Vector__XXX
 SG_ VCFRONT_a496_serviceMode m496 : 20|1@1+ (1,0) [0|1] "" Vector__XXX
 SG_ VCFRONT_a496_frunkOpen m496 : 21|1@1+ (1,0) [0|1] "" Vector__XXX
 SG_ VCFRONT_a496_PCS_MIA m496 : 22|1@1+ (1,0) [0|1] "" Vector__XXX
 SG_ VCFRONT_a496_NotEnoughPowerForSu m496 : 23|1@1+ (1,0) [0|1] "" Vector__XXX
 SG_ VCFRONT_a496_bmsState m496 : 24|4@1+ (1,0) [0|15] "" Vector__XXX
 SG_ VCFRONT_a497_serviceMode m497 : 16|1@1+ (1,0) [0|1] "" Vector__XXX
 SG_ VCFRONT_a497_FactoryMode m497 : 17|1@1+ (1,0) [0|1] "" Vector__XXX
 SG_ VCFRONT_a497_SOC m497 : 24|7@1+ (1,0) [0|127] "%" Vector__XXX
 SG_ VCFRONT_a497_PackCurrent m497 : 32|12@1+ (0.2,-600) [-600|219] "A" Vector__XXX
 SG_ VCFRONT_a497_SumCellVoltage m497 : 48|8@1+ (0.1,0) [0|25.5] "V" Vector__XXX
 SG_ VCFRONT_a497_frunkOpen m497 : 56|1@1+ (1,0) [0|1] "" Vector__XXX
 SG_ VCFRONT_a500_channel m500 : 16|8@1+ (1,0) [0|255] "" Vector__XXX
 SG_ VCFRONT_a500_mismatchedState m500 : 24|3@1+ (1,0) [0|7] "" Vector__XXX
 SG_ VCFRONT_a503_brickVoltageMin m503 : 16|10@1+ (0.005,0) [0|5.115] "V" Vector__XXX
 SG_ VCFRONT_a503_brickVoltageMax m503 : 26|10@1+ (0.005,0) [0|5.115] "V" Vector__XXX
 SG_ VCFRONT_a503_packCurrent m503 : 36|10@1- (5,0) [-2560|2555] "A" Vector__XXX
 SG_ VCFRONT_a503_socMax m503 : 46|8@1+ (0.5,0) [0|127.5] "%" Vector__XXX
 SG_ VCFRONT_a503_brickId m503 : 54|8@1+ (1,1) [1|256] "" Vector__XXX
 SG_ VCFRONT_a509_vcrightEFuseCurrent m509 : 16|16@1- (0.1,0) [-3276.8|3276.7] "A" Vector__XXX
 SG_ VCFRONT_a509_vcrightEFuseTemp m509 : 32|8@1+ (0.75,0) [0|191.25] "degC" Vector__XXX
 SG_ VCFRONT_a509_ambientTemp m509 : 40|8@1+ (0.5,-40) [-40|87.5] "degC" Vector__XXX
 SG_ VCFRONT_a509_serviceMode m509 : 48|1@1+ (1,0) [0|1] "" Vector__XXX
 SG_ VCFRONT_a509_frunkOpen m509 : 49|1@1+ (1,0) [0|1] "" Vector__XXX
 SG_ VCFRONT_a510_sumCellVoltage m510 : 16|8@1+ (0.1,0) [0|25.5] "V" Vector__XXX
 SG_ VCFRONT_a510_packVoltage m510 : 24|8@1+ (0.1,0) [0|25.5] "V" Vector__XXX
 SG_ VCFRONT_a510_targetPCSVoltage m510 : 32|8@1+ (0.1,0) [0|25.5] "V" Vector__XXX
 SG_ VCFRONT_a510_serviceMode m510 : 40|1@1+ (1,0) [0|1] "" Vector__XXX
 SG_ VCFRONT_a510_frunkOpen m510 : 41|1@1+ (1,0) [0|1] "" Vector__XXX
 SG_ VCFRONT_a511_PCSEFuseCurrent m511 : 16|16@1- (0.1,0) [-3276.8|3276.7] "A" Vector__XXX
 SG_ VCFRONT_a511_DCDCMaxOutputCurren m511 : 32|16@1- (0.1,0) [-3276.8|3276.7] "A" Vector__XXX
 SG_ VCFRONT_a511_hvState m511 : 48|3@1+ (1,0) [0|7] "" Vector__XXX
 SG_ VCFRONT_a511_DCDCOutputIsLimited m511 : 51|1@1+ (1,0) [0|1] "" Vector__XXX
 SG_ VCFRONT_a511_PCSSignalsAreValid m511 : 52|1@1+ (1,0) [0|1] "" Vector__XXX
 SG_ VCFRONT_a511_factoryGated m511 : 53|1@1+ (1,0) [0|1] "" Vector__XXX
 SG_ VCFRONT_a511_vehicleIsUpdating m511 : 54|1@1+ (1,0) [0|1] "" Vector__XXX
 SG_ VCFRONT_a511_serviceMode m511 : 55|1@1+ (1,0) [0|1] "" Vector__XXX
 SG_ VCFRONT_a511_frunkOpen m511 : 56|1@1+ (1,0) [0|1] "" Vector__XXX
 SG_ VCFRONT_a512_packVoltageInt_0001 m512 : 16|8@1+ (0.1,0) [0|25.5] "V" Vector__XXX
 SG_ VCFRONT_a512_packVoltageInterval m512 : 24|8@1+ (0.1,0) [0|25.5] "V" Vector__XXX
 SG_ VCFRONT_a512_packTemperature m512 : 32|8@1+ (1,-40) [-40|215] "C" Vector__XXX
 SG_ VCFRONT_a512_sumCellVoltage m512 : 40|8@1+ (0.1,0) [0|25.5] "V" Vector__XXX
 SG_ VCFRONT_a512_overcurrentDirectio m512 : 48|2@1+ (1,0) [0|3] "" Vector__XXX
 SG_ VCFRONT_a512_serviceMode m512 : 50|1@1+ (1,0) [0|1] "" Vector__XXX
 SG_ VCFRONT_a512_frunkOpen m512 : 51|1@1+ (1,0) [0|1] "" Vector__XXX
 SG_ VCFRONT_a512_vehiclePowerState m512 : 52|2@1+ (1,0) [0|3] "" Vector__XXX
 SG_ VCFRONT_a513_packCurrent m513 : 16|12@1+ (0.2,-600) [-600|219] "A" Vector__XXX
 SG_ VCFRONT_a513_packTemperature m513 : 32|8@1+ (1,-40) [-40|215] "C" Vector__XXX
 SG_ VCFRONT_a513_packVoltage m513 : 40|8@1+ (0.1,0) [0|25.5] "V" Vector__XXX
 SG_ VCFRONT_a513_packSOC m513 : 48|10@1+ (0.1,0) [0|102.3] "%" Vector__XXX
 SG_ VCFRONT_a513_serviceMode m513 : 58|1@1+ (1,0) [0|1] "" Vector__XXX
 SG_ VCFRONT_a513_frunkOpen m513 : 59|1@1+ (1,0) [0|1] "" Vector__XXX
 SG_ VCFRONT_a513_vehiclePowerState m513 : 60|2@1+ (1,0) [0|3] "" Vector__XXX
 SG_ VCFRONT_a514_cell1Voltage m514 : 16|7@1+ (0.08,0) [0|10.16] "V" Vector__XXX
 SG_ VCFRONT_a514_cell2Voltage m514 : 23|7@1+ (0.08,0) [0|10.16] "V" Vector__XXX
 SG_ VCFRONT_a514_cell3Voltage m514 : 30|7@1+ (0.08,0) [0|10.16] "V" Vector__XXX
 SG_ VCFRONT_a514_cell4Voltage m514 : 37|7@1+ (0.08,0) [0|10.16] "V" Vector__XXX
 SG_ VCFRONT_a514_packVoltage m514 : 44|8@1+ (0.1,0) [0|25.5] "V" Vector__XXX
 SG_ VCFRONT_a514_packSOC m514 : 52|8@1+ (0.4,0) [0|102] "%" Vector__XXX
 SG_ VCFRONT_a514_serviceMode m514 : 60|1@1+ (1,0) [0|1] "" Vector__XXX
 SG_ VCFRONT_a514_frunkOpen m514 : 61|1@1+ (1,0) [0|1] "" Vector__XXX
 SG_ VCFRONT_a514_vehiclePowerState m514 : 62|2@1+ (1,0) [0|3] "" Vector__XXX
 SG_ VCFRONT_a515_cell1Voltage m515 : 16|7@1+ (0.08,0) [0|10.16] "V" Vector__XXX
 SG_ VCFRONT_a515_cell2Voltage m515 : 23|7@1+ (0.08,0) [0|10.16] "V" Vector__XXX
 SG_ VCFRONT_a515_cell3Voltage m515 : 30|7@1+ (0.08,0) [0|10.16] "V" Vector__XXX
 SG_ VCFRONT_a515_cell4Voltage m515 : 37|7@1+ (0.08,0) [0|10.16] "V" Vector__XXX
 SG_ VCFRONT_a515_packVoltage m515 : 44|8@1+ (0.1,0) [0|25.5] "V" Vector__XXX
 SG_ VCFRONT_a515_packSOC m515 : 52|8@1+ (0.4,0) [0|102] "%" Vector__XXX
 SG_ VCFRONT_a515_serviceMode m515 : 60|1@1+ (1,0) [0|1] "" Vector__XXX
 SG_ VCFRONT_a515_frunkOpen m515 : 61|1@1+ (1,0) [0|1] "" Vector__XXX
 SG_ VCFRONT_a515_vehiclePowerState m515 : 62|2@1+ (1,0) [0|3] "" Vector__XXX
 SG_ VCFRONT_a516_IBSVoltage m516 : 16|8@1+ (0.1,0) [0|25.5] "V" Vector__XXX
 SG_ VCFRONT_a516_HVSoc m516 : 24|10@1+ (0.1,0) [0|102.3] "%" Vector__XXX
 SG_ VCFRONT_a516_contactorsPermanent m516 : 34|1@1+ (1,0) [0|1] "" Vector__XXX
 SG_ VCFRONT_a516_LVBatteryDisconnect m516 : 35|1@1+ (1,0) [0|1] "" Vector__XXX
 SG_ VCFRONT_a516_reverseBatteryFault m516 : 36|1@1+ (1,0) [0|1] "" Vector__XXX
 SG_ VCFRONT_a516_LVBatteryCannotSupp m516 : 37|1@1+ (1,0) [0|1] "" Vector__XXX
 SG_ VCFRONT_a517_IBSVoltage m517 : 16|8@1+ (0.1,0) [0|25.5] "V" Vector__XXX
 SG_ VCFRONT_a517_HVSoc m517 : 24|10@1+ (0.1,0) [0|102.3] "%" Vector__XXX
 SG_ VCFRONT_a518_packVoltage m518 : 16|8@1+ (0.1,0) [0|25.5] "V" Vector__XXX
 SG_ VCFRONT_a518_IBSVoltage m518 : 24|9@1+ (0.05,0) [0|25.55] "V" Vector__XXX
 SG_ VCFRONT_a518_targetPCSVoltage m518 : 33|8@1+ (0.1,0) [0|25.5] "V" Vector__XXX
 SG_ VCFRONT_a518_outputVoltageAtPCS m518 : 41|8@1+ (0.1,0) [0|25.5] "V" Vector__XXX
 SG_ VCFRONT_a518_packSOC m518 : 49|10@1+ (0.1,0) [0|102.3] "%" Vector__XXX
 SG_ VCFRONT_a518_serviceMode m518 : 59|1@1+ (1,0) [0|1] "" Vector__XXX
 SG_ VCFRONT_a518_frunkOpen m518 : 60|1@1+ (1,0) [0|1] "" Vector__XXX
 SG_ VCFRONT_a518_vehiclePowerState m518 : 61|2@1+ (1,0) [0|3] "" Vector__XXX
 SG_ VCFRONT_a519_MatrixBank1Status m519 : 16|2@1+ (1,0) [0|3] "" Vector__XXX
 SG_ VCFRONT_a519_MatrixBank2Status m519 : 18|2@1+ (1,0) [0|3] "" Vector__XXX
 SG_ VCFRONT_a519_MatrixBank3Status m519 : 20|2@1+ (1,0) [0|3] "" Vector__XXX
 SG_ VCFRONT_a519_MatrixBank4Status m519 : 22|2@1+ (1,0) [0|3] "" Vector__XXX
 SG_ VCFRONT_a519_TurnSignalStatus m519 : 24|3@1+ (1,0) [0|7] "" Vector__XXX
 SG_ VCFRONT_a519_SideMarkerStatus m519 : 27|2@1+ (1,0) [0|3] "" Vector__XXX
 SG_ VCFRONT_a519_DRLStatus m519 : 29|3@1+ (1,0) [0|7] "" Vector__XXX
 SG_ VCFRONT_a519_AmbientStatus m519 : 32|3@1+ (1,0) [0|7] "" Vector__XXX
 SG_ VCFRONT_a519_LBFlatSAEStatus m519 : 35|3@1+ (1,0) [0|7] "" Vector__XXX
 SG_ VCFRONT_a519_LBFlatECEStatus m519 : 40|3@1+ (1,0) [0|7] "" Vector__XXX
 SG_ VCFRONT_a519_TPS92520_COMPOV m519 : 43|1@1+ (1,0) [0|1] "" Vector__XXX
 SG_ VCFRONT_a519_TPS92520_HSILIM m519 : 44|1@1+ (1,0) [0|1] "" Vector__XXX
 SG_ VCFRONT_a519_TPS92520_BSTUV m519 : 45|1@1+ (1,0) [0|1] "" Vector__XXX
 SG_ VCFRONT_a519_CoolingFanStatus m519 : 46|1@1+ (1,0) [0|1] "" Vector__XXX
 SG_ VCFRONT_a519_BoostRailStatus m519 : 47|1@1+ (1,0) [0|1] "" Vector__XXX
 SG_ VCFRONT_a519_EEPROMCurrentBinSta m519 : 48|1@1+ (1,0) [0|1] "" Vector__XXX
 SG_ VCFRONT_a519_EEPROMCalCurrentSta m519 : 49|1@1+ (1,0) [0|1] "" Vector__XXX
 SG_ VCFRONT_a519_HeadlampECURevision m519 : 50|4@1+ (1,0) [0|15] "" Vector__XXX
 SG_ VCFRONT_a519_NonzeroEEPROMRetrie m519 : 54|1@1+ (1,0) [0|1] "" Vector__XXX
 SG_ VCFRONT_a519_MaxEEPROMRetries m519 : 55|1@1+ (1,0) [0|1] "" Vector__XXX
 SG_ VCFRONT_a520_MatrixBank1Status m520 : 16|2@1+ (1,0) [0|3] "" Vector__XXX
 SG_ VCFRONT_a520_MatrixBank2Status m520 : 18|2@1+ (1,0) [0|3] "" Vector__XXX
 SG_ VCFRONT_a520_MatrixBank3Status m520 : 20|2@1+ (1,0) [0|3] "" Vector__XXX
 SG_ VCFRONT_a520_MatrixBank4Status m520 : 22|2@1+ (1,0) [0|3] "" Vector__XXX
 SG_ VCFRONT_a520_TurnSignalStatus m520 : 24|3@1+ (1,0) [0|7] "" Vector__XXX
 SG_ VCFRONT_a520_SideMarkerStatus m520 : 27|2@1+ (1,0) [0|3] "" Vector__XXX
 SG_ VCFRONT_a520_DRLStatus m520 : 29|3@1+ (1,0) [0|7] "" Vector__XXX
 SG_ VCFRONT_a520_AmbientStatus m520 : 32|3@1+ (1,0) [0|7] "" Vector__XXX
 SG_ VCFRONT_a520_LBFlatSAEStatus m520 : 35|3@1+ (1,0) [0|7] "" Vector__XXX
 SG_ VCFRONT_a520_LBFlatECEStatus m520 : 40|3@1+ (1,0) [0|7] "" Vector__XXX
 SG_ VCFRONT_a520_TPS92520_COMPOV m520 : 43|1@1+ (1,0) [0|1] "" Vector__XXX
 SG_ VCFRONT_a520_TPS92520_HSILIM m520 : 44|1@1+ (1,0) [0|1] "" Vector__XXX
 SG_ VCFRONT_a520_TPS92520_BSTUV m520 : 45|1@1+ (1,0) [0|1] "" Vector__XXX
 SG_ VCFRONT_a520_CoolingFanStatus m520 : 46|1@1+ (1,0) [0|1] "" Vector__XXX
 SG_ VCFRONT_a520_BoostRailStatus m520 : 47|1@1+ (1,0) [0|1] "" Vector__XXX
 SG_ VCFRONT_a520_EEPROMCurrentBinSta m520 : 48|1@1+ (1,0) [0|1] "" Vector__XXX
 SG_ VCFRONT_a520_EEPROMCalCurrentSta m520 : 49|1@1+ (1,0) [0|1] "" Vector__XXX
 SG_ VCFRONT_a520_HeadlampECURevision m520 : 50|4@1+ (1,0) [0|15] "" Vector__XXX
 SG_ VCFRONT_a520_NonzeroEEPROMRetrie m520 : 54|1@1+ (1,0) [0|1] "" Vector__XXX
 SG_ VCFRONT_a520_MaxEEPROMRetries m520 : 55|1@1+ (1,0) [0|1] "" Vector__XXX
 SG_ VCFRONT_a521_vcleftEFuseCurrent m521 : 16|16@1- (0.1,0) [-3276.8|3276.7] "A" Vector__XXX
 SG_ VCFRONT_a521_vcleftEFuseTemp m521 : 32|8@1+ (0.75,0) [0|191.25] "degC" Vector__XXX
 SG_ VCFRONT_a521_ambientTemp m521 : 40|8@1+ (0.5,-40) [-40|87.5] "degC" Vector__XXX
 SG_ VCFRONT_a521_serviceMode m521 : 48|1@1+ (1,0) [0|1] "" Vector__XXX
 SG_ VCFRONT_a521_frunkOpen m521 : 49|1@1+ (1,0) [0|1] "" Vector__XXX
 SG_ VCFRONT_a522_IBSVoltage m522 : 16|8@1+ (0.1,0) [0|25.5] "V" Vector__XXX
 SG_ VCFRONT_a522_HVSoc m522 : 24|10@1+ (0.1,0) [0|102.3] "%" Vector__XXX
 SG_ VCFRONT_a522_contactorsPermanent m522 : 34|1@1+ (1,0) [0|1] "" Vector__XXX
 SG_ VCFRONT_a522_LVBatteryDisconnect m522 : 35|1@1+ (1,0) [0|1] "" Vector__XXX
 SG_ VCFRONT_a522_reverseBatteryFault m522 : 36|1@1+ (1,0) [0|1] "" Vector__XXX
 SG_ VCFRONT_a522_LVBatteryCannotSupp m522 : 37|1@1+ (1,0) [0|1] "" Vector__XXX
 SG_ VCFRONT_a523_channel m523 : 16|8@1+ (1,0) [0|255] "" Vector__XXX
 SG_ VCFRONT_a523_control2Byte1 m523 : 24|8@1+ (1,0) [0|255] "" Vector__XXX
 SG_ VCFRONT_a523_control2Byte2 m523 : 32|8@1+ (1,0) [0|255] "" Vector__XXX
 SG_ VCFRONT_a523_control2Byte3 m523 : 40|8@1+ (1,0) [0|255] "" Vector__XXX
 SG_ VCFRONT_a523_control3Byte2 m523 : 48|8@1+ (1,0) [0|255] "" Vector__XXX
 SG_ VCFRONT_a523_control3Byte3 m523 : 56|8@1+ (1,0) [0|255] "" Vector__XXX
 SG_ VCFRONT_a525_GTW_twelveVBatteryT m525 : 16|3@1+ (1,0) [0|7] "" Vector__XXX
 SG_ VCFRONT_a525_newLVBatteryType m525 : 19|3@1+ (1,0) [0|7] "" Vector__XXX
 SG_ VCFRONT_a525_initialLVBatteryTyp m525 : 24|3@1+ (1,0) [0|7] "" Vector__XXX
 SG_ VCFRONT_a525_serviceMode m525 : 27|1@1+ (1,0) [0|1] "" Vector__XXX
 SG_ VCFRONT_a525_factoryGated m525 : 28|1@1+ (1,0) [0|1] "" Vector__XXX
 SG_ VCFRONT_a525_frunkOpen m525 : 29|1@1+ (1,0) [0|1] "" Vector__XXX
 SG_ VCFRONT_a527_cell1Voltage m527 : 16|10@1+ (0.01,0) [0|10.23] "V" Vector__XXX
 SG_ VCFRONT_a527_cell2Voltage m527 : 26|10@1+ (0.01,0) [0|10.23] "V" Vector__XXX
 SG_ VCFRONT_a527_cell3Voltage m527 : 36|10@1+ (0.01,0) [0|10.23] "V" Vector__XXX
 SG_ VCFRONT_a527_cell4Voltage m527 : 46|10@1+ (0.01,0) [0|10.23] "V" Vector__XXX
 SG_ VCFRONT_a527_serviceMode m527 : 56|1@1+ (1,0) [0|1] "" Vector__XXX
 SG_ VCFRONT_a527_frunkOpen m527 : 57|1@1+ (1,0) [0|1] "" Vector__XXX
 SG_ VCFRONT_a528_ECPAStateSNA m528 : 16|1@1+ (1,0) [0|1] "" Vector__XXX
 SG_ VCFRONT_a528_ECPAFrameTimeout m528 : 17|1@1+ (1,0) [0|1] "" Vector__XXX
 SG_ VCFRONT_a528_currentSenseFaulted m528 : 18|1@1+ (1,0) [0|1] "" Vector__XXX
 SG_ VCFRONT_a528_serviceMode m528 : 19|1@1+ (1,0) [0|1] "" Vector__XXX
 SG_ VCFRONT_a528_frunkOpen m528 : 20|1@1+ (1,0) [0|1] "" Vector__XXX
 SG_ VCFRONT_a531_powerIndexFiltered m531 : 16|7@1+ (1,0) [0|127] "-" Vector__XXX
 SG_ VCFRONT_a532_eFuseFault m532 : 16|1@1+ (1,0) [0|1] "" Vector__XXX
 SG_ VCFRONT_a533_temperature m533 : 16|16@1+ (0.01,0) [0|655.35] "C" Vector__XXX
 SG_ VCFRONT_a541_PackTemperature m541 : 16|9@1+ (0.5,-50) [-50|205.5] "degC" Vector__XXX
 SG_ VCFRONT_a541_ChargeCurrentLimit m541 : 25|10@1+ (0.05,0) [0|51.15] "A" Vector__XXX
 SG_ VCFRONT_a541_PeakCurrent m541 : 35|10@1+ (0.05,0) [0|51.15] "A" Vector__XXX
 SG_ VCFRONT_a541_AverageCurrent m541 : 45|10@1+ (0.05,0) [0|51.15] "A" Vector__XXX
 SG_ VCFRONT_a541_SOC m541 : 56|7@1+ (1,0) [0|127] "%" Vector__XXX
 SG_ VCFRONT_a544_serviceMode m544 : 16|1@1+ (1,0) [0|1] "" Vector__XXX
 SG_ VCFRONT_a544_frunkOpen m544 : 17|1@1+ (1,0) [0|1] "" Vector__XXX
 SG_ VCFRONT_a544_LVBMSSOC m544 : 18|5@1+ (3,0) [0|93] "%" Vector__XXX
 SG_ VCFRONT_a545_GTW_twelveVBatteryT m545 : 16|3@1+ (1,0) [0|7] "" Vector__XXX
 SG_ VCFRONT_a545_newLVBatteryType m545 : 19|3@1+ (1,0) [0|7] "" Vector__XXX
 SG_ VCFRONT_a545_serviceMode m545 : 22|1@1+ (1,0) [0|1] "" Vector__XXX
 SG_ VCFRONT_a545_factoryGated m545 : 23|1@1+ (1,0) [0|1] "" Vector__XXX
 SG_ VCFRONT_a545_frunkOpen m545 : 24|1@1+ (1,0) [0|1] "" Vector__XXX
 SG_ VCFRONT_a547_serviceMode m547 : 16|1@1+ (1,0) [0|1] "" Vector__XXX
 SG_ VCFRONT_a547_frunkOpen m547 : 17|1@1+ (1,0) [0|1] "" Vector__XXX
 SG_ VCFRONT_a548_vehiclePowerState m548 : 16|2@1+ (1,0) [0|3] "" Vector__XXX
 SG_ VCFRONT_a548_notEnoughPowerForSu m548 : 18|1@1+ (1,0) [0|1] "" Vector__XXX
 SG_ VCFRONT_a548_HVBlockingMismatch m548 : 19|1@1+ (1,0) [0|1] "" Vector__XXX
 SG_ VCFRONT_a548_LVBatteryCannotSupp m548 : 20|1@1+ (1,0) [0|1] "" Vector__XXX
 SG_ VCFRONT_a548_DI_gear m548 : 21|3@1+ (1,0) [0|6] "" Vector__XXX
 SG_ VCFRONT_a548_backstopBucketCount m548 : 24|5@1+ (0.035,0) [0|1.085] "Ah" Vector__XXX

CM_ SG_ 1332 VCFRONT_a289_chargePumpUndervolt "Front body controller: a289 charge pump undervoltage";
CM_ SG_ 1332 VCFRONT_a289_isCoilOpenX "Front body controller: a289 is coil open x";
CM_ SG_ 1332 VCFRONT_a289_isCoilOpenY "Front body controller: a289 is coil open y";
CM_ SG_ 1332 VCFRONT_a289_isCoilShortXPGnd "Front body controller: a289 is coil short XP gnd";
CM_ SG_ 1332 VCFRONT_a289_isCoilShortXPVbb "Front body controller: a289 is coil short XP vbb";
CM_ SG_ 1332 VCFRONT_a289_isCoilShortXNGnd "Front body controller: a289 is coil short XN gnd";
CM_ SG_ 1332 VCFRONT_a289_isCoilShortXNVbb "Front body controller: a289 is coil short XN vbb";
CM_ SG_ 1332 VCFRONT_a289_isCoilShortYPGnd "Front body controller: a289 is coil short YP gnd";
CM_ SG_ 1332 VCFRONT_a289_isCoilShortYPVbb "Front body controller: a289 is coil short YP vbb";
CM_ SG_ 1332 VCFRONT_a289_isCoilShortYNGnd "Front body controller: a289 is coil short YN gnd";
CM_ SG_ 1332 VCFRONT_a289_isCoilShortYNVbb "Front body controller: a289 is coil short YN vbb";
CM_ SG_ 1332 VCFRONT_a289_driverHasCommError "Front body controller: a289 driver has comm error";
CM_ SG_ 1332 VCFRONT_a290_outputFaulted "Front body controller: a290 output faulted";
CM_ SG_ 1332 VCFRONT_a290_currentSenseFaulted "Front body controller: a290 current sense faulted";
CM_ SG_ 1332 VCFRONT_a290_tempSenseFaulted "Front body controller: a290 temp sense faulted";
CM_ SG_ 1332 VCFRONT_a290_underCurrent "Front body controller: a290 under current";
CM_ SG_ 1332 VCFRONT_a290_overCurrent "Front body controller: a290 over current";
CM_ SG_ 1332 VCFRONT_a290_overTemperature "Front body controller: a290 over temperature";
CM_ SG_ 1332 VCFRONT_a291_outputFaulted "Front body controller: a291 output faulted";
CM_ SG_ 1332 VCFRONT_a291_currentSenseFaulted "Front body controller: a291 current sense faulted";
CM_ SG_ 1332 VCFRONT_a291_tempSenseFaulted "Front body controller: a291 temp sense faulted";
CM_ SG_ 1332 VCFRONT_a291_underCurrent "Front body controller: a291 under current";
CM_ SG_ 1332 VCFRONT_a291_overCurrent "Front body controller: a291 over current";
CM_ SG_ 1332 VCFRONT_a291_overTemperature "Front body controller: a291 over temperature";
CM_ SG_ 1332 VCFRONT_a292_outputFaulted "Front body controller: a292 output faulted";
CM_ SG_ 1332 VCFRONT_a292_currentSenseFaulted "Front body controller: a292 current sense faulted";
CM_ SG_ 1332 VCFRONT_a292_tempSenseFaulted "Front body controller: a292 temp sense faulted";
CM_ SG_ 1332 VCFRONT_a292_underCurrent "Front body controller: a292 under current";
CM_ SG_ 1332 VCFRONT_a292_overCurrent "Front body controller: a292 over current";
CM_ SG_ 1332 VCFRONT_a292_overTemperature "Front body controller: a292 over temperature";
CM_ SG_ 1332 VCFRONT_a293_outputFaulted "Front body controller: a293 output faulted";
CM_ SG_ 1332 VCFRONT_a293_currentSenseFaulted "Front body controller: a293 current sense faulted";
CM_ SG_ 1332 VCFRONT_a293_tempSenseFaulted "Front body controller: a293 temp sense faulted";
CM_ SG_ 1332 VCFRONT_a293_underCurrent "Front body controller: a293 under current";
CM_ SG_ 1332 VCFRONT_a293_overCurrent "Front body controller: a293 over current";
CM_ SG_ 1332 VCFRONT_a293_overTemperature "Front body controller: a293 over temperature";
CM_ SG_ 1332 VCFRONT_a294_outputFaulted "Front body controller: a294 output faulted";
CM_ SG_ 1332 VCFRONT_a294_currentSenseFaulted "Front body controller: a294 current sense faulted";
CM_ SG_ 1332 VCFRONT_a294_tempSenseFaulted "Front body controller: a294 temp sense faulted";
CM_ SG_ 1332 VCFRONT_a294_underCurrent "Front body controller: a294 under current";
CM_ SG_ 1332 VCFRONT_a294_overCurrent "Front body controller: a294 over current";
CM_ SG_ 1332 VCFRONT_a294_overTemperature "Front body controller: a294 over temperature";
CM_ SG_ 1332 VCFRONT_a295_outputFaulted "Front body controller: a295 output faulted";
CM_ SG_ 1332 VCFRONT_a295_currentSenseFaulted "Front body controller: a295 current sense faulted";
CM_ SG_ 1332 VCFRONT_a295_tempSenseFaulted "Front body controller: a295 temp sense faulted";
CM_ SG_ 1332 VCFRONT_a295_underCurrent "Front body controller: a295 under current";
CM_ SG_ 1332 VCFRONT_a295_overCurrent "Front body controller: a295 over current";
CM_ SG_ 1332 VCFRONT_a295_overTemperature "Front body controller: a295 over temperature";
CM_ SG_ 1332 VCFRONT_a297_bmbDeviceId "Front body controller: a297 bmb device id";
CM_ SG_ 1332 VCFRONT_a297_bmbDeviceFaultTempM "Front body controller: a297 bmb device fault temp mask";
CM_ SG_ 1332 VCFRONT_a300_oldType "Front body controller: a300 old type";
CM_ SG_ 1332 VCFRONT_a300_newType "Front body controller: a300 new type";
CM_ SG_ 1332 VCFRONT_a302_LINFrameStatus "Front body controller: a302 LIN frame status";
CM_ SG_ 1332 VCFRONT_a303_vehicleSpeed "Front body controller: a303 vehicle speed";
CM_ SG_ 1332 VCFRONT_a303_postVoltage "Front body controller: a303 post voltage";
CM_ SG_ 1332 VCFRONT_a303_lockStatus "Front body controller: a303 lock status; raw 0 = signal not available (SNA)";
CM_ SG_ 1332 VCFRONT_a304_voltage "Front body controller: a304 voltage";
CM_ SG_ 1332 VCFRONT_a304_temperature "Front body controller: a304 temperature";
CM_ SG_ 1332 VCFRONT_a305_voltage "Front body controller: a305 voltage";
CM_ SG_ 1332 VCFRONT_a305_temperature "Front body controller: a305 temperature";
CM_ SG_ 1332 VCFRONT_a305_actuatorCurrent "Front body controller: a305 actuator current";
CM_ SG_ 1332 VCFRONT_a306_voltage "Front body controller: a306 voltage";
CM_ SG_ 1332 VCFRONT_a306_temperature "Front body controller: a306 temperature";
CM_ SG_ 1332 VCFRONT_a306_actuatorCurrent "Front body controller: a306 actuator current";
CM_ SG_ 1332 VCFRONT_a307_voltage "Front body controller: a307 voltage";
CM_ SG_ 1332 VCFRONT_a307_temperature "Front body controller: a307 temperature";
CM_ SG_ 1332 VCFRONT_a307_actuatorCurrent "Front body controller: a307 actuator current";
CM_ SG_ 1332 VCFRONT_a308_voltage "Front body controller: a308 voltage";
CM_ SG_ 1332 VCFRONT_a308_temperature "Front body controller: a308 temperature";
CM_ SG_ 1332 VCFRONT_a308_actuatorCurrent "Front body controller: a308 actuator current";
CM_ SG_ 1332 VCFRONT_a309_vehicleSpeed "Front body controller: a309 vehicle speed";
CM_ SG_ 1332 VCFRONT_a309_switchVoltage "Front body controller: a309 switch voltage";
CM_ SG_ 1332 VCFRONT_a309_lockStatus "Front body controller: a309 lock status; raw 0 = signal not available (SNA)";
CM_ SG_ 1332 VCFRONT_a334_maxSlope "Front body controller: a334 max slope";
CM_ SG_ 1332 VCFRONT_a334_avgCurrent "Front body controller: a334 avg current";
CM_ SG_ 1332 VCFRONT_a334_maxCurrent "Front body controller: a334 max current";
CM_ SG_ 1332 VCFRONT_a334_vehicleState "Front body controller: a334 vehicle state";
CM_ SG_ 1332 VCFRONT_a335_maxSlope "Front body controller: a335 max slope";
CM_ SG_ 1332 VCFRONT_a335_avgCurrent "Front body controller: a335 avg current";
CM_ SG_ 1332 VCFRONT_a335_maxCurrent "Front body controller: a335 max current";
CM_ SG_ 1332 VCFRONT_a335_vehicleState "Front body controller: a335 vehicle state";
CM_ SG_ 1332 VCFRONT_a336_maxSlope "Front body controller: a336 max slope";
CM_ SG_ 1332 VCFRONT_a336_avgCurrent "Front body controller: a336 avg current";
CM_ SG_ 1332 VCFRONT_a336_maxCurrent "Front body controller: a336 max current";
CM_ SG_ 1332 VCFRONT_a336_vehicleState "Front body controller: a336 vehicle state";
CM_ SG_ 1332 VCFRONT_a337_maxSlope "Front body controller: a337 max slope";
CM_ SG_ 1332 VCFRONT_a337_avgCurrent "Front body controller: a337 avg current";
CM_ SG_ 1332 VCFRONT_a337_maxCurrent "Front body controller: a337 max current";
CM_ SG_ 1332 VCFRONT_a337_vehicleState "Front body controller: a337 vehicle state";
CM_ SG_ 1332 VCFRONT_a338_maxSlope "Front body controller: a338 max slope";
CM_ SG_ 1332 VCFRONT_a338_avgCurrent "Front body controller: a338 avg current";
CM_ SG_ 1332 VCFRONT_a338_maxCurrent "Front body controller: a338 max current";
CM_ SG_ 1332 VCFRONT_a338_vehicleState "Front body controller: a338 vehicle state";
CM_ SG_ 1332 VCFRONT_a339_maxSlope "Front body controller: a339 max slope";
CM_ SG_ 1332 VCFRONT_a339_avgCurrent "Front body controller: a339 avg current";
CM_ SG_ 1332 VCFRONT_a339_maxCurrent "Front body controller: a339 max current";
CM_ SG_ 1332 VCFRONT_a339_vehicleState "Front body controller: a339 vehicle state";
CM_ SG_ 1332 VCFRONT_a340_maxSlope "Front body controller: a340 max slope";
CM_ SG_ 1332 VCFRONT_a340_avgCurrent "Front body controller: a340 avg current";
CM_ SG_ 1332 VCFRONT_a340_maxCurrent "Front body controller: a340 max current";
CM_ SG_ 1332 VCFRONT_a340_vehicleState "Front body controller: a340 vehicle state";
CM_ SG_ 1332 VCFRONT_a341_maxSlope "Front body controller: a341 max slope";
CM_ SG_ 1332 VCFRONT_a341_avgCurrent "Front body controller: a341 avg current";
CM_ SG_ 1332 VCFRONT_a341_maxCurrent "Front body controller: a341 max current";
CM_ SG_ 1332 VCFRONT_a341_vehicleState "Front body controller: a341 vehicle state";
CM_ SG_ 1332 VCFRONT_a342_maxSlope "Front body controller: a342 max slope";
CM_ SG_ 1332 VCFRONT_a342_avgCurrent "Front body controller: a342 avg current";
CM_ SG_ 1332 VCFRONT_a342_maxCurrent "Front body controller: a342 max current";
CM_ SG_ 1332 VCFRONT_a342_vehicleState "Front body controller: a342 vehicle state";
CM_ SG_ 1332 VCFRONT_a343_maxSlope "Front body controller: a343 max slope";
CM_ SG_ 1332 VCFRONT_a343_avgCurrent "Front body controller: a343 avg current";
CM_ SG_ 1332 VCFRONT_a343_maxCurrent "Front body controller: a343 max current";
CM_ SG_ 1332 VCFRONT_a343_vehicleState "Front body controller: a343 vehicle state";
CM_ SG_ 1332 VCFRONT_a344_maxSlope "Front body controller: a344 max slope";
CM_ SG_ 1332 VCFRONT_a344_avgCurrent "Front body controller: a344 avg current";
CM_ SG_ 1332 VCFRONT_a344_maxCurrent "Front body controller: a344 max current";
CM_ SG_ 1332 VCFRONT_a344_vehicleState "Front body controller: a344 vehicle state";
CM_ SG_ 1332 VCFRONT_a345_maxSlope "Front body controller: a345 max slope";
CM_ SG_ 1332 VCFRONT_a345_avgCurrent "Front body controller: a345 avg current";
CM_ SG_ 1332 VCFRONT_a345_maxCurrent "Front body controller: a345 max current";
CM_ SG_ 1332 VCFRONT_a345_vehicleState "Front body controller: a345 vehicle state";
CM_ SG_ 1332 VCFRONT_a346_maxSlope "Front body controller: a346 max slope";
CM_ SG_ 1332 VCFRONT_a346_avgCurrent "Front body controller: a346 avg current";
CM_ SG_ 1332 VCFRONT_a346_maxCurrent "Front body controller: a346 max current";
CM_ SG_ 1332 VCFRONT_a346_vehicleState "Front body controller: a346 vehicle state";
CM_ SG_ 1332 VCFRONT_a347_maxSlope "Front body controller: a347 max slope";
CM_ SG_ 1332 VCFRONT_a347_avgCurrent "Front body controller: a347 avg current";
CM_ SG_ 1332 VCFRONT_a347_maxCurrent "Front body controller: a347 max current";
CM_ SG_ 1332 VCFRONT_a347_vehicleState "Front body controller: a347 vehicle state";
CM_ SG_ 1332 VCFRONT_a348_maxSlope "Front body controller: a348 max slope";
CM_ SG_ 1332 VCFRONT_a348_avgCurrent "Front body controller: a348 avg current";
CM_ SG_ 1332 VCFRONT_a348_maxCurrent "Front body controller: a348 max current";
CM_ SG_ 1332 VCFRONT_a348_vehicleState "Front body controller: a348 vehicle state";
CM_ SG_ 1332 VCFRONT_a349_maxSlope "Front body controller: a349 max slope";
CM_ SG_ 1332 VCFRONT_a349_avgCurrent "Front body controller: a349 avg current";
CM_ SG_ 1332 VCFRONT_a349_maxCurrent "Front body controller: a349 max current";
CM_ SG_ 1332 VCFRONT_a349_vehicleState "Front body controller: a349 vehicle state";
CM_ SG_ 1332 VCFRONT_a350_espValveCurrent "Front body controller: a350 esp valve current";
CM_ SG_ 1332 VCFRONT_a353_wiperHeaterCurrent "Front body controller: a353 wiper heater current";
CM_ SG_ 1332 VCFRONT_a353_batteryVoltage "Front body controller: a353 battery voltage";
CM_ SG_ 1332 VCFRONT_a353_ambientTemperature "Front body controller: a353 ambient temperature; raw 0 = signal not available (SNA)";
CM_ SG_ 1332 VCFRONT_a354_windshieldCameraHea "Front body controller: a354 windshield camera heater current";
CM_ SG_ 1332 VCFRONT_a354_batteryVoltage "Front body controller: a354 battery voltage";
CM_ SG_ 1332 VCFRONT_a354_ambientTemperature "Front body controller: a354 ambient temperature; raw 0 = signal not available (SNA)";
CM_ SG_ 1332 VCFRONT_a355_fluidNotFilled "Front body controller: a355 fluid not filled";
CM_ SG_ 1332 VCFRONT_a355_systemNotCommission "Front body controller: a355 system not commissioned";
CM_ SG_ 1332 VCFRONT_a355_serviceLockout "Front body controller: a355 service lockout";
CM_ SG_ 1332 VCFRONT_a355_factoryGated "Front body controller: a355 factory gated";
CM_ SG_ 1332 VCFRONT_a356_fluidNotFilled "Front body controller: a356 fluid not filled";
CM_ SG_ 1332 VCFRONT_a356_systemNotCommission "Front body controller: a356 system not commissioned";
CM_ SG_ 1332 VCFRONT_a356_serviceLockout "Front body controller: a356 service lockout";
CM_ SG_ 1332 VCFRONT_a356_factoryGated "Front body controller: a356 factory gated";
CM_ SG_ 1332 VCFRONT_a356_refCommissionStatus "Front body controller: a356 ref commission status";
CM_ SG_ 1332 VCFRONT_a357_maxTransientCurrent "Front body controller: a357 max transient current";
CM_ SG_ 1332 VCFRONT_a358_maxTransientCurrent "Front body controller: a358 max transient current";
CM_ SG_ 1332 VCFRONT_a359_IBSVolts "Front body controller: a359 IBS volts";
CM_ SG_ 1332 VCFRONT_a359_IBSAh "Front body controller: a359 IBS ah";
CM_ SG_ 1332 VCFRONT_a359_vehiclePowerState "Front body controller: a359 vehicle power state";
CM_ SG_ 1332 VCFRONT_a359_batterySMState "Front body controller: a359 battery SM state";
CM_ SG_ 1332 VCFRONT_a359_hvState "Front body controller: a359 hv state";
CM_ SG_ 1332 VCFRONT_a359_coolantHasBeenFille "Front body controller: a359 coolant has been filled";
CM_ SG_ 1332 VCFRONT_a359_crashDetected "Front body controller: a359 crash detected";
CM_ SG_ 1332 VCFRONT_a359_BMS_MIA "Front body controller: a359 BMS MIA";
CM_ SG_ 1332 VCFRONT_a359_PCS_MIA "Front body controller: a359 PCS MIA";
CM_ SG_ 1332 VCFRONT_a359_serviceMode "Signal reported by Front body controller";
CM_ SG_ 1332 VCFRONT_a359_dcdcLVSupportStatus "Front body controller: a359 dcdc LV support status";
CM_ SG_ 1332 VCFRONT_a359_bmsState "Front body controller: a359 bms state; raw 9 = signal not available (SNA)";
CM_ SG_ 1332 VCFRONT_a360_vehicleLoadShedActi "Front body controller: a360 vehicle load shed active";
CM_ SG_ 1332 VCFRONT_a360_notEnoughPowerForSu "Front body controller: a360 not enough power for support";
CM_ SG_ 1332 VCFRONT_a367_bmsSoc "Front body controller: a367 bms soc";
CM_ SG_ 1332 VCFRONT_a368_bmsRequestRemoved "Front body controller: a368 bms request removed";
CM_ SG_ 1332 VCFRONT_a368_enteringState "Front body controller: a368 entering state";
CM_ SG_ 1332 VCFRONT_a368_exitingState "Front body controller: a368 exiting state";
CM_ SG_ 1332 VCFRONT_a368_bmsSoc "Front body controller: a368 bms soc";
CM_ SG_ 1332 VCFRONT_a368_systemFaulted "Front body controller: a368 system faulted";
CM_ SG_ 1332 VCFRONT_a368_coolantTempSensorsF "Front body controller: a368 coolant temp sensors faulted";
CM_ SG_ 1332 VCFRONT_a368_coolantValveFaulted "Front body controller: a368 coolant valve faulted";
CM_ SG_ 1332 VCFRONT_a368_louverFaulted "Front body controller: a368 louver faulted";
CM_ SG_ 1332 VCFRONT_a368_fansFaulted "Front body controller: a368 fans faulted";
CM_ SG_ 1332 VCFRONT_a368_coolantNotFilled "Front body controller: a368 coolant not filled";
CM_ SG_ 1332 VCFRONT_a368_coolantPumpsFaulted "Front body controller: a368 coolant pumps faulted";
CM_ SG_ 1332 VCFRONT_a368_preconditionsNotMet "Front body controller: a368 preconditions not met";
CM_ SG_ 1332 VCFRONT_a368_belowSocMin "Front body controller: a368 below soc min";
CM_ SG_ 1332 VCFRONT_a369_powerGenerationLimi "Front body controller: a369 power generation limited";
CM_ SG_ 1332 VCFRONT_a369_heatRejectionLimite "Front body controller: a369 heat rejection limited";
CM_ SG_ 1332 VCFRONT_a369_bmsSoc "Front body controller: a369 bms soc";
CM_ SG_ 1332 VCFRONT_a369_wasteHeatPower "Front body controller: a369 waste heat power";
CM_ SG_ 1332 VCFRONT_a370_IBSVolts "Front body controller: a370 IBS volts";
CM_ SG_ 1332 VCFRONT_a370_IBSAh "Front body controller: a370 IBS ah";
CM_ SG_ 1332 VCFRONT_a370_notEnoughPowerForSu "Front body controller: a370 not enough power for support";
CM_ SG_ 1332 VCFRONT_a370_serviceMode "Signal reported by Front body controller";
CM_ SG_ 1332 VCFRONT_a370_sleepCurrent "Front body controller: a370 sleep current";
CM_ SG_ 1332 VCFRONT_a370_SOC "Front body controller: a370 SOC; raw 7 = signal not available (SNA)";
CM_ SG_ 1332 VCFRONT_a371_shortedCellTestTrig "Front body controller: a371 shorted cell test trigger";
CM_ SG_ 1332 VCFRONT_a371_voltDropOnHighCurre "Front body controller: a371 volt drop on high current trigger";
CM_ SG_ 1332 VCFRONT_a371_deadLVMinimalAhDisc "Front body controller: a371 dead LV minimal ah discharged trigger";
CM_ SG_ 1332 VCFRONT_a371_resistanceEstimatio "Front body controller: a371 resistance estimation hard fail trigger";
CM_ SG_ 1332 VCFRONT_a371_dcrMilliOhmsAboveTh "Front body controller: a371 dcr milli ohms above threshold trigger";
CM_ SG_ 1332 VCFRONT_a371_prechargeLVLoadRedu "Front body controller: a371 precharge LV load reduction trigger";
CM_ SG_ 1332 VCFRONT_a371_instantPrechargeDCR "Front body controller: a371 instant precharge DCR too high trigger";
CM_ SG_ 1332 VCFRONT_a372_bmbDeviceId "Front body controller: a372 bmb device id";
CM_ SG_ 1332 VCFRONT_a372_bmbDeviceFaultBrick "Front body controller: a372 bmb device fault brick mask";
CM_ SG_ 1332 VCFRONT_a373_tempSuperheatActual "Front body controller: a373 temp superheat actual; raw 1023 = signal not available (SNA)";
CM_ SG_ 1332 VCFRONT_a373_tempSuperheatTarget "Front body controller: a373 temp superheat target";
CM_ SG_ 1332 VCFRONT_a373_compDemandChiller "Front body controller: a373 comp demand chiller";
CM_ SG_ 1332 VCFRONT_a374_lccInletSolenoidISe "Front body controller: a374 lcc inlet solenoid i sense";
CM_ SG_ 1332 VCFRONT_a377_wiperStuckOutOfPark "Front body controller: a377 wiper stuck out of park";
CM_ SG_ 1332 VCFRONT_a377_wiperStuckInPark "Front body controller: a377 wiper stuck in park";
CM_ SG_ 1332 VCFRONT_a378_wiperBlocked "Front body controller: a378 wiper blocked";
CM_ SG_ 1332 VCFRONT_a378_wiperOverload "Front body controller: a378 wiper overload";
CM_ SG_ 1332 VCFRONT_a378_wiperFault "Front body controller: a378 wiper fault";
CM_ SG_ 1332 VCFRONT_a378_wiperOvertemperatur "Front body controller: a378 wiper overtemperature";
CM_ SG_ 1332 VCFRONT_a378_wiperUndervoltage "Front body controller: a378 wiper undervoltage";
CM_ SG_ 1332 VCFRONT_a378_wiperOvervoltage "Front body controller: a378 wiper overvoltage";
CM_ SG_ 1332 VCFRONT_a378_wiperLINError "Front body controller: a378 wiper LIN error";
CM_ SG_ 1332 VCFRONT_a387_shortedCellFaultCou "Front body controller: a387 shorted cell fault counter";
CM_ SG_ 1332 VCFRONT_a387_minVoltageReached "Front body controller: a387 min voltage reached";
CM_ SG_ 1332 VCFRONT_a387_opportunisticTest "Front body controller: a387 opportunistic test";
CM_ SG_ 1332 VCFRONT_a387_IBSTemp "Front body controller: a387 IBS temp";
CM_ SG_ 1332 VCFRONT_a387_maxCurrentReached "Front body controller: a387 max current reached";
CM_ SG_ 1332 VCFRONT_a388_shortedCellFaultCou "Front body controller: a388 shorted cell fault counter";
CM_ SG_ 1332 VCFRONT_a388_minVoltageReached "Front body controller: a388 min voltage reached";
CM_ SG_ 1332 VCFRONT_a388_opportunisticTest "Front body controller: a388 opportunistic test";
CM_ SG_ 1332 VCFRONT_a388_IBSTemp "Front body controller: a388 IBS temp";
CM_ SG_ 1332 VCFRONT_a388_maxCurrentReached "Front body controller: a388 max current reached";
CM_ SG_ 1332 VCFRONT_a389_closedAtSpeed "Front body controller: a389 closed at speed";
CM_ SG_ 1332 VCFRONT_a389_faultedWhileOpenAtS "Front body controller: a389 faulted while open at speed";
CM_ SG_ 1332 VCFRONT_a389_possiblyStuckClosed "Front body controller: a389 possibly stuck closed";
CM_ SG_ 1332 VCFRONT_a389_vehicleSpeed "Front body controller: a389 vehicle speed";
CM_ SG_ 1332 VCFRONT_a389_temperature "Front body controller: a389 temperature";
CM_ SG_ 1332 VCFRONT_a389_latchStatus "Front body controller: a389 latch status; raw 0 = signal not available (SNA)";
CM_ SG_ 1332 VCFRONT_a391_switchMismatch "Front body controller: a391 switch mismatch";
CM_ SG_ 1332 VCFRONT_a391_switch1Shorted "Front body controller: a391 switch1 shorted";
CM_ SG_ 1332 VCFRONT_a391_switch1Disconnected "Front body controller: a391 switch1 disconnected";
CM_ SG_ 1332 VCFRONT_a391_switch2Shorted "Front body controller: a391 switch2 shorted";
CM_ SG_ 1332 VCFRONT_a391_switch2Disconnected "Front body controller: a391 switch2 disconnected";
CM_ SG_ 1332 VCFRONT_a391_switch1Voltage "Front body controller: a391 switch1 voltage";
CM_ SG_ 1332 VCFRONT_a391_switch2Voltage "Front body controller: a391 switch2 voltage";
CM_ SG_ 1332 VCFRONT_a392_bmbDeviceId "Front body controller: a392 bmb device id";
CM_ SG_ 1332 VCFRONT_a392_bmbDeviceFaultBrick "Front body controller: a392 bmb device fault brick mask";
CM_ SG_ 1332 VCFRONT_a397_discharge "Front body controller: a397 discharge";
CM_ SG_ 1332 VCFRONT_a397_suction "Front body controller: a397 suction";
CM_ SG_ 1332 VCFRONT_a397_liquid "Front body controller: a397 liquid";
CM_ SG_ 1332 VCFRONT_a397_offsetError "Front body controller: a397 offset error";
CM_ SG_ 1332 VCFRONT_a397_runTimeOffSetDetect "Front body controller: a397 run time off set detected";
CM_ SG_ 1332 VCFRONT_a401_LVBatteryTemp "Front body controller: a401 LV battery temp; raw 127 = signal not available (SNA)";
CM_ SG_ 1332 VCFRONT_a401_IBSCurrent "Front body controller: a401 IBS current";
CM_ SG_ 1332 VCFRONT_a401_IBSVoltage "Front body controller: a401 IBS voltage";
CM_ SG_ 1332 VCFRONT_a401_IBSAmpHours "Front body controller: a401 IBS amp hours";
CM_ SG_ 1332 VCFRONT_a402_LVBatteryTemp "Front body controller: a402 LV battery temp; raw 127 = signal not available (SNA)";
CM_ SG_ 1332 VCFRONT_a402_batterySMState "Front body controller: a402 battery SM state";
CM_ SG_ 1332 VCFRONT_a402_failureToPrechargeR "Front body controller: a402 failure to precharge risk";
CM_ SG_ 1332 VCFRONT_a402_electricalDisconnec "Front body controller: a402 electrical disconnect LV battery";
CM_ SG_ 1332 VCFRONT_a402_communicationDiscon "Front body controller: a402 communication disconnect LV battery";
CM_ SG_ 1332 VCFRONT_a402_reverseBatteryFault "Front body controller: a402 reverse battery fault";
CM_ SG_ 1332 VCFRONT_a402_MOSOpen "Front body controller: a402 MOS open";
CM_ SG_ 1332 VCFRONT_a402_serviceMode "Signal reported by Front body controller";
CM_ SG_ 1332 VCFRONT_a402_frunkOpen "Front body controller: a402 frunk open";
CM_ SG_ 1332 VCFRONT_a404_minVoltageReached "Front body controller: a404 min voltage reached";
CM_ SG_ 1332 VCFRONT_a404_IBSTemp "Front body controller: a404 IBS temp";
CM_ SG_ 1332 VCFRONT_a404_maxCurrentReached "Front body controller: a404 max current reached";
CM_ SG_ 1332 VCFRONT_a407_dcrMilliOhms "Front body controller: a407 dcr milli ohms";
CM_ SG_ 1332 VCFRONT_a407_dcr12VThreshold "Front body controller: a407 dcr12 v threshold";
CM_ SG_ 1332 VCFRONT_a407_avgIntervalCurrent "Front body controller: a407 avg interval current";
CM_ SG_ 1332 VCFRONT_a407_intervalCurrentVari "Front body controller: a407 interval current variance";
CM_ SG_ 1332 VCFRONT_a407_avgPulseCurrent "Front body controller: a407 avg pulse current";
CM_ SG_ 1332 VCFRONT_a407_pulseCurrentVarianc "Front body controller: a407 pulse current variance";
CM_ SG_ 1332 VCFRONT_a407_IBSTemperature "Front body controller: a407 IBS temperature";
CM_ SG_ 1332 VCFRONT_a407_testCounter "Front body controller: a407 test counter";
CM_ SG_ 1332 VCFRONT_a407_testingExpended "Front body controller: a407 testing expended";
CM_ SG_ 1332 VCFRONT_a407_opportunisticTest "Front body controller: a407 opportunistic test";
CM_ SG_ 1332 VCFRONT_a409_brushlessMotorConfi "Front body controller: a409 brushless motor configuration invalid";
CM_ SG_ 1332 VCFRONT_a414_dcrMilliOhms "Front body controller: a414 dcr milli ohms";
CM_ SG_ 1332 VCFRONT_a414_LVBatteryTemp "Front body controller: a414 LV battery temp; raw 127 = signal not available (SNA)";
CM_ SG_ 1332 VCFRONT_a414_IBSCurrent "Front body controller: a414 IBS current";
CM_ SG_ 1332 VCFRONT_a414_IBSVoltage "Front body controller: a414 IBS voltage";
CM_ SG_ 1332 VCFRONT_a414_IBSAmpHours "Front body controller: a414 IBS amp hours";
CM_ SG_ 1332 VCFRONT_a414_vehiclePowerState "Front body controller: a414 vehicle power state";
CM_ SG_ 1332 VCFRONT_a415_dcrMilliOhms "Front body controller: a415 dcr milli ohms";
CM_ SG_ 1332 VCFRONT_a415_LVBatteryTemp "Front body controller: a415 LV battery temp; raw 127 = signal not available (SNA)";
CM_ SG_ 1332 VCFRONT_a415_IBSCurrent "Front body controller: a415 IBS current";
CM_ SG_ 1332 VCFRONT_a415_IBSVoltage "Front body controller: a415 IBS voltage";
CM_ SG_ 1332 VCFRONT_a415_IBSAmpHours "Front body controller: a415 IBS amp hours";
CM_ SG_ 1332 VCFRONT_a415_vehiclePowerState "Front body controller: a415 vehicle power state";
CM_ SG_ 1332 VCFRONT_a415_HV_UP "Front body controller: a415 HV UP";
CM_ SG_ 1332 VCFRONT_a415_hvUpFirstTrigger "Front body controller: a415 hv up first trigger";
CM_ SG_ 1332 VCFRONT_a415_hvUpAnyTrigger "Front body controller: a415 hv up any trigger";
CM_ SG_ 1332 VCFRONT_a415_pcsEFuseUnstable "Front body controller: a415 pcs e fuse unstable";
CM_ SG_ 1332 VCFRONT_a415_vcrightEfuseUnstabl "Front body controller: a415 vcright efuse unstable";
CM_ SG_ 1332 VCFRONT_a415_vcleftEfuseUnstable "Front body controller: a415 vcleft efuse unstable";
CM_ SG_ 1332 VCFRONT_a415_contactorEFuseUnsta "Front body controller: a415 contactor e fuse unstable";
CM_ SG_ 1332 VCFRONT_a415_hvcEFuseUnstable "Front body controller: a415 hvc e fuse unstable";
CM_ SG_ 1332 VCFRONT_a416_brickVoltageMin "Front body controller: a416 brick voltage min";
CM_ SG_ 1332 VCFRONT_a416_brickVoltageMax "Front body controller: a416 brick voltage max";
CM_ SG_ 1332 VCFRONT_a416_packCurrent "Front body controller: a416 pack current";
CM_ SG_ 1332 VCFRONT_a416_socMin "Front body controller: a416 soc min";
CM_ SG_ 1332 VCFRONT_a416_brickId "Front body controller: a416 brick id";
CM_ SG_ 1332 VCFRONT_a417_brickVoltageMin "Front body controller: a417 brick voltage min";
CM_ SG_ 1332 VCFRONT_a417_brickVoltageMax "Front body controller: a417 brick voltage max";
CM_ SG_ 1332 VCFRONT_a417_packCurrent "Front body controller: a417 pack current";
CM_ SG_ 1332 VCFRONT_a417_socMax "Front body controller: a417 soc max";
CM_ SG_ 1332 VCFRONT_a417_brickId "Front body controller: a417 brick id";
CM_ SG_ 1332 VCFRONT_a418_brickVoltageMin "Front body controller: a418 brick voltage min";
CM_ SG_ 1332 VCFRONT_a418_brickVoltageMax "Front body controller: a418 brick voltage max";
CM_ SG_ 1332 VCFRONT_a418_packCurrent "Front body controller: a418 pack current";
CM_ SG_ 1332 VCFRONT_a418_socMax "Front body controller: a418 soc max";
CM_ SG_ 1332 VCFRONT_a418_brickId "Front body controller: a418 brick id";
CM_ SG_ 1332 VCFRONT_a419_brickVoltageMin "Front body controller: a419 brick voltage min";
CM_ SG_ 1332 VCFRONT_a419_brickVoltageMax "Front body controller: a419 brick voltage max";
CM_ SG_ 1332 VCFRONT_a419_packCurrent "Front body controller: a419 pack current";
CM_ SG_ 1332 VCFRONT_a419_socMin "Front body controller: a419 soc min";
CM_ SG_ 1332 VCFRONT_a419_brickId "Front body controller: a419 brick id";
CM_ SG_ 1332 VCFRONT_a423_brickVoltageMin "Front body controller: a423 brick voltage min";
CM_ SG_ 1332 VCFRONT_a423_brickVoltageMax "Front body controller: a423 brick voltage max";
CM_ SG_ 1332 VCFRONT_a423_packCurrent "Front body controller: a423 pack current";
CM_ SG_ 1332 VCFRONT_a423_socMin "Front body controller: a423 soc min";
CM_ SG_ 1332 VCFRONT_a423_brickId "Front body controller: a423 brick id";
CM_ SG_ 1332 VCFRONT_a424_brickVoltageMin "Front body controller: a424 brick voltage min";
CM_ SG_ 1332 VCFRONT_a424_brickVoltageMax "Front body controller: a424 brick voltage max";
CM_ SG_ 1332 VCFRONT_a424_packCurrent "Front body controller: a424 pack current";
CM_ SG_ 1332 VCFRONT_a424_socMin "Front body controller: a424 soc min";
CM_ SG_ 1332 VCFRONT_a424_brickId "Front body controller: a424 brick id";
CM_ SG_ 1332 VCFRONT_a431_netPackCurrent "Front body controller: a431 net pack current; raw 32768 = signal not available (SNA)";
CM_ SG_ 1332 VCFRONT_a431_maxChargeCurrentLim "Front body controller: a431 max charge current limit; raw 32768 = signal not available (SNA)";
CM_ SG_ 1332 VCFRONT_a431_hvjbCurrentLimit "Front body controller: a431 hvjb current limit; raw 32768 = signal not available (SNA)";
CM_ SG_ 1332 VCFRONT_a432_targetCurrent "Front body controller: a432 target current; raw 32768 = signal not available (SNA)";
CM_ SG_ 1332 VCFRONT_a432_packCurrent "Front body controller: a432 pack current; raw 32768 = signal not available (SNA)";
CM_ SG_ 1332 VCFRONT_a433_bmbModuleId "Front body controller: a433 bmb module id";
CM_ SG_ 1332 VCFRONT_a433_packTypeData "Front body controller: a433 pack type data";
CM_ SG_ 1332 VCFRONT_a433_cellTypeData "Front body controller: a433 cell type data";
CM_ SG_ 1332 VCFRONT_a433_bmbModuleIdValid "Front body controller: a433 bmb module id valid";
CM_ SG_ 1332 VCFRONT_a433_useBmbModuleId "Front body controller: a433 use bmb module id";
CM_ SG_ 1332 VCFRONT_a434_bmbModuleId "Front body controller: a434 bmb module id";
CM_ SG_ 1332 VCFRONT_a434_packTypeData "Front body controller: a434 pack type data";
CM_ SG_ 1332 VCFRONT_a434_cellTypeData "Front body controller: a434 cell type data";
CM_ SG_ 1332 VCFRONT_a434_bmbModuleIdValid "Front body controller: a434 bmb module id valid";
CM_ SG_ 1332 VCFRONT_a434_useBmbModuleId "Front body controller: a434 use bmb module id";
CM_ SG_ 1332 VCFRONT_a436_netPackCurrent "Front body controller: a436 net pack current; raw 32768 = signal not available (SNA)";
CM_ SG_ 1332 VCFRONT_a436_maxDischargeCurrent "Front body controller: a436 max discharge current limit; raw 32768 = signal not available (SNA)";
CM_ SG_ 1332 VCFRONT_a436_hvjbCurrentLimit "Front body controller: a436 hvjb current limit; raw 32768 = signal not available (SNA)";
CM_ SG_ 1332 VCFRONT_a437_nvmDataMissingA "Front body controller: a437 nvm data missing a";
CM_ SG_ 1332 VCFRONT_a437_nvmDataMissingB "Front body controller: a437 nvm data missing b";
CM_ SG_ 1332 VCFRONT_a438_temperature "Front body controller: a438 temperature";
CM_ SG_ 1332 VCFRONT_a438_sensorId "Front body controller: a438 sensor id";
CM_ SG_ 1332 VCFRONT_a439_temperature "Front body controller: a439 temperature";
CM_ SG_ 1332 VCFRONT_a439_sensorId "Front body controller: a439 sensor id";
CM_ SG_ 1332 VCFRONT_a441_bmbModuleId "Front body controller: a441 bmb module id";
CM_ SG_ 1332 VCFRONT_a441_bmbModuleIdPrev "Front body controller: a441 bmb module id prev";
CM_ SG_ 1332 VCFRONT_a444_retriesAvailable "Front body controller: a444 retries available";
CM_ SG_ 1332 VCFRONT_a444_channel "Front body controller: a444 channel";
CM_ SG_ 1332 VCFRONT_a444_watchdog "Front body controller: a444 watchdog";
CM_ SG_ 1332 VCFRONT_a444_gateDriver "Front body controller: a444 gate driver";
CM_ SG_ 1332 VCFRONT_a444_overcurrent "Front body controller: a444 overcurrent";
CM_ SG_ 1332 VCFRONT_a444_supplyUndervoltage "Front body controller: a444 supply undervoltage";
CM_ SG_ 1332 VCFRONT_a444_cpUndervoltage "Front body controller: a444 cp undervoltage";
CM_ SG_ 1332 VCFRONT_a444_overTempShutdown "Front body controller: a444 over temp shutdown";
CM_ SG_ 1332 VCFRONT_a444_overTempWarning "Front body controller: a444 over temp warning";
CM_ SG_ 1332 VCFRONT_a444_highSide2GateDriver "Front body controller: a444 high side2 gate driver";
CM_ SG_ 1332 VCFRONT_a444_lowSide2GateDriver "Front body controller: a444 low side2 gate driver";
CM_ SG_ 1332 VCFRONT_a444_highSide1GateDriver "Front body controller: a444 high side1 gate driver";
CM_ SG_ 1332 VCFRONT_a444_lowSide1GateDriver "Front body controller: a444 low side1 gate driver";
CM_ SG_ 1332 VCFRONT_a444_highSide2OverCurent "Front body controller: a444 high side2 over curent";
CM_ SG_ 1332 VCFRONT_a444_lowSide2OverCurent "Front body controller: a444 low side2 over curent";
CM_ SG_ 1332 VCFRONT_a444_highSide1OverCurent "Front body controller: a444 high side1 over curent";
CM_ SG_ 1332 VCFRONT_a444_lowSide1OverCurent "Front body controller: a444 low side1 over curent";
CM_ SG_ 1332 VCFRONT_a444_spiInit "Front body controller: a444 spi init";
CM_ SG_ 1332 VCFRONT_a444_spiPeriodicCheck "Front body controller: a444 spi periodic check";
CM_ SG_ 1332 VCFRONT_a444_spiFault "Front body controller: a444 spi fault";
CM_ SG_ 1332 VCFRONT_a444_voltageMonitor "Front body controller: a444 voltage monitor";
CM_ SG_ 1332 VCFRONT_a444_enableLow "Front body controller: a444 enable low";
CM_ SG_ 1332 VCFRONT_a446_compFaultRefrigeran "Front body controller: a446 comp fault refrigerant";
CM_ SG_ 1332 VCFRONT_a446_compFaultTdHigh "Front body controller: a446 comp fault td high";
CM_ SG_ 1332 VCFRONT_a446_compFaultPdLow "Front body controller: a446 comp fault pd low";
CM_ SG_ 1332 VCFRONT_a446_compFaultPdHigh "Front body controller: a446 comp fault pd high";
CM_ SG_ 1332 VCFRONT_a446_compFaultPsLow "Front body controller: a446 comp fault ps low";
CM_ SG_ 1332 VCFRONT_a446_compStandbyLowAmbie "Front body controller: a446 comp standby low ambient";
CM_ SG_ 1332 VCFRONT_a446_compStandbyLowDisch "Front body controller: a446 comp standby low disch press";
CM_ SG_ 1332 VCFRONT_a446_compStandbyHVNotRea "Front body controller: a446 comp standby HV not ready";
CM_ SG_ 1332 VCFRONT_a446_compStandbyCommunic "Front body controller: a446 comp standby communication";
CM_ SG_ 1332 VCFRONT_a446_compStandbySelfNotR "Front body controller: a446 comp standby self not ready";
CM_ SG_ 1332 VCFRONT_a446_compStandbyRefrigNo "Front body controller: a446 comp standby refrig not ok";
CM_ SG_ 1332 VCFRONT_a446_compStandbyCoastDow "Front body controller: a446 comp standby coast down mode";
CM_ SG_ 1332 VCFRONT_a446_compStandbyMultiple "Front body controller: a446 comp standby multiple pd cutouts";
CM_ SG_ 1332 VCFRONT_a446_compStandbyShowroom "Front body controller: a446 comp standby showroom mode";
CM_ SG_ 1332 VCFRONT_a446_compStandbyMul_0001 "Front body controller: a446 comp standby multiple td cutouts";
CM_ SG_ 1332 VCFRONT_a446_hpCabinLoadType "Front body controller: a446 hp cabin load type";
CM_ SG_ 1332 VCFRONT_a446_hpBatteryLoadType "Front body controller: a446 hp battery load type";
CM_ SG_ 1332 VCFRONT_a446_usingModeledPs "Front body controller: a446 using modeled ps";
CM_ SG_ 1332 VCFRONT_a446_usingModeledPd "Front body controller: a446 using modeled pd";
CM_ SG_ 1332 VCFRONT_a446_usingModeledPl "Front body controller: a446 using modeled pl";
CM_ SG_ 1332 VCFRONT_a446_usingModeledTs "Front body controller: a446 using modeled ts";
CM_ SG_ 1332 VCFRONT_a446_usingModeledTd "Front body controller: a446 using modeled td";
CM_ SG_ 1332 VCFRONT_a446_usingModeledTl "Front body controller: a446 using modeled tl";
CM_ SG_ 1332 VCFRONT_a446_sensorHasOffsetTd "Front body controller: a446 sensor has offset td";
CM_ SG_ 1332 VCFRONT_a446_sensorHasOffsetPd "Front body controller: a446 sensor has offset pd";
CM_ SG_ 1332 VCFRONT_a446_sensorDroopPd "Front body controller: a446 sensor droop pd";
CM_ SG_ 1332 VCFRONT_a446_sensorHasOffsetTl "Front body controller: a446 sensor has offset tl";
CM_ SG_ 1332 VCFRONT_a446_sensorIntermit_0002 "Front body controller: a446 sensor intermittent ps";
CM_ SG_ 1332 VCFRONT_a446_sensorIntermittentP "Front body controller: a446 sensor intermittent pd";
CM_ SG_ 1332 VCFRONT_a446_sensorIntermit_0001 "Front body controller: a446 sensor intermittent pl";
CM_ SG_ 1332 VCFRONT_a446_sensorIntermit_0004 "Front body controller: a446 sensor intermittent ts";
CM_ SG_ 1332 VCFRONT_a446_sensorIntermittentT "Front body controller: a446 sensor intermittent td";
CM_ SG_ 1332 VCFRONT_a446_sensorIntermit_0003 "Front body controller: a446 sensor intermittent tl";
CM_ SG_ 1332 VCFRONT_a446_highSuctionSuperhea "Front body controller: a446 high suction superheat";
CM_ SG_ 1332 VCFRONT_a446_evapLowPsCutout "Front body controller: a446 evap low ps cutout";
CM_ SG_ 1332 VCFRONT_a446_batteryOverTemp "Front body controller: a446 battery over temp";
CM_ SG_ 1332 VCFRONT_a446_hvacSystemFault "Front body controller: a446 hvac system fault";
CM_ SG_ 1332 VCFRONT_a446_coolantSysLockedOut "Front body controller: a446 coolant sys locked out";
CM_ SG_ 1332 VCFRONT_a446_refSysLockedOut "Front body controller: a446 ref sys locked out";
CM_ SG_ 1332 VCFRONT_a446_chillerEXVNotReady "Front body controller: a446 chiller EXV not ready";
CM_ SG_ 1332 VCFRONT_a446_CCLEXVNotReady "Front body controller: a446 CCLEXV not ready";
CM_ SG_ 1332 VCFRONT_a446_CCREXVNotReady "Front body controller: a446 CCREXV not ready";
CM_ SG_ 1332 VCFRONT_a446_LCCEXVNotReady "Front body controller: a446 LCCEXV not ready";
CM_ SG_ 1332 VCFRONT_a446_evapEXVNotReady "Front body controller: a446 evap EXV not ready";
CM_ SG_ 1332 VCFRONT_a446_recircEXVNotReady "Front body controller: a446 recirc EXV not ready";
CM_ SG_ 1332 VCFRONT_a446_checkA447Alert "Front body controller: a446 check A447 alert";
CM_ SG_ 1332 VCFRONT_a447_caseHVACUnavailable "Front body controller: a447 case HVAC unavailable";
CM_ SG_ 1332 VCFRONT_a447_heatPumpHVACUnavail "Front body controller: a447 heat pump HVAC unavailable";
CM_ SG_ 1332 VCFRONT_a447_activeLouverComprom "Front body controller: a447 active louver compromised";
CM_ SG_ 1332 VCFRONT_a447_coolantValveComprom "Front body controller: a447 coolant valve compromised";
CM_ SG_ 1332 VCFRONT_a447_ambientSourcingComp "Front body controller: a447 ambient sourcing compromised";
CM_ SG_ 1332 VCFRONT_a447_scavengeLoopComprom "Front body controller: a447 scavenge loop compromised";
CM_ SG_ 1332 VCFRONT_a447_coolantSystemCompro "Front body controller: a447 coolant system compromised";
CM_ SG_ 1332 VCFRONT_a447_hvBattActiveDischgC "Front body controller: a447 hv batt active dischg compromised";
CM_ SG_ 1332 VCFRONT_a447_hvBatteryDischargin "Front body controller: a447 hv battery discharging compromised";
CM_ SG_ 1332 VCFRONT_a447_lccSolenoidCompromi "Front body controller: a447 lcc solenoid compromised";
CM_ SG_ 1332 VCFRONT_a447_refrigerantSystemCo "Front body controller: a447 refrigerant system compromised";
CM_ SG_ 1332 VCFRONT_a447_powertrainThermalFa "Front body controller: a447 powertrain thermal fans compromised";
CM_ SG_ 1332 VCFRONT_a447_refrigDischargePres "Front body controller: a447 refrig discharge press compromised";
CM_ SG_ 1332 VCFRONT_a447_refrigeDischargeTem "Front body controller: a447 refrige discharge temp compromised";
CM_ SG_ 1332 VCFRONT_a447_refrigSuctionPressC "Front body controller: a447 refrig suction press compromised";
CM_ SG_ 1332 VCFRONT_a447_refrigSuctionTempCo "Front body controller: a447 refrig suction temp compromised";
CM_ SG_ 1332 VCFRONT_a447_refrigLiquidPressCo "Front body controller: a447 refrig liquid press compromised";
CM_ SG_ 1332 VCFRONT_a447_refrigLiquidTempCom "Front body controller: a447 refrig liquid temp compromised";
CM_ SG_ 1332 VCFRONT_a459_coolantFillActive "Front body controller: a459 coolant fill active";
CM_ SG_ 1332 VCFRONT_a459_refrigerantFillActi "Front body controller: a459 refrigerant fill active";
CM_ SG_ 1332 VCFRONT_a462_CellOVLevel1 "Front body controller: a462 cell OV level1";
CM_ SG_ 1332 VCFRONT_a462_CellOVLevel2 "Front body controller: a462 cell OV level2";
CM_ SG_ 1332 VCFRONT_a462_CellOVLevel3 "Front body controller: a462 cell OV level3";
CM_ SG_ 1332 VCFRONT_a462_CellUVLevel1 "Front body controller: a462 cell UV level1";
CM_ SG_ 1332 VCFRONT_a462_CellUVLevel2 "Front body controller: a462 cell UV level2";
CM_ SG_ 1332 VCFRONT_a462_ModuleOTLevel1 "Front body controller: a462 module OT level1";
CM_ SG_ 1332 VCFRONT_a462_PackOVLevel1 "Front body controller: a462 pack OV level1";
CM_ SG_ 1332 VCFRONT_a462_PackOVLevel2 "Front body controller: a462 pack OV level2";
CM_ SG_ 1332 VCFRONT_a462_DischrgOCLevel1 "Front body controller: a462 dischrg OC level1";
CM_ SG_ 1332 VCFRONT_a462_HardwareOCLevel2 "Front body controller: a462 hardware OC level2";
CM_ SG_ 1332 VCFRONT_a462_ChrgOCLevel1 "Front body controller: a462 chrg OC level1";
CM_ SG_ 1332 VCFRONT_a462_ChrgOCLevel2 "Front body controller: a462 chrg OC level2";
CM_ SG_ 1332 VCFRONT_a462_MOSFETOTLevel1 "Front body controller: a462 MOSFETOT level1";
CM_ SG_ 1332 VCFRONT_a462_CPA_State "Front body controller: a462 CPA state";
CM_ SG_ 1332 VCFRONT_a462_NTCTempDiffWarnLeve "Front body controller: a462 NTC temp diff warn level1";
CM_ SG_ 1332 VCFRONT_a462_KBValueLostFault "Front body controller: a462 KB value lost fault";
CM_ SG_ 1332 VCFRONT_a462_BalanceCircuitFault "Front body controller: a462 balance circuit fault";
CM_ SG_ 1332 VCFRONT_a462_MOSOpenFault "Front body controller: a462 MOS open fault";
CM_ SG_ 1332 VCFRONT_a462_DeepDischarge "Front body controller: a462 deep discharge";
CM_ SG_ 1332 VCFRONT_a462_SamplingError "Front body controller: a462 sampling error";
CM_ SG_ 1332 VCFRONT_a462_MOSFETStuckClose "Front body controller: a462 MOSFET stuck close";
CM_ SG_ 1332 VCFRONT_a462_MOSFETStuckOpen "Front body controller: a462 MOSFET stuck open";
CM_ SG_ 1332 VCFRONT_a462_Imbalance "Front body controller: a462 imbalance";
CM_ SG_ 1332 VCFRONT_a462_serviceMode "Signal reported by Front body controller";
CM_ SG_ 1332 VCFRONT_a462_frunkOpen "Front body controller: a462 frunk open";
CM_ SG_ 1332 VCFRONT_a463_switchMismatch "Front body controller: a463 switch mismatch";
CM_ SG_ 1332 VCFRONT_a463_switch1Shorted "Front body controller: a463 switch1 shorted";
CM_ SG_ 1332 VCFRONT_a463_switch1Disconnected "Front body controller: a463 switch1 disconnected";
CM_ SG_ 1332 VCFRONT_a463_switch2Shorted "Front body controller: a463 switch2 shorted";
CM_ SG_ 1332 VCFRONT_a463_switch2Disconnected "Front body controller: a463 switch2 disconnected";
CM_ SG_ 1332 VCFRONT_a463_switch1Voltage "Front body controller: a463 switch1 voltage";
CM_ SG_ 1332 VCFRONT_a463_switch2Voltage "Front body controller: a463 switch2 voltage";
CM_ SG_ 1332 VCFRONT_a464_flowIndex "Front body controller: a464 flow index";
CM_ SG_ 1332 VCFRONT_a464_flowIndexFiltered "Front body controller: a464 flow index filtered";
CM_ SG_ 1332 VCFRONT_a464_subcool "Front body controller: a464 subcool";
CM_ SG_ 1332 VCFRONT_a464_subcoolFiltered "Front body controller: a464 subcool filtered";
CM_ SG_ 1332 VCFRONT_a465_flowIndex "Front body controller: a465 flow index";
CM_ SG_ 1332 VCFRONT_a465_flowIndexFiltered "Front body controller: a465 flow index filtered";
CM_ SG_ 1332 VCFRONT_a465_subcool "Front body controller: a465 subcool";
CM_ SG_ 1332 VCFRONT_a465_subcoolFiltered "Front body controller: a465 subcool filtered";
CM_ SG_ 1332 VCFRONT_a465_flaggedAtSteadyStat "Front body controller: a465 flagged at steady state";
CM_ SG_ 1332 VCFRONT_a465_flaggedAtUnsteadySt "Front body controller: a465 flagged at unsteady state";
CM_ SG_ 1332 VCFRONT_a466_flowIndex "Front body controller: a466 flow index";
CM_ SG_ 1332 VCFRONT_a466_flowIndexFiltered "Front body controller: a466 flow index filtered";
CM_ SG_ 1332 VCFRONT_a466_subcool "Front body controller: a466 subcool";
CM_ SG_ 1332 VCFRONT_a466_subcoolFiltered "Front body controller: a466 subcool filtered";
CM_ SG_ 1332 VCFRONT_a467_powerIndexFiltered "Front body controller: a467 power index filtered";
CM_ SG_ 1332 VCFRONT_a470_pressureLiquid "Front body controller: a470 pressure liquid";
CM_ SG_ 1332 VCFRONT_a470_pressureDischarge "Front body controller: a470 pressure discharge";
CM_ SG_ 1332 VCFRONT_a474_ssl100Bank1Status "Front body controller: a474 ssl100 bank1 status";
CM_ SG_ 1332 VCFRONT_a474_ssl100Bank2Status "Front body controller: a474 ssl100 bank2 status";
CM_ SG_ 1332 VCFRONT_a474_ssl100Bank3Status "Front body controller: a474 ssl100 bank3 status";
CM_ SG_ 1332 VCFRONT_a474_ssl100Bank4Status "Front body controller: a474 ssl100 bank4 status";
CM_ SG_ 1332 VCFRONT_a474_ssl100Bank5Status "Front body controller: a474 ssl100 bank5 status";
CM_ SG_ 1332 VCFRONT_a474_ssl100Bank6Status "Front body controller: a474 ssl100 bank6 status";
CM_ SG_ 1332 VCFRONT_a474_ssl100Bank7Status "Front body controller: a474 ssl100 bank7 status";
CM_ SG_ 1332 VCFRONT_a474_ssl100Bank8Status "Front body controller: a474 ssl100 bank8 status";
CM_ SG_ 1332 VCFRONT_a474_ssl100Bank9Status "Front body controller: a474 ssl100 bank9 status";
CM_ SG_ 1332 VCFRONT_a474_lowBeamPrefieldStat "Front body controller: a474 low beam prefield status";
CM_ SG_ 1332 VCFRONT_a474_drl1Status "Front body controller: a474 drl1 status";
CM_ SG_ 1332 VCFRONT_a474_drl2Status "Front body controller: a474 drl2 status";
CM_ SG_ 1332 VCFRONT_a474_drl3Status "Front body controller: a474 drl3 status";
CM_ SG_ 1332 VCFRONT_a474_turnStatus "Front body controller: a474 turn status";
CM_ SG_ 1332 VCFRONT_a474_fanStatus "Front body controller: a474 fan status";
CM_ SG_ 1332 VCFRONT_a474_TPS92520_COMPOV "Front body controller: a474 TPS92520 COMPOV";
CM_ SG_ 1332 VCFRONT_a474_TPS92520_HSILIM "Front body controller: a474 TPS92520 HSILIM";
CM_ SG_ 1332 VCFRONT_a474_TPS92520_BSTUV "Front body controller: a474 TPS92520 BSTUV";
CM_ SG_ 1332 VCFRONT_a474_BoostRailStatus "Front body controller: a474 boost rail status";
CM_ SG_ 1332 VCFRONT_a474_EEPROM_DataStatus "Front body controller: a474 EEPROM data status";
CM_ SG_ 1332 VCFRONT_a474_LMMVariant "Front body controller: a474 LMM variant; raw 0 = signal not available (SNA)";
CM_ SG_ 1332 VCFRONT_a474_headlampECURevision "Front body controller: a474 headlamp ECU revision";
CM_ SG_ 1332 VCFRONT_a475_ssl100Bank1Status "Front body controller: a475 ssl100 bank1 status";
CM_ SG_ 1332 VCFRONT_a475_ssl100Bank2Status "Front body controller: a475 ssl100 bank2 status";
CM_ SG_ 1332 VCFRONT_a475_ssl100Bank3Status "Front body controller: a475 ssl100 bank3 status";
CM_ SG_ 1332 VCFRONT_a475_ssl100Bank4Status "Front body controller: a475 ssl100 bank4 status";
CM_ SG_ 1332 VCFRONT_a475_ssl100Bank5Status "Front body controller: a475 ssl100 bank5 status";
CM_ SG_ 1332 VCFRONT_a475_ssl100Bank6Status "Front body controller: a475 ssl100 bank6 status";
CM_ SG_ 1332 VCFRONT_a475_ssl100Bank7Status "Front body controller: a475 ssl100 bank7 status";
CM_ SG_ 1332 VCFRONT_a475_ssl100Bank8Status "Front body controller: a475 ssl100 bank8 status";
CM_ SG_ 1332 VCFRONT_a475_ssl100Bank9Status "Front body controller: a475 ssl100 bank9 status";
CM_ SG_ 1332 VCFRONT_a475_lowBeamPrefieldStat "Front body controller: a475 low beam prefield status";
CM_ SG_ 1332 VCFRONT_a475_drl1Status "Front body controller: a475 drl1 status";
CM_ SG_ 1332 VCFRONT_a475_drl2Status "Front body controller: a475 drl2 status";
CM_ SG_ 1332 VCFRONT_a475_drl3Status "Front body controller: a475 drl3 status";
CM_ SG_ 1332 VCFRONT_a475_turnStatus "Front body controller: a475 turn status";
CM_ SG_ 1332 VCFRONT_a475_fanStatus "Front body controller: a475 fan status";
CM_ SG_ 1332 VCFRONT_a475_TPS92520_COMPOV "Front body controller: a475 TPS92520 COMPOV";
CM_ SG_ 1332 VCFRONT_a475_TPS92520_HSILIM "Front body controller: a475 TPS92520 HSILIM";
CM_ SG_ 1332 VCFRONT_a475_TPS92520_BSTUV "Front body controller: a475 TPS92520 BSTUV";
CM_ SG_ 1332 VCFRONT_a475_BoostRailStatus "Front body controller: a475 boost rail status";
CM_ SG_ 1332 VCFRONT_a475_EEPROM_DataStatus "Front body controller: a475 EEPROM data status";
CM_ SG_ 1332 VCFRONT_a475_LMMVariant "Front body controller: a475 LMM variant; raw 0 = signal not available (SNA)";
CM_ SG_ 1332 VCFRONT_a475_headlampECURevision "Front body controller: a475 headlamp ECU revision";
CM_ SG_ 1332 VCFRONT_a476_FRM1_timedOut "Front body controller: a476 FRM1 timed out";
CM_ SG_ 1332 VCFRONT_a476_FRM2_timedOut "Front body controller: a476 FRM2 timed out";
CM_ SG_ 1332 VCFRONT_a476_FRM3_timedOut "Front body controller: a476 FRM3 timed out";
CM_ SG_ 1332 VCFRONT_a476_FRM4_timedOut "Front body controller: a476 FRM4 timed out";
CM_ SG_ 1332 VCFRONT_a476_FRM5_timedOut "Front body controller: a476 FRM5 timed out";
CM_ SG_ 1332 VCFRONT_a476_FRM6_timedOut "Front body controller: a476 FRM6 timed out";
CM_ SG_ 1332 VCFRONT_a476_FRM7_timedOut "Front body controller: a476 FRM7 timed out";
CM_ SG_ 1332 VCFRONT_a476_FRM8_timedOut "Front body controller: a476 FRM8 timed out";
CM_ SG_ 1332 VCFRONT_a476_FRM9_timedOut "Front body controller: a476 FRM9 timed out";
CM_ SG_ 1332 VCFRONT_a476_FRM10_timedOut "Front body controller: a476 FRM10 timed out";
CM_ SG_ 1332 VCFRONT_a476_FRM11_timedOut "Front body controller: a476 FRM11 timed out";
CM_ SG_ 1332 VCFRONT_a476_FRM12_timedOut "Front body controller: a476 FRM12 timed out";
CM_ SG_ 1332 VCFRONT_a476_factoryMode "Front body controller: a476 factory mode";
CM_ SG_ 1332 VCFRONT_a476_serviceMode "Signal reported by Front body controller";
CM_ SG_ 1332 VCFRONT_a476_transportMode "Front body controller: a476 transport mode";
CM_ SG_ 1332 VCFRONT_a476_frunkOpen "Front body controller: a476 frunk open";
CM_ SG_ 1332 VCFRONT_a476_vehiclePowerState "Front body controller: a476 vehicle power state";
CM_ SG_ 1332 VCFRONT_a476_batterySMState "Front body controller: a476 battery SM state";
CM_ SG_ 1332 VCFRONT_a476_ECPAState "Front body controller: a476 ECPA state; raw 3 = signal not available (SNA)";
CM_ SG_ 1332 VCFRONT_a477_cell1Voltage "Front body controller: a477 cell1 voltage";
CM_ SG_ 1332 VCFRONT_a477_cell2Voltage "Front body controller: a477 cell2 voltage";
CM_ SG_ 1332 VCFRONT_a477_cell3Voltage "Front body controller: a477 cell3 voltage";
CM_ SG_ 1332 VCFRONT_a477_cell4Voltage "Front body controller: a477 cell4 voltage";
CM_ SG_ 1332 VCFRONT_a477_sumCellVoltage "Front body controller: a477 sum cell voltage";
CM_ SG_ 1332 VCFRONT_a477_deepDischargeFlag "Front body controller: a477 deep discharge flag";
CM_ SG_ 1332 VCFRONT_a477_serviceMode "Signal reported by Front body controller";
CM_ SG_ 1332 VCFRONT_a477_frunkOpen "Front body controller: a477 frunk open";
CM_ SG_ 1332 VCFRONT_a478_battFaultPackOverVo "Front body controller: a478 batt fault pack over voltage";
CM_ SG_ 1332 VCFRONT_a478_battFaultHardwareOv "Front body controller: a478 batt fault hardware over current";
CM_ SG_ 1332 VCFRONT_a478_battFaultChargeOver "Front body controller: a478 batt fault charge over current";
CM_ SG_ 1332 VCFRONT_a478_battFaultCellUnderV "Front body controller: a478 batt fault cell under voltage";
CM_ SG_ 1332 VCFRONT_a478_battFaultCellOverVo "Front body controller: a478 batt fault cell over voltage";
CM_ SG_ 1332 VCFRONT_a478_vehiclePowerState "Front body controller: a478 vehicle power state";
CM_ SG_ 1332 VCFRONT_a478_batterySMState "Front body controller: a478 battery SM state";
CM_ SG_ 1332 VCFRONT_a478_bmsState "Front body controller: a478 bms state; raw 9 = signal not available (SNA)";
CM_ SG_ 1332 VCFRONT_a478_dcdcLVSupportStatus "Front body controller: a478 dcdc LV support status";
CM_ SG_ 1332 VCFRONT_a478_factoryMode "Front body controller: a478 factory mode";
CM_ SG_ 1332 VCFRONT_a478_serviceMode "Signal reported by Front body controller";
CM_ SG_ 1332 VCFRONT_a478_transportMode "Front body controller: a478 transport mode";
CM_ SG_ 1332 VCFRONT_a478_notEnoughPowerForSu "Front body controller: a478 not enough power for support";
CM_ SG_ 1332 VCFRONT_a478_crashDetected "Front body controller: a478 crash detected";
CM_ SG_ 1332 VCFRONT_a478_BMS_MIA "Front body controller: a478 BMS MIA";
CM_ SG_ 1332 VCFRONT_a478_PCS_MIA "Front body controller: a478 PCS MIA";
CM_ SG_ 1332 VCFRONT_a478_HVBlockingMismatch "Front body controller: a478 HV blocking mismatch";
CM_ SG_ 1332 VCFRONT_a478_HV_UP "Front body controller: a478 HV UP";
CM_ SG_ 1332 VCFRONT_a478_pcsEFuseStable "Front body controller: a478 pcs e fuse stable";
CM_ SG_ 1332 VCFRONT_a478_vcrightEFuseStable "Front body controller: a478 vcright e fuse stable";
CM_ SG_ 1332 VCFRONT_a478_contactorEFuseStabl "Front body controller: a478 contactor e fuse stable";
CM_ SG_ 1332 VCFRONT_a478_hvcEFuseStable "Front body controller: a478 hvc e fuse stable";
CM_ SG_ 1332 VCFRONT_a478_frunkOpen "Front body controller: a478 frunk open";
CM_ SG_ 1332 VCFRONT_a479_FRM3_timedOut "Front body controller: a479 FRM3 timed out";
CM_ SG_ 1332 VCFRONT_a479_ECPAState "Front body controller: a479 ECPA state; raw 3 = signal not available (SNA)";
CM_ SG_ 1332 VCFRONT_a479_factoryMode "Front body controller: a479 factory mode";
CM_ SG_ 1332 VCFRONT_a479_serviceMode "Signal reported by Front body controller";
CM_ SG_ 1332 VCFRONT_a479_transportMode "Front body controller: a479 transport mode";
CM_ SG_ 1332 VCFRONT_a479_frunkLatchStatus "Front body controller: a479 frunk latch status; raw 0 = signal not available (SNA)";
CM_ SG_ 1332 VCFRONT_a479_vehiclePowerState "Front body controller: a479 vehicle power state";
CM_ SG_ 1332 VCFRONT_a479_batterySMState "Front body controller: a479 battery SM state";
CM_ SG_ 1332 VCFRONT_a480_channel "Front body controller: a480 channel";
CM_ SG_ 1332 VCFRONT_a480_reset "Front body controller: a480 reset";
CM_ SG_ 1332 VCFRONT_a480_spiError "Front body controller: a480 spi error";
CM_ SG_ 1332 VCFRONT_a480_autoOn "Front body controller: a480 auto on";
CM_ SG_ 1332 VCFRONT_a480_diagnosticBit "Front body controller: a480 diagnostic bit";
CM_ SG_ 1332 VCFRONT_a480_deviceError "Front body controller: a480 device error";
CM_ SG_ 1332 VCFRONT_a480_overcurrent "Front body controller: a480 overcurrent";
CM_ SG_ 1332 VCFRONT_a480_unexpectedLock "Front body controller: a480 unexpected lock";
CM_ SG_ 1332 VCFRONT_a480_disableOutputFault "Front body controller: a480 disable output fault";
CM_ SG_ 1332 VCFRONT_a480_vsUndervoltage "Front body controller: a480 vs undervoltage";
CM_ SG_ 1332 VCFRONT_a480_hardShort "Front body controller: a480 hard short";
CM_ SG_ 1332 VCFRONT_a480_vdsMax "Front body controller: a480 vds max";
CM_ SG_ 1332 VCFRONT_a480_bypassSaturation "Front body controller: a480 bypass saturation";
CM_ SG_ 1332 VCFRONT_a480_fuseLatch "Front body controller: a480 fuse latch";
CM_ SG_ 1332 VCFRONT_a480_deviceOvertemperatu "Front body controller: a480 device overtemperature";
CM_ SG_ 1332 VCFRONT_a480_ntcOvertemperature "Front body controller: a480 ntc overtemperature";
CM_ SG_ 1332 VCFRONT_a480_vgsLow "Front body controller: a480 vgs low";
CM_ SG_ 1332 VCFRONT_a480_chargePumpLow "Front body controller: a480 charge pump low";
CM_ SG_ 1332 VCFRONT_a480_watchdog "Front body controller: a480 watchdog";
CM_ SG_ 1332 VCFRONT_a480_spiNotDone "Front body controller: a480 spi not done";
CM_ SG_ 1332 VCFRONT_a480_configIncorrect "Front body controller: a480 config incorrect";
CM_ SG_ 1332 VCFRONT_a480_bufferFull "Front body controller: a480 buffer full";
CM_ SG_ 1332 VCFRONT_a480_hitAlertRateLimit "Front body controller: a480 hit alert rate limit";
CM_ SG_ 1332 VCFRONT_a480_hwlo "Front body controller: a480 hwlo";
CM_ SG_ 1332 VCFRONT_a480_enable "Front body controller: a480 enable";
CM_ SG_ 1332 VCFRONT_a486_mcuGraphicsEFuseCur "Front body controller: a486 mcu graphics e fuse current";
CM_ SG_ 1332 VCFRONT_a490_coolantPumpType "Front body controller: a490 coolant pump type";
CM_ SG_ 1332 VCFRONT_a493_minBrickSocId "Front body controller: a493 min brick soc id";
CM_ SG_ 1332 VCFRONT_a493_minBrickSocByOcvMax "Front body controller: a493 min brick soc by ocv max";
CM_ SG_ 1332 VCFRONT_a493_maxBrickSocId "Front body controller: a493 max brick soc id";
CM_ SG_ 1332 VCFRONT_a493_maxBrickSocByOcvMin "Front body controller: a493 max brick soc by ocv min";
CM_ SG_ 1332 VCFRONT_a493_maxBrickSoc "Front body controller: a493 max brick soc";
CM_ SG_ 1332 VCFRONT_a493_avgBrickSoc "Front body controller: a493 avg brick soc";
CM_ SG_ 1332 VCFRONT_a495_SoCUnrecoverable "Front body controller: a495 so c unrecoverable";
CM_ SG_ 1332 VCFRONT_a495_SocTooLow "Front body controller: a495 soc too low";
CM_ SG_ 1332 VCFRONT_a495_retryExpended "Front body controller: a495 retry expended";
CM_ SG_ 1332 VCFRONT_a495_LVBMSMIA "Front body controller: a495 LVBMSMIA";
CM_ SG_ 1332 VCFRONT_a495_reverseBatteryEFuse "Front body controller: a495 reverse battery e fuse fault";
CM_ SG_ 1332 VCFRONT_a495_DCDCOff "Front body controller: a495 DCDC off";
CM_ SG_ 1332 VCFRONT_a495_HVOff "Front body controller: a495 HV off";
CM_ SG_ 1332 VCFRONT_a495_externalInteraction "Front body controller: a495 external interaction";
CM_ SG_ 1332 VCFRONT_a495_serviceMode "Signal reported by Front body controller";
CM_ SG_ 1332 VCFRONT_a495_frunkOpen "Front body controller: a495 frunk open";
CM_ SG_ 1332 VCFRONT_a495_externalPowerSupply "Front body controller: a495 external power supply";
CM_ SG_ 1332 VCFRONT_a496_reverseBatteryEFuse "Front body controller: a496 reverse battery e fuse fault";
CM_ SG_ 1332 VCFRONT_a496_vehicleLoadShedActi "Front body controller: a496 vehicle load shed active";
CM_ SG_ 1332 VCFRONT_a496_MOSState "Front body controller: a496 MOS state; raw 3 = signal not available (SNA)";
CM_ SG_ 1332 VCFRONT_a496_serviceMode "Signal reported by Front body controller";
CM_ SG_ 1332 VCFRONT_a496_frunkOpen "Front body controller: a496 frunk open";
CM_ SG_ 1332 VCFRONT_a496_PCS_MIA "Front body controller: a496 PCS MIA";
CM_ SG_ 1332 VCFRONT_a496_NotEnoughPowerForSu "Front body controller: a496 not enough power for support";
CM_ SG_ 1332 VCFRONT_a496_bmsState "Front body controller: a496 bms state; raw 9 = signal not available (SNA)";
CM_ SG_ 1332 VCFRONT_a497_serviceMode "Signal reported by Front body controller";
CM_ SG_ 1332 VCFRONT_a497_FactoryMode "Front body controller: a497 factory mode";
CM_ SG_ 1332 VCFRONT_a497_SOC "Front body controller: a497 SOC";
CM_ SG_ 1332 VCFRONT_a497_PackCurrent "Front body controller: a497 pack current";
CM_ SG_ 1332 VCFRONT_a497_SumCellVoltage "Front body controller: a497 sum cell voltage";
CM_ SG_ 1332 VCFRONT_a497_frunkOpen "Front body controller: a497 frunk open";
CM_ SG_ 1332 VCFRONT_a500_channel "Front body controller: a500 channel";
CM_ SG_ 1332 VCFRONT_a500_mismatchedState "Front body controller: a500 mismatched state";
CM_ SG_ 1332 VCFRONT_a503_brickVoltageMin "Front body controller: a503 brick voltage min";
CM_ SG_ 1332 VCFRONT_a503_brickVoltageMax "Front body controller: a503 brick voltage max";
CM_ SG_ 1332 VCFRONT_a503_packCurrent "Front body controller: a503 pack current";
CM_ SG_ 1332 VCFRONT_a503_socMax "Front body controller: a503 soc max";
CM_ SG_ 1332 VCFRONT_a503_brickId "Front body controller: a503 brick id";
CM_ SG_ 1332 VCFRONT_a509_vcrightEFuseCurrent "Front body controller: a509 vcright e fuse current";
CM_ SG_ 1332 VCFRONT_a509_vcrightEFuseTemp "Front body controller: a509 vcright e fuse temp";
CM_ SG_ 1332 VCFRONT_a509_ambientTemp "Front body controller: a509 ambient temp";
CM_ SG_ 1332 VCFRONT_a509_serviceMode "Signal reported by Front body controller";
CM_ SG_ 1332 VCFRONT_a509_frunkOpen "Front body controller: a509 frunk open";
CM_ SG_ 1332 VCFRONT_a510_sumCellVoltage "Front body controller: a510 sum cell voltage";
CM_ SG_ 1332 VCFRONT_a510_packVoltage "Front body controller: a510 pack voltage";
CM_ SG_ 1332 VCFRONT_a510_targetPCSVoltage "Front body controller: a510 target PCS voltage";
CM_ SG_ 1332 VCFRONT_a510_serviceMode "Signal reported by Front body controller";
CM_ SG_ 1332 VCFRONT_a510_frunkOpen "Front body controller: a510 frunk open";
CM_ SG_ 1332 VCFRONT_a511_PCSEFuseCurrent "Front body controller: a511 PCSE fuse current";
CM_ SG_ 1332 VCFRONT_a511_DCDCMaxOutputCurren "Front body controller: a511 DCDC max output current allowed";
CM_ SG_ 1332 VCFRONT_a511_hvState "Front body controller: a511 hv state";
CM_ SG_ 1332 VCFRONT_a511_DCDCOutputIsLimited "Front body controller: a511 DCDC output is limited";
CM_ SG_ 1332 VCFRONT_a511_PCSSignalsAreValid "Front body controller: a511 PCS signals are valid";
CM_ SG_ 1332 VCFRONT_a511_factoryGated "Front body controller: a511 factory gated";
CM_ SG_ 1332 VCFRONT_a511_vehicleIsUpdating "Front body controller: a511 vehicle is updating";
CM_ SG_ 1332 VCFRONT_a511_serviceMode "Signal reported by Front body controller";
CM_ SG_ 1332 VCFRONT_a511_frunkOpen "Front body controller: a511 frunk open";
CM_ SG_ 1332 VCFRONT_a512_packVoltageInt_0001 "Front body controller: a512 pack voltage interval min";
CM_ SG_ 1332 VCFRONT_a512_packVoltageInterval "Front body controller: a512 pack voltage interval max";
CM_ SG_ 1332 VCFRONT_a512_packTemperature "Front body controller: a512 pack temperature";
CM_ SG_ 1332 VCFRONT_a512_sumCellVoltage "Front body controller: a512 sum cell voltage";
CM_ SG_ 1332 VCFRONT_a512_overcurrentDirectio "Front body controller: a512 overcurrent direction";
CM_ SG_ 1332 VCFRONT_a512_serviceMode "Signal reported by Front body controller";
CM_ SG_ 1332 VCFRONT_a512_frunkOpen "Front body controller: a512 frunk open";
CM_ SG_ 1332 VCFRONT_a512_vehiclePowerState "Front body controller: a512 vehicle power state";
CM_ SG_ 1332 VCFRONT_a513_packCurrent "Front body controller: a513 pack current";
CM_ SG_ 1332 VCFRONT_a513_packTemperature "Front body controller: a513 pack temperature";
CM_ SG_ 1332 VCFRONT_a513_packVoltage "Front body controller: a513 pack voltage";
CM_ SG_ 1332 VCFRONT_a513_packSOC "Front body controller: a513 pack SOC";
CM_ SG_ 1332 VCFRONT_a513_serviceMode "Signal reported by Front body controller";
CM_ SG_ 1332 VCFRONT_a513_frunkOpen "Front body controller: a513 frunk open";
CM_ SG_ 1332 VCFRONT_a513_vehiclePowerState "Front body controller: a513 vehicle power state";
CM_ SG_ 1332 VCFRONT_a514_cell1Voltage "Front body controller: a514 cell1 voltage";
CM_ SG_ 1332 VCFRONT_a514_cell2Voltage "Front body controller: a514 cell2 voltage";
CM_ SG_ 1332 VCFRONT_a514_cell3Voltage "Front body controller: a514 cell3 voltage";
CM_ SG_ 1332 VCFRONT_a514_cell4Voltage "Front body controller: a514 cell4 voltage";
CM_ SG_ 1332 VCFRONT_a514_packVoltage "Front body controller: a514 pack voltage";
CM_ SG_ 1332 VCFRONT_a514_packSOC "Front body controller: a514 pack SOC";
CM_ SG_ 1332 VCFRONT_a514_serviceMode "Signal reported by Front body controller";
CM_ SG_ 1332 VCFRONT_a514_frunkOpen "Front body controller: a514 frunk open";
CM_ SG_ 1332 VCFRONT_a514_vehiclePowerState "Front body controller: a514 vehicle power state";
CM_ SG_ 1332 VCFRONT_a515_cell1Voltage "Front body controller: a515 cell1 voltage";
CM_ SG_ 1332 VCFRONT_a515_cell2Voltage "Front body controller: a515 cell2 voltage";
CM_ SG_ 1332 VCFRONT_a515_cell3Voltage "Front body controller: a515 cell3 voltage";
CM_ SG_ 1332 VCFRONT_a515_cell4Voltage "Front body controller: a515 cell4 voltage";
CM_ SG_ 1332 VCFRONT_a515_packVoltage "Front body controller: a515 pack voltage";
CM_ SG_ 1332 VCFRONT_a515_packSOC "Front body controller: a515 pack SOC";
CM_ SG_ 1332 VCFRONT_a515_serviceMode "Signal reported by Front body controller";
CM_ SG_ 1332 VCFRONT_a515_frunkOpen "Front body controller: a515 frunk open";
CM_ SG_ 1332 VCFRONT_a515_vehiclePowerState "Front body controller: a515 vehicle power state";
CM_ SG_ 1332 VCFRONT_a516_IBSVoltage "Front body controller: a516 IBS voltage";
CM_ SG_ 1332 VCFRONT_a516_HVSoc "Front body controller: a516 HV soc";
CM_ SG_ 1332 VCFRONT_a516_contactorsPermanent "Front body controller: a516 contactors permanently closed";
CM_ SG_ 1332 VCFRONT_a516_LVBatteryDisconnect "Front body controller: a516 LV battery disconnected";
CM_ SG_ 1332 VCFRONT_a516_reverseBatteryFault "Front body controller: a516 reverse battery fault";
CM_ SG_ 1332 VCFRONT_a516_LVBatteryCannotSupp "Front body controller: a516 LV battery cannot support vehicle";
CM_ SG_ 1332 VCFRONT_a517_IBSVoltage "Front body controller: a517 IBS voltage";
CM_ SG_ 1332 VCFRONT_a517_HVSoc "Front body controller: a517 HV soc";
CM_ SG_ 1332 VCFRONT_a518_packVoltage "Front body controller: a518 pack voltage";
CM_ SG_ 1332 VCFRONT_a518_IBSVoltage "Front body controller: a518 IBS voltage";
CM_ SG_ 1332 VCFRONT_a518_targetPCSVoltage "Front body controller: a518 target PCS voltage";
CM_ SG_ 1332 VCFRONT_a518_outputVoltageAtPCS "Front body controller: a518 output voltage at PCS";
CM_ SG_ 1332 VCFRONT_a518_packSOC "Front body controller: a518 pack SOC";
CM_ SG_ 1332 VCFRONT_a518_serviceMode "Signal reported by Front body controller";
CM_ SG_ 1332 VCFRONT_a518_frunkOpen "Front body controller: a518 frunk open";
CM_ SG_ 1332 VCFRONT_a518_vehiclePowerState "Front body controller: a518 vehicle power state";
CM_ SG_ 1332 VCFRONT_a519_MatrixBank1Status "Front body controller: a519 matrix bank1 status";
CM_ SG_ 1332 VCFRONT_a519_MatrixBank2Status "Front body controller: a519 matrix bank2 status";
CM_ SG_ 1332 VCFRONT_a519_MatrixBank3Status "Front body controller: a519 matrix bank3 status";
CM_ SG_ 1332 VCFRONT_a519_MatrixBank4Status "Front body controller: a519 matrix bank4 status";
CM_ SG_ 1332 VCFRONT_a519_TurnSignalStatus "Front body controller: a519 turn signal status";
CM_ SG_ 1332 VCFRONT_a519_SideMarkerStatus "Front body controller: a519 side marker status";
CM_ SG_ 1332 VCFRONT_a519_DRLStatus "Front body controller: a519 DRL status";
CM_ SG_ 1332 VCFRONT_a519_AmbientStatus "Front body controller: a519 ambient status";
CM_ SG_ 1332 VCFRONT_a519_LBFlatSAEStatus "Front body controller: a519 LB flat SAE status";
CM_ SG_ 1332 VCFRONT_a519_LBFlatECEStatus "Front body controller: a519 LB flat ECE status";
CM_ SG_ 1332 VCFRONT_a519_TPS92520_COMPOV "Front body controller: a519 TPS92520 COMPOV";
CM_ SG_ 1332 VCFRONT_a519_TPS92520_HSILIM "Front body controller: a519 TPS92520 HSILIM";
CM_ SG_ 1332 VCFRONT_a519_TPS92520_BSTUV "Front body controller: a519 TPS92520 BSTUV";
CM_ SG_ 1332 VCFRONT_a519_CoolingFanStatus "Front body controller: a519 cooling fan status";
CM_ SG_ 1332 VCFRONT_a519_BoostRailStatus "Front body controller: a519 boost rail status";
CM_ SG_ 1332 VCFRONT_a519_EEPROMCurrentBinSta "Front body controller: a519 EEPROM current bin status";
CM_ SG_ 1332 VCFRONT_a519_EEPROMCalCurrentSta "Front body controller: a519 EEPROM cal current status";
CM_ SG_ 1332 VCFRONT_a519_HeadlampECURevision "Front body controller: a519 headlamp ECU revision";
CM_ SG_ 1332 VCFRONT_a519_NonzeroEEPROMRetrie "Front body controller: a519 nonzero EEPROM retries";
CM_ SG_ 1332 VCFRONT_a519_MaxEEPROMRetries "Front body controller: a519 max EEPROM retries";
CM_ SG_ 1332 VCFRONT_a520_MatrixBank1Status "Front body controller: a520 matrix bank1 status";
CM_ SG_ 1332 VCFRONT_a520_MatrixBank2Status "Front body controller: a520 matrix bank2 status";
CM_ SG_ 1332 VCFRONT_a520_MatrixBank3Status "Front body controller: a520 matrix bank3 status";
CM_ SG_ 1332 VCFRONT_a520_MatrixBank4Status "Front body controller: a520 matrix bank4 status";
CM_ SG_ 1332 VCFRONT_a520_TurnSignalStatus "Front body controller: a520 turn signal status";
CM_ SG_ 1332 VCFRONT_a520_SideMarkerStatus "Front body controller: a520 side marker status";
CM_ SG_ 1332 VCFRONT_a520_DRLStatus "Front body controller: a520 DRL status";
CM_ SG_ 1332 VCFRONT_a520_AmbientStatus "Front body controller: a520 ambient status";
CM_ SG_ 1332 VCFRONT_a520_LBFlatSAEStatus "Front body controller: a520 LB flat SAE status";
CM_ SG_ 1332 VCFRONT_a520_LBFlatECEStatus "Front body controller: a520 LB flat ECE status";
CM_ SG_ 1332 VCFRONT_a520_TPS92520_COMPOV "Front body controller: a520 TPS92520 COMPOV";
CM_ SG_ 1332 VCFRONT_a520_TPS92520_HSILIM "Front body controller: a520 TPS92520 HSILIM";
CM_ SG_ 1332 VCFRONT_a520_TPS92520_BSTUV "Front body controller: a520 TPS92520 BSTUV";
CM_ SG_ 1332 VCFRONT_a520_CoolingFanStatus "Front body controller: a520 cooling fan status";
CM_ SG_ 1332 VCFRONT_a520_BoostRailStatus "Front body controller: a520 boost rail status";
CM_ SG_ 1332 VCFRONT_a520_EEPROMCurrentBinSta "Front body controller: a520 EEPROM current bin status";
CM_ SG_ 1332 VCFRONT_a520_EEPROMCalCurrentSta "Front body controller: a520 EEPROM cal current status";
CM_ SG_ 1332 VCFRONT_a520_HeadlampECURevision "Front body controller: a520 headlamp ECU revision";
CM_ SG_ 1332 VCFRONT_a520_NonzeroEEPROMRetrie "Front body controller: a520 nonzero EEPROM retries";
CM_ SG_ 1332 VCFRONT_a520_MaxEEPROMRetries "Front body controller: a520 max EEPROM retries";
CM_ SG_ 1332 VCFRONT_a521_vcleftEFuseCurrent "Front body controller: a521 vcleft e fuse current";
CM_ SG_ 1332 VCFRONT_a521_vcleftEFuseTemp "Front body controller: a521 vcleft e fuse temp";
CM_ SG_ 1332 VCFRONT_a521_ambientTemp "Front body controller: a521 ambient temp";
CM_ SG_ 1332 VCFRONT_a521_serviceMode "Signal reported by Front body controller";
CM_ SG_ 1332 VCFRONT_a521_frunkOpen "Front body controller: a521 frunk open";
CM_ SG_ 1332 VCFRONT_a522_IBSVoltage "Front body controller: a522 IBS voltage";
CM_ SG_ 1332 VCFRONT_a522_HVSoc "Front body controller: a522 HV soc";
CM_ SG_ 1332 VCFRONT_a522_contactorsPermanent "Front body controller: a522 contactors permanently closed";
CM_ SG_ 1332 VCFRONT_a522_LVBatteryDisconnect "Front body controller: a522 LV battery disconnected";
CM_ SG_ 1332 VCFRONT_a522_reverseBatteryFault "Front body controller: a522 reverse battery fault";
CM_ SG_ 1332 VCFRONT_a522_LVBatteryCannotSupp "Front body controller: a522 LV battery cannot support vehicle";
CM_ SG_ 1332 VCFRONT_a523_channel "Front body controller: a523 channel";
CM_ SG_ 1332 VCFRONT_a523_control2Byte1 "Front body controller: a523 control2 byte1";
CM_ SG_ 1332 VCFRONT_a523_control2Byte2 "Front body controller: a523 control2 byte2";
CM_ SG_ 1332 VCFRONT_a523_control2Byte3 "Front body controller: a523 control2 byte3";
CM_ SG_ 1332 VCFRONT_a523_control3Byte2 "Front body controller: a523 control3 byte2";
CM_ SG_ 1332 VCFRONT_a523_control3Byte3 "Front body controller: a523 control3 byte3";
CM_ SG_ 1332 VCFRONT_a525_GTW_twelveVBatteryT "Front body controller: a525 GTW twelve v battery type";
CM_ SG_ 1332 VCFRONT_a525_newLVBatteryType "Front body controller: a525 new LV battery type";
CM_ SG_ 1332 VCFRONT_a525_initialLVBatteryTyp "Front body controller: a525 initial LV battery type";
CM_ SG_ 1332 VCFRONT_a525_serviceMode "Signal reported by Front body controller";
CM_ SG_ 1332 VCFRONT_a525_factoryGated "Front body controller: a525 factory gated";
CM_ SG_ 1332 VCFRONT_a525_frunkOpen "Front body controller: a525 frunk open";
CM_ SG_ 1332 VCFRONT_a527_cell1Voltage "Front body controller: a527 cell1 voltage";
CM_ SG_ 1332 VCFRONT_a527_cell2Voltage "Front body controller: a527 cell2 voltage";
CM_ SG_ 1332 VCFRONT_a527_cell3Voltage "Front body controller: a527 cell3 voltage";
CM_ SG_ 1332 VCFRONT_a527_cell4Voltage "Front body controller: a527 cell4 voltage";
CM_ SG_ 1332 VCFRONT_a527_serviceMode "Signal reported by Front body controller";
CM_ SG_ 1332 VCFRONT_a527_frunkOpen "Front body controller: a527 frunk open";
CM_ SG_ 1332 VCFRONT_a528_ECPAStateSNA "Front body controller: a528 ECPA state SNA";
CM_ SG_ 1332 VCFRONT_a528_ECPAFrameTimeout "Front body controller: a528 ECPA frame timeout";
CM_ SG_ 1332 VCFRONT_a528_currentSenseFaulted "Front body controller: a528 current sense faulted";
CM_ SG_ 1332 VCFRONT_a528_serviceMode "Signal reported by Front body controller";
CM_ SG_ 1332 VCFRONT_a528_frunkOpen "Front body controller: a528 frunk open";
CM_ SG_ 1332 VCFRONT_a531_powerIndexFiltered "Front body controller: a531 power index filtered";
CM_ SG_ 1332 VCFRONT_a532_eFuseFault "Front body controller: a532 e fuse fault";
CM_ SG_ 1332 VCFRONT_a533_temperature "Front body controller: a533 temperature";
CM_ SG_ 1332 VCFRONT_a541_PackTemperature "Front body controller: a541 pack temperature";
CM_ SG_ 1332 VCFRONT_a541_ChargeCurrentLimit "Front body controller: a541 charge current limit";
CM_ SG_ 1332 VCFRONT_a541_PeakCurrent "Front body controller: a541 peak current";
CM_ SG_ 1332 VCFRONT_a541_AverageCurrent "Front body controller: a541 average current";
CM_ SG_ 1332 VCFRONT_a541_SOC "Front body controller: a541 SOC";
CM_ SG_ 1332 VCFRONT_a544_serviceMode "Signal reported by Front body controller";
CM_ SG_ 1332 VCFRONT_a544_frunkOpen "Front body controller: a544 frunk open";
CM_ SG_ 1332 VCFRONT_a544_LVBMSSOC "Front body controller: a544 LVBMSSOC";
CM_ SG_ 1332 VCFRONT_a545_GTW_twelveVBatteryT "Front body controller: a545 GTW twelve v battery type";
CM_ SG_ 1332 VCFRONT_a545_newLVBatteryType "Front body controller: a545 new LV battery type";
CM_ SG_ 1332 VCFRONT_a545_serviceMode "Signal reported by Front body controller";
CM_ SG_ 1332 VCFRONT_a545_factoryGated "Front body controller: a545 factory gated";
CM_ SG_ 1332 VCFRONT_a545_frunkOpen "Front body controller: a545 frunk open";
CM_ SG_ 1332 VCFRONT_a547_serviceMode "Signal reported by Front body controller";
CM_ SG_ 1332 VCFRONT_a547_frunkOpen "Front body controller: a547 frunk open";
CM_ SG_ 1332 VCFRONT_a548_vehiclePowerState "Front body controller: a548 vehicle power state";
CM_ SG_ 1332 VCFRONT_a548_notEnoughPowerForSu "Front body controller: a548 not enough power for support";
CM_ SG_ 1332 VCFRONT_a548_HVBlockingMismatch "Front body controller: a548 HV blocking mismatch";
CM_ SG_ 1332 VCFRONT_a548_LVBatteryCannotSupp "Front body controller: a548 LV battery cannot support vehicle";
CM_ SG_ 1332 VCFRONT_a548_DI_gear "Front body controller: a548 DI gear; raw 7 = signal not available (SNA)";
CM_ SG_ 1332 VCFRONT_a548_backstopBucketCount "Front body controller: a548 backstop bucket count";
BA_DEF_ BO_ "GenMsgCycleTime" INT 0 3600000;
BA_DEF_ BO_ "GenMsgSendType" ENUM "Cyclic","NotUsed","NotUsed","NotUsed","NotUsed","NotUsed","NotUsed","IfActive","NoMsgSendType","NotUsed";
BA_DEF_ BO_ "VFrameFormat" ENUM "StandardCAN","ExtendedCAN","reserved","J1939PG","reserved","reserved","reserved","reserved","reserved","reserved","reserved","reserved","reserved","reserved","StandardCAN_FD","ExtendedCAN_FD";
BA_DEF_ BO_ "CANFD_BRS" ENUM "0","1";
BA_DEF_ SG_ "GenSigSNA" STRING;
BA_DEF_ SG_ "SystemSignalLongSymbol" STRING;
BA_DEF_ SG_ "Confidence" ENUM "validated","plausible","layout-only","contradicted";
BA_DEF_DEF_ "GenMsgCycleTime" 0;
BA_DEF_DEF_ "GenMsgSendType" "NoMsgSendType";
BA_DEF_DEF_ "VFrameFormat" "StandardCAN";
BA_DEF_DEF_ "CANFD_BRS" "1";
BA_DEF_DEF_ "GenSigSNA" "";
BA_DEF_DEF_ "SystemSignalLongSymbol" "";
BA_DEF_DEF_ "Confidence" "layout-only";
BA_ "SystemSignalLongSymbol" SG_ 1332 VCFRONT_a289_chargePumpUndervolt "VCFRONT_a289_chargePumpUndervoltage";
BA_ "SystemSignalLongSymbol" SG_ 1332 VCFRONT_a297_bmbDeviceFaultTempM "VCFRONT_a297_bmbDeviceFaultTempMask";
BA_ "Confidence" SG_ 1332 VCFRONT_a300_oldType 1;
BA_ "Confidence" SG_ 1332 VCFRONT_a300_newType 1;
BA_ "Confidence" SG_ 1332 VCFRONT_a302_LINFrameStatus 1;
BA_ "Confidence" SG_ 1332 VCFRONT_a303_vehicleSpeed 1;
BA_ "Confidence" SG_ 1332 VCFRONT_a303_postVoltage 1;
BA_ "Confidence" SG_ 1332 VCFRONT_a303_lockStatus 1;
BA_ "GenSigSNA" SG_ 1332 VCFRONT_a303_lockStatus "0";
BA_ "Confidence" SG_ 1332 VCFRONT_a304_voltage 1;
BA_ "Confidence" SG_ 1332 VCFRONT_a304_temperature 1;
BA_ "Confidence" SG_ 1332 VCFRONT_a305_voltage 1;
BA_ "Confidence" SG_ 1332 VCFRONT_a305_temperature 1;
BA_ "Confidence" SG_ 1332 VCFRONT_a305_actuatorCurrent 1;
BA_ "Confidence" SG_ 1332 VCFRONT_a306_voltage 1;
BA_ "Confidence" SG_ 1332 VCFRONT_a306_temperature 1;
BA_ "Confidence" SG_ 1332 VCFRONT_a306_actuatorCurrent 1;
BA_ "Confidence" SG_ 1332 VCFRONT_a307_voltage 1;
BA_ "Confidence" SG_ 1332 VCFRONT_a307_temperature 1;
BA_ "Confidence" SG_ 1332 VCFRONT_a307_actuatorCurrent 1;
BA_ "Confidence" SG_ 1332 VCFRONT_a308_voltage 1;
BA_ "Confidence" SG_ 1332 VCFRONT_a308_temperature 1;
BA_ "Confidence" SG_ 1332 VCFRONT_a308_actuatorCurrent 1;
BA_ "Confidence" SG_ 1332 VCFRONT_a309_vehicleSpeed 1;
BA_ "Confidence" SG_ 1332 VCFRONT_a309_switchVoltage 1;
BA_ "Confidence" SG_ 1332 VCFRONT_a309_lockStatus 1;
BA_ "GenSigSNA" SG_ 1332 VCFRONT_a309_lockStatus "0";
BA_ "Confidence" SG_ 1332 VCFRONT_a334_maxSlope 1;
BA_ "Confidence" SG_ 1332 VCFRONT_a334_avgCurrent 1;
BA_ "Confidence" SG_ 1332 VCFRONT_a334_maxCurrent 1;
BA_ "Confidence" SG_ 1332 VCFRONT_a334_vehicleState 1;
BA_ "Confidence" SG_ 1332 VCFRONT_a335_maxSlope 1;
BA_ "Confidence" SG_ 1332 VCFRONT_a335_avgCurrent 1;
BA_ "Confidence" SG_ 1332 VCFRONT_a335_maxCurrent 1;
BA_ "Confidence" SG_ 1332 VCFRONT_a335_vehicleState 1;
BA_ "Confidence" SG_ 1332 VCFRONT_a336_maxSlope 1;
BA_ "Confidence" SG_ 1332 VCFRONT_a336_avgCurrent 1;
BA_ "Confidence" SG_ 1332 VCFRONT_a336_maxCurrent 1;
BA_ "Confidence" SG_ 1332 VCFRONT_a336_vehicleState 1;
BA_ "Confidence" SG_ 1332 VCFRONT_a337_maxSlope 1;
BA_ "Confidence" SG_ 1332 VCFRONT_a337_avgCurrent 1;
BA_ "Confidence" SG_ 1332 VCFRONT_a337_maxCurrent 1;
BA_ "Confidence" SG_ 1332 VCFRONT_a337_vehicleState 1;
BA_ "Confidence" SG_ 1332 VCFRONT_a338_maxSlope 1;
BA_ "Confidence" SG_ 1332 VCFRONT_a338_avgCurrent 1;
BA_ "Confidence" SG_ 1332 VCFRONT_a338_maxCurrent 1;
BA_ "Confidence" SG_ 1332 VCFRONT_a338_vehicleState 1;
BA_ "Confidence" SG_ 1332 VCFRONT_a339_maxSlope 1;
BA_ "Confidence" SG_ 1332 VCFRONT_a339_avgCurrent 1;
BA_ "Confidence" SG_ 1332 VCFRONT_a339_maxCurrent 1;
BA_ "Confidence" SG_ 1332 VCFRONT_a339_vehicleState 1;
BA_ "Confidence" SG_ 1332 VCFRONT_a340_maxSlope 1;
BA_ "Confidence" SG_ 1332 VCFRONT_a340_avgCurrent 1;
BA_ "Confidence" SG_ 1332 VCFRONT_a340_maxCurrent 1;
BA_ "Confidence" SG_ 1332 VCFRONT_a340_vehicleState 1;
BA_ "Confidence" SG_ 1332 VCFRONT_a341_maxSlope 1;
BA_ "Confidence" SG_ 1332 VCFRONT_a341_avgCurrent 1;
BA_ "Confidence" SG_ 1332 VCFRONT_a341_maxCurrent 1;
BA_ "Confidence" SG_ 1332 VCFRONT_a341_vehicleState 1;
BA_ "Confidence" SG_ 1332 VCFRONT_a342_maxSlope 1;
BA_ "Confidence" SG_ 1332 VCFRONT_a342_avgCurrent 1;
BA_ "Confidence" SG_ 1332 VCFRONT_a342_maxCurrent 1;
BA_ "Confidence" SG_ 1332 VCFRONT_a342_vehicleState 1;
BA_ "Confidence" SG_ 1332 VCFRONT_a343_maxSlope 1;
BA_ "Confidence" SG_ 1332 VCFRONT_a343_avgCurrent 1;
BA_ "Confidence" SG_ 1332 VCFRONT_a343_maxCurrent 1;
BA_ "Confidence" SG_ 1332 VCFRONT_a343_vehicleState 1;
BA_ "Confidence" SG_ 1332 VCFRONT_a344_maxSlope 1;
BA_ "Confidence" SG_ 1332 VCFRONT_a344_avgCurrent 1;
BA_ "Confidence" SG_ 1332 VCFRONT_a344_maxCurrent 1;
BA_ "Confidence" SG_ 1332 VCFRONT_a344_vehicleState 1;
BA_ "Confidence" SG_ 1332 VCFRONT_a345_maxSlope 1;
BA_ "Confidence" SG_ 1332 VCFRONT_a345_avgCurrent 1;
BA_ "Confidence" SG_ 1332 VCFRONT_a345_maxCurrent 1;
BA_ "Confidence" SG_ 1332 VCFRONT_a345_vehicleState 1;
BA_ "Confidence" SG_ 1332 VCFRONT_a346_maxSlope 1;
BA_ "Confidence" SG_ 1332 VCFRONT_a346_avgCurrent 1;
BA_ "Confidence" SG_ 1332 VCFRONT_a346_maxCurrent 1;
BA_ "Confidence" SG_ 1332 VCFRONT_a346_vehicleState 1;
BA_ "Confidence" SG_ 1332 VCFRONT_a347_maxSlope 1;
BA_ "Confidence" SG_ 1332 VCFRONT_a347_avgCurrent 1;
BA_ "Confidence" SG_ 1332 VCFRONT_a347_maxCurrent 1;
BA_ "Confidence" SG_ 1332 VCFRONT_a347_vehicleState 1;
BA_ "Confidence" SG_ 1332 VCFRONT_a348_maxSlope 1;
BA_ "Confidence" SG_ 1332 VCFRONT_a348_avgCurrent 1;
BA_ "Confidence" SG_ 1332 VCFRONT_a348_maxCurrent 1;
BA_ "Confidence" SG_ 1332 VCFRONT_a348_vehicleState 1;
BA_ "Confidence" SG_ 1332 VCFRONT_a349_maxSlope 1;
BA_ "Confidence" SG_ 1332 VCFRONT_a349_avgCurrent 1;
BA_ "Confidence" SG_ 1332 VCFRONT_a349_maxCurrent 1;
BA_ "Confidence" SG_ 1332 VCFRONT_a349_vehicleState 1;
BA_ "Confidence" SG_ 1332 VCFRONT_a350_espValveCurrent 1;
BA_ "Confidence" SG_ 1332 VCFRONT_a353_wiperHeaterCurrent 1;
BA_ "Confidence" SG_ 1332 VCFRONT_a353_batteryVoltage 1;
BA_ "Confidence" SG_ 1332 VCFRONT_a353_ambientTemperature 1;
BA_ "GenSigSNA" SG_ 1332 VCFRONT_a353_ambientTemperature "0";
BA_ "Confidence" SG_ 1332 VCFRONT_a354_windshieldCameraHea 1;
BA_ "SystemSignalLongSymbol" SG_ 1332 VCFRONT_a354_windshieldCameraHea "VCFRONT_a354_windshieldCameraHeaterCurrent";
BA_ "Confidence" SG_ 1332 VCFRONT_a354_batteryVoltage 1;
BA_ "Confidence" SG_ 1332 VCFRONT_a354_ambientTemperature 1;
BA_ "GenSigSNA" SG_ 1332 VCFRONT_a354_ambientTemperature "0";
BA_ "SystemSignalLongSymbol" SG_ 1332 VCFRONT_a355_systemNotCommission "VCFRONT_a355_systemNotCommissioned";
BA_ "SystemSignalLongSymbol" SG_ 1332 VCFRONT_a356_systemNotCommission "VCFRONT_a356_systemNotCommissioned";
BA_ "Confidence" SG_ 1332 VCFRONT_a357_maxTransientCurrent 1;
BA_ "Confidence" SG_ 1332 VCFRONT_a358_maxTransientCurrent 1;
BA_ "Confidence" SG_ 1332 VCFRONT_a359_IBSVolts 1;
BA_ "Confidence" SG_ 1332 VCFRONT_a359_IBSAh 1;
BA_ "Confidence" SG_ 1332 VCFRONT_a359_vehiclePowerState 1;
BA_ "Confidence" SG_ 1332 VCFRONT_a359_batterySMState 1;
BA_ "Confidence" SG_ 1332 VCFRONT_a359_hvState 1;
BA_ "SystemSignalLongSymbol" SG_ 1332 VCFRONT_a359_coolantHasBeenFille "VCFRONT_a359_coolantHasBeenFilled";
BA_ "Confidence" SG_ 1332 VCFRONT_a359_dcdcLVSupportStatus 1;
BA_ "Confidence" SG_ 1332 VCFRONT_a359_bmsState 1;
BA_ "GenSigSNA" SG_ 1332 VCFRONT_a359_bmsState "9";
BA_ "SystemSignalLongSymbol" SG_ 1332 VCFRONT_a360_vehicleLoadShedActi "VCFRONT_a360_vehicleLoadShedActive";
BA_ "SystemSignalLongSymbol" SG_ 1332 VCFRONT_a360_notEnoughPowerForSu "VCFRONT_a360_notEnoughPowerForSupport";
BA_ "Confidence" SG_ 1332 VCFRONT_a367_bmsSoc 1;
BA_ "Confidence" SG_ 1332 VCFRONT_a368_enteringState 1;
BA_ "Confidence" SG_ 1332 VCFRONT_a368_exitingState 1;
BA_ "Confidence" SG_ 1332 VCFRONT_a368_bmsSoc 1;
BA_ "SystemSignalLongSymbol" SG_ 1332 VCFRONT_a368_coolantTempSensorsF "VCFRONT_a368_coolantTempSensorsFaulted";
BA_ "SystemSignalLongSymbol" SG_ 1332 VCFRONT_a369_powerGenerationLimi "VCFRONT_a369_powerGenerationLimited";
BA_ "SystemSignalLongSymbol" SG_ 1332 VCFRONT_a369_heatRejectionLimite "VCFRONT_a369_heatRejectionLimited";
BA_ "Confidence" SG_ 1332 VCFRONT_a369_bmsSoc 1;
BA_ "Confidence" SG_ 1332 VCFRONT_a369_wasteHeatPower 1;
BA_ "Confidence" SG_ 1332 VCFRONT_a370_IBSVolts 1;
BA_ "Confidence" SG_ 1332 VCFRONT_a370_IBSAh 1;
BA_ "SystemSignalLongSymbol" SG_ 1332 VCFRONT_a370_notEnoughPowerForSu "VCFRONT_a370_notEnoughPowerForSupport";
BA_ "Confidence" SG_ 1332 VCFRONT_a370_sleepCurrent 1;
BA_ "Confidence" SG_ 1332 VCFRONT_a370_SOC 1;
BA_ "GenSigSNA" SG_ 1332 VCFRONT_a370_SOC "7";
BA_ "SystemSignalLongSymbol" SG_ 1332 VCFRONT_a371_shortedCellTestTrig "VCFRONT_a371_shortedCellTestTrigger";
BA_ "SystemSignalLongSymbol" SG_ 1332 VCFRONT_a371_voltDropOnHighCurre "VCFRONT_a371_voltDropOnHighCurrentTrigger";
BA_ "SystemSignalLongSymbol" SG_ 1332 VCFRONT_a371_deadLVMinimalAhDisc "VCFRONT_a371_deadLVMinimalAhDischargedTrigger";
BA_ "SystemSignalLongSymbol" SG_ 1332 VCFRONT_a371_resistanceEstimatio "VCFRONT_a371_resistanceEstimationHardFailTrigger";
BA_ "SystemSignalLongSymbol" SG_ 1332 VCFRONT_a371_dcrMilliOhmsAboveTh "VCFRONT_a371_dcrMilliOhmsAboveThresholdTrigger";
BA_ "SystemSignalLongSymbol" SG_ 1332 VCFRONT_a371_prechargeLVLoadRedu "VCFRONT_a371_prechargeLVLoadReductionTrigger";
BA_ "SystemSignalLongSymbol" SG_ 1332 VCFRONT_a371_instantPrechargeDCR "VCFRONT_a371_instantPrechargeDCRTooHighTrigger";
BA_ "SystemSignalLongSymbol" SG_ 1332 VCFRONT_a372_bmbDeviceFaultBrick "VCFRONT_a372_bmbDeviceFaultBrickMask";
BA_ "Confidence" SG_ 1332 VCFRONT_a373_tempSuperheatActual 1;
BA_ "GenSigSNA" SG_ 1332 VCFRONT_a373_tempSuperheatActual "1023";
BA_ "Confidence" SG_ 1332 VCFRONT_a373_tempSuperheatTarget 1;
BA_ "Confidence" SG_ 1332 VCFRONT_a373_compDemandChiller 1;
BA_ "Confidence" SG_ 1332 VCFRONT_a374_lccInletSolenoidISe 1;
BA_ "SystemSignalLongSymbol" SG_ 1332 VCFRONT_a374_lccInletSolenoidISe "VCFRONT_a374_lccInletSolenoidISense";
BA_ "Confidence" SG_ 1332 VCFRONT_a378_wiperOverload 1;
BA_ "Confidence" SG_ 1332 VCFRONT_a378_wiperOvertemperatur 1;
BA_ "SystemSignalLongSymbol" SG_ 1332 VCFRONT_a378_wiperOvertemperatur "VCFRONT_a378_wiperOvertemperature";
BA_ "Confidence" SG_ 1332 VCFRONT_a387_shortedCellFaultCou 1;
BA_ "SystemSignalLongSymbol" SG_ 1332 VCFRONT_a387_shortedCellFaultCou "VCFRONT_a387_shortedCellFaultCounter";
BA_ "Confidence" SG_ 1332 VCFRONT_a387_minVoltageReached 1;
BA_ "Confidence" SG_ 1332 VCFRONT_a387_IBSTemp 1;
BA_ "Confidence" SG_ 1332 VCFRONT_a387_maxCurrentReached 1;
BA_ "Confidence" SG_ 1332 VCFRONT_a388_shortedCellFaultCou 1;
BA_ "SystemSignalLongSymbol" SG_ 1332 VCFRONT_a388_shortedCellFaultCou "VCFRONT_a388_shortedCellFaultCounter";
BA_ "Confidence" SG_ 1332 VCFRONT_a388_minVoltageReached 1;
BA_ "Confidence" SG_ 1332 VCFRONT_a388_IBSTemp 1;
BA_ "Confidence" SG_ 1332 VCFRONT_a388_maxCurrentReached 1;
BA_ "SystemSignalLongSymbol" SG_ 1332 VCFRONT_a389_faultedWhileOpenAtS "VCFRONT_a389_faultedWhileOpenAtSpeed";
BA_ "Confidence" SG_ 1332 VCFRONT_a389_vehicleSpeed 1;
BA_ "Confidence" SG_ 1332 VCFRONT_a389_temperature 1;
BA_ "Confidence" SG_ 1332 VCFRONT_a389_latchStatus 1;
BA_ "GenSigSNA" SG_ 1332 VCFRONT_a389_latchStatus "0";
BA_ "Confidence" SG_ 1332 VCFRONT_a391_switch1Voltage 1;
BA_ "Confidence" SG_ 1332 VCFRONT_a391_switch2Voltage 1;
BA_ "SystemSignalLongSymbol" SG_ 1332 VCFRONT_a392_bmbDeviceFaultBrick "VCFRONT_a392_bmbDeviceFaultBrickMask";
BA_ "Confidence" SG_ 1332 VCFRONT_a397_offsetError 1;
BA_ "SystemSignalLongSymbol" SG_ 1332 VCFRONT_a397_runTimeOffSetDetect "VCFRONT_a397_runTimeOffSetDetected";
BA_ "Confidence" SG_ 1332 VCFRONT_a401_LVBatteryTemp 1;
BA_ "GenSigSNA" SG_ 1332 VCFRONT_a401_LVBatteryTemp "127";
BA_ "Confidence" SG_ 1332 VCFRONT_a401_IBSCurrent 1;
BA_ "Confidence" SG_ 1332 VCFRONT_a401_IBSVoltage 1;
BA_ "Confidence" SG_ 1332 VCFRONT_a401_IBSAmpHours 1;
BA_ "Confidence" SG_ 1332 VCFRONT_a402_LVBatteryTemp 1;
BA_ "GenSigSNA" SG_ 1332 VCFRONT_a402_LVBatteryTemp "127";
BA_ "Confidence" SG_ 1332 VCFRONT_a402_batterySMState 1;
BA_ "SystemSignalLongSymbol" SG_ 1332 VCFRONT_a402_failureToPrechargeR "VCFRONT_a402_failureToPrechargeRisk";
BA_ "SystemSignalLongSymbol" SG_ 1332 VCFRONT_a402_electricalDisconnec "VCFRONT_a402_electricalDisconnectLVBattery";
BA_ "SystemSignalLongSymbol" SG_ 1332 VCFRONT_a402_communicationDiscon "VCFRONT_a402_communicationDisconnectLVBattery";
BA_ "Confidence" SG_ 1332 VCFRONT_a404_minVoltageReached 1;
BA_ "Confidence" SG_ 1332 VCFRONT_a404_IBSTemp 1;
BA_ "Confidence" SG_ 1332 VCFRONT_a404_maxCurrentReached 1;
BA_ "Confidence" SG_ 1332 VCFRONT_a407_dcrMilliOhms 1;
BA_ "Confidence" SG_ 1332 VCFRONT_a407_dcr12VThreshold 1;
BA_ "Confidence" SG_ 1332 VCFRONT_a407_avgIntervalCurrent 1;
BA_ "Confidence" SG_ 1332 VCFRONT_a407_intervalCurrentVari 1;
BA_ "SystemSignalLongSymbol" SG_ 1332 VCFRONT_a407_intervalCurrentVari "VCFRONT_a407_intervalCurrentVariance";
BA_ "Confidence" SG_ 1332 VCFRONT_a407_avgPulseCurrent 1;
BA_ "Confidence" SG_ 1332 VCFRONT_a407_pulseCurrentVarianc 1;
BA_ "SystemSignalLongSymbol" SG_ 1332 VCFRONT_a407_pulseCurrentVarianc "VCFRONT_a407_pulseCurrentVariance";
BA_ "Confidence" SG_ 1332 VCFRONT_a407_IBSTemperature 1;
BA_ "Confidence" SG_ 1332 VCFRONT_a407_testCounter 1;
BA_ "SystemSignalLongSymbol" SG_ 1332 VCFRONT_a409_brushlessMotorConfi "VCFRONT_a409_brushlessMotorConfigurationInvalid";
BA_ "Confidence" SG_ 1332 VCFRONT_a414_dcrMilliOhms 1;
BA_ "Confidence" SG_ 1332 VCFRONT_a414_LVBatteryTemp 1;
BA_ "GenSigSNA" SG_ 1332 VCFRONT_a414_LVBatteryTemp "127";
BA_ "Confidence" SG_ 1332 VCFRONT_a414_IBSCurrent 1;
BA_ "Confidence" SG_ 1332 VCFRONT_a414_IBSVoltage 1;
BA_ "Confidence" SG_ 1332 VCFRONT_a414_IBSAmpHours 1;
BA_ "Confidence" SG_ 1332 VCFRONT_a414_vehiclePowerState 1;
BA_ "Confidence" SG_ 1332 VCFRONT_a415_dcrMilliOhms 1;
BA_ "Confidence" SG_ 1332 VCFRONT_a415_LVBatteryTemp 1;
BA_ "GenSigSNA" SG_ 1332 VCFRONT_a415_LVBatteryTemp "127";
BA_ "Confidence" SG_ 1332 VCFRONT_a415_IBSCurrent 1;
BA_ "Confidence" SG_ 1332 VCFRONT_a415_IBSVoltage 1;
BA_ "Confidence" SG_ 1332 VCFRONT_a415_IBSAmpHours 1;
BA_ "Confidence" SG_ 1332 VCFRONT_a415_vehiclePowerState 1;
BA_ "SystemSignalLongSymbol" SG_ 1332 VCFRONT_a415_vcrightEfuseUnstabl "VCFRONT_a415_vcrightEfuseUnstable";
BA_ "SystemSignalLongSymbol" SG_ 1332 VCFRONT_a415_contactorEFuseUnsta "VCFRONT_a415_contactorEFuseUnstable";
BA_ "Confidence" SG_ 1332 VCFRONT_a416_brickVoltageMin 1;
BA_ "Confidence" SG_ 1332 VCFRONT_a416_brickVoltageMax 1;
BA_ "Confidence" SG_ 1332 VCFRONT_a416_packCurrent 1;
BA_ "Confidence" SG_ 1332 VCFRONT_a416_socMin 1;
BA_ "Confidence" SG_ 1332 VCFRONT_a417_brickVoltageMin 1;
BA_ "Confidence" SG_ 1332 VCFRONT_a417_brickVoltageMax 1;
BA_ "Confidence" SG_ 1332 VCFRONT_a417_packCurrent 1;
BA_ "Confidence" SG_ 1332 VCFRONT_a417_socMax 1;
BA_ "Confidence" SG_ 1332 VCFRONT_a418_brickVoltageMin 1;
BA_ "Confidence" SG_ 1332 VCFRONT_a418_brickVoltageMax 1;
BA_ "Confidence" SG_ 1332 VCFRONT_a418_packCurrent 1;
BA_ "Confidence" SG_ 1332 VCFRONT_a418_socMax 1;
BA_ "Confidence" SG_ 1332 VCFRONT_a419_brickVoltageMin 1;
BA_ "Confidence" SG_ 1332 VCFRONT_a419_brickVoltageMax 1;
BA_ "Confidence" SG_ 1332 VCFRONT_a419_packCurrent 1;
BA_ "Confidence" SG_ 1332 VCFRONT_a419_socMin 1;
BA_ "Confidence" SG_ 1332 VCFRONT_a423_brickVoltageMin 1;
BA_ "Confidence" SG_ 1332 VCFRONT_a423_brickVoltageMax 1;
BA_ "Confidence" SG_ 1332 VCFRONT_a423_packCurrent 1;
BA_ "Confidence" SG_ 1332 VCFRONT_a423_socMin 1;
BA_ "Confidence" SG_ 1332 VCFRONT_a424_brickVoltageMin 1;
BA_ "Confidence" SG_ 1332 VCFRONT_a424_brickVoltageMax 1;
BA_ "Confidence" SG_ 1332 VCFRONT_a424_packCurrent 1;
BA_ "Confidence" SG_ 1332 VCFRONT_a424_socMin 1;
BA_ "Confidence" SG_ 1332 VCFRONT_a431_netPackCurrent 1;
BA_ "GenSigSNA" SG_ 1332 VCFRONT_a431_netPackCurrent "32768";
BA_ "Confidence" SG_ 1332 VCFRONT_a431_maxChargeCurrentLim 1;
BA_ "GenSigSNA" SG_ 1332 VCFRONT_a431_maxChargeCurrentLim "32768";
BA_ "SystemSignalLongSymbol" SG_ 1332 VCFRONT_a431_maxChargeCurrentLim "VCFRONT_a431_maxChargeCurrentLimit";
BA_ "Confidence" SG_ 1332 VCFRONT_a431_hvjbCurrentLimit 1;
BA_ "GenSigSNA" SG_ 1332 VCFRONT_a431_hvjbCurrentLimit "32768";
BA_ "Confidence" SG_ 1332 VCFRONT_a432_targetCurrent 1;
BA_ "GenSigSNA" SG_ 1332 VCFRONT_a432_targetCurrent "32768";
BA_ "Confidence" SG_ 1332 VCFRONT_a432_packCurrent 1;
BA_ "GenSigSNA" SG_ 1332 VCFRONT_a432_packCurrent "32768";
BA_ "Confidence" SG_ 1332 VCFRONT_a436_netPackCurrent 1;
BA_ "GenSigSNA" SG_ 1332 VCFRONT_a436_netPackCurrent "32768";
BA_ "Confidence" SG_ 1332 VCFRONT_a436_maxDischargeCurrent 1;
BA_ "GenSigSNA" SG_ 1332 VCFRONT_a436_maxDischargeCurrent "32768";
BA_ "SystemSignalLongSymbol" SG_ 1332 VCFRONT_a436_maxDischargeCurrent "VCFRONT_a436_maxDischargeCurrentLimit";
BA_ "Confidence" SG_ 1332 VCFRONT_a436_hvjbCurrentLimit 1;
BA_ "GenSigSNA" SG_ 1332 VCFRONT_a436_hvjbCurrentLimit "32768";
BA_ "Confidence" SG_ 1332 VCFRONT_a438_temperature 1;
BA_ "Confidence" SG_ 1332 VCFRONT_a439_temperature 1;
BA_ "SystemSignalLongSymbol" SG_ 1332 VCFRONT_a446_compFaultRefrigeran "VCFRONT_a446_compFaultRefrigerant";
BA_ "SystemSignalLongSymbol" SG_ 1332 VCFRONT_a446_compStandbyLowAmbie "VCFRONT_a446_compStandbyLowAmbient";
BA_ "SystemSignalLongSymbol" SG_ 1332 VCFRONT_a446_compStandbyLowDisch "VCFRONT_a446_compStandbyLowDischPress";
BA_ "SystemSignalLongSymbol" SG_ 1332 VCFRONT_a446_compStandbyHVNotRea "VCFRONT_a446_compStandbyHVNotReady";
BA_ "SystemSignalLongSymbol" SG_ 1332 VCFRONT_a446_compStandbyCommunic "VCFRONT_a446_compStandbyCommunication";
BA_ "SystemSignalLongSymbol" SG_ 1332 VCFRONT_a446_compStandbySelfNotR "VCFRONT_a446_compStandbySelfNotReady";
BA_ "SystemSignalLongSymbol" SG_ 1332 VCFRONT_a446_compStandbyRefrigNo "VCFRONT_a446_compStandbyRefrigNotOk";
BA_ "SystemSignalLongSymbol" SG_ 1332 VCFRONT_a446_compStandbyCoastDow "VCFRONT_a446_compStandbyCoastDownMode";
BA_ "SystemSignalLongSymbol" SG_ 1332 VCFRONT_a446_compStandbyMultiple "VCFRONT_a446_compStandbyMultiplePdCutouts";
BA_ "SystemSignalLongSymbol" SG_ 1332 VCFRONT_a446_compStandbyShowroom "VCFRONT_a446_compStandbyShowroomMode";
BA_ "SystemSignalLongSymbol" SG_ 1332 VCFRONT_a446_compStandbyMul_0001 "VCFRONT_a446_compStandbyMultipleTdCutouts";
BA_ "Confidence" SG_ 1332 VCFRONT_a446_hpCabinLoadType 1;
BA_ "Confidence" SG_ 1332 VCFRONT_a446_hpBatteryLoadType 1;
BA_ "SystemSignalLongSymbol" SG_ 1332 VCFRONT_a446_sensorIntermit_0002 "VCFRONT_a446_sensorIntermittentPs";
BA_ "SystemSignalLongSymbol" SG_ 1332 VCFRONT_a446_sensorIntermittentP "VCFRONT_a446_sensorIntermittentPd";
BA_ "SystemSignalLongSymbol" SG_ 1332 VCFRONT_a446_sensorIntermit_0001 "VCFRONT_a446_sensorIntermittentPl";
BA_ "SystemSignalLongSymbol" SG_ 1332 VCFRONT_a446_sensorIntermit_0004 "VCFRONT_a446_sensorIntermittentTs";
BA_ "SystemSignalLongSymbol" SG_ 1332 VCFRONT_a446_sensorIntermittentT "VCFRONT_a446_sensorIntermittentTd";
BA_ "SystemSignalLongSymbol" SG_ 1332 VCFRONT_a446_sensorIntermit_0003 "VCFRONT_a446_sensorIntermittentTl";
BA_ "SystemSignalLongSymbol" SG_ 1332 VCFRONT_a446_highSuctionSuperhea "VCFRONT_a446_highSuctionSuperheat";
BA_ "SystemSignalLongSymbol" SG_ 1332 VCFRONT_a447_heatPumpHVACUnavail "VCFRONT_a447_heatPumpHVACUnavailable";
BA_ "SystemSignalLongSymbol" SG_ 1332 VCFRONT_a447_activeLouverComprom "VCFRONT_a447_activeLouverCompromised";
BA_ "SystemSignalLongSymbol" SG_ 1332 VCFRONT_a447_coolantValveComprom "VCFRONT_a447_coolantValveCompromised";
BA_ "SystemSignalLongSymbol" SG_ 1332 VCFRONT_a447_ambientSourcingComp "VCFRONT_a447_ambientSourcingCompromised";
BA_ "SystemSignalLongSymbol" SG_ 1332 VCFRONT_a447_scavengeLoopComprom "VCFRONT_a447_scavengeLoopCompromised";
BA_ "SystemSignalLongSymbol" SG_ 1332 VCFRONT_a447_coolantSystemCompro "VCFRONT_a447_coolantSystemCompromised";
BA_ "SystemSignalLongSymbol" SG_ 1332 VCFRONT_a447_hvBattActiveDischgC "VCFRONT_a447_hvBattActiveDischgCompromised";
BA_ "SystemSignalLongSymbol" SG_ 1332 VCFRONT_a447_hvBatteryDischargin "VCFRONT_a447_hvBatteryDischargingCompromised";
BA_ "SystemSignalLongSymbol" SG_ 1332 VCFRONT_a447_lccSolenoidCompromi "VCFRONT_a447_lccSolenoidCompromised";
BA_ "SystemSignalLongSymbol" SG_ 1332 VCFRONT_a447_refrigerantSystemCo "VCFRONT_a447_refrigerantSystemCompromised";
BA_ "SystemSignalLongSymbol" SG_ 1332 VCFRONT_a447_powertrainThermalFa "VCFRONT_a447_powertrainThermalFansCompromised";
BA_ "SystemSignalLongSymbol" SG_ 1332 VCFRONT_a447_refrigDischargePres "VCFRONT_a447_refrigDischargePressCompromised";
BA_ "SystemSignalLongSymbol" SG_ 1332 VCFRONT_a447_refrigeDischargeTem "VCFRONT_a447_refrigeDischargeTempCompromised";
BA_ "SystemSignalLongSymbol" SG_ 1332 VCFRONT_a447_refrigSuctionPressC "VCFRONT_a447_refrigSuctionPressCompromised";
BA_ "SystemSignalLongSymbol" SG_ 1332 VCFRONT_a447_refrigSuctionTempCo "VCFRONT_a447_refrigSuctionTempCompromised";
BA_ "SystemSignalLongSymbol" SG_ 1332 VCFRONT_a447_refrigLiquidPressCo "VCFRONT_a447_refrigLiquidPressCompromised";
BA_ "SystemSignalLongSymbol" SG_ 1332 VCFRONT_a447_refrigLiquidTempCom "VCFRONT_a447_refrigLiquidTempCompromised";
BA_ "SystemSignalLongSymbol" SG_ 1332 VCFRONT_a459_refrigerantFillActi "VCFRONT_a459_refrigerantFillActive";
BA_ "SystemSignalLongSymbol" SG_ 1332 VCFRONT_a462_NTCTempDiffWarnLeve "VCFRONT_a462_NTCTempDiffWarnLevel1";
BA_ "Confidence" SG_ 1332 VCFRONT_a463_switch1Voltage 1;
BA_ "Confidence" SG_ 1332 VCFRONT_a463_switch2Voltage 1;
BA_ "Confidence" SG_ 1332 VCFRONT_a464_flowIndex 1;
BA_ "Confidence" SG_ 1332 VCFRONT_a464_flowIndexFiltered 1;
BA_ "Confidence" SG_ 1332 VCFRONT_a464_subcool 1;
BA_ "Confidence" SG_ 1332 VCFRONT_a464_subcoolFiltered 1;
BA_ "Confidence" SG_ 1332 VCFRONT_a465_flowIndex 1;
BA_ "Confidence" SG_ 1332 VCFRONT_a465_flowIndexFiltered 1;
BA_ "Confidence" SG_ 1332 VCFRONT_a465_subcool 1;
BA_ "Confidence" SG_ 1332 VCFRONT_a465_subcoolFiltered 1;
BA_ "SystemSignalLongSymbol" SG_ 1332 VCFRONT_a465_flaggedAtSteadyStat "VCFRONT_a465_flaggedAtSteadyState";
BA_ "SystemSignalLongSymbol" SG_ 1332 VCFRONT_a465_flaggedAtUnsteadySt "VCFRONT_a465_flaggedAtUnsteadyState";
BA_ "Confidence" SG_ 1332 VCFRONT_a466_flowIndex 1;
BA_ "Confidence" SG_ 1332 VCFRONT_a466_flowIndexFiltered 1;
BA_ "Confidence" SG_ 1332 VCFRONT_a466_subcool 1;
BA_ "Confidence" SG_ 1332 VCFRONT_a466_subcoolFiltered 1;
BA_ "Confidence" SG_ 1332 VCFRONT_a467_powerIndexFiltered 1;
BA_ "Confidence" SG_ 1332 VCFRONT_a470_pressureLiquid 1;
BA_ "Confidence" SG_ 1332 VCFRONT_a470_pressureDischarge 1;
BA_ "Confidence" SG_ 1332 VCFRONT_a474_ssl100Bank1Status 1;
BA_ "Confidence" SG_ 1332 VCFRONT_a474_ssl100Bank2Status 1;
BA_ "Confidence" SG_ 1332 VCFRONT_a474_ssl100Bank3Status 1;
BA_ "Confidence" SG_ 1332 VCFRONT_a474_ssl100Bank4Status 1;
BA_ "Confidence" SG_ 1332 VCFRONT_a474_ssl100Bank5Status 1;
BA_ "Confidence" SG_ 1332 VCFRONT_a474_ssl100Bank6Status 1;
BA_ "Confidence" SG_ 1332 VCFRONT_a474_ssl100Bank7Status 1;
BA_ "Confidence" SG_ 1332 VCFRONT_a474_ssl100Bank8Status 1;
BA_ "Confidence" SG_ 1332 VCFRONT_a474_ssl100Bank9Status 1;
BA_ "Confidence" SG_ 1332 VCFRONT_a474_lowBeamPrefieldStat 1;
BA_ "SystemSignalLongSymbol" SG_ 1332 VCFRONT_a474_lowBeamPrefieldStat "VCFRONT_a474_lowBeamPrefieldStatus";
BA_ "Confidence" SG_ 1332 VCFRONT_a474_drl1Status 1;
BA_ "Confidence" SG_ 1332 VCFRONT_a474_drl2Status 1;
BA_ "Confidence" SG_ 1332 VCFRONT_a474_drl3Status 1;
BA_ "Confidence" SG_ 1332 VCFRONT_a474_turnStatus 1;
BA_ "Confidence" SG_ 1332 VCFRONT_a474_fanStatus 1;
BA_ "Confidence" SG_ 1332 VCFRONT_a474_TPS92520_COMPOV 1;
BA_ "Confidence" SG_ 1332 VCFRONT_a474_TPS92520_HSILIM 1;
BA_ "Confidence" SG_ 1332 VCFRONT_a474_TPS92520_BSTUV 1;
BA_ "Confidence" SG_ 1332 VCFRONT_a474_BoostRailStatus 1;
BA_ "Confidence" SG_ 1332 VCFRONT_a474_EEPROM_DataStatus 1;
BA_ "Confidence" SG_ 1332 VCFRONT_a474_LMMVariant 1;
BA_ "GenSigSNA" SG_ 1332 VCFRONT_a474_LMMVariant "0";
BA_ "Confidence" SG_ 1332 VCFRONT_a474_headlampECURevision 1;
BA_ "Confidence" SG_ 1332 VCFRONT_a475_ssl100Bank1Status 1;
BA_ "Confidence" SG_ 1332 VCFRONT_a475_ssl100Bank2Status 1;
BA_ "Confidence" SG_ 1332 VCFRONT_a475_ssl100Bank3Status 1;
BA_ "Confidence" SG_ 1332 VCFRONT_a475_ssl100Bank4Status 1;
BA_ "Confidence" SG_ 1332 VCFRONT_a475_ssl100Bank5Status 1;
BA_ "Confidence" SG_ 1332 VCFRONT_a475_ssl100Bank6Status 1;
BA_ "Confidence" SG_ 1332 VCFRONT_a475_ssl100Bank7Status 1;
BA_ "Confidence" SG_ 1332 VCFRONT_a475_ssl100Bank8Status 1;
BA_ "Confidence" SG_ 1332 VCFRONT_a475_ssl100Bank9Status 1;
BA_ "Confidence" SG_ 1332 VCFRONT_a475_lowBeamPrefieldStat 1;
BA_ "SystemSignalLongSymbol" SG_ 1332 VCFRONT_a475_lowBeamPrefieldStat "VCFRONT_a475_lowBeamPrefieldStatus";
BA_ "Confidence" SG_ 1332 VCFRONT_a475_drl1Status 1;
BA_ "Confidence" SG_ 1332 VCFRONT_a475_drl2Status 1;
BA_ "Confidence" SG_ 1332 VCFRONT_a475_drl3Status 1;
BA_ "Confidence" SG_ 1332 VCFRONT_a475_turnStatus 1;
BA_ "Confidence" SG_ 1332 VCFRONT_a475_fanStatus 1;
BA_ "Confidence" SG_ 1332 VCFRONT_a475_TPS92520_COMPOV 1;
BA_ "Confidence" SG_ 1332 VCFRONT_a475_TPS92520_HSILIM 1;
BA_ "Confidence" SG_ 1332 VCFRONT_a475_TPS92520_BSTUV 1;
BA_ "Confidence" SG_ 1332 VCFRONT_a475_BoostRailStatus 1;
BA_ "Confidence" SG_ 1332 VCFRONT_a475_EEPROM_DataStatus 1;
BA_ "Confidence" SG_ 1332 VCFRONT_a475_LMMVariant 1;
BA_ "GenSigSNA" SG_ 1332 VCFRONT_a475_LMMVariant "0";
BA_ "Confidence" SG_ 1332 VCFRONT_a475_headlampECURevision 1;
BA_ "Confidence" SG_ 1332 VCFRONT_a476_vehiclePowerState 1;
BA_ "Confidence" SG_ 1332 VCFRONT_a476_batterySMState 1;
BA_ "Confidence" SG_ 1332 VCFRONT_a476_ECPAState 1;
BA_ "GenSigSNA" SG_ 1332 VCFRONT_a476_ECPAState "3";
BA_ "Confidence" SG_ 1332 VCFRONT_a477_cell1Voltage 1;
BA_ "Confidence" SG_ 1332 VCFRONT_a477_cell2Voltage 1;
BA_ "Confidence" SG_ 1332 VCFRONT_a477_cell3Voltage 1;
BA_ "Confidence" SG_ 1332 VCFRONT_a477_cell4Voltage 1;
BA_ "Confidence" SG_ 1332 VCFRONT_a477_sumCellVoltage 1;
BA_ "SystemSignalLongSymbol" SG_ 1332 VCFRONT_a478_battFaultPackOverVo "VCFRONT_a478_battFaultPackOverVoltage";
BA_ "SystemSignalLongSymbol" SG_ 1332 VCFRONT_a478_battFaultHardwareOv "VCFRONT_a478_battFaultHardwareOverCurrent";
BA_ "SystemSignalLongSymbol" SG_ 1332 VCFRONT_a478_battFaultChargeOver "VCFRONT_a478_battFaultChargeOverCurrent";
BA_ "SystemSignalLongSymbol" SG_ 1332 VCFRONT_a478_battFaultCellUnderV "VCFRONT_a478_battFaultCellUnderVoltage";
BA_ "SystemSignalLongSymbol" SG_ 1332 VCFRONT_a478_battFaultCellOverVo "VCFRONT_a478_battFaultCellOverVoltage";
BA_ "Confidence" SG_ 1332 VCFRONT_a478_vehiclePowerState 1;
BA_ "Confidence" SG_ 1332 VCFRONT_a478_batterySMState 1;
BA_ "Confidence" SG_ 1332 VCFRONT_a478_bmsState 1;
BA_ "GenSigSNA" SG_ 1332 VCFRONT_a478_bmsState "9";
BA_ "Confidence" SG_ 1332 VCFRONT_a478_dcdcLVSupportStatus 1;
BA_ "SystemSignalLongSymbol" SG_ 1332 VCFRONT_a478_notEnoughPowerForSu "VCFRONT_a478_notEnoughPowerForSupport";
BA_ "SystemSignalLongSymbol" SG_ 1332 VCFRONT_a478_contactorEFuseStabl "VCFRONT_a478_contactorEFuseStable";
BA_ "Confidence" SG_ 1332 VCFRONT_a479_ECPAState 1;
BA_ "GenSigSNA" SG_ 1332 VCFRONT_a479_ECPAState "3";
BA_ "Confidence" SG_ 1332 VCFRONT_a479_frunkLatchStatus 1;
BA_ "GenSigSNA" SG_ 1332 VCFRONT_a479_frunkLatchStatus "0";
BA_ "Confidence" SG_ 1332 VCFRONT_a479_vehiclePowerState 1;
BA_ "Confidence" SG_ 1332 VCFRONT_a479_batterySMState 1;
BA_ "Confidence" SG_ 1332 VCFRONT_a480_channel 1;
BA_ "SystemSignalLongSymbol" SG_ 1332 VCFRONT_a480_deviceOvertemperatu "VCFRONT_a480_deviceOvertemperature";
BA_ "Confidence" SG_ 1332 VCFRONT_a486_mcuGraphicsEFuseCur 1;
BA_ "SystemSignalLongSymbol" SG_ 1332 VCFRONT_a486_mcuGraphicsEFuseCur "VCFRONT_a486_mcuGraphicsEFuseCurrent";
BA_ "Confidence" SG_ 1332 VCFRONT_a490_coolantPumpType 1;
BA_ "Confidence" SG_ 1332 VCFRONT_a493_minBrickSocByOcvMax 1;
BA_ "Confidence" SG_ 1332 VCFRONT_a493_maxBrickSocByOcvMin 1;
BA_ "Confidence" SG_ 1332 VCFRONT_a493_maxBrickSoc 1;
BA_ "Confidence" SG_ 1332 VCFRONT_a493_avgBrickSoc 1;
BA_ "SystemSignalLongSymbol" SG_ 1332 VCFRONT_a495_reverseBatteryEFuse "VCFRONT_a495_reverseBatteryEFuseFault";
BA_ "SystemSignalLongSymbol" SG_ 1332 VCFRONT_a496_reverseBatteryEFuse "VCFRONT_a496_reverseBatteryEFuseFault";
BA_ "SystemSignalLongSymbol" SG_ 1332 VCFRONT_a496_vehicleLoadShedActi "VCFRONT_a496_vehicleLoadShedActive";
BA_ "Confidence" SG_ 1332 VCFRONT_a496_MOSState 1;
BA_ "GenSigSNA" SG_ 1332 VCFRONT_a496_MOSState "3";
BA_ "SystemSignalLongSymbol" SG_ 1332 VCFRONT_a496_NotEnoughPowerForSu "VCFRONT_a496_NotEnoughPowerForSupport";
BA_ "Confidence" SG_ 1332 VCFRONT_a496_bmsState 1;
BA_ "GenSigSNA" SG_ 1332 VCFRONT_a496_bmsState "9";
BA_ "Confidence" SG_ 1332 VCFRONT_a497_SOC 1;
BA_ "Confidence" SG_ 1332 VCFRONT_a497_PackCurrent 1;
BA_ "Confidence" SG_ 1332 VCFRONT_a497_SumCellVoltage 1;
BA_ "Confidence" SG_ 1332 VCFRONT_a500_mismatchedState 1;
BA_ "Confidence" SG_ 1332 VCFRONT_a503_brickVoltageMin 1;
BA_ "Confidence" SG_ 1332 VCFRONT_a503_brickVoltageMax 1;
BA_ "Confidence" SG_ 1332 VCFRONT_a503_packCurrent 1;
BA_ "Confidence" SG_ 1332 VCFRONT_a503_socMax 1;
BA_ "Confidence" SG_ 1332 VCFRONT_a509_vcrightEFuseCurrent 1;
BA_ "Confidence" SG_ 1332 VCFRONT_a509_vcrightEFuseTemp 1;
BA_ "Confidence" SG_ 1332 VCFRONT_a509_ambientTemp 1;
BA_ "Confidence" SG_ 1332 VCFRONT_a510_sumCellVoltage 1;
BA_ "Confidence" SG_ 1332 VCFRONT_a510_packVoltage 1;
BA_ "Confidence" SG_ 1332 VCFRONT_a510_targetPCSVoltage 1;
BA_ "Confidence" SG_ 1332 VCFRONT_a511_PCSEFuseCurrent 1;
BA_ "Confidence" SG_ 1332 VCFRONT_a511_DCDCMaxOutputCurren 1;
BA_ "SystemSignalLongSymbol" SG_ 1332 VCFRONT_a511_DCDCMaxOutputCurren "VCFRONT_a511_DCDCMaxOutputCurrentAllowed";
BA_ "Confidence" SG_ 1332 VCFRONT_a511_hvState 1;
BA_ "Confidence" SG_ 1332 VCFRONT_a512_packVoltageInt_0001 1;
BA_ "SystemSignalLongSymbol" SG_ 1332 VCFRONT_a512_packVoltageInt_0001 "VCFRONT_a512_packVoltageIntervalMin";
BA_ "Confidence" SG_ 1332 VCFRONT_a512_packVoltageInterval 1;
BA_ "SystemSignalLongSymbol" SG_ 1332 VCFRONT_a512_packVoltageInterval "VCFRONT_a512_packVoltageIntervalMax";
BA_ "Confidence" SG_ 1332 VCFRONT_a512_packTemperature 1;
BA_ "Confidence" SG_ 1332 VCFRONT_a512_sumCellVoltage 1;
BA_ "Confidence" SG_ 1332 VCFRONT_a512_overcurrentDirectio 1;
BA_ "SystemSignalLongSymbol" SG_ 1332 VCFRONT_a512_overcurrentDirectio "VCFRONT_a512_overcurrentDirection";
BA_ "Confidence" SG_ 1332 VCFRONT_a512_vehiclePowerState 1;
BA_ "Confidence" SG_ 1332 VCFRONT_a513_packCurrent 1;
BA_ "Confidence" SG_ 1332 VCFRONT_a513_packTemperature 1;
BA_ "Confidence" SG_ 1332 VCFRONT_a513_packVoltage 1;
BA_ "Confidence" SG_ 1332 VCFRONT_a513_packSOC 1;
BA_ "Confidence" SG_ 1332 VCFRONT_a513_vehiclePowerState 1;
BA_ "Confidence" SG_ 1332 VCFRONT_a514_cell1Voltage 1;
BA_ "Confidence" SG_ 1332 VCFRONT_a514_cell2Voltage 1;
BA_ "Confidence" SG_ 1332 VCFRONT_a514_cell3Voltage 1;
BA_ "Confidence" SG_ 1332 VCFRONT_a514_cell4Voltage 1;
BA_ "Confidence" SG_ 1332 VCFRONT_a514_packVoltage 1;
BA_ "Confidence" SG_ 1332 VCFRONT_a514_packSOC 1;
BA_ "Confidence" SG_ 1332 VCFRONT_a514_vehiclePowerState 1;
BA_ "Confidence" SG_ 1332 VCFRONT_a515_cell1Voltage 1;
BA_ "Confidence" SG_ 1332 VCFRONT_a515_cell2Voltage 1;
BA_ "Confidence" SG_ 1332 VCFRONT_a515_cell3Voltage 1;
BA_ "Confidence" SG_ 1332 VCFRONT_a515_cell4Voltage 1;
BA_ "Confidence" SG_ 1332 VCFRONT_a515_packVoltage 1;
BA_ "Confidence" SG_ 1332 VCFRONT_a515_packSOC 1;
BA_ "Confidence" SG_ 1332 VCFRONT_a515_vehiclePowerState 1;
BA_ "Confidence" SG_ 1332 VCFRONT_a516_IBSVoltage 1;
BA_ "Confidence" SG_ 1332 VCFRONT_a516_HVSoc 1;
BA_ "SystemSignalLongSymbol" SG_ 1332 VCFRONT_a516_contactorsPermanent "VCFRONT_a516_contactorsPermanentlyClosed";
BA_ "SystemSignalLongSymbol" SG_ 1332 VCFRONT_a516_LVBatteryDisconnect "VCFRONT_a516_LVBatteryDisconnected";
BA_ "SystemSignalLongSymbol" SG_ 1332 VCFRONT_a516_LVBatteryCannotSupp "VCFRONT_a516_LVBatteryCannotSupportVehicle";
BA_ "Confidence" SG_ 1332 VCFRONT_a517_IBSVoltage 1;
BA_ "Confidence" SG_ 1332 VCFRONT_a517_HVSoc 1;
BA_ "Confidence" SG_ 1332 VCFRONT_a518_packVoltage 1;
BA_ "Confidence" SG_ 1332 VCFRONT_a518_IBSVoltage 1;
BA_ "Confidence" SG_ 1332 VCFRONT_a518_targetPCSVoltage 1;
BA_ "Confidence" SG_ 1332 VCFRONT_a518_outputVoltageAtPCS 1;
BA_ "Confidence" SG_ 1332 VCFRONT_a518_packSOC 1;
BA_ "Confidence" SG_ 1332 VCFRONT_a518_vehiclePowerState 1;
BA_ "Confidence" SG_ 1332 VCFRONT_a519_MatrixBank1Status 1;
BA_ "Confidence" SG_ 1332 VCFRONT_a519_MatrixBank2Status 1;
BA_ "Confidence" SG_ 1332 VCFRONT_a519_MatrixBank3Status 1;
BA_ "Confidence" SG_ 1332 VCFRONT_a519_MatrixBank4Status 1;
BA_ "Confidence" SG_ 1332 VCFRONT_a519_TurnSignalStatus 1;
BA_ "Confidence" SG_ 1332 VCFRONT_a519_SideMarkerStatus 1;
BA_ "Confidence" SG_ 1332 VCFRONT_a519_DRLStatus 1;
BA_ "Confidence" SG_ 1332 VCFRONT_a519_AmbientStatus 1;
BA_ "Confidence" SG_ 1332 VCFRONT_a519_LBFlatSAEStatus 1;
BA_ "Confidence" SG_ 1332 VCFRONT_a519_LBFlatECEStatus 1;
BA_ "Confidence" SG_ 1332 VCFRONT_a519_TPS92520_COMPOV 1;
BA_ "Confidence" SG_ 1332 VCFRONT_a519_TPS92520_HSILIM 1;
BA_ "Confidence" SG_ 1332 VCFRONT_a519_TPS92520_BSTUV 1;
BA_ "Confidence" SG_ 1332 VCFRONT_a519_CoolingFanStatus 1;
BA_ "Confidence" SG_ 1332 VCFRONT_a519_BoostRailStatus 1;
BA_ "Confidence" SG_ 1332 VCFRONT_a519_EEPROMCurrentBinSta 1;
BA_ "SystemSignalLongSymbol" SG_ 1332 VCFRONT_a519_EEPROMCurrentBinSta "VCFRONT_a519_EEPROMCurrentBinStatus";
BA_ "Confidence" SG_ 1332 VCFRONT_a519_EEPROMCalCurrentSta 1;
BA_ "SystemSignalLongSymbol" SG_ 1332 VCFRONT_a519_EEPROMCalCurrentSta "VCFRONT_a519_EEPROMCalCurrentStatus";
BA_ "Confidence" SG_ 1332 VCFRONT_a519_HeadlampECURevision 1;
BA_ "Confidence" SG_ 1332 VCFRONT_a519_NonzeroEEPROMRetrie 1;
BA_ "SystemSignalLongSymbol" SG_ 1332 VCFRONT_a519_NonzeroEEPROMRetrie "VCFRONT_a519_NonzeroEEPROMRetries";
BA_ "Confidence" SG_ 1332 VCFRONT_a519_MaxEEPROMRetries 1;
BA_ "Confidence" SG_ 1332 VCFRONT_a520_MatrixBank1Status 1;
BA_ "Confidence" SG_ 1332 VCFRONT_a520_MatrixBank2Status 1;
BA_ "Confidence" SG_ 1332 VCFRONT_a520_MatrixBank3Status 1;
BA_ "Confidence" SG_ 1332 VCFRONT_a520_MatrixBank4Status 1;
BA_ "Confidence" SG_ 1332 VCFRONT_a520_TurnSignalStatus 1;
BA_ "Confidence" SG_ 1332 VCFRONT_a520_SideMarkerStatus 1;
BA_ "Confidence" SG_ 1332 VCFRONT_a520_DRLStatus 1;
BA_ "Confidence" SG_ 1332 VCFRONT_a520_AmbientStatus 1;
BA_ "Confidence" SG_ 1332 VCFRONT_a520_LBFlatSAEStatus 1;
BA_ "Confidence" SG_ 1332 VCFRONT_a520_LBFlatECEStatus 1;
BA_ "Confidence" SG_ 1332 VCFRONT_a520_TPS92520_COMPOV 1;
BA_ "Confidence" SG_ 1332 VCFRONT_a520_TPS92520_HSILIM 1;
BA_ "Confidence" SG_ 1332 VCFRONT_a520_TPS92520_BSTUV 1;
BA_ "Confidence" SG_ 1332 VCFRONT_a520_CoolingFanStatus 1;
BA_ "Confidence" SG_ 1332 VCFRONT_a520_BoostRailStatus 1;
BA_ "Confidence" SG_ 1332 VCFRONT_a520_EEPROMCurrentBinSta 1;
BA_ "SystemSignalLongSymbol" SG_ 1332 VCFRONT_a520_EEPROMCurrentBinSta "VCFRONT_a520_EEPROMCurrentBinStatus";
BA_ "Confidence" SG_ 1332 VCFRONT_a520_EEPROMCalCurrentSta 1;
BA_ "SystemSignalLongSymbol" SG_ 1332 VCFRONT_a520_EEPROMCalCurrentSta "VCFRONT_a520_EEPROMCalCurrentStatus";
BA_ "Confidence" SG_ 1332 VCFRONT_a520_HeadlampECURevision 1;
BA_ "Confidence" SG_ 1332 VCFRONT_a520_NonzeroEEPROMRetrie 1;
BA_ "SystemSignalLongSymbol" SG_ 1332 VCFRONT_a520_NonzeroEEPROMRetrie "VCFRONT_a520_NonzeroEEPROMRetries";
BA_ "Confidence" SG_ 1332 VCFRONT_a520_MaxEEPROMRetries 1;
BA_ "Confidence" SG_ 1332 VCFRONT_a521_vcleftEFuseCurrent 1;
BA_ "Confidence" SG_ 1332 VCFRONT_a521_vcleftEFuseTemp 1;
BA_ "Confidence" SG_ 1332 VCFRONT_a521_ambientTemp 1;
BA_ "Confidence" SG_ 1332 VCFRONT_a522_IBSVoltage 1;
BA_ "Confidence" SG_ 1332 VCFRONT_a522_HVSoc 1;
BA_ "SystemSignalLongSymbol" SG_ 1332 VCFRONT_a522_contactorsPermanent "VCFRONT_a522_contactorsPermanentlyClosed";
BA_ "SystemSignalLongSymbol" SG_ 1332 VCFRONT_a522_LVBatteryDisconnect "VCFRONT_a522_LVBatteryDisconnected";
BA_ "SystemSignalLongSymbol" SG_ 1332 VCFRONT_a522_LVBatteryCannotSupp "VCFRONT_a522_LVBatteryCannotSupportVehicle";
BA_ "Confidence" SG_ 1332 VCFRONT_a525_GTW_twelveVBatteryT 1;
BA_ "SystemSignalLongSymbol" SG_ 1332 VCFRONT_a525_GTW_twelveVBatteryT "VCFRONT_a525_GTW_twelveVBatteryType";
BA_ "Confidence" SG_ 1332 VCFRONT_a525_newLVBatteryType 1;
BA_ "Confidence" SG_ 1332 VCFRONT_a525_initialLVBatteryTyp 1;
BA_ "SystemSignalLongSymbol" SG_ 1332 VCFRONT_a525_initialLVBatteryTyp "VCFRONT_a525_initialLVBatteryType";
BA_ "Confidence" SG_ 1332 VCFRONT_a527_cell1Voltage 1;
BA_ "Confidence" SG_ 1332 VCFRONT_a527_cell2Voltage 1;
BA_ "Confidence" SG_ 1332 VCFRONT_a527_cell3Voltage 1;
BA_ "Confidence" SG_ 1332 VCFRONT_a527_cell4Voltage 1;
BA_ "Confidence" SG_ 1332 VCFRONT_a531_powerIndexFiltered 1;
BA_ "Confidence" SG_ 1332 VCFRONT_a533_temperature 1;
BA_ "Confidence" SG_ 1332 VCFRONT_a541_PackTemperature 1;
BA_ "Confidence" SG_ 1332 VCFRONT_a541_ChargeCurrentLimit 1;
BA_ "Confidence" SG_ 1332 VCFRONT_a541_PeakCurrent 1;
BA_ "Confidence" SG_ 1332 VCFRONT_a541_AverageCurrent 1;
BA_ "Confidence" SG_ 1332 VCFRONT_a541_SOC 1;
BA_ "Confidence" SG_ 1332 VCFRONT_a544_LVBMSSOC 1;
BA_ "Confidence" SG_ 1332 VCFRONT_a545_GTW_twelveVBatteryT 1;
BA_ "SystemSignalLongSymbol" SG_ 1332 VCFRONT_a545_GTW_twelveVBatteryT "VCFRONT_a545_GTW_twelveVBatteryType";
BA_ "Confidence" SG_ 1332 VCFRONT_a545_newLVBatteryType 1;
BA_ "Confidence" SG_ 1332 VCFRONT_a548_vehiclePowerState 1;
BA_ "SystemSignalLongSymbol" SG_ 1332 VCFRONT_a548_notEnoughPowerForSu "VCFRONT_a548_notEnoughPowerForSupport";
BA_ "SystemSignalLongSymbol" SG_ 1332 VCFRONT_a548_LVBatteryCannotSupp "VCFRONT_a548_LVBatteryCannotSupportVehicle";
BA_ "Confidence" SG_ 1332 VCFRONT_a548_DI_gear 1;
BA_ "GenSigSNA" SG_ 1332 VCFRONT_a548_DI_gear "7";
BA_ "Confidence" SG_ 1332 VCFRONT_a548_backstopBucketCount 1;
VAL_ 1332 VCFRONT_a300_oldType 3 "UNKOWN" 1 "KEBODA" 0 "PMDM" ;
VAL_ 1332 VCFRONT_a300_newType 3 "UNKOWN" 1 "KEBODA" 0 "PMDM" ;
VAL_ 1332 VCFRONT_a302_LINFrameStatus 4 "NA" 3 "ERROR" 2 "TIMEOUT" 1 "OK" 0 "UNKNOWN" ;
VAL_ 1332 VCFRONT_a303_lockStatus 2 "LOCKED" 1 "UNLOCKED" 0 "SNA" ;
VAL_ 1332 VCFRONT_a309_lockStatus 2 "LOCKED" 1 "UNLOCKED" 0 "SNA" ;
VAL_ 1332 VCFRONT_a334_vehicleState 3 "DRIVE" 2 "ACCESSORY" 1 "CONDITIONING" 0 "OFF" ;
VAL_ 1332 VCFRONT_a335_vehicleState 3 "DRIVE" 2 "ACCESSORY" 1 "CONDITIONING" 0 "OFF" ;
VAL_ 1332 VCFRONT_a336_vehicleState 3 "DRIVE" 2 "ACCESSORY" 1 "CONDITIONING" 0 "OFF" ;
VAL_ 1332 VCFRONT_a337_vehicleState 3 "DRIVE" 2 "ACCESSORY" 1 "CONDITIONING" 0 "OFF" ;
VAL_ 1332 VCFRONT_a338_vehicleState 3 "DRIVE" 2 "ACCESSORY" 1 "CONDITIONING" 0 "OFF" ;
VAL_ 1332 VCFRONT_a339_vehicleState 3 "DRIVE" 2 "ACCESSORY" 1 "CONDITIONING" 0 "OFF" ;
VAL_ 1332 VCFRONT_a340_vehicleState 3 "DRIVE" 2 "ACCESSORY" 1 "CONDITIONING" 0 "OFF" ;
VAL_ 1332 VCFRONT_a341_vehicleState 3 "DRIVE" 2 "ACCESSORY" 1 "CONDITIONING" 0 "OFF" ;
VAL_ 1332 VCFRONT_a342_vehicleState 3 "DRIVE" 2 "ACCESSORY" 1 "CONDITIONING" 0 "OFF" ;
VAL_ 1332 VCFRONT_a343_vehicleState 3 "DRIVE" 2 "ACCESSORY" 1 "CONDITIONING" 0 "OFF" ;
VAL_ 1332 VCFRONT_a344_vehicleState 3 "DRIVE" 2 "ACCESSORY" 1 "CONDITIONING" 0 "OFF" ;
VAL_ 1332 VCFRONT_a345_vehicleState 3 "DRIVE" 2 "ACCESSORY" 1 "CONDITIONING" 0 "OFF" ;
VAL_ 1332 VCFRONT_a346_vehicleState 3 "DRIVE" 2 "ACCESSORY" 1 "CONDITIONING" 0 "OFF" ;
VAL_ 1332 VCFRONT_a347_vehicleState 3 "DRIVE" 2 "ACCESSORY" 1 "CONDITIONING" 0 "OFF" ;
VAL_ 1332 VCFRONT_a348_vehicleState 3 "DRIVE" 2 "ACCESSORY" 1 "CONDITIONING" 0 "OFF" ;
VAL_ 1332 VCFRONT_a349_vehicleState 3 "DRIVE" 2 "ACCESSORY" 1 "CONDITIONING" 0 "OFF" ;
VAL_ 1332 VCFRONT_a353_ambientTemperature 0 "SNA" ;
VAL_ 1332 VCFRONT_a354_ambientTemperature 0 "SNA" ;
VAL_ 1332 VCFRONT_a359_vehiclePowerState 3 "DRIVE" 2 "ACCESSORY" 1 "CONDITIONING" 0 "OFF" ;
VAL_ 1332 VCFRONT_a359_batterySMState 10 "EXTERNAL_LV_BUS_CONTROL" 9 "RECOVERY" 8 "FAULT" 7 "SHORTED_CELL_TEST" 6 "DISCONNECTED_BATTERY_TEST" 5 "OTA_STANDBY" 4 "RESISTANCE_ESTIMATION" 3 "STANDBY" 2 "DISCHARGE" 1 "CHARGE" 0 "INIT" ;
VAL_ 1332 VCFRONT_a359_hvState 6 "UP" 5 "UP_FOR_DC_CHARGE" 4 "UP_FOR_CHARGE" 3 "UP_FOR_DRIVE" 2 "GOING_DOWN" 1 "COMING_UP" 0 "DOWN" ;
VAL_ 1332 VCFRONT_a359_dcdcLVSupportStatus 2 "FAULTED" 1 "ACTIVE" 0 "IDLE" ;
VAL_ 1332 VCFRONT_a359_bmsState 10 "DIAG" 9 "SNA" 8 "TEST" 7 "WELD" 6 "FAULT" 5 "CLEAR_FAULT" 4 "FEIM" 3 "CHARGE" 2 "SUPPORT" 1 "DRIVE" 0 "STANDBY" ;
VAL_ 1332 VCFRONT_a368_enteringState 5 "FAULTED" 4 "INHIBIT_FOR_REST" 3 "BATTERY_DISCHARGE" 2 "BATTERY_HEATING" 1 "READY" 0 "NOT_READY" ;
VAL_ 1332 VCFRONT_a368_exitingState 5 "FAULTED" 4 "INHIBIT_FOR_REST" 3 "BATTERY_DISCHARGE" 2 "BATTERY_HEATING" 1 "READY" 0 "NOT_READY" ;
VAL_ 1332 VCFRONT_a370_SOC 7 "SNA" ;
VAL_ 1332 VCFRONT_a373_tempSuperheatActual 1023 "SNA" ;
VAL_ 1332 VCFRONT_a378_wiperOverload 2 "TQLIMIT2" 1 "TQLIMIT1" 0 "NORMAL" ;
VAL_ 1332 VCFRONT_a378_wiperOvertemperatur 3 "TLIMIT3" 2 "TLIMIT2" 1 "TLIMIT1" 0 "NORMAL" ;
VAL_ 1332 VCFRONT_a389_latchStatus 8 "FAULT" 7 "DEFAULT" 6 "TIMEOUT" 5 "AJAR" 4 "OPENING" 3 "CLOSING" 2 "CLOSED" 1 "OPENED" 0 "SNA" ;
VAL_ 1332 VCFRONT_a401_LVBatteryTemp 127 "SNA" ;
VAL_ 1332 VCFRONT_a402_LVBatteryTemp 127 "SNA" ;
VAL_ 1332 VCFRONT_a402_batterySMState 10 "EXTERNAL_LV_BUS_CONTROL" 9 "RECOVERY" 8 "FAULT" 7 "SHORTED_CELL_TEST" 6 "DISCONNECTED_BATTERY_TEST" 5 "OTA_STANDBY" 4 "RESISTANCE_ESTIMATION" 3 "STANDBY" 2 "DISCHARGE" 1 "CHARGE" 0 "INIT" ;
VAL_ 1332 VCFRONT_a407_dcr12VThreshold 12 "15_MILLIOHMS" 11 "16_MILLIOHMS" 10 "17_MILLIOHMS" 9 "18_MILLIOHMS" 8 "19_MILLIOHMS" 7 "20_MILLIOHMS" 6 "22_MILLIOHMS" 5 "24_MILLIOHMS" 4 "27_MILLIOHMS" 3 "30_MILLIOHMS" 2 "35_MILLIOHMS" 1 "40_MILLIOHMS" 0 "OFF" ;
VAL_ 1332 VCFRONT_a414_LVBatteryTemp 127 "SNA" ;
VAL_ 1332 VCFRONT_a414_vehiclePowerState 3 "DRIVE" 2 "ACCESSORY" 1 "CONDITIONING" 0 "OFF" ;
VAL_ 1332 VCFRONT_a415_LVBatteryTemp 127 "SNA" ;
VAL_ 1332 VCFRONT_a415_vehiclePowerState 3 "DRIVE" 2 "ACCESSORY" 1 "CONDITIONING" 0 "OFF" ;
VAL_ 1332 VCFRONT_a431_netPackCurrent -32768 "SNA" ;
VAL_ 1332 VCFRONT_a431_maxChargeCurrentLim -32768 "SNA" ;
VAL_ 1332 VCFRONT_a431_hvjbCurrentLimit -32768 "SNA" ;
VAL_ 1332 VCFRONT_a432_targetCurrent -32768 "SNA" ;
VAL_ 1332 VCFRONT_a432_packCurrent -32768 "SNA" ;
VAL_ 1332 VCFRONT_a436_netPackCurrent -32768 "SNA" ;
VAL_ 1332 VCFRONT_a436_maxDischargeCurrent -32768 "SNA" ;
VAL_ 1332 VCFRONT_a436_hvjbCurrentLimit -32768 "SNA" ;
VAL_ 1332 VCFRONT_a446_hpCabinLoadType 3 "EVAP" 2 "REHEAT" 1 "CC" 0 "NONE" ;
VAL_ 1332 VCFRONT_a446_hpBatteryLoadType 2 "BATT_COOL" 1 "BATT_HEAT" 0 "NONE" ;
VAL_ 1332 VCFRONT_a474_ssl100Bank1Status 3 "UNRESPONSIVE" 2 "PIXEL_ERROR" 1 "CRC_ERROR" 0 "OK" ;
VAL_ 1332 VCFRONT_a474_ssl100Bank2Status 3 "UNRESPONSIVE" 2 "PIXEL_ERROR" 1 "CRC_ERROR" 0 "OK" ;
VAL_ 1332 VCFRONT_a474_ssl100Bank3Status 3 "UNRESPONSIVE" 2 "PIXEL_ERROR" 1 "CRC_ERROR" 0 "OK" ;
VAL_ 1332 VCFRONT_a474_ssl100Bank4Status 3 "UNRESPONSIVE" 2 "PIXEL_ERROR" 1 "CRC_ERROR" 0 "OK" ;
VAL_ 1332 VCFRONT_a474_ssl100Bank5Status 3 "UNRESPONSIVE" 2 "PIXEL_ERROR" 1 "CRC_ERROR" 0 "OK" ;
VAL_ 1332 VCFRONT_a474_ssl100Bank6Status 3 "UNRESPONSIVE" 2 "PIXEL_ERROR" 1 "CRC_ERROR" 0 "OK" ;
VAL_ 1332 VCFRONT_a474_ssl100Bank7Status 3 "UNRESPONSIVE" 2 "PIXEL_ERROR" 1 "CRC_ERROR" 0 "OK" ;
VAL_ 1332 VCFRONT_a474_ssl100Bank8Status 3 "UNRESPONSIVE" 2 "PIXEL_ERROR" 1 "CRC_ERROR" 0 "OK" ;
VAL_ 1332 VCFRONT_a474_ssl100Bank9Status 3 "UNRESPONSIVE" 2 "PIXEL_ERROR" 1 "CRC_ERROR" 0 "OK" ;
VAL_ 1332 VCFRONT_a474_lowBeamPrefieldStat 6 "DRIVER_STATUS_FALSE_TRIGGER" 5 "UNDERVOLTAGE_FALSE_TRIGGER" 4 "OVERVOLTAGE_FALSE_TRIGGER" 3 "DRIVER_STATUS_FAULT" 2 "UNDERVOLTAGE_FAULT" 1 "OVERVOLTAGE_FAULT" 0 "OK" ;
VAL_ 1332 VCFRONT_a474_drl1Status 6 "DRIVER_STATUS_FALSE_TRIGGER" 5 "UNDERVOLTAGE_FALSE_TRIGGER" 4 "OVERVOLTAGE_FALSE_TRIGGER" 3 "DRIVER_STATUS_FAULT" 2 "UNDERVOLTAGE_FAULT" 1 "OVERVOLTAGE_FAULT" 0 "OK" ;
VAL_ 1332 VCFRONT_a474_drl2Status 6 "DRIVER_STATUS_FALSE_TRIGGER" 5 "UNDERVOLTAGE_FALSE_TRIGGER" 4 "OVERVOLTAGE_FALSE_TRIGGER" 3 "DRIVER_STATUS_FAULT" 2 "UNDERVOLTAGE_FAULT" 1 "OVERVOLTAGE_FAULT" 0 "OK" ;
VAL_ 1332 VCFRONT_a474_drl3Status 6 "DRIVER_STATUS_FALSE_TRIGGER" 5 "UNDERVOLTAGE_FALSE_TRIGGER" 4 "OVERVOLTAGE_FALSE_TRIGGER" 3 "DRIVER_STATUS_FAULT" 2 "UNDERVOLTAGE_FAULT" 1 "OVERVOLTAGE_FAULT" 0 "OK" ;
VAL_ 1332 VCFRONT_a474_turnStatus 6 "DRIVER_STATUS_FALSE_TRIGGER" 5 "UNDERVOLTAGE_FALSE_TRIGGER" 4 "OVERVOLTAGE_FALSE_TRIGGER" 3 "DRIVER_STATUS_FAULT" 2 "UNDERVOLTAGE_FAULT" 1 "OVERVOLTAGE_FAULT" 0 "OK" ;
VAL_ 1332 VCFRONT_a474_fanStatus 1 "FAULT" 0 "OK" ;
VAL_ 1332 VCFRONT_a474_TPS92520_COMPOV 1 "FAULT" 0 "OK" ;
VAL_ 1332 VCFRONT_a474_TPS92520_HSILIM 1 "FAULT" 0 "OK" ;
VAL_ 1332 VCFRONT_a474_TPS92520_BSTUV 1 "FAULT" 0 "OK" ;
VAL_ 1332 VCFRONT_a474_BoostRailStatus 1 "FAULT" 0 "OK" ;
VAL_ 1332 VCFRONT_a474_EEPROM_DataStatus 1 "FAULT" 0 "OK" ;
VAL_ 1332 VCFRONT_a474_LMMVariant 2 "LMM4" 1 "NOT_LMM4_OR_UNKNOWN" 0 "SNA" ;
VAL_ 1332 VCFRONT_a474_headlampECURevision 15 "RESERVED" 8 "GEN_5_REV_E" 7 "GEN_5_REV_D" 6 "GEN_5_REV_C" 5 "GEN_5_REV_A" 4 "GEN_3_REV_F" 3 "GEN_3_REV_E" 2 "GEN_3_REV_D" 1 "GEN_3_REV_C" 0 "UNKNOWN" ;
VAL_ 1332 VCFRONT_a475_ssl100Bank1Status 3 "UNRESPONSIVE" 2 "PIXEL_ERROR" 1 "CRC_ERROR" 0 "OK" ;
VAL_ 1332 VCFRONT_a475_ssl100Bank2Status 3 "UNRESPONSIVE" 2 "PIXEL_ERROR" 1 "CRC_ERROR" 0 "OK" ;
VAL_ 1332 VCFRONT_a475_ssl100Bank3Status 3 "UNRESPONSIVE" 2 "PIXEL_ERROR" 1 "CRC_ERROR" 0 "OK" ;
VAL_ 1332 VCFRONT_a475_ssl100Bank4Status 3 "UNRESPONSIVE" 2 "PIXEL_ERROR" 1 "CRC_ERROR" 0 "OK" ;
VAL_ 1332 VCFRONT_a475_ssl100Bank5Status 3 "UNRESPONSIVE" 2 "PIXEL_ERROR" 1 "CRC_ERROR" 0 "OK" ;
VAL_ 1332 VCFRONT_a475_ssl100Bank6Status 3 "UNRESPONSIVE" 2 "PIXEL_ERROR" 1 "CRC_ERROR" 0 "OK" ;
VAL_ 1332 VCFRONT_a475_ssl100Bank7Status 3 "UNRESPONSIVE" 2 "PIXEL_ERROR" 1 "CRC_ERROR" 0 "OK" ;
VAL_ 1332 VCFRONT_a475_ssl100Bank8Status 3 "UNRESPONSIVE" 2 "PIXEL_ERROR" 1 "CRC_ERROR" 0 "OK" ;
VAL_ 1332 VCFRONT_a475_ssl100Bank9Status 3 "UNRESPONSIVE" 2 "PIXEL_ERROR" 1 "CRC_ERROR" 0 "OK" ;
VAL_ 1332 VCFRONT_a475_lowBeamPrefieldStat 6 "DRIVER_STATUS_FALSE_TRIGGER" 5 "UNDERVOLTAGE_FALSE_TRIGGER" 4 "OVERVOLTAGE_FALSE_TRIGGER" 3 "DRIVER_STATUS_FAULT" 2 "UNDERVOLTAGE_FAULT" 1 "OVERVOLTAGE_FAULT" 0 "OK" ;
VAL_ 1332 VCFRONT_a475_drl1Status 6 "DRIVER_STATUS_FALSE_TRIGGER" 5 "UNDERVOLTAGE_FALSE_TRIGGER" 4 "OVERVOLTAGE_FALSE_TRIGGER" 3 "DRIVER_STATUS_FAULT" 2 "UNDERVOLTAGE_FAULT" 1 "OVERVOLTAGE_FAULT" 0 "OK" ;
VAL_ 1332 VCFRONT_a475_drl2Status 6 "DRIVER_STATUS_FALSE_TRIGGER" 5 "UNDERVOLTAGE_FALSE_TRIGGER" 4 "OVERVOLTAGE_FALSE_TRIGGER" 3 "DRIVER_STATUS_FAULT" 2 "UNDERVOLTAGE_FAULT" 1 "OVERVOLTAGE_FAULT" 0 "OK" ;
VAL_ 1332 VCFRONT_a475_drl3Status 6 "DRIVER_STATUS_FALSE_TRIGGER" 5 "UNDERVOLTAGE_FALSE_TRIGGER" 4 "OVERVOLTAGE_FALSE_TRIGGER" 3 "DRIVER_STATUS_FAULT" 2 "UNDERVOLTAGE_FAULT" 1 "OVERVOLTAGE_FAULT" 0 "OK" ;
VAL_ 1332 VCFRONT_a475_turnStatus 6 "DRIVER_STATUS_FALSE_TRIGGER" 5 "UNDERVOLTAGE_FALSE_TRIGGER" 4 "OVERVOLTAGE_FALSE_TRIGGER" 3 "DRIVER_STATUS_FAULT" 2 "UNDERVOLTAGE_FAULT" 1 "OVERVOLTAGE_FAULT" 0 "OK" ;
VAL_ 1332 VCFRONT_a475_fanStatus 1 "FAULT" 0 "OK" ;
VAL_ 1332 VCFRONT_a475_TPS92520_COMPOV 1 "FAULT" 0 "OK" ;
VAL_ 1332 VCFRONT_a475_TPS92520_HSILIM 1 "FAULT" 0 "OK" ;
VAL_ 1332 VCFRONT_a475_TPS92520_BSTUV 1 "FAULT" 0 "OK" ;
VAL_ 1332 VCFRONT_a475_BoostRailStatus 1 "FAULT" 0 "OK" ;
VAL_ 1332 VCFRONT_a475_EEPROM_DataStatus 1 "FAULT" 0 "OK" ;
VAL_ 1332 VCFRONT_a475_LMMVariant 2 "LMM4" 1 "NOT_LMM4_OR_UNKNOWN" 0 "SNA" ;
VAL_ 1332 VCFRONT_a475_headlampECURevision 15 "RESERVED" 8 "GEN_5_REV_E" 7 "GEN_5_REV_D" 6 "GEN_5_REV_C" 5 "GEN_5_REV_A" 4 "GEN_3_REV_F" 3 "GEN_3_REV_E" 2 "GEN_3_REV_D" 1 "GEN_3_REV_C" 0 "UNKNOWN" ;
VAL_ 1332 VCFRONT_a476_vehiclePowerState 3 "DRIVE" 2 "ACCESSORY" 1 "CONDITIONING" 0 "OFF" ;
VAL_ 1332 VCFRONT_a476_batterySMState 10 "EXTERNAL_LV_BUS_CONTROL" 9 "RECOVERY" 8 "FAULT" 7 "SHORTED_CELL_TEST" 6 "DISCONNECTED_BATTERY_TEST" 5 "OTA_STANDBY" 4 "RESISTANCE_ESTIMATION" 3 "STANDBY" 2 "DISCHARGE" 1 "CHARGE" 0 "INIT" ;
VAL_ 1332 VCFRONT_a476_ECPAState 3 "SNA" 2 "INVALID" 1 "CLOSED" 0 "OPEN" ;
VAL_ 1332 VCFRONT_a478_vehiclePowerState 3 "DRIVE" 2 "ACCESSORY" 1 "CONDITIONING" 0 "OFF" ;
VAL_ 1332 VCFRONT_a478_batterySMState 10 "EXTERNAL_LV_BUS_CONTROL" 9 "RECOVERY" 8 "FAULT" 7 "SHORTED_CELL_TEST" 6 "DISCONNECTED_BATTERY_TEST" 5 "OTA_STANDBY" 4 "RESISTANCE_ESTIMATION" 3 "STANDBY" 2 "DISCHARGE" 1 "CHARGE" 0 "INIT" ;
VAL_ 1332 VCFRONT_a478_bmsState 10 "DIAG" 9 "SNA" 8 "TEST" 7 "WELD" 6 "FAULT" 5 "CLEAR_FAULT" 4 "FEIM" 3 "CHARGE" 2 "SUPPORT" 1 "DRIVE" 0 "STANDBY" ;
VAL_ 1332 VCFRONT_a478_dcdcLVSupportStatus 2 "FAULTED" 1 "ACTIVE" 0 "IDLE" ;
VAL_ 1332 VCFRONT_a479_ECPAState 3 "SNA" 2 "INVALID" 1 "CLOSED" 0 "OPEN" ;
VAL_ 1332 VCFRONT_a479_frunkLatchStatus 8 "FAULT" 7 "DEFAULT" 6 "TIMEOUT" 5 "AJAR" 4 "OPENING" 3 "CLOSING" 2 "CLOSED" 1 "OPENED" 0 "SNA" ;
VAL_ 1332 VCFRONT_a479_vehiclePowerState 3 "DRIVE" 2 "ACCESSORY" 1 "CONDITIONING" 0 "OFF" ;
VAL_ 1332 VCFRONT_a479_batterySMState 10 "EXTERNAL_LV_BUS_CONTROL" 9 "RECOVERY" 8 "FAULT" 7 "SHORTED_CELL_TEST" 6 "DISCONNECTED_BATTERY_TEST" 5 "OTA_STANDBY" 4 "RESISTANCE_ESTIMATION" 3 "STANDBY" 2 "DISCHARGE" 1 "CHARGE" 0 "INIT" ;
VAL_ 1332 VCFRONT_a480_channel 7 "INVALID" 6 "IBOOSTER" 5 "HCU_ESP_ABS" 4 "EPAS_2" 3 "EPAS_1" 2 "RIGHT_CONTROLLER" 1 "LEFT_CONTROLLER" 0 "PCS" ;
VAL_ 1332 VCFRONT_a490_coolantPumpType 5 "DUAL_MIX" 4 "DUAL_SAN_P4_LUB" 2 "DUAL_SAN_P4" 1 "SINGLE_PUMP_BATT" 0 "DUAL" ;
VAL_ 1332 VCFRONT_a496_MOSState 3 "SNA" 2 "INVALID" 1 "CLOSED" 0 "OPEN" ;
VAL_ 1332 VCFRONT_a496_bmsState 10 "DIAG" 9 "SNA" 8 "TEST" 7 "WELD" 6 "FAULT" 5 "CLEAR_FAULT" 4 "FEIM" 3 "CHARGE" 2 "SUPPORT" 1 "DRIVE" 0 "STANDBY" ;
VAL_ 1332 VCFRONT_a500_mismatchedState 7 "SELF_TEST" 6 "SELF_TEST_PREP" 5 "LOCKED" 4 "UNLOCKED" 3 "CONFIGURATION" 2 "WAKEUP" 1 "STANDBY" 0 "UNKNOWN" ;
VAL_ 1332 VCFRONT_a511_hvState 6 "UP" 5 "UP_FOR_DC_CHARGE" 4 "UP_FOR_CHARGE" 3 "UP_FOR_DRIVE" 2 "GOING_DOWN" 1 "COMING_UP" 0 "DOWN" ;
VAL_ 1332 VCFRONT_a512_overcurrentDirectio 2 "DISCHARGE" 1 "CHARGE" 0 "INCONCLUSIVE" ;
VAL_ 1332 VCFRONT_a512_vehiclePowerState 3 "DRIVE" 2 "ACCESSORY" 1 "CONDITIONING" 0 "OFF" ;
VAL_ 1332 VCFRONT_a513_vehiclePowerState 3 "DRIVE" 2 "ACCESSORY" 1 "CONDITIONING" 0 "OFF" ;
VAL_ 1332 VCFRONT_a514_vehiclePowerState 3 "DRIVE" 2 "ACCESSORY" 1 "CONDITIONING" 0 "OFF" ;
VAL_ 1332 VCFRONT_a515_vehiclePowerState 3 "DRIVE" 2 "ACCESSORY" 1 "CONDITIONING" 0 "OFF" ;
VAL_ 1332 VCFRONT_a518_vehiclePowerState 3 "DRIVE" 2 "ACCESSORY" 1 "CONDITIONING" 0 "OFF" ;
VAL_ 1332 VCFRONT_a519_MatrixBank1Status 3 "UNRESPONSIVE" 2 "PIXEL_ERROR" 1 "CRC_ERROR" 0 "OK" ;
VAL_ 1332 VCFRONT_a519_MatrixBank2Status 3 "UNRESPONSIVE" 2 "PIXEL_ERROR" 1 "CRC_ERROR" 0 "OK" ;
VAL_ 1332 VCFRONT_a519_MatrixBank3Status 3 "UNRESPONSIVE" 2 "PIXEL_ERROR" 1 "CRC_ERROR" 0 "OK" ;
VAL_ 1332 VCFRONT_a519_MatrixBank4Status 3 "UNRESPONSIVE" 2 "PIXEL_ERROR" 1 "CRC_ERROR" 0 "OK" ;
VAL_ 1332 VCFRONT_a519_TurnSignalStatus 6 "DRIVER_STATUS_FALSE_TRIGGER" 5 "UNDERVOLTAGE_FALSE_TRIGGER" 4 "OVERVOLTAGE_FALSE_TRIGGER" 3 "DRIVER_STATUS_FAULT" 2 "UNDERVOLTAGE_FAULT" 1 "OVERVOLTAGE_FAULT" 0 "OK" ;
VAL_ 1332 VCFRONT_a519_SideMarkerStatus 2 "OVERCURRENT_FAULT" 1 "UNDERCURRENT_FAULT" 0 "OK" ;
VAL_ 1332 VCFRONT_a519_DRLStatus 6 "DRIVER_STATUS_FALSE_TRIGGER" 5 "UNDERVOLTAGE_FALSE_TRIGGER" 4 "OVERVOLTAGE_FALSE_TRIGGER" 3 "DRIVER_STATUS_FAULT" 2 "UNDERVOLTAGE_FAULT" 1 "OVERVOLTAGE_FAULT" 0 "OK" ;
VAL_ 1332 VCFRONT_a519_AmbientStatus 6 "DRIVER_STATUS_FALSE_TRIGGER" 5 "UNDERVOLTAGE_FALSE_TRIGGER" 4 "OVERVOLTAGE_FALSE_TRIGGER" 3 "DRIVER_STATUS_FAULT" 2 "UNDERVOLTAGE_FAULT" 1 "OVERVOLTAGE_FAULT" 0 "OK" ;
VAL_ 1332 VCFRONT_a519_LBFlatSAEStatus 6 "DRIVER_STATUS_FALSE_TRIGGER" 5 "UNDERVOLTAGE_FALSE_TRIGGER" 4 "OVERVOLTAGE_FALSE_TRIGGER" 3 "DRIVER_STATUS_FAULT" 2 "UNDERVOLTAGE_FAULT" 1 "OVERVOLTAGE_FAULT" 0 "OK" ;
VAL_ 1332 VCFRONT_a519_LBFlatECEStatus 6 "DRIVER_STATUS_FALSE_TRIGGER" 5 "UNDERVOLTAGE_FALSE_TRIGGER" 4 "OVERVOLTAGE_FALSE_TRIGGER" 3 "DRIVER_STATUS_FAULT" 2 "UNDERVOLTAGE_FAULT" 1 "OVERVOLTAGE_FAULT" 0 "OK" ;
VAL_ 1332 VCFRONT_a519_TPS92520_COMPOV 1 "FAULT" 0 "OK" ;
VAL_ 1332 VCFRONT_a519_TPS92520_HSILIM 1 "FAULT" 0 "OK" ;
VAL_ 1332 VCFRONT_a519_TPS92520_BSTUV 1 "FAULT" 0 "OK" ;
VAL_ 1332 VCFRONT_a519_CoolingFanStatus 1 "FAULT" 0 "OK" ;
VAL_ 1332 VCFRONT_a519_BoostRailStatus 1 "FAULT" 0 "OK" ;
VAL_ 1332 VCFRONT_a519_EEPROMCurrentBinSta 1 "FAULT" 0 "OK" ;
VAL_ 1332 VCFRONT_a519_EEPROMCalCurrentSta 1 "FAULT" 0 "OK" ;
VAL_ 1332 VCFRONT_a519_HeadlampECURevision 15 "RESERVED" 8 "GEN_5_REV_E" 7 "GEN_5_REV_D" 6 "GEN_5_REV_C" 5 "GEN_5_REV_A" 4 "GEN_3_REV_F" 3 "GEN_3_REV_E" 2 "GEN_3_REV_D" 1 "GEN_3_REV_C" 0 "UNKNOWN" ;
VAL_ 1332 VCFRONT_a519_NonzeroEEPROMRetrie 1 "FAULT" 0 "OK" ;
VAL_ 1332 VCFRONT_a519_MaxEEPROMRetries 1 "FAULT" 0 "OK" ;
VAL_ 1332 VCFRONT_a520_MatrixBank1Status 3 "UNRESPONSIVE" 2 "PIXEL_ERROR" 1 "CRC_ERROR" 0 "OK" ;
VAL_ 1332 VCFRONT_a520_MatrixBank2Status 3 "UNRESPONSIVE" 2 "PIXEL_ERROR" 1 "CRC_ERROR" 0 "OK" ;
VAL_ 1332 VCFRONT_a520_MatrixBank3Status 3 "UNRESPONSIVE" 2 "PIXEL_ERROR" 1 "CRC_ERROR" 0 "OK" ;
VAL_ 1332 VCFRONT_a520_MatrixBank4Status 3 "UNRESPONSIVE" 2 "PIXEL_ERROR" 1 "CRC_ERROR" 0 "OK" ;
VAL_ 1332 VCFRONT_a520_TurnSignalStatus 6 "DRIVER_STATUS_FALSE_TRIGGER" 5 "UNDERVOLTAGE_FALSE_TRIGGER" 4 "OVERVOLTAGE_FALSE_TRIGGER" 3 "DRIVER_STATUS_FAULT" 2 "UNDERVOLTAGE_FAULT" 1 "OVERVOLTAGE_FAULT" 0 "OK" ;
VAL_ 1332 VCFRONT_a520_SideMarkerStatus 2 "OVERCURRENT_FAULT" 1 "UNDERCURRENT_FAULT" 0 "OK" ;
VAL_ 1332 VCFRONT_a520_DRLStatus 6 "DRIVER_STATUS_FALSE_TRIGGER" 5 "UNDERVOLTAGE_FALSE_TRIGGER" 4 "OVERVOLTAGE_FALSE_TRIGGER" 3 "DRIVER_STATUS_FAULT" 2 "UNDERVOLTAGE_FAULT" 1 "OVERVOLTAGE_FAULT" 0 "OK" ;
VAL_ 1332 VCFRONT_a520_AmbientStatus 6 "DRIVER_STATUS_FALSE_TRIGGER" 5 "UNDERVOLTAGE_FALSE_TRIGGER" 4 "OVERVOLTAGE_FALSE_TRIGGER" 3 "DRIVER_STATUS_FAULT" 2 "UNDERVOLTAGE_FAULT" 1 "OVERVOLTAGE_FAULT" 0 "OK" ;
VAL_ 1332 VCFRONT_a520_LBFlatSAEStatus 6 "DRIVER_STATUS_FALSE_TRIGGER" 5 "UNDERVOLTAGE_FALSE_TRIGGER" 4 "OVERVOLTAGE_FALSE_TRIGGER" 3 "DRIVER_STATUS_FAULT" 2 "UNDERVOLTAGE_FAULT" 1 "OVERVOLTAGE_FAULT" 0 "OK" ;
VAL_ 1332 VCFRONT_a520_LBFlatECEStatus 6 "DRIVER_STATUS_FALSE_TRIGGER" 5 "UNDERVOLTAGE_FALSE_TRIGGER" 4 "OVERVOLTAGE_FALSE_TRIGGER" 3 "DRIVER_STATUS_FAULT" 2 "UNDERVOLTAGE_FAULT" 1 "OVERVOLTAGE_FAULT" 0 "OK" ;
VAL_ 1332 VCFRONT_a520_TPS92520_COMPOV 1 "FAULT" 0 "OK" ;
VAL_ 1332 VCFRONT_a520_TPS92520_HSILIM 1 "FAULT" 0 "OK" ;
VAL_ 1332 VCFRONT_a520_TPS92520_BSTUV 1 "FAULT" 0 "OK" ;
VAL_ 1332 VCFRONT_a520_CoolingFanStatus 1 "FAULT" 0 "OK" ;
VAL_ 1332 VCFRONT_a520_BoostRailStatus 1 "FAULT" 0 "OK" ;
VAL_ 1332 VCFRONT_a520_EEPROMCurrentBinSta 1 "FAULT" 0 "OK" ;
VAL_ 1332 VCFRONT_a520_EEPROMCalCurrentSta 1 "FAULT" 0 "OK" ;
VAL_ 1332 VCFRONT_a520_HeadlampECURevision 15 "RESERVED" 8 "GEN_5_REV_E" 7 "GEN_5_REV_D" 6 "GEN_5_REV_C" 5 "GEN_5_REV_A" 4 "GEN_3_REV_F" 3 "GEN_3_REV_E" 2 "GEN_3_REV_D" 1 "GEN_3_REV_C" 0 "UNKNOWN" ;
VAL_ 1332 VCFRONT_a520_NonzeroEEPROMRetrie 1 "FAULT" 0 "OK" ;
VAL_ 1332 VCFRONT_a520_MaxEEPROMRetries 1 "FAULT" 0 "OK" ;
VAL_ 1332 VCFRONT_a525_GTW_twelveVBatteryT 3 "TESLA_16V_LI_ION" 2 "CATL_LI_ION" 1 "CLARIOS_B24_FLOODED" 0 "ATLASBX_B24_FLOODED" ;
VAL_ 1332 VCFRONT_a525_newLVBatteryType 5 "TESLA_48V_LI_ION" 4 "TESLA_16V_LI_ION" 3 "CATL_LI_ION" 2 "CLARIOS_B24_FLOODED" 1 "ATLASBX_B24_FLOODED" 0 "UNKNOWN" ;
VAL_ 1332 VCFRONT_a525_initialLVBatteryTyp 5 "TESLA_48V_LI_ION" 4 "TESLA_16V_LI_ION" 3 "CATL_LI_ION" 2 "CLARIOS_B24_FLOODED" 1 "ATLASBX_B24_FLOODED" 0 "UNKNOWN" ;
VAL_ 1332 VCFRONT_a545_GTW_twelveVBatteryT 3 "TESLA_16V_LI_ION" 2 "CATL_LI_ION" 1 "CLARIOS_B24_FLOODED" 0 "ATLASBX_B24_FLOODED" ;
VAL_ 1332 VCFRONT_a545_newLVBatteryType 5 "TESLA_48V_LI_ION" 4 "TESLA_16V_LI_ION" 3 "CATL_LI_ION" 2 "CLARIOS_B24_FLOODED" 1 "ATLASBX_B24_FLOODED" 0 "UNKNOWN" ;
VAL_ 1332 VCFRONT_a548_vehiclePowerState 3 "DRIVE" 2 "ACCESSORY" 1 "CONDITIONING" 0 "OFF" ;
VAL_ 1332 VCFRONT_a548_DI_gear 7 "SNA" 4 "D" 3 "N" 2 "R" 1 "P" 0 "INVALID" ;
