VERSION "dbc-export 1 2026.26.6.5"

NS_ :

BS_:

BU_: ADSP APB APP APS APSB BB BMS CC CMP CMPD CP DAS DI DIF DIR DPB EPAS3P EPAS3S EPASTP EPASTS EPBL EPBR ESP EVSE FC GTW HCML HCMR HVP IBST ICR IDB LS OCS1P ODIN PARK PCS PCS2 PLG PM PMF PMR PNCD PTC RADC RCM RCM2 RCM3 RCU SCCM SCM SCS SDCR TAS TCU TCU2 TPMS TRCM UDS UI UIS UMC USM V2G VC VCBATT VCBATT0 VCBATT1 VCBATT2 VCCC VCFRONT VCFRONT1 VCFRONT2 VCLEFT VCRIGHT VCSEAT2L VCSEAT2R VCSEC VEH

BO_ 1949 V2G_evseLogData: 8 V2G
 SG_ V2G_evseLogDataSelect M : 0|5@1+ (1,0) [0|31] "" Vector__XXX
 SG_ V2G_chgParamRes_respCode m7 : 8|5@1+ (1,0) [0|31] "" Vector__XXX
 SG_ V2G_chgParamRes_finished m7 : 13|1@1+ (1,0) [0|1] "" Vector__XXX
 SG_ V2G_chgParamRes_evseStatus m7 : 14|4@1+ (1,0) [0|15] "" Vector__XXX
 SG_ V2G_chgParamRes_evseMaxILim m7 : 18|8@1+ (7.032,0) [0|1793.16] "A" Vector__XXX
 SG_ V2G_chgParamRes_evseMaxVLim m7 : 26|8@1+ (4.688,0) [0|1195.44] "V" Vector__XXX
 SG_ V2G_chgParamRes_evseMinILim m7 : 34|8@1+ (7.032,0) [0|1793.16] "A" Vector__XXX
 SG_ V2G_chgParamRes_evseMinVLim m7 : 42|8@1+ (4.688,0) [0|1195.44] "V" Vector__XXX
 SG_ V2G_chgParamRes_evseMaxPowerLim m7 : 50|8@1+ (5.9766,0) [0|1524.033] "kW" Vector__XXX
 SG_ V2G_chgParamRes_evseMaxPower_val m7 : 58|1@1+ (1,0) [0|1] "" Vector__XXX
 SG_ V2G_chgParamRes_isoState m7 : 59|3@1+ (1,0) [0|7] "" Vector__XXX
 SG_ V2G_chgParamRes_isoState_val m7 : 62|1@1+ (1,0) [0|1] "" Vector__XXX

BO_ 1338 VCBATT0_alertLog: 8 VCBATT0
 SG_ VCBATT0_alertID M : 0|9@1+ (1,0) [0|511] "" Vector__XXX
 SG_ VCBATT0_alertState : 15|1@1+ (1,0) [0|1] "" Vector__XXX
 SG_ VCBATT0_a001_InternalWatchdog m1 : 16|1@1+ (1,0) [0|1] "" Vector__XXX
 SG_ VCBATT0_a015_NVMMMemOverflow m15 : 16|1@1+ (1,0) [0|1] "" Vector__XXX
 SG_ VCBATT0_a015_NVMMFilesystemError m15 : 17|1@1+ (1,0) [0|1] "" Vector__XXX
 SG_ VCBATT0_a015_NVMMRecordIDError m15 : 18|1@1+ (1,0) [0|1] "" Vector__XXX
 SG_ VCBATT0_a059_voltageDrop m59 : 16|12@1+ (0.005443676,0) [0|22.29185322] "V" Vector__XXX
 SG_ VCBATT0_a059_resistanceEstimate m59 : 28|12@1+ (0.00244,0) [0|9.9918] "Ohms" Vector__XXX
 SG_ VCBATT0_a059_current m59 : 40|12@1+ (0.05,0) [0|204.75] "A" Vector__XXX
 SG_ VCBATT0_a063_switchChannel m63 : 16|8@1+ (1,0) [0|255] "" Vector__XXX
 SG_ VCBATT0_a063_switchType m63 : 24|8@1+ (1,0) [0|255] "" Vector__XXX
 SG_ VCBATT0_a063_ADCVoltage m63 : 32|8@1+ (0.025,0) [0|6.375] "V" Vector__XXX
 SG_ VCBATT0_a063_disconnected m63 : 40|1@1+ (1,0) [0|1] "" Vector__XXX
 SG_ VCBATT0_a063_indeterminate m63 : 41|1@1+ (1,0) [0|1] "" Vector__XXX
 SG_ VCBATT0_a063_stuckActive m63 : 42|1@1+ (1,0) [0|1] "" Vector__XXX
 SG_ VCBATT0_a063_faulted m63 : 43|1@1+ (1,0) [0|1] "" Vector__XXX

BO_ 973 VCBATT0_alertMatrix: 8 VCBATT0
 SG_ VCBATT0_matrixIndex M : 0|4@1+ (1,0) [0|15] "" Vector__XXX
 SG_ VCBATT0_a001_WatchdogReset m0 : 4|1@1+ (1,0) [0|1] "" Vector__XXX
 SG_ VCBATT0_a002_PowerLossReset m0 : 5|1@1+ (1,0) [0|1] "" Vector__XXX
 SG_ VCBATT0_a003_SWAssertion m0 : 6|1@1+ (1,0) [0|1] "" Vector__XXX
 SG_ VCBATT0_a005_CANTXError m0 : 8|1@1+ (1,0) [0|1] "" Vector__XXX
 SG_ VCBATT0_a006_CANTX_cyclicError m0 : 9|1@1+ (1,0) [0|1] "" Vector__XXX
 SG_ VCBATT0_a012_CPUReset m0 : 15|1@1+ (1,0) [0|1] "" Vector__XXX
 SG_ VCBATT0_a013_AlertManagerFault m0 : 16|1@1+ (1,0) [0|1] "" Vector__XXX
 SG_ VCBATT0_a015_NVMMError m0 : 18|1@1+ (1,0) [0|1] "" Vector__XXX
 SG_ VCBATT0_a016_NVMMRecordError m0 : 19|1@1+ (1,0) [0|1] "" Vector__XXX
 SG_ VCBATT0_a021_TaskSchedulerError m0 : 24|1@1+ (1,0) [0|1] "" Vector__XXX
 SG_ VCBATT0_a022_TaskInitError m0 : 25|1@1+ (1,0) [0|1] "" Vector__XXX
 SG_ VCBATT0_a029_CoreDump m0 : 32|1@1+ (1,0) [0|1] "" Vector__XXX
 SG_ VCBATT0_a030_ECULogUploadRequest m0 : 33|1@1+ (1,0) [0|1] "" Vector__XXX
 SG_ VCBATT0_a031_UDSActive m0 : 34|1@1+ (1,0) [0|1] "" Vector__XXX
 SG_ VCBATT0_a032_ipcWatchdogExpired m0 : 35|1@1+ (1,0) [0|1] "" Vector__XXX
 SG_ VCBATT0_a033_eccNonCorrectableEr m0 : 36|1@1+ (1,0) [0|1] "" Vector__XXX
 SG_ VCBATT0_a038_ProtFaultInfo m0 : 41|1@1+ (1,0) [0|1] "" Vector__XXX
 SG_ VCBATT0_a039_ProtFaultAddress m0 : 42|1@1+ (1,0) [0|1] "" Vector__XXX
 SG_ VCBATT0_a040_Backtrace m0 : 43|1@1+ (1,0) [0|1] "" Vector__XXX
 SG_ VCBATT0_a041_HighCPULoad m0 : 44|1@1+ (1,0) [0|1] "" Vector__XXX
 SG_ VCBATT0_a042_HighStackUsage m0 : 45|1@1+ (1,0) [0|1] "" Vector__XXX
 SG_ VCBATT0_a043_Task1msError m0 : 46|1@1+ (1,0) [0|1] "" Vector__XXX
 SG_ VCBATT0_a044_Task10msError m0 : 47|1@1+ (1,0) [0|1] "" Vector__XXX
 SG_ VCBATT0_a045_Task100msError m0 : 48|1@1+ (1,0) [0|1] "" Vector__XXX
 SG_ VCBATT0_a046_Task1000msError m0 : 49|1@1+ (1,0) [0|1] "" Vector__XXX
 SG_ VCBATT0_a047_resetReason m0 : 50|1@1+ (1,0) [0|1] "" Vector__XXX
 SG_ VCBATT0_a058_inputRHighSyncDebug m0 : 61|1@1+ (1,0) [0|1] "" Vector__XXX
 SG_ VCBATT0_a059_inputResistanceHigh m0 : 62|1@1+ (1,0) [0|1] "" Vector__XXX
 SG_ VCBATT0_a060_engineeringBuild m0 : 63|1@1+ (1,0) [0|1] "" Vector__XXX
 SG_ VCBATT0_a061_XCPConnected m1 : 4|1@1+ (1,0) [0|1] "" Vector__XXX
 SG_ VCBATT0_a062_XCPWasConnected m1 : 5|1@1+ (1,0) [0|1] "" Vector__XXX
 SG_ VCBATT0_a063_SwitchFault m1 : 6|1@1+ (1,0) [0|1] "" Vector__XXX
 SG_ VCBATT0_a064_busSleepReqTimeout m1 : 7|1@1+ (1,0) [0|1] "" Vector__XXX
 SG_ VCBATT0_a423_rtosSleepFailed m7 : 6|1@1+ (1,0) [0|1] "" Vector__XXX

BO_ 1618 VCBATT0_info: 8 VCBATT0
 SG_ VCBATT0_infoIndex M : 0|8@1+ (1,0) [0|255] "" Vector__XXX
 SG_ VCBATT0_infoBuildType m10 : 8|3@1+ (1,0) [0|7] "" Vector__XXX
 SG_ VCBATT0_infoBuildConfigId m10 : 16|16@1+ (1,0) [0|65535] "" Vector__XXX
 SG_ VCBATT0_infoHardwareId m10 : 32|16@1+ (1,0) [0|65535] "" Vector__XXX
 SG_ VCBATT0_infoComponentId m10 : 48|16@1+ (1,0) [0|65535] "" Vector__XXX
 SG_ VCBATT0_infoPcbaId m11 : 8|8@1+ (1,0) [0|255] "" Vector__XXX
 SG_ VCBATT0_infoAssemblyId m11 : 16|8@1+ (1,0) [0|254] "" Vector__XXX
 SG_ VCBATT0_infoUsageId m11 : 24|16@1+ (1,0) [0|65535] "" Vector__XXX
 SG_ VCBATT0_infoSubUsageId m11 : 40|16@1+ (1,0) [0|65535] "" Vector__XXX
 SG_ VCBATT0_infoAppCrc m13 : 8|32@1+ (1,0) [0|4294967295] "" Vector__XXX
 SG_ VCBATT0_infoAppGitHash m17 : 8|56@1+ (1,0) [0|7.20575940379e+16] "" Vector__XXX
 SG_ VCBATT0_infoBootGitHash m18 : 8|56@1+ (1,0) [0|7.20575940379e+16] "" Vector__XXX
 SG_ VCBATT0_infoBootUdsProtoVersion m20 : 8|16@1+ (1,0) [0|65535] "" Vector__XXX
 SG_ VCBATT0_infoBootCrc m20 : 24|32@1+ (1,0) [0|4294967295] "" Vector__XXX

BO_ 1858 VCBATT1_LVBMS_statusHigh: 8 VCBATT1
 SG_ VCBATT1_lvbmsStatusHighIndex M : 0|3@1+ (1,0) [0|7] "" Vector__XXX
 SG_ VCBATT1_LVBMS_packCurrent m0 : 3|22@1+ (0.001,-2000) [-2000|2194.302] "A" Vector__XXX
 SG_ VCBATT1_LVBMS_packVoltage m0 : 25|16@1+ (0.001,0) [0|65.534] "V" Vector__XXX
 SG_ VCBATT1_LVBMS_packTemperature m0 : 41|9@1+ (0.5,-50) [-50|205] "degC" Vector__XXX
 SG_ VCBATT1_LVBMS_MOSTemperature m0 : 50|12@1+ (0.5,-50) [-50|1997] "degC" Vector__XXX
 SG_ VCBATT1_LVBMS_sumCellVoltage m1 : 8|16@1+ (0.001,0) [0|65.534] "V" Vector__XXX
 SG_ VCBATT1_LVBMS_maxBrickVoltage m1 : 24|13@1+ (0.001,0) [0|8.19] "V" Vector__XXX
 SG_ VCBATT1_LVBMS_maxBrickVoltageInd m1 : 40|8@1+ (1,0) [0|254] "" Vector__XXX
 SG_ VCBATT1_totalLVLoadCurrent m2 : 8|14@1- (0.1,0) [-200|400] "A" Vector__XXX
 SG_ VCBATT1_LVPackChargeCurrentLimit m2 : 22|12@1+ (0.1,0) [0|400] "A" Vector__XXX
 SG_ VCBATT1_LVPackCurrent m2 : 34|14@1- (0.1,0) [-200|400] "A" Vector__XXX
 SG_ VCBATT1_LVBMS_estimatedPackOcv m2 : 48|16@1+ (0.001,0) [0|65.535] "V" Vector__XXX
 SG_ VCBATT1_LVBMS_voltageTarget m3 : 3|16@1+ (0.001,0) [0|65.534] "V" Vector__XXX
 SG_ VCBATT1_LVBMS_currentTarget m3 : 19|18@1+ (0.001,-122) [-120|120] "A" Vector__XXX
 SG_ VCBATT1_LVBMS_maxAllowedChargeCu m3 : 37|13@1+ (0.1,0) [0|819] "A" Vector__XXX
 SG_ VCBATT1_LVBMS_maxAllowedDischarg m3 : 50|13@1+ (0.1,0) [0|819] "A" Vector__XXX
 SG_ VCBATT1_LVBMS_MOSCommand m4 : 3|1@1+ (1,0) [0|1] "" Vector__XXX
 SG_ VCBATT1_LVBMS_ClearErrorCntrComm m4 : 4|1@1+ (1,0) [0|1] "" Vector__XXX
 SG_ VCBATT1_LVBMS_ClearHistoricFault m4 : 5|1@1+ (1,0) [0|1] "" Vector__XXX
 SG_ VCBATT1_LVBMS_ResetLVBMSCommand m4 : 6|1@1+ (1,0) [0|1] "" Vector__XXX
 SG_ VCBATT1_LVBMS_EnterHibernationCo m4 : 7|1@1+ (1,0) [0|1] "" Vector__XXX
 SG_ VCBATT1_LVBMS_ECPAState m4 : 8|2@1+ (1,0) [0|2] "" Vector__XXX
 SG_ VCBATT1_LVBMS_MOSState m4 : 10|2@1+ (1,0) [0|2] "" Vector__XXX
 SG_ VCBATT1_LVBMS_VehicleState m4 : 12|2@1+ (1,0) [0|3] "" Vector__XXX
 SG_ VCBATT1_LVBMS_LINWakeDisabled m4 : 14|1@1+ (1,0) [0|1] "" Vector__XXX
 SG_ VCBATT1_LVBMS_chargeType m4 : 16|3@1+ (1,0) [0|7] "" Vector__XXX
 SG_ VCBATT1_LVBMS_cellAndArcProtEnab m4 : 19|1@1+ (1,0) [0|1] "" Vector__XXX
 SG_ VCBATT1_LVBMS_avgBrickVoltage m4 : 24|13@1+ (0.001,0) [0|8.19] "V" Vector__XXX
 SG_ VCBATT1_LVBMS_minBrickVoltage m4 : 40|13@1+ (0.001,0) [0|8.19] "V" Vector__XXX
 SG_ VCBATT1_LVBMS_minBrickVoltageInd m4 : 56|8@1+ (1,0) [0|254] "" Vector__XXX

BO_ 1119 VCBATT1_LVSelfTests: 8 VCBATT1
 SG_ VCBATT1_LVSelfTestsChecksum : 0|8@1+ (1,0) [0|255] "" Vector__XXX
 SG_ VCBATT1_LVSelfTestsCounter : 8|4@1+ (1,0) [0|15] "" Vector__XXX
 SG_ VCBATT1_LVSelfTestsIndex M : 12|1@1+ (1,0) [0|1] "" Vector__XXX
 SG_ VCBATT1_lvProtectionSelfTestsEna m1 : 13|1@1+ (1,0) [0|1] "" Vector__XXX
 SG_ VCBATT1_startBattDomainOvercurre m1 : 14|1@1+ (1,0) [0|1] "" Vector__XXX
 SG_ VCBATT1_startBattDomainOvervolta m1 : 15|1@1+ (1,0) [0|1] "" Vector__XXX
 SG_ VCBATT1_startBattDomainUndervolt m1 : 16|1@1+ (1,0) [0|1] "" Vector__XXX
 SG_ VCBATT1_startDualPowerLoadsSelfT m1 : 17|1@1+ (1,0) [0|1] "" Vector__XXX
 SG_ VCBATT1_startVCBattBridgeEFuseAS m1 : 18|1@1+ (1,0) [0|1] "" Vector__XXX
 SG_ VCBATT1_startPCSOVShutdownSelfTe m1 : 19|1@1+ (1,0) [0|1] "" Vector__XXX
 SG_ VCBATT1_startPCSDomainOvervoltag m1 : 20|1@1+ (1,0) [0|1] "" Vector__XXX
 SG_ VCBATT1_startBattDomainUnde_0001 m1 : 21|1@1+ (1,0) [0|1] "" Vector__XXX
 SG_ VCBATT1_startPCSDomainUndervolta m1 : 22|1@1+ (1,0) [0|1] "" Vector__XXX
 SG_ VCBATT1_startVCFrontBridgeEFuseA m1 : 23|1@1+ (1,0) [0|1] "" Vector__XXX
 SG_ VCBATT1_battDomainOvercurrentSel m1 : 24|2@1+ (1,0) [0|3] "" Vector__XXX
 SG_ VCBATT1_battDomainOvercurre_0001 m1 : 26|3@1+ (1,0) [0|7] "" Vector__XXX
 SG_ VCBATT1_battDomainOvervoltageSel m1 : 29|2@1+ (1,0) [0|3] "" Vector__XXX
 SG_ VCBATT1_battDomainOvervolta_0001 m1 : 32|3@1+ (1,0) [0|7] "" Vector__XXX
 SG_ VCBATT1_battDomainUndervoltageSe m1 : 35|2@1+ (1,0) [0|3] "" Vector__XXX
 SG_ VCBATT1_battDomainUndervolt_0001 m1 : 37|3@1+ (1,0) [0|7] "" Vector__XXX
 SG_ VCBATT1_dualPowerLoadsSelfTestRe m1 : 40|2@1+ (1,0) [0|3] "" Vector__XXX
 SG_ VCBATT1_dualPowerLoadsSelfTestSt m1 : 42|3@1+ (1,0) [0|7] "" Vector__XXX
 SG_ VCBATT1_vcbattBridgeEFuseASICSel m1 : 45|2@1+ (1,0) [0|3] "" Vector__XXX
 SG_ VCBATT1_vcbattBridgeEFuseAS_0001 m1 : 48|3@1+ (1,0) [0|7] "" Vector__XXX
 SG_ VCBATT1_uvProtectionState m1 : 51|4@1+ (1,0) [0|15] "" Vector__XXX
 SG_ VCBATT1_undervoltageSelfTestFaul m1 : 55|1@1+ (1,0) [0|1] "" Vector__XXX
 SG_ VC_selfTestsRunningMode m1 : 56|3@1+ (1,0) [0|7] "" Vector__XXX

BO_TX_BU_ 1949 : V2G;
BO_TX_BU_ 1338 : VCBATT0;
BO_TX_BU_ 973 : VCBATT0;
BO_TX_BU_ 1618 : VCBATT0;
BO_TX_BU_ 1858 : VCBATT1;
BO_TX_BU_ 1119 : VCBATT1;
CM_ BO_ 1949 "V2G ECU message: evse log data";
CM_ SG_ 1949 V2G_evseLogDataSelect "V2G ECU: evse log data select";
CM_ SG_ 1949 V2G_chgParamRes_respCode "Charge parameter response code reported by CCS DC charger";
CM_ SG_ 1949 V2G_chgParamRes_finished "V2G ECU: chg param res finished";
CM_ SG_ 1949 V2G_chgParamRes_evseStatus "Charge parameter discovery status reported by CCS DC charger";
CM_ SG_ 1949 V2G_chgParamRes_evseMaxILim "Maximum current limit reported by CCS DC charger in charge parameter discovery message";
CM_ SG_ 1949 V2G_chgParamRes_evseMaxVLim "Maximum voltage limit reported by CCS DC charger in charge parameter discovery message";
CM_ SG_ 1949 V2G_chgParamRes_evseMinILim "Minimum current limit reported by CCS DC charger in charge parameter discovery message";
CM_ SG_ 1949 V2G_chgParamRes_evseMinVLim "Minimum voltage limit reported by CCS DC charger in charge parameter discovery message";
CM_ SG_ 1949 V2G_chgParamRes_evseMaxPowerLim "Maximum power limit reported by CCS DC charger in charge parameter discovery message";
CM_ SG_ 1949 V2G_chgParamRes_evseMaxPower_val "Whether maximum power limit reported by CCS DC charger is valid in charge parameter discovery message";
CM_ SG_ 1949 V2G_chgParamRes_isoState "The EVSE's reported isolation status";
CM_ SG_ 1949 V2G_chgParamRes_isoState_val "The validity of the EVSE's reported isolation status";
CM_ BO_ 1338 "VCBATT0 ECU message: alert log";
CM_ SG_ 1338 VCBATT0_alertID "VCBATT0 ECU: alert ID";
CM_ SG_ 1338 VCBATT0_alertState "VCBATT0 ECU: alert state";
CM_ SG_ 1338 VCBATT0_a001_InternalWatchdog "VCBATT0 ECU: a001 internal watchdog";
CM_ SG_ 1338 VCBATT0_a015_NVMMMemOverflow "VCBATT0 ECU: a015 NVMM mem overflow";
CM_ SG_ 1338 VCBATT0_a015_NVMMFilesystemError "VCBATT0 ECU: a015 NVMM filesystem error";
CM_ SG_ 1338 VCBATT0_a015_NVMMRecordIDError "VCBATT0 ECU: a015 NVMM record ID error";
CM_ SG_ 1338 VCBATT0_a059_voltageDrop "VCBATT0 ECU: a059 voltage drop";
CM_ SG_ 1338 VCBATT0_a059_resistanceEstimate "VCBATT0 ECU: a059 resistance estimate";
CM_ SG_ 1338 VCBATT0_a059_current "VCBATT0 ECU: a059 current";
CM_ SG_ 1338 VCBATT0_a063_switchChannel "VCBATT0 ECU: a063 switch channel";
CM_ SG_ 1338 VCBATT0_a063_switchType "VCBATT0 ECU: a063 switch type";
CM_ SG_ 1338 VCBATT0_a063_ADCVoltage "VCBATT0 ECU: a063 ADC voltage";
CM_ SG_ 1338 VCBATT0_a063_disconnected "VCBATT0 ECU: a063 disconnected";
CM_ SG_ 1338 VCBATT0_a063_indeterminate "VCBATT0 ECU: a063 indeterminate";
CM_ SG_ 1338 VCBATT0_a063_stuckActive "VCBATT0 ECU: a063 stuck active";
CM_ SG_ 1338 VCBATT0_a063_faulted "VCBATT0 ECU: a063 faulted";
CM_ BO_ 973 "VCBATT0 ECU message: alert matrix";
CM_ SG_ 973 VCBATT0_matrixIndex "VCBATT0 ECU: matrix index";
CM_ SG_ 973 VCBATT0_a001_WatchdogReset "VCBATT0 ECU: a001 watchdog reset";
CM_ SG_ 973 VCBATT0_a002_PowerLossReset "VCBATT0 ECU: a002 power loss reset";
CM_ SG_ 973 VCBATT0_a003_SWAssertion "VCBATT0 ECU: a003 SW assertion";
CM_ SG_ 973 VCBATT0_a005_CANTXError "VCBATT0 ECU: a005 CANTX error";
CM_ SG_ 973 VCBATT0_a006_CANTX_cyclicError "VCBATT0 ECU: a006 CANTX cyclic error";
CM_ SG_ 973 VCBATT0_a012_CPUReset "VCBATT0 ECU: a012 CPU reset";
CM_ SG_ 973 VCBATT0_a013_AlertManagerFault "VCBATT0 ECU: a013 alert manager fault";
CM_ SG_ 973 VCBATT0_a015_NVMMError "VCBATT0 ECU: a015 NVMM error";
CM_ SG_ 973 VCBATT0_a016_NVMMRecordError "VCBATT0 ECU: a016 NVMM record error";
CM_ SG_ 973 VCBATT0_a021_TaskSchedulerError "VCBATT0 ECU: a021 task scheduler error";
CM_ SG_ 973 VCBATT0_a022_TaskInitError "VCBATT0 ECU: a022 task init error";
CM_ SG_ 973 VCBATT0_a029_CoreDump "VCBATT0 ECU: a029 core dump";
CM_ SG_ 973 VCBATT0_a030_ECULogUploadRequest "VCBATT0 ECU: a030 ECU log upload request";
CM_ SG_ 973 VCBATT0_a031_UDSActive "VCBATT0 ECU: a031 UDS active";
CM_ SG_ 973 VCBATT0_a032_ipcWatchdogExpired "VCBATT0 ECU: a032 ipc watchdog expired";
CM_ SG_ 973 VCBATT0_a033_eccNonCorrectableEr "VCBATT0 ECU: a033 ecc non correctable error";
CM_ SG_ 973 VCBATT0_a038_ProtFaultInfo "VCBATT0 ECU: a038 prot fault info";
CM_ SG_ 973 VCBATT0_a039_ProtFaultAddress "VCBATT0 ECU: a039 prot fault address";
CM_ SG_ 973 VCBATT0_a040_Backtrace "VCBATT0 ECU: a040 backtrace";
CM_ SG_ 973 VCBATT0_a041_HighCPULoad "VCBATT0 ECU: a041 high CPU load";
CM_ SG_ 973 VCBATT0_a042_HighStackUsage "VCBATT0 ECU: a042 high stack usage";
CM_ SG_ 973 VCBATT0_a043_Task1msError "VCBATT0 ECU: a043 task1ms error";
CM_ SG_ 973 VCBATT0_a044_Task10msError "VCBATT0 ECU: a044 task10ms error";
CM_ SG_ 973 VCBATT0_a045_Task100msError "VCBATT0 ECU: a045 task100ms error";
CM_ SG_ 973 VCBATT0_a046_Task1000msError "VCBATT0 ECU: a046 task1000ms error";
CM_ SG_ 973 VCBATT0_a047_resetReason "VCBATT0 ECU: a047 reset reason";
CM_ SG_ 973 VCBATT0_a058_inputRHighSyncDebug "VCBATT0 ECU: a058 input r high sync debug";
CM_ SG_ 973 VCBATT0_a059_inputResistanceHigh "VCBATT0 ECU: a059 input resistance high";
CM_ SG_ 973 VCBATT0_a060_engineeringBuild "VCBATT0 ECU: a060 engineering build";
CM_ SG_ 973 VCBATT0_a061_XCPConnected "VCBATT0 ECU: a061 XCP connected";
CM_ SG_ 973 VCBATT0_a062_XCPWasConnected "VCBATT0 ECU: a062 XCP was connected";
CM_ SG_ 973 VCBATT0_a063_SwitchFault "VCBATT0 ECU: a063 switch fault";
CM_ SG_ 973 VCBATT0_a064_busSleepReqTimeout "VCBATT0 ECU: a064 bus sleep req timeout";
CM_ SG_ 973 VCBATT0_a423_rtosSleepFailed "VCBATT0 ECU: a423 rtos sleep failed";
CM_ BO_ 1618 "VCBATT0 ECU message: info";
CM_ SG_ 1618 VCBATT0_infoIndex "VCBATT0 ECU: info index";
CM_ SG_ 1618 VCBATT0_infoBuildType "VCBATT0 ECU: info build type";
CM_ SG_ 1618 VCBATT0_infoBuildConfigId "VCBATT0 ECU: info build config id";
CM_ SG_ 1618 VCBATT0_infoHardwareId "VCBATT0 ECU: info hardware id";
CM_ SG_ 1618 VCBATT0_infoComponentId "VCBATT0 ECU: info component id";
CM_ SG_ 1618 VCBATT0_infoPcbaId "VCBATT0 ECU: info pcba id";
CM_ SG_ 1618 VCBATT0_infoAssemblyId "VCBATT0 ECU: info assembly id; raw 255 = signal not available (SNA)";
CM_ SG_ 1618 VCBATT0_infoUsageId "VCBATT0 ECU: info usage id";
CM_ SG_ 1618 VCBATT0_infoSubUsageId "VCBATT0 ECU: info sub usage id";
CM_ SG_ 1618 VCBATT0_infoAppCrc "VCBATT0 ECU: info app crc";
CM_ SG_ 1618 VCBATT0_infoAppGitHash "VCBATT0 ECU: info app git hash";
CM_ SG_ 1618 VCBATT0_infoBootGitHash "VCBATT0 ECU: info boot git hash";
CM_ SG_ 1618 VCBATT0_infoBootUdsProtoVersion "VCBATT0 ECU: info boot uds proto version";
CM_ SG_ 1618 VCBATT0_infoBootCrc "VCBATT0 ECU: info boot crc";
CM_ BO_ 1858 "VCBATT1 ECU message: LVBMS status high";
CM_ SG_ 1858 VCBATT1_lvbmsStatusHighIndex "VCBATT1 ECU: lvbms status high index";
CM_ SG_ 1858 VCBATT1_LVBMS_packCurrent "Electrical current into the low voltage battery; raw 4194303 = signal not available (SNA)";
CM_ SG_ 1858 VCBATT1_LVBMS_packVoltage "Voltage of the low voltage battery; raw 65535 = signal not available (SNA)";
CM_ SG_ 1858 VCBATT1_LVBMS_packTemperature "Temperature of the low voltage battery; raw 511 = signal not available (SNA)";
CM_ SG_ 1858 VCBATT1_LVBMS_MOSTemperature "Temperature of the MOSFET on the low voltage battery; raw 4095 = signal not available (SNA)";
CM_ SG_ 1858 VCBATT1_LVBMS_sumCellVoltage "Sum of the cell voltage of the low voltage battery; raw 65535 = signal not available (SNA)";
CM_ SG_ 1858 VCBATT1_LVBMS_maxBrickVoltage "Maximum cell voltage in the low voltage battery; raw 8191 = signal not available (SNA)";
CM_ SG_ 1858 VCBATT1_LVBMS_maxBrickVoltageInd "VCBATT1 ECU: LVBMS max brick voltage index; raw 255 = signal not available (SNA)";
CM_ SG_ 1858 VCBATT1_totalLVLoadCurrent "Total LV load current of the vehicle.";
CM_ SG_ 1858 VCBATT1_LVPackChargeCurrentLimit "Charge current limit for the LV battery pack.";
CM_ SG_ 1858 VCBATT1_LVPackCurrent "Current of the LV battery pack.";
CM_ SG_ 1858 VCBATT1_LVBMS_estimatedPackOcv "VCBATT1 ECU: LVBMS estimated pack ocv";
CM_ SG_ 1858 VCBATT1_LVBMS_voltageTarget "Voltage target of the LV battery; raw 65535 = signal not available (SNA)";
CM_ SG_ 1858 VCBATT1_LVBMS_currentTarget "Target current requested by the LV battery; raw 262143 = signal not available (SNA)";
CM_ SG_ 1858 VCBATT1_LVBMS_maxAllowedChargeCu "Maximum allowed charge current of the battery; raw 8191 = signal not available (SNA)";
CM_ SG_ 1858 VCBATT1_LVBMS_maxAllowedDischarg "Maximum allowed discharge current of the battery; raw 8191 = signal not available (SNA)";
CM_ SG_ 1858 VCBATT1_LVBMS_MOSCommand "Current state of the MOS command to the LV battery";
CM_ SG_ 1858 VCBATT1_LVBMS_ClearErrorCntrComm "VCBATT1 ECU: LVBMS clear error cntr command";
CM_ SG_ 1858 VCBATT1_LVBMS_ClearHistoricFault "VCBATT1 ECU: LVBMS clear historic fault command";
CM_ SG_ 1858 VCBATT1_LVBMS_ResetLVBMSCommand "Reset command issued to LVBMS, commanded by VC";
CM_ SG_ 1858 VCBATT1_LVBMS_EnterHibernationCo "VCBATT1 ECU: LVBMS enter hibernation command";
CM_ SG_ 1858 VCBATT1_LVBMS_ECPAState "Current state of the E-CPA on the LV battery; raw 3 = signal not available (SNA)";
CM_ SG_ 1858 VCBATT1_LVBMS_MOSState "Current state of the MOS on the LV battery; raw 3 = signal not available (SNA)";
CM_ SG_ 1858 VCBATT1_LVBMS_VehicleState "VCBATT1 ECU: LVBMS vehicle state";
CM_ SG_ 1858 VCBATT1_LVBMS_LINWakeDisabled "VCBATT1 ECU: LVBMS LIN wake disabled";
CM_ SG_ 1858 VCBATT1_LVBMS_chargeType "VCBATT1 ECU: LVBMS charge type; raw 4 = signal not available (SNA)";
CM_ SG_ 1858 VCBATT1_LVBMS_cellAndArcProtEnab "Indicates whether the VC has commanded cell protections to be active";
CM_ SG_ 1858 VCBATT1_LVBMS_avgBrickVoltage "Average voltage of all cells in the low voltage battery; raw 8191 = signal not available (SNA)";
CM_ SG_ 1858 VCBATT1_LVBMS_minBrickVoltage "Minimum cell voltage in the low voltage battery; raw 8191 = signal not available (SNA)";
CM_ SG_ 1858 VCBATT1_LVBMS_minBrickVoltageInd "VCBATT1 ECU: LVBMS min brick voltage index; raw 255 = signal not available (SNA)";
CM_ BO_ 1119 "VCBATT1 ECU message: LV self tests";
CM_ SG_ 1119 VCBATT1_LVSelfTestsChecksum "VCBATT1 ECU: LV self tests checksum";
CM_ SG_ 1119 VCBATT1_LVSelfTestsCounter "VCBATT1 ECU: LV self tests counter";
CM_ SG_ 1119 VCBATT1_LVSelfTestsIndex "VCBATT1 ECU: LV self tests index";
CM_ SG_ 1119 VCBATT1_lvProtectionSelfTestsEna "VCBATT1 ECU: lv protection self tests enabled";
CM_ SG_ 1119 VCBATT1_startBattDomainOvercurre "VCBATT1 ECU: start batt domain overcurrent self test";
CM_ SG_ 1119 VCBATT1_startBattDomainOvervolta "VCBATT1 ECU: start batt domain overvoltage self test";
CM_ SG_ 1119 VCBATT1_startBattDomainUndervolt "VCBATT1 ECU: start batt domain undervoltage self test";
CM_ SG_ 1119 VCBATT1_startDualPowerLoadsSelfT "VCBATT1 ECU: start dual power loads self test";
CM_ SG_ 1119 VCBATT1_startVCBattBridgeEFuseAS "VCBATT1 ECU: start VC batt bridge e fuse ASIC self test";
CM_ SG_ 1119 VCBATT1_startPCSOVShutdownSelfTe "VCBATT1 ECU: start PCSOV shutdown self test";
CM_ SG_ 1119 VCBATT1_startPCSDomainOvervoltag "VCBATT1 ECU: start PCS domain overvoltage self test";
CM_ SG_ 1119 VCBATT1_startBattDomainUnde_0001 "VCBATT1 ECU: start batt domain undervoltage VC left self test";
CM_ SG_ 1119 VCBATT1_startPCSDomainUndervolta "VCBATT1 ECU: start PCS domain undervoltage self test";
CM_ SG_ 1119 VCBATT1_startVCFrontBridgeEFuseA "VCBATT1 ECU: start VC front bridge e fuse ASIC self test";
CM_ SG_ 1119 VCBATT1_battDomainOvercurrentSel "Self-Test Result.";
CM_ SG_ 1119 VCBATT1_battDomainOvercurre_0001 "Self-Test State; raw 4 = signal not available (SNA)";
CM_ SG_ 1119 VCBATT1_battDomainOvervoltageSel "Self-Test Result.";
CM_ SG_ 1119 VCBATT1_battDomainOvervolta_0001 "Self-Test State; raw 4 = signal not available (SNA)";
CM_ SG_ 1119 VCBATT1_battDomainUndervoltageSe "Self-Test Result.";
CM_ SG_ 1119 VCBATT1_battDomainUndervolt_0001 "Self-Test State; raw 4 = signal not available (SNA)";
CM_ SG_ 1119 VCBATT1_dualPowerLoadsSelfTestRe "Self-Test Result.";
CM_ SG_ 1119 VCBATT1_dualPowerLoadsSelfTestSt "Self-Test State; raw 4 = signal not available (SNA)";
CM_ SG_ 1119 VCBATT1_vcbattBridgeEFuseASICSel "Self-Test Result.";
CM_ SG_ 1119 VCBATT1_vcbattBridgeEFuseAS_0001 "Self-Test State; raw 4 = signal not available (SNA)";
CM_ SG_ 1119 VCBATT1_uvProtectionState "VCBATT1 ECU: uv protection state";
CM_ SG_ 1119 VCBATT1_undervoltageSelfTestFaul "VCBATT1 ECU: undervoltage self test fault injection ready";
CM_ SG_ 1119 VC_selfTestsRunningMode "VCBATT1 ECU: self tests running mode";
BA_DEF_ BO_ "GenMsgCycleTime" INT 0 3600000;
BA_DEF_ BO_ "GenMsgSendType" ENUM "Cyclic","NotUsed","NotUsed","NotUsed","NotUsed","NotUsed","NotUsed","IfActive","NoMsgSendType","NotUsed";
BA_DEF_ BO_ "VFrameFormat" ENUM "StandardCAN","ExtendedCAN","reserved","J1939PG","reserved","reserved","reserved","reserved","reserved","reserved","reserved","reserved","reserved","reserved","StandardCAN_FD","ExtendedCAN_FD";
BA_DEF_ BO_ "CANFD_BRS" ENUM "0","1";
BA_DEF_ SG_ "GenSigSNA" STRING;
BA_DEF_ SG_ "SystemSignalLongSymbol" STRING;
BA_DEF_ SG_ "Confidence" ENUM "validated","plausible","layout-only","contradicted";
BA_DEF_DEF_ "GenMsgCycleTime" 0;
BA_DEF_DEF_ "GenMsgSendType" "NoMsgSendType";
BA_DEF_DEF_ "VFrameFormat" "StandardCAN";
BA_DEF_DEF_ "CANFD_BRS" "1";
BA_DEF_DEF_ "GenSigSNA" "";
BA_DEF_DEF_ "SystemSignalLongSymbol" "";
BA_DEF_DEF_ "Confidence" "layout-only";
BA_ "GenMsgCycleTime" BO_ 973 100;
BA_ "GenMsgSendType" BO_ 973 0;
BA_ "GenMsgCycleTime" BO_ 1618 1000;
BA_ "GenMsgSendType" BO_ 1618 0;
BA_ "GenMsgCycleTime" BO_ 1858 40;
BA_ "GenMsgSendType" BO_ 1858 0;
BA_ "GenMsgCycleTime" BO_ 1119 500;
BA_ "GenMsgSendType" BO_ 1119 0;
BA_ "Confidence" SG_ 1949 V2G_evseLogDataSelect 1;
BA_ "Confidence" SG_ 1949 V2G_chgParamRes_respCode 0;
BA_ "Confidence" SG_ 1949 V2G_chgParamRes_finished 0;
BA_ "Confidence" SG_ 1949 V2G_chgParamRes_evseStatus 0;
BA_ "Confidence" SG_ 1949 V2G_chgParamRes_evseMaxILim 0;
BA_ "Confidence" SG_ 1949 V2G_chgParamRes_evseMaxVLim 0;
BA_ "Confidence" SG_ 1949 V2G_chgParamRes_evseMinILim 0;
BA_ "Confidence" SG_ 1949 V2G_chgParamRes_evseMinVLim 0;
BA_ "Confidence" SG_ 1949 V2G_chgParamRes_evseMaxPowerLim 0;
BA_ "Confidence" SG_ 1949 V2G_chgParamRes_evseMaxPower_val 0;
BA_ "Confidence" SG_ 1949 V2G_chgParamRes_isoState 0;
BA_ "Confidence" SG_ 1949 V2G_chgParamRes_isoState_val 0;
BA_ "Confidence" SG_ 1338 VCBATT0_alertID 1;
BA_ "Confidence" SG_ 1338 VCBATT0_alertState 1;
BA_ "Confidence" SG_ 1338 VCBATT0_a059_voltageDrop 1;
BA_ "Confidence" SG_ 1338 VCBATT0_a059_resistanceEstimate 1;
BA_ "Confidence" SG_ 1338 VCBATT0_a059_current 1;
BA_ "Confidence" SG_ 1338 VCBATT0_a063_ADCVoltage 1;
BA_ "Confidence" SG_ 973 VCBATT0_matrixIndex 1;
BA_ "SystemSignalLongSymbol" SG_ 973 VCBATT0_a033_eccNonCorrectableEr "VCBATT0_a033_eccNonCorrectableError";
BA_ "Confidence" SG_ 1618 VCBATT0_infoIndex 1;
BA_ "Confidence" SG_ 1618 VCBATT0_infoBuildType 0;
BA_ "Confidence" SG_ 1618 VCBATT0_infoBuildConfigId 0;
BA_ "Confidence" SG_ 1618 VCBATT0_infoHardwareId 0;
BA_ "Confidence" SG_ 1618 VCBATT0_infoComponentId 0;
BA_ "Confidence" SG_ 1618 VCBATT0_infoPcbaId 0;
BA_ "Confidence" SG_ 1618 VCBATT0_infoAssemblyId 0;
BA_ "GenSigSNA" SG_ 1618 VCBATT0_infoAssemblyId "255";
BA_ "Confidence" SG_ 1618 VCBATT0_infoUsageId 0;
BA_ "Confidence" SG_ 1618 VCBATT0_infoSubUsageId 0;
BA_ "Confidence" SG_ 1618 VCBATT0_infoAppCrc 0;
BA_ "Confidence" SG_ 1618 VCBATT0_infoAppGitHash 0;
BA_ "Confidence" SG_ 1618 VCBATT0_infoBootGitHash 0;
BA_ "Confidence" SG_ 1618 VCBATT0_infoBootUdsProtoVersion 0;
BA_ "Confidence" SG_ 1618 VCBATT0_infoBootCrc 0;
BA_ "Confidence" SG_ 1858 VCBATT1_lvbmsStatusHighIndex 1;
BA_ "Confidence" SG_ 1858 VCBATT1_LVBMS_packCurrent 0;
BA_ "GenSigSNA" SG_ 1858 VCBATT1_LVBMS_packCurrent "4194303";
BA_ "Confidence" SG_ 1858 VCBATT1_LVBMS_packVoltage 0;
BA_ "GenSigSNA" SG_ 1858 VCBATT1_LVBMS_packVoltage "65535";
BA_ "Confidence" SG_ 1858 VCBATT1_LVBMS_packTemperature 0;
BA_ "GenSigSNA" SG_ 1858 VCBATT1_LVBMS_packTemperature "511";
BA_ "Confidence" SG_ 1858 VCBATT1_LVBMS_MOSTemperature 0;
BA_ "GenSigSNA" SG_ 1858 VCBATT1_LVBMS_MOSTemperature "4095";
BA_ "Confidence" SG_ 1858 VCBATT1_LVBMS_sumCellVoltage 0;
BA_ "GenSigSNA" SG_ 1858 VCBATT1_LVBMS_sumCellVoltage "65535";
BA_ "Confidence" SG_ 1858 VCBATT1_LVBMS_maxBrickVoltage 0;
BA_ "GenSigSNA" SG_ 1858 VCBATT1_LVBMS_maxBrickVoltage "8191";
BA_ "Confidence" SG_ 1858 VCBATT1_LVBMS_maxBrickVoltageInd 0;
BA_ "GenSigSNA" SG_ 1858 VCBATT1_LVBMS_maxBrickVoltageInd "255";
BA_ "SystemSignalLongSymbol" SG_ 1858 VCBATT1_LVBMS_maxBrickVoltageInd "VCBATT1_LVBMS_maxBrickVoltageIndex";
BA_ "Confidence" SG_ 1858 VCBATT1_totalLVLoadCurrent 0;
BA_ "Confidence" SG_ 1858 VCBATT1_LVPackChargeCurrentLimit 0;
BA_ "Confidence" SG_ 1858 VCBATT1_LVPackCurrent 0;
BA_ "Confidence" SG_ 1858 VCBATT1_LVBMS_estimatedPackOcv 0;
BA_ "Confidence" SG_ 1858 VCBATT1_LVBMS_voltageTarget 0;
BA_ "GenSigSNA" SG_ 1858 VCBATT1_LVBMS_voltageTarget "65535";
BA_ "Confidence" SG_ 1858 VCBATT1_LVBMS_currentTarget 0;
BA_ "GenSigSNA" SG_ 1858 VCBATT1_LVBMS_currentTarget "262143";
BA_ "Confidence" SG_ 1858 VCBATT1_LVBMS_maxAllowedChargeCu 0;
BA_ "GenSigSNA" SG_ 1858 VCBATT1_LVBMS_maxAllowedChargeCu "8191";
BA_ "SystemSignalLongSymbol" SG_ 1858 VCBATT1_LVBMS_maxAllowedChargeCu "VCBATT1_LVBMS_maxAllowedChargeCurrent";
BA_ "Confidence" SG_ 1858 VCBATT1_LVBMS_maxAllowedDischarg 0;
BA_ "GenSigSNA" SG_ 1858 VCBATT1_LVBMS_maxAllowedDischarg "8191";
BA_ "SystemSignalLongSymbol" SG_ 1858 VCBATT1_LVBMS_maxAllowedDischarg "VCBATT1_LVBMS_maxAllowedDischargeCurrent";
BA_ "Confidence" SG_ 1858 VCBATT1_LVBMS_MOSCommand 0;
BA_ "Confidence" SG_ 1858 VCBATT1_LVBMS_ClearErrorCntrComm 0;
BA_ "SystemSignalLongSymbol" SG_ 1858 VCBATT1_LVBMS_ClearErrorCntrComm "VCBATT1_LVBMS_ClearErrorCntrCommand";
BA_ "Confidence" SG_ 1858 VCBATT1_LVBMS_ClearHistoricFault 0;
BA_ "SystemSignalLongSymbol" SG_ 1858 VCBATT1_LVBMS_ClearHistoricFault "VCBATT1_LVBMS_ClearHistoricFaultCommand";
BA_ "Confidence" SG_ 1858 VCBATT1_LVBMS_ResetLVBMSCommand 0;
BA_ "Confidence" SG_ 1858 VCBATT1_LVBMS_EnterHibernationCo 0;
BA_ "SystemSignalLongSymbol" SG_ 1858 VCBATT1_LVBMS_EnterHibernationCo "VCBATT1_LVBMS_EnterHibernationCommand";
BA_ "Confidence" SG_ 1858 VCBATT1_LVBMS_ECPAState 0;
BA_ "GenSigSNA" SG_ 1858 VCBATT1_LVBMS_ECPAState "3";
BA_ "Confidence" SG_ 1858 VCBATT1_LVBMS_MOSState 0;
BA_ "GenSigSNA" SG_ 1858 VCBATT1_LVBMS_MOSState "3";
BA_ "Confidence" SG_ 1858 VCBATT1_LVBMS_VehicleState 0;
BA_ "Confidence" SG_ 1858 VCBATT1_LVBMS_LINWakeDisabled 0;
BA_ "Confidence" SG_ 1858 VCBATT1_LVBMS_chargeType 0;
BA_ "GenSigSNA" SG_ 1858 VCBATT1_LVBMS_chargeType "4";
BA_ "Confidence" SG_ 1858 VCBATT1_LVBMS_cellAndArcProtEnab 0;
BA_ "SystemSignalLongSymbol" SG_ 1858 VCBATT1_LVBMS_cellAndArcProtEnab "VCBATT1_LVBMS_cellAndArcProtEnabled";
BA_ "Confidence" SG_ 1858 VCBATT1_LVBMS_avgBrickVoltage 0;
BA_ "GenSigSNA" SG_ 1858 VCBATT1_LVBMS_avgBrickVoltage "8191";
BA_ "Confidence" SG_ 1858 VCBATT1_LVBMS_minBrickVoltage 0;
BA_ "GenSigSNA" SG_ 1858 VCBATT1_LVBMS_minBrickVoltage "8191";
BA_ "Confidence" SG_ 1858 VCBATT1_LVBMS_minBrickVoltageInd 0;
BA_ "GenSigSNA" SG_ 1858 VCBATT1_LVBMS_minBrickVoltageInd "255";
BA_ "SystemSignalLongSymbol" SG_ 1858 VCBATT1_LVBMS_minBrickVoltageInd "VCBATT1_LVBMS_minBrickVoltageIndex";
BA_ "Confidence" SG_ 1119 VCBATT1_LVSelfTestsChecksum 0;
BA_ "Confidence" SG_ 1119 VCBATT1_LVSelfTestsCounter 0;
BA_ "Confidence" SG_ 1119 VCBATT1_LVSelfTestsIndex 1;
BA_ "Confidence" SG_ 1119 VCBATT1_lvProtectionSelfTestsEna 0;
BA_ "SystemSignalLongSymbol" SG_ 1119 VCBATT1_lvProtectionSelfTestsEna "VCBATT1_lvProtectionSelfTestsEnabled";
BA_ "Confidence" SG_ 1119 VCBATT1_startBattDomainOvercurre 0;
BA_ "SystemSignalLongSymbol" SG_ 1119 VCBATT1_startBattDomainOvercurre "VCBATT1_startBattDomainOvercurrentSelfTest";
BA_ "Confidence" SG_ 1119 VCBATT1_startBattDomainOvervolta 0;
BA_ "SystemSignalLongSymbol" SG_ 1119 VCBATT1_startBattDomainOvervolta "VCBATT1_startBattDomainOvervoltageSelfTest";
BA_ "Confidence" SG_ 1119 VCBATT1_startBattDomainUndervolt 0;
BA_ "SystemSignalLongSymbol" SG_ 1119 VCBATT1_startBattDomainUndervolt "VCBATT1_startBattDomainUndervoltageSelfTest";
BA_ "Confidence" SG_ 1119 VCBATT1_startDualPowerLoadsSelfT 0;
BA_ "SystemSignalLongSymbol" SG_ 1119 VCBATT1_startDualPowerLoadsSelfT "VCBATT1_startDualPowerLoadsSelfTest";
BA_ "Confidence" SG_ 1119 VCBATT1_startVCBattBridgeEFuseAS 0;
BA_ "SystemSignalLongSymbol" SG_ 1119 VCBATT1_startVCBattBridgeEFuseAS "VCBATT1_startVCBattBridgeEFuseASICSelfTest";
BA_ "Confidence" SG_ 1119 VCBATT1_startPCSOVShutdownSelfTe 0;
BA_ "SystemSignalLongSymbol" SG_ 1119 VCBATT1_startPCSOVShutdownSelfTe "VCBATT1_startPCSOVShutdownSelfTest";
BA_ "Confidence" SG_ 1119 VCBATT1_startPCSDomainOvervoltag 0;
BA_ "SystemSignalLongSymbol" SG_ 1119 VCBATT1_startPCSDomainOvervoltag "VCBATT1_startPCSDomainOvervoltageSelfTest";
BA_ "Confidence" SG_ 1119 VCBATT1_startBattDomainUnde_0001 0;
BA_ "SystemSignalLongSymbol" SG_ 1119 VCBATT1_startBattDomainUnde_0001 "VCBATT1_startBattDomainUndervoltageVCLeftSelfTest";
BA_ "Confidence" SG_ 1119 VCBATT1_startPCSDomainUndervolta 0;
BA_ "SystemSignalLongSymbol" SG_ 1119 VCBATT1_startPCSDomainUndervolta "VCBATT1_startPCSDomainUndervoltageSelfTest";
BA_ "Confidence" SG_ 1119 VCBATT1_startVCFrontBridgeEFuseA 0;
BA_ "SystemSignalLongSymbol" SG_ 1119 VCBATT1_startVCFrontBridgeEFuseA "VCBATT1_startVCFrontBridgeEFuseASICSelfTest";
BA_ "Confidence" SG_ 1119 VCBATT1_battDomainOvercurrentSel 0;
BA_ "SystemSignalLongSymbol" SG_ 1119 VCBATT1_battDomainOvercurrentSel "VCBATT1_battDomainOvercurrentSelfTestResult";
BA_ "Confidence" SG_ 1119 VCBATT1_battDomainOvercurre_0001 0;
BA_ "GenSigSNA" SG_ 1119 VCBATT1_battDomainOvercurre_0001 "4";
BA_ "SystemSignalLongSymbol" SG_ 1119 VCBATT1_battDomainOvercurre_0001 "VCBATT1_battDomainOvercurrentSelfTestState";
BA_ "Confidence" SG_ 1119 VCBATT1_battDomainOvervoltageSel 0;
BA_ "SystemSignalLongSymbol" SG_ 1119 VCBATT1_battDomainOvervoltageSel "VCBATT1_battDomainOvervoltageSelfTestResult";
BA_ "Confidence" SG_ 1119 VCBATT1_battDomainOvervolta_0001 0;
BA_ "GenSigSNA" SG_ 1119 VCBATT1_battDomainOvervolta_0001 "4";
BA_ "SystemSignalLongSymbol" SG_ 1119 VCBATT1_battDomainOvervolta_0001 "VCBATT1_battDomainOvervoltageSelfTestState";
BA_ "Confidence" SG_ 1119 VCBATT1_battDomainUndervoltageSe 0;
BA_ "SystemSignalLongSymbol" SG_ 1119 VCBATT1_battDomainUndervoltageSe "VCBATT1_battDomainUndervoltageSelfTestResult";
BA_ "Confidence" SG_ 1119 VCBATT1_battDomainUndervolt_0001 0;
BA_ "GenSigSNA" SG_ 1119 VCBATT1_battDomainUndervolt_0001 "4";
BA_ "SystemSignalLongSymbol" SG_ 1119 VCBATT1_battDomainUndervolt_0001 "VCBATT1_battDomainUndervoltageSelfTestState";
BA_ "Confidence" SG_ 1119 VCBATT1_dualPowerLoadsSelfTestRe 0;
BA_ "SystemSignalLongSymbol" SG_ 1119 VCBATT1_dualPowerLoadsSelfTestRe "VCBATT1_dualPowerLoadsSelfTestResult";
BA_ "Confidence" SG_ 1119 VCBATT1_dualPowerLoadsSelfTestSt 0;
BA_ "GenSigSNA" SG_ 1119 VCBATT1_dualPowerLoadsSelfTestSt "4";
BA_ "SystemSignalLongSymbol" SG_ 1119 VCBATT1_dualPowerLoadsSelfTestSt "VCBATT1_dualPowerLoadsSelfTestState";
BA_ "Confidence" SG_ 1119 VCBATT1_vcbattBridgeEFuseASICSel 0;
BA_ "SystemSignalLongSymbol" SG_ 1119 VCBATT1_vcbattBridgeEFuseASICSel "VCBATT1_vcbattBridgeEFuseASICSelfTestResult";
BA_ "Confidence" SG_ 1119 VCBATT1_vcbattBridgeEFuseAS_0001 0;
BA_ "GenSigSNA" SG_ 1119 VCBATT1_vcbattBridgeEFuseAS_0001 "4";
BA_ "SystemSignalLongSymbol" SG_ 1119 VCBATT1_vcbattBridgeEFuseAS_0001 "VCBATT1_vcbattBridgeEFuseASICSelfTestState";
BA_ "Confidence" SG_ 1119 VCBATT1_uvProtectionState 0;
BA_ "Confidence" SG_ 1119 VCBATT1_undervoltageSelfTestFaul 0;
BA_ "SystemSignalLongSymbol" SG_ 1119 VCBATT1_undervoltageSelfTestFaul "VCBATT1_undervoltageSelfTestFaultInjectionReady";
BA_ "Confidence" SG_ 1119 VC_selfTestsRunningMode 0;
VAL_ 1949 V2G_evseLogDataSelect 17 "NUM_MSG" 16 "MSG_NONE" 15 "SESSION_STOP" 14 "WELDING_DETECTION" 13 "POWER_DELIVERY_END" 12 "CHARGING_STATUS" 11 "CURRENT_DEMAND" 10 "POWER_DELIVERY_START" 9 "PRECHARGE" 8 "CABLE_CHECK" 7 "CHARGE_PARAMETER_DISCOVERY" 6 "CONTRACT_AUTHENTICATION" 5 "PAYMENT_DETAILS" 4 "SERVICE_PAYMENT_SELECTION" 3 "SERVICE_DETAIL" 2 "SERVICE_DISCOVERY" 1 "SESSION_SETUP" 0 "SUPPORTED_APP_PROTOCOL" ;
VAL_ 1949 V2G_chgParamRes_respCode 27 "CCS_EVSE_RESP_CODE_MAX" 26 "CCS_EVSE_RESP_CODE_FAILED_CERT_REVOKED" 25 "CCS_EVSE_RESP_CODE_FAILED_CERT_NOT_ALLOWED_AT_EVSE" 24 "CCS_EVSE_RESP_CODE_FAILED_CONTACTOR_ERROR" 23 "CCS_EVSE_RESP_CODE_FAILED_NO_CHARGE_SERVICE_SELECTED" 22 "CCS_EVSE_RESP_CODE_FAILED_WRONG_ENERGY_TRANSFER_TYPE" 21 "CCS_EVSE_RESP_CODE_FAILED_METERING_SIGNATURE_NOT_VALID" 20 "CCS_EVSE_RESP_CODE_FAILED_EVSE_PRESENT_VOLTAGE_TOO_LOW" 19 "CCS_EVSE_RESP_CODE_FAILED_CHARGING_PROFILE_INVALID" 18 "CCS_EVSE_RESP_CODE_FAILED_TARIFF_SELECTION_INVALID" 17 "CCS_EVSE_RESP_CODE_FAILED_POWER_DELIVERY_NOT_APPLIED" 16 "CCS_EVSE_RESP_CODE_FAILED_WRONG_CHARGE_PARAMETER" 15 "CCS_EVSE_RESP_CODE_FAILED_CONTRACT_CANCELED" 14 "CCS_EVSE_RESP_CODE_FAILED_CHALLENGE_INVALID" 13 "CCS_EVSE_RESP_CODE_FAILED_CERT_CHAIN_ERROR" 12 "CCS_EVSE_RESP_CODE_FAILED_NO_CERTIFICATE_AVAILABLE" 11 "CCS_EVSE_RESP_CODE_FAILED_SIGNATURE_ERROR" 10 "CCS_EVSE_RESP_CODE_FAILED_CERTIFICATE_EXPIRED" 9 "CCS_EVSE_RESP_CODE_FAILED_PAYMENT_SELECTION_INVALID" 8 "CCS_EVSE_RESP_CODE_FAILED_SERVICE_SELECTION_INVALID" 7 "CCS_EVSE_RESP_CODE_FAILED_UNKNOWN_SESSION" 6 "CCS_EVSE_RESP_CODE_FAILED_SERVICE_ID_INVALID" 5 "CCS_EVSE_RESP_CODE_FAILED_SEQUENCE_ERROR" 4 "CCS_EVSE_RESP_CODE_FAILED" 3 "CCS_EVSE_RESP_CODE_OK_CERTIFICATE_EXPIRES_SOON" 2 "CCS_EVSE_RESP_CODE_OK_OLD_SESSION_JOINED" 1 "CCS_EVSE_RESP_CODE_OK_NEW_SESSION_ESTABLISHED" 0 "CCS_EVSE_RESP_CODE_OK" ;
VAL_ 1949 V2G_chgParamRes_evseStatus 12 "CCS_DC_EVSE_STATUS_MAX" 11 "CCS_DC_EVSE_STATUS_RESERVED_C" 10 "CCS_DC_EVSE_STATUS_RESERVED_B" 9 "CCS_DC_EVSE_STATUS_RESERVED_A" 8 "CCS_DC_EVSE_STATUS_RESERVED_9" 7 "CCS_DC_EVSE_STATUS_RESERVED_8" 6 "CCS_DC_EVSE_STATUS_MALFUNCTION" 5 "CCS_DC_EVSE_STATUS_EMERGENCY_SHUTDOWN" 4 "CCS_DC_EVSE_STATUS_ISOLATION_MONITORING_ACTIVE" 3 "CCS_DC_EVSE_STATUS_UTILITY_INTERRUPT_EVENT" 2 "CCS_DC_EVSE_STATUS_SHUTDOWN" 1 "CCS_DC_EVSE_STATUS_READY" 0 "CCS_DC_EVSE_STATUS_NOT_READY" ;
VAL_ 1949 V2G_chgParamRes_isoState 4 "CCS_ISOLATION_STATUS_NO_IMD" 3 "CCS_ISOLATION_STATUS_FAULT" 2 "CCS_ISOLATION_STATUS_WARNING" 1 "CCS_ISOLATION_STATUS_VALID" 0 "CCS_ISOLATION_STATUS_INVALID" ;
VAL_ 1338 VCBATT0_alertID 423 "a423_rtosSleepFailed" 64 "a064_busSleepReqTimeout" 63 "a063_SwitchFault" 62 "a062_XCPWasConnected" 61 "a061_XCPConnected" 60 "a060_engineeringBuild" 59 "a059_inputResistanceHigh" 58 "a058_inputRHighSyncDebug" 47 "a047_resetReason" 46 "a046_Task1000msError" 45 "a045_Task100msError" 44 "a044_Task10msError" 43 "a043_Task1msError" 42 "a042_HighStackUsage" 41 "a041_HighCPULoad" 40 "a040_Backtrace" 39 "a039_ProtFaultAddress" 38 "a038_ProtFaultInfo" 33 "a033_eccNonCorrectableError" 32 "a032_ipcWatchdogExpired" 31 "a031_UDSActive" 30 "a030_ECULogUploadRequest" 29 "a029_CoreDump" 22 "a022_TaskInitError" 21 "a021_TaskSchedulerError" 16 "a016_NVMMRecordError" 15 "a015_NVMMError" 13 "a013_AlertManagerFault" 12 "a012_CPUReset" 6 "a006_CANTX_cyclicError" 5 "a005_CANTXError" 3 "a003_SWAssertion" 2 "a002_PowerLossReset" 1 "a001_WatchdogReset" 0 "ALERT_DO_NOT_USE_ZERO" ;
VAL_ 1338 VCBATT0_alertState 1 "SET" 0 "CLEARED" ;
VAL_ 973 VCBATT0_matrixIndex 7 "AlertMatrix7" 1 "AlertMatrix1" 0 "AlertMatrix0" ;
VAL_ 1618 VCBATT0_infoIndex 255 "END" 41 "SUBCOMPONENT14" 40 "SUBCOMPONENT13" 39 "SUBCOMPONENT12" 38 "SUBCOMPONENT11" 37 "SUBCOMPONENT10" 36 "SUBCOMPONENT9" 35 "SUBCOMPONENT8" 34 "SUBCOMPONENT7" 33 "SUBCOMPONENT6" 32 "SUBCOMPONENT5" 31 "SUBCOMPONENT4" 24 "SUBCOMPONENT3" 23 "SUBCOMPONENT2" 20 "UDS_PROTOCOL_BOOTCRC" 19 "VERSION_DEPRECATED" 18 "BOOTLOADER_GITHASH" 17 "APP_GITHASH" 16 "SUBCOMPONENT1" 15 "BOOTLOADER_CRC" 14 "BOOTLOADER_SVN" 13 "APP_CRC" 11 "PCBAID_ASSYID_USAGEID" 10 "BUILD_HWID_COMPONENTID" 9 "DEPRECATED_9" 8 "DEPRECATED_8" 7 "DEPRECATED_7" 6 "DEPRECATED_6" 5 "DEPRECATED_5" 4 "DEPRECATED_4" 3 "DEPRECATED_3" 2 "DEPRECATED_2" 1 "DEPRECATED_1" 0 "DEPRECATED_0" ;
VAL_ 1618 VCBATT0_infoBuildType 4 "INFO_MFG_BUILD" 3 "INFO_TRACEABLE_CI_BUILD" 2 "INFO_LOCAL_BUILD" 1 "INFO_PLATFORM_BUILD" 0 "INFO_UNKNOWN_BUILD" ;
VAL_ 1618 VCBATT0_infoAssemblyId 255 "ASSEMBLY_SNA" 1 "ASSEMBLY1" ;
VAL_ 1858 VCBATT1_lvbmsStatusHighIndex 5 "INVALID" 4 "CELL_VITALS_2_AND_STATE_AND_COMMANDS" 3 "TARGETS" 2 "PCS_INTERFACE" 1 "CELL_VITALS_1" 0 "PACK_VITALS_1" ;
VAL_ 1858 VCBATT1_LVBMS_packCurrent 4194303 "SNA" ;
VAL_ 1858 VCBATT1_LVBMS_packVoltage 65535 "SNA" ;
VAL_ 1858 VCBATT1_LVBMS_packTemperature 511 "SNA" ;
VAL_ 1858 VCBATT1_LVBMS_MOSTemperature 4095 "SNA" ;
VAL_ 1858 VCBATT1_LVBMS_sumCellVoltage 65535 "SNA" 65534 "INVALID" ;
VAL_ 1858 VCBATT1_LVBMS_maxBrickVoltage 8191 "SNA" ;
VAL_ 1858 VCBATT1_LVBMS_maxBrickVoltageInd 255 "SNA" ;
VAL_ 1858 VCBATT1_LVBMS_voltageTarget 65535 "SNA" ;
VAL_ 1858 VCBATT1_LVBMS_currentTarget 262143 "SNA" ;
VAL_ 1858 VCBATT1_LVBMS_maxAllowedChargeCu 8191 "SNA" ;
VAL_ 1858 VCBATT1_LVBMS_maxAllowedDischarg 8191 "SNA" ;
VAL_ 1858 VCBATT1_LVBMS_ECPAState 3 "LVBMS_ECPA_STATE_SNA" 2 "LVBMS_ECPA_STATE_INVALID" 1 "LVBMS_ECPA_STATE_CLOSED" 0 "LVBMS_ECPA_STATE_OPEN" ;
VAL_ 1858 VCBATT1_LVBMS_MOSState 3 "LVBMS_MOS_STATE_SNA" 2 "LVBMS_MOS_STATE_INVALID" 1 "LVBMS_MOS_STATE_CLOSED" 0 "LVBMS_MOS_STATE_OPEN" ;
VAL_ 1858 VCBATT1_LVBMS_VehicleState 3 "LVBMS_VEHICLE_STATE_OFF" 2 "LVBMS_VEHICLE_STATE_CONDITIONING" 1 "LVBMS_VEHICLE_STATE_ACCESSORY" 0 "LVBMS_VEHICLE_STATE_DRIVE" ;
VAL_ 1858 VCBATT1_LVBMS_LINWakeDisabled 1 "LVBMS_LIN_WAKE_DISABLED" 0 "LVBMS_LIN_WAKE_ENABLED" ;
VAL_ 1858 VCBATT1_LVBMS_chargeType 4 "LVBMS_CHARGE_SNA" 3 "LVBMS_CHARGE_COMPLETE" 2 "LVBMS_CHARGE_CONSTANT_VOLTAGE" 1 "LVBMS_CHARGE_CONSTANT_CURRENT" 0 "LVBMS_CHARGE_UNDEFINED" ;
VAL_ 1858 VCBATT1_LVBMS_avgBrickVoltage 8191 "SNA" ;
VAL_ 1858 VCBATT1_LVBMS_minBrickVoltage 8191 "SNA" ;
VAL_ 1858 VCBATT1_LVBMS_minBrickVoltageInd 255 "SNA" ;
VAL_ 1119 VCBATT1_LVSelfTestsIndex 1 "STATES" 0 "ORCHESTRATOR" ;
VAL_ 1119 VCBATT1_battDomainOvercurrentSel 2 "VC_SELF_TEST_RESULT_PASSED" 1 "VC_SELF_TEST_RESULT_FAILED" 0 "VC_SELF_TEST_RESULT_INVALID" ;
VAL_ 1119 VCBATT1_battDomainOvercurre_0001 4 "VC_SELF_TEST_STATE_SNA" 3 "VC_SELF_TEST_STATE_NEW_RESULT" 2 "VC_SELF_TEST_STATE_RUNNING" 1 "VC_SELF_TEST_STATE_PENDING" 0 "VC_SELF_TEST_STATE_IDLE" ;
VAL_ 1119 VCBATT1_battDomainOvervoltageSel 2 "VC_SELF_TEST_RESULT_PASSED" 1 "VC_SELF_TEST_RESULT_FAILED" 0 "VC_SELF_TEST_RESULT_INVALID" ;
VAL_ 1119 VCBATT1_battDomainOvervolta_0001 4 "VC_SELF_TEST_STATE_SNA" 3 "VC_SELF_TEST_STATE_NEW_RESULT" 2 "VC_SELF_TEST_STATE_RUNNING" 1 "VC_SELF_TEST_STATE_PENDING" 0 "VC_SELF_TEST_STATE_IDLE" ;
VAL_ 1119 VCBATT1_battDomainUndervoltageSe 2 "VC_SELF_TEST_RESULT_PASSED" 1 "VC_SELF_TEST_RESULT_FAILED" 0 "VC_SELF_TEST_RESULT_INVALID" ;
VAL_ 1119 VCBATT1_battDomainUndervolt_0001 4 "VC_SELF_TEST_STATE_SNA" 3 "VC_SELF_TEST_STATE_NEW_RESULT" 2 "VC_SELF_TEST_STATE_RUNNING" 1 "VC_SELF_TEST_STATE_PENDING" 0 "VC_SELF_TEST_STATE_IDLE" ;
VAL_ 1119 VCBATT1_dualPowerLoadsSelfTestRe 2 "VC_SELF_TEST_RESULT_PASSED" 1 "VC_SELF_TEST_RESULT_FAILED" 0 "VC_SELF_TEST_RESULT_INVALID" ;
VAL_ 1119 VCBATT1_dualPowerLoadsSelfTestSt 4 "VC_SELF_TEST_STATE_SNA" 3 "VC_SELF_TEST_STATE_NEW_RESULT" 2 "VC_SELF_TEST_STATE_RUNNING" 1 "VC_SELF_TEST_STATE_PENDING" 0 "VC_SELF_TEST_STATE_IDLE" ;
VAL_ 1119 VCBATT1_vcbattBridgeEFuseASICSel 2 "VC_SELF_TEST_RESULT_PASSED" 1 "VC_SELF_TEST_RESULT_FAILED" 0 "VC_SELF_TEST_RESULT_INVALID" ;
VAL_ 1119 VCBATT1_vcbattBridgeEFuseAS_0001 4 "VC_SELF_TEST_STATE_SNA" 3 "VC_SELF_TEST_STATE_NEW_RESULT" 2 "VC_SELF_TEST_STATE_RUNNING" 1 "VC_SELF_TEST_STATE_PENDING" 0 "VC_SELF_TEST_STATE_IDLE" ;
VAL_ 1119 VCBATT1_uvProtectionState 12 "VC_UV_STATE_DELIBERATELY_TRIPPED" 11 "VC_UV_STATE_TRIPPED" 10 "VC_UV_STATE_ARMED" 9 "VC_UV_STATE_SELF_TEST_CLEAN_UP" 8 "VC_UV_STATE_SELF_TEST_CHECK_STUCK_ON" 7 "VC_UV_STATE_SELF_TEST_CHECK_STUCK_OFF_COMPLETE" 6 "VC_UV_STATE_SELF_TEST_CHECK_STUCK_OFF" 5 "VC_UV_STATE_SELF_TEST_LOADS_GOING_DOWN_COMPLETE" 4 "VC_UV_STATE_SELF_TEST_LOADS_GOING_DOWN" 3 "VC_UV_STATE_SELF_TEST_LOADS_ON" 2 "VC_UV_STATE_SELF_TEST_TURN_ON_LOADS" 1 "VC_UV_STATE_SELF_TEST_SETUP" 0 "VC_UV_STATE_IDLE" ;
VAL_ 1119 VC_selfTestsRunningMode 4 "DISABLED" 3 "REDUCED" 2 "FACTORY_REDUCED" 1 "FACTORY_NORMAL" 0 "NORMAL" ;
