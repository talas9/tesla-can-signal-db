VERSION "dbc-export 1 2026.26.6.5"

NS_ :

BS_:

BU_: ADSP APB APP APS APSB BB BMS CC CMP CMPD CP DAS DI DIF DIR DPB EPAS3P EPAS3S EPASTP EPASTS EPBL EPBR ESP EVSE FC GTW HCML HCMR HVP IBST ICR IDB LS OCS1P ODIN PARK PCS PCS2 PLG PM PMF PMR PNCD PTC RADC RCM RCM2 RCM3 RCU SCCM SCM SCS SDCR TAS TCU TCU2 TPMS TRCM UDS UI UIS UMC USM V2G VC VCBATT VCBATT0 VCBATT1 VCBATT2 VCCC VCFRONT VCFRONT1 VCFRONT2 VCLEFT VCRIGHT VCSEAT2L VCSEAT2R VCSEC VEH

BO_ 1092 PCS2_alertLog: 8 PCS2
 SG_ PCS2_alertID M : 0|8@1+ (1,0) [0|255] "" Vector__XXX
 SG_ PCS2_alertSet : 15|1@1+ (1,0) [0|1] "" Vector__XXX
 SG_ PCS2_alertSource : 60|4@1+ (1,0) [0|15] "" Vector__XXX
 SG_ PCS2_a003_assertionCode m3 : 16|2@1+ (1,0) [0|3] "" Vector__XXX
 SG_ PCS2_a005_acL1OverCurrentTrip m5 : 16|1@1+ (1,0) [0|1] "" Vector__XXX
 SG_ PCS2_a005_chgMainStateMachineSta m5 : 17|4@1+ (1,0) [0|15] "" Vector__XXX
 SG_ PCS2_a005_gridFormStateMachineSt m5 : 24|4@1+ (1,0) [0|15] "" Vector__XXX
 SG_ PCS2_a005_acManagerOperatingMode m5 : 28|4@1+ (1,0) [0|15] "" Vector__XXX
 SG_ PCS2_a005_acL1MaxThreshold m5 : 32|13@1- (0.1,0) [-409.6|409.5] "A" Vector__XXX
 SG_ PCS2_a005_acL1MinThreshold m5 : 45|13@1- (0.1,0) [-409.6|409.5] "A" Vector__XXX
 SG_ PCS2_a006_acL2NOverVoltageTrip m6 : 16|1@1+ (1,0) [0|1] "" Vector__XXX
 SG_ PCS2_a006_chgMainStateMachineSta m6 : 17|4@1+ (1,0) [0|15] "" Vector__XXX
 SG_ PCS2_a006_gridFormStateMachineSt m6 : 24|4@1+ (1,0) [0|15] "" Vector__XXX
 SG_ PCS2_a006_acManagerOperatingMode m6 : 28|4@1+ (1,0) [0|15] "" Vector__XXX
 SG_ PCS2_a007_acL2OverCurrentTrip m7 : 16|1@1+ (1,0) [0|1] "" Vector__XXX
 SG_ PCS2_a007_chgMainStateMachineSta m7 : 17|4@1+ (1,0) [0|15] "" Vector__XXX
 SG_ PCS2_a007_gridFormStateMachineSt m7 : 24|4@1+ (1,0) [0|15] "" Vector__XXX
 SG_ PCS2_a007_acManagerOperatingMode m7 : 28|4@1+ (1,0) [0|15] "" Vector__XXX
 SG_ PCS2_a007_acL2MaxThreshold m7 : 32|13@1- (0.1,0) [-409.6|409.5] "A" Vector__XXX
 SG_ PCS2_a007_acL2MinThreshold m7 : 45|13@1- (0.1,0) [-409.6|409.5] "A" Vector__XXX
 SG_ PCS2_a008_acL3NOverVoltageTrip m8 : 16|1@1+ (1,0) [0|1] "" Vector__XXX
 SG_ PCS2_a008_chgMainStateMachineSta m8 : 17|4@1+ (1,0) [0|15] "" Vector__XXX
 SG_ PCS2_a008_gridFormStateMachineSt m8 : 24|4@1+ (1,0) [0|15] "" Vector__XXX
 SG_ PCS2_a008_acManagerOperatingMode m8 : 28|4@1+ (1,0) [0|15] "" Vector__XXX
 SG_ PCS2_a009_acL3OverCurrentTrip m9 : 16|1@1+ (1,0) [0|1] "" Vector__XXX
 SG_ PCS2_a009_chgMainStateMachineSta m9 : 17|4@1+ (1,0) [0|15] "" Vector__XXX
 SG_ PCS2_a009_gridFormStateMachineSt m9 : 24|4@1+ (1,0) [0|15] "" Vector__XXX
 SG_ PCS2_a009_acManagerOperatingMode m9 : 28|4@1+ (1,0) [0|15] "" Vector__XXX
 SG_ PCS2_a009_acL3MaxThreshold m9 : 32|13@1- (0.1,0) [-409.6|409.5] "A" Vector__XXX
 SG_ PCS2_a009_acL3MinThreshold m9 : 45|13@1- (0.1,0) [-409.6|409.5] "A" Vector__XXX
 SG_ PCS2_a010_acLNOverCurrentTrip m10 : 16|1@1+ (1,0) [0|1] "" Vector__XXX
 SG_ PCS2_a010_chgMainStateMachineSta m10 : 17|4@1+ (1,0) [0|15] "" Vector__XXX
 SG_ PCS2_a010_gridFormStateMachineSt m10 : 24|4@1+ (1,0) [0|15] "" Vector__XXX
 SG_ PCS2_a010_acManagerOperatingMode m10 : 28|4@1+ (1,0) [0|15] "" Vector__XXX
 SG_ PCS2_a011_hvdcOverCurrentTrip m11 : 16|1@1+ (1,0) [0|1] "" Vector__XXX
 SG_ PCS2_a011_hvdcMaxThreshold m11 : 17|13@1- (0.1,0) [-409.6|409.5] "A" Vector__XXX
 SG_ PCS2_a011_hvdcMinThreshold m11 : 32|13@1- (0.1,0) [-409.6|409.5] "A" Vector__XXX
 SG_ PCS2_a012_cycloATankOverCurrentT m12 : 16|1@1+ (1,0) [0|1] "" Vector__XXX
 SG_ PCS2_a013_DcdcALv2Temp m13 : 16|11@1- (0.15,70.05) [-83.55|223.5] "C" Vector__XXX
 SG_ PCS2_a013_DcdcALv2TempUpperThres m13 : 27|11@1- (0.15,70.05) [-83.55|223.5] "C" Vector__XXX
 SG_ PCS2_a014_cycloBTankOverCurrentT m14 : 16|1@1+ (1,0) [0|1] "" Vector__XXX
 SG_ PCS2_a015_DcdcAHvTemp m15 : 16|11@1- (0.15,70.05) [-83.55|223.5] "C" Vector__XXX
 SG_ PCS2_a015_DcdcAHvTempUpperThresh m15 : 27|11@1- (0.15,70.05) [-83.55|223.5] "C" Vector__XXX
 SG_ PCS2_a016_dcdcATankOverCurrentTr m16 : 16|1@1+ (1,0) [0|1] "" Vector__XXX
 SG_ PCS2_a017_DcdcBLv2Temp m17 : 16|11@1- (0.15,70.05) [-83.55|223.5] "C" Vector__XXX
 SG_ PCS2_a017_DcdcBLv2TempUpperThres m17 : 27|11@1- (0.15,70.05) [-83.55|223.5] "C" Vector__XXX
 SG_ PCS2_a018_dcdcBTankOverCurrentTr m18 : 16|1@1+ (1,0) [0|1] "" Vector__XXX
 SG_ PCS2_a019_DcacADcTemp m19 : 16|11@1- (0.15,70.05) [-83.55|223.5] "C" Vector__XXX
 SG_ PCS2_a019_DcacADcTempUpperThresh m19 : 27|11@1- (0.15,70.05) [-83.55|223.5] "C" Vector__XXX
 SG_ PCS2_a020_DcacBDcTemp m20 : 16|11@1- (0.15,70.05) [-83.55|223.5] "C" Vector__XXX
 SG_ PCS2_a020_DcacBDcTempUpperThresh m20 : 27|11@1- (0.15,70.05) [-83.55|223.5] "C" Vector__XXX
 SG_ PCS2_a021_4V5RailUnderVoltageTri m21 : 16|1@1+ (1,0) [0|1] "" Vector__XXX
 SG_ PCS2_a021_10V0RailUnderVoltageTr m21 : 17|1@1+ (1,0) [0|1] "" Vector__XXX
 SG_ PCS2_a021_13V5RailUnderVoltageTr m21 : 18|1@1+ (1,0) [0|1] "" Vector__XXX
 SG_ PCS2_a021_18V0RailUnderVoltageTr m21 : 19|1@1+ (1,0) [0|1] "" Vector__XXX
 SG_ PCS2_a021_48V0RailUnderVoltageTr m21 : 20|1@1+ (1,0) [0|1] "" Vector__XXX
 SG_ PCS2_a021_4V5RailUnderVoltageThr m21 : 24|5@1+ (1,0) [0|31] "V" Vector__XXX
 SG_ PCS2_a021_10V0RailUnderVoltageTh m21 : 32|5@1+ (1,0) [0|31] "V" Vector__XXX
 SG_ PCS2_a021_13V5RailUnderVoltageTh m21 : 40|5@1+ (1,0) [0|31] "V" Vector__XXX
 SG_ PCS2_a021_18V0RailUnderVoltageTh m21 : 48|5@1+ (1,0) [0|31] "V" Vector__XXX
 SG_ PCS2_a021_48V0RailUnderVoltageTh m21 : 53|7@1+ (1,0) [0|127] "V" Vector__XXX
 SG_ PCS2_a024_DcacATxTemp m24 : 16|11@1- (0.15,70.05) [-83.55|223.5] "C" Vector__XXX
 SG_ PCS2_a024_DcacATxTempUpperThresh m24 : 27|11@1- (0.15,70.05) [-83.55|223.5] "C" Vector__XXX
 SG_ PCS2_a025_DcacBTxTemp m25 : 16|11@1- (0.15,70.05) [-83.55|223.5] "C" Vector__XXX
 SG_ PCS2_a025_DcacBTxTempUpperThresh m25 : 27|11@1- (0.15,70.05) [-83.55|223.5] "C" Vector__XXX
 SG_ PCS2_a026_AcConnectorTemp m26 : 16|11@1- (0.15,70.05) [-83.55|223.5] "C" Vector__XXX
 SG_ PCS2_a026_AcConnectorTempUpperTh m26 : 27|11@1- (0.15,70.05) [-83.55|223.5] "C" Vector__XXX
 SG_ PCS2_a027_AmbientTemp m27 : 16|11@1- (0.15,70.05) [-83.55|223.5] "C" Vector__XXX
 SG_ PCS2_a027_AmbientTempUpperThresh m27 : 27|11@1- (0.15,70.05) [-83.55|223.5] "C" Vector__XXX
 SG_ PCS2_a028_CoolantTemp m28 : 16|11@1- (0.15,70.05) [-83.55|223.5] "C" Vector__XXX
 SG_ PCS2_a028_CoolantTempUpperThresh m28 : 27|11@1- (0.15,70.05) [-83.55|223.5] "C" Vector__XXX
 SG_ PCS2_a028_CoolantSensorSource m28 : 38|1@1+ (1,0) [0|1] "" Vector__XXX
 SG_ PCS2_a029_DcacAAc1Temp m29 : 16|11@1- (0.15,70.05) [-83.55|223.5] "C" Vector__XXX
 SG_ PCS2_a029_DcacAAc1TempUpperThres m29 : 27|11@1- (0.15,70.05) [-83.55|223.5] "C" Vector__XXX
 SG_ PCS2_a030_DcacAAc2Temp m30 : 16|11@1- (0.15,70.05) [-83.55|223.5] "C" Vector__XXX
 SG_ PCS2_a030_DcacAAc2TempUpperThres m30 : 27|11@1- (0.15,70.05) [-83.55|223.5] "C" Vector__XXX
 SG_ PCS2_a031_DcacBAc1Temp m31 : 16|11@1- (0.15,70.05) [-83.55|223.5] "C" Vector__XXX
 SG_ PCS2_a031_DcacBAc1TempUpperThres m31 : 27|11@1- (0.15,70.05) [-83.55|223.5] "C" Vector__XXX
 SG_ PCS2_a032_DcacBAc2Temp m32 : 16|11@1- (0.15,70.05) [-83.55|223.5] "C" Vector__XXX
 SG_ PCS2_a032_DcacBAc2TempUpperThres m32 : 27|11@1- (0.15,70.05) [-83.55|223.5] "C" Vector__XXX
 SG_ PCS2_a034_lvBusVoltage m34 : 16|13@1+ (0.01,0) [0|81.91] "V" Vector__XXX
 SG_ PCS2_a034_voltageFaultThreshold m34 : 32|13@1+ (0.01,0) [0|81.91] "V" Vector__XXX
 SG_ PCS2_a035_lvBusVoltage m35 : 16|13@1+ (0.01,0) [0|81.91] "V" Vector__XXX
 SG_ PCS2_a035_voltageFaultThreshold m35 : 32|13@1+ (0.01,0) [0|81.91] "V" Vector__XXX
 SG_ PCS2_a036_hvBusVoltage m36 : 16|11@1+ (1,0) [0|2047] "V" Vector__XXX
 SG_ PCS2_a036_hvBusTopVoltage m36 : 27|11@1+ (1,0) [0|2047] "V" Vector__XXX
 SG_ PCS2_a036_hvBusBotVoltage m36 : 38|11@1+ (1,0) [0|2047] "V" Vector__XXX
 SG_ PCS2_a036_voltageFaultThreshold m36 : 49|11@1+ (1,0) [0|2047] "V" Vector__XXX
 SG_ PCS2_a037_hvBusVoltage m37 : 16|11@1+ (1,0) [0|2047] "V" Vector__XXX
 SG_ PCS2_a037_hvBusTopVoltage m37 : 27|11@1+ (1,0) [0|2047] "V" Vector__XXX
 SG_ PCS2_a037_hvBusBotVoltage m37 : 38|11@1+ (1,0) [0|2047] "V" Vector__XXX
 SG_ PCS2_a037_voltageFaultThreshold m37 : 49|11@1+ (1,0) [0|2047] "V" Vector__XXX
 SG_ PCS2_a038_hvBusVoltage m38 : 16|11@1+ (1,0) [0|2047] "V" Vector__XXX
 SG_ PCS2_a038_hvBusTopVoltage m38 : 27|11@1+ (1,0) [0|2047] "V" Vector__XXX
 SG_ PCS2_a038_hvBusBotVoltage m38 : 38|11@1+ (1,0) [0|2047] "V" Vector__XXX
 SG_ PCS2_a038_voltageFaultThreshold m38 : 49|11@1+ (1,0) [0|2047] "V" Vector__XXX
 SG_ PCS2_a039_hvBusVoltage m39 : 16|11@1+ (1,0) [0|2047] "V" Vector__XXX
 SG_ PCS2_a039_hvBusTopVoltage m39 : 27|11@1+ (1,0) [0|2047] "V" Vector__XXX
 SG_ PCS2_a039_hvBusBotVoltage m39 : 38|11@1+ (1,0) [0|2047] "V" Vector__XXX
 SG_ PCS2_a039_voltageFaultThreshold m39 : 49|11@1+ (1,0) [0|2047] "V" Vector__XXX
 SG_ PCS2_a040_hvBusVoltage m40 : 16|11@1+ (1,0) [0|2047] "V" Vector__XXX
 SG_ PCS2_a040_hvBusTopVoltage m40 : 27|11@1+ (1,0) [0|2047] "V" Vector__XXX
 SG_ PCS2_a040_hvBusBotVoltage m40 : 38|11@1+ (1,0) [0|2047] "V" Vector__XXX
 SG_ PCS2_a040_voltageFaultThreshold m40 : 49|11@1+ (1,0) [0|2047] "V" Vector__XXX
 SG_ PCS2_a041_hvBusVoltage m41 : 16|11@1+ (1,0) [0|2047] "V" Vector__XXX
 SG_ PCS2_a041_hvBusTopVoltage m41 : 27|11@1+ (1,0) [0|2047] "V" Vector__XXX
 SG_ PCS2_a041_hvBusBotVoltage m41 : 38|11@1+ (1,0) [0|2047] "V" Vector__XXX
 SG_ PCS2_a041_voltageFaultThreshold m41 : 49|11@1+ (1,0) [0|2047] "V" Vector__XXX
 SG_ PCS2_a043_hvBattVoltage m43 : 16|11@1+ (1,0) [0|2047] "V" Vector__XXX
 SG_ PCS2_a043_hvBattTopVoltage m43 : 27|11@1+ (1,0) [0|2047] "V" Vector__XXX
 SG_ PCS2_a043_hvBattBotVoltage m43 : 38|11@1+ (1,0) [0|2047] "V" Vector__XXX
 SG_ PCS2_a043_voltageFaultThreshold m43 : 49|11@1+ (1,0) [0|2047] "V" Vector__XXX
 SG_ PCS2_a044_hvBattVoltage m44 : 16|11@1+ (1,0) [0|2047] "V" Vector__XXX
 SG_ PCS2_a044_hvBattTopVoltage m44 : 27|11@1+ (1,0) [0|2047] "V" Vector__XXX
 SG_ PCS2_a044_hvBattBotVoltage m44 : 38|11@1+ (1,0) [0|2047] "V" Vector__XXX
 SG_ PCS2_a044_voltageFaultThreshold m44 : 49|11@1+ (1,0) [0|2047] "V" Vector__XXX
 SG_ PCS2_a045_hvBattVoltage m45 : 16|11@1+ (1,0) [0|2047] "V" Vector__XXX
 SG_ PCS2_a045_hvBattTopVoltage m45 : 27|11@1+ (1,0) [0|2047] "V" Vector__XXX
 SG_ PCS2_a045_hvBattBotVoltage m45 : 38|11@1+ (1,0) [0|2047] "V" Vector__XXX
 SG_ PCS2_a045_voltageFaultThreshold m45 : 49|11@1+ (1,0) [0|2047] "V" Vector__XXX
 SG_ PCS2_a046_hvBattVoltage m46 : 16|11@1+ (1,0) [0|2047] "V" Vector__XXX
 SG_ PCS2_a046_hvBattTopVoltage m46 : 27|11@1+ (1,0) [0|2047] "V" Vector__XXX
 SG_ PCS2_a046_hvBattBotVoltage m46 : 38|11@1+ (1,0) [0|2047] "V" Vector__XXX
 SG_ PCS2_a046_voltageFaultThreshold m46 : 49|11@1+ (1,0) [0|2047] "V" Vector__XXX
 SG_ PCS2_a047_hvBattVoltage m47 : 16|11@1+ (1,0) [0|2047] "V" Vector__XXX
 SG_ PCS2_a047_hvBattTopVoltage m47 : 27|11@1+ (1,0) [0|2047] "V" Vector__XXX
 SG_ PCS2_a047_hvBattBotVoltage m47 : 38|11@1+ (1,0) [0|2047] "V" Vector__XXX
 SG_ PCS2_a047_voltageFaultThreshold m47 : 49|11@1+ (1,0) [0|2047] "V" Vector__XXX
 SG_ PCS2_a048_hvBusVoltage m48 : 16|11@1+ (1,0) [0|2047] "V" Vector__XXX
 SG_ PCS2_a048_hvBusTopVoltage m48 : 27|11@1+ (1,0) [0|2047] "V" Vector__XXX
 SG_ PCS2_a048_hvBusBotVoltage m48 : 38|11@1+ (1,0) [0|2047] "V" Vector__XXX
 SG_ PCS2_a048_voltageFaultThreshold m48 : 49|11@1+ (1,0) [0|2047] "V" Vector__XXX
 SG_ PCS2_a049_hvBusVoltage m49 : 16|11@1+ (1,0) [0|2047] "V" Vector__XXX
 SG_ PCS2_a049_hvBusTopVoltage m49 : 27|11@1+ (1,0) [0|2047] "V" Vector__XXX
 SG_ PCS2_a049_hvBusBotVoltage m49 : 38|11@1+ (1,0) [0|2047] "V" Vector__XXX
 SG_ PCS2_a049_voltageFaultThreshold m49 : 49|11@1+ (1,0) [0|2047] "V" Vector__XXX
 SG_ PCS2_a050_VC_pcsInterface m50 : 16|1@1+ (1,0) [0|1] "" Vector__XXX
 SG_ PCS2_a052_CP_chargeStatus m52 : 16|1@1+ (1,0) [0|1] "" Vector__XXX
 SG_ PCS2_a052_CP_status m52 : 17|1@1+ (1,0) [0|1] "" Vector__XXX
 SG_ PCS2_a052_CP_gridFormControl m52 : 18|1@1+ (1,0) [0|1] "" Vector__XXX
 SG_ PCS2_a052_CP_eptoStatus m52 : 19|1@1+ (1,0) [0|1] "" Vector__XXX
 SG_ PCS2_a053_HV_dcdcControl m53 : 16|1@1+ (1,0) [0|1] "" Vector__XXX
 SG_ PCS2_a053_HVP_hvsControl m53 : 17|1@1+ (1,0) [0|1] "" Vector__XXX
 SG_ PCS2_a054_UI_chargeRequest m54 : 16|1@1+ (1,0) [0|1] "" Vector__XXX
 SG_ PCS2_a055_tankCapacitanceDefined m55 : 16|1@1+ (1,0) [0|1] "" Vector__XXX
 SG_ PCS2_a055_leakageInductanceDefin m55 : 17|1@1+ (1,0) [0|1] "" Vector__XXX
 SG_ PCS2_a055_magnetizingInductanceD m55 : 18|1@1+ (1,0) [0|1] "" Vector__XXX
 SG_ PCS2_a056_tankCapacitanceDefined m56 : 16|1@1+ (1,0) [0|1] "" Vector__XXX
 SG_ PCS2_a056_leakageInductanceDefin m56 : 17|1@1+ (1,0) [0|1] "" Vector__XXX
 SG_ PCS2_a056_magnetizingInductanceD m56 : 18|1@1+ (1,0) [0|1] "" Vector__XXX
 SG_ PCS2_a057_tankCapacitanceDefined m57 : 16|1@1+ (1,0) [0|1] "" Vector__XXX
 SG_ PCS2_a057_leakageInductanceDefin m57 : 17|1@1+ (1,0) [0|1] "" Vector__XXX
 SG_ PCS2_a057_magnetizingInductanceD m57 : 18|1@1+ (1,0) [0|1] "" Vector__XXX
 SG_ PCS2_a058_tankCapacitanceDefined m58 : 16|1@1+ (1,0) [0|1] "" Vector__XXX
 SG_ PCS2_a058_leakageInductanceDefin m58 : 17|1@1+ (1,0) [0|1] "" Vector__XXX
 SG_ PCS2_a058_magnetizingInductanceD m58 : 18|1@1+ (1,0) [0|1] "" Vector__XXX
 SG_ PCS2_a059_dcdcHvcEnableLineTZLat m59 : 16|1@1+ (1,0) [0|1] "" Vector__XXX
 SG_ PCS2_a059_dcdcHvcEnableLineStatu m59 : 17|1@1+ (1,0) [0|1] "" Vector__XXX
 SG_ PCS2_a059_dcdcVcrEnableLineTZLat m59 : 18|1@1+ (1,0) [0|1] "" Vector__XXX
 SG_ PCS2_a059_dcdcVcrEnableLineStatu m59 : 19|1@1+ (1,0) [0|1] "" Vector__XXX
 SG_ PCS2_a059_dcdcStageState m59 : 20|3@1+ (1,0) [0|7] "" Vector__XXX
 SG_ PCS2_a059_dcdcStageRequestProces m59 : 24|2@1+ (1,0) [0|3] "" Vector__XXX
 SG_ PCS2_a059_dcdcRequest m59 : 26|2@1+ (1,0) [0|3] "" Vector__XXX
 SG_ PCS2_a060_maxRetriesAllowed m60 : 16|4@1+ (1,0) [0|15] "" Vector__XXX
 SG_ PCS2_a060_retryCount m60 : 20|4@1+ (1,0) [0|15] "" Vector__XXX
 SG_ PCS2_a060_pauseRequestedByDcdc m60 : 24|1@1+ (1,0) [0|1] "" Vector__XXX
 SG_ PCS2_a061_maxRetriesAllowed m61 : 16|4@1+ (1,0) [0|15] "" Vector__XXX
 SG_ PCS2_a061_retryCount m61 : 20|4@1+ (1,0) [0|15] "" Vector__XXX
 SG_ PCS2_a061_pauseRequestedByDcdc m61 : 24|1@1+ (1,0) [0|1] "" Vector__XXX
 SG_ PCS2_a062_acL1NVrms m62 : 16|7@1+ (3,0) [0|381] "V" Vector__XXX
 SG_ PCS2_a062_acL2NVrms m62 : 24|7@1+ (3,0) [0|381] "V" Vector__XXX
 SG_ PCS2_a062_acL3NVrms m62 : 32|7@1+ (3,0) [0|381] "V" Vector__XXX
 SG_ PCS2_a062_acL1L2Vrms m62 : 39|7@1+ (3,0) [0|381] "V" Vector__XXX
 SG_ PCS2_a062_acL1L3Vrms m62 : 46|7@1+ (3,0) [0|381] "V" Vector__XXX
 SG_ PCS2_a062_acL2L3Vrms m62 : 53|7@1+ (3,0) [0|381] "V" Vector__XXX
 SG_ PCS2_a063_phase_diff_L1N_L2N m63 : 16|8@1+ (1,0) [0|255] "Deg" Vector__XXX
 SG_ PCS2_a063_phase_diff_L1N_L3N m63 : 24|8@1+ (1,0) [0|255] "Deg" Vector__XXX
 SG_ PCS2_a063_phase_diff_L2N_L3N m63 : 32|8@1+ (1,0) [0|255] "Deg" Vector__XXX
 SG_ PCS2_a063_phase_diff_L1L3_L2L3 m63 : 40|8@1+ (1,0) [0|255] "Deg" Vector__XXX
 SG_ PCS2_a063_L1NAvailableForChargin m63 : 48|1@1+ (1,0) [0|1] "" Vector__XXX
 SG_ PCS2_a063_L2NAvailableForChargin m63 : 49|1@1+ (1,0) [0|1] "" Vector__XXX
 SG_ PCS2_a063_L3NAvailableForChargin m63 : 50|1@1+ (1,0) [0|1] "" Vector__XXX
 SG_ PCS2_a063_L1L2AvailableForChargi m63 : 51|1@1+ (1,0) [0|1] "" Vector__XXX
 SG_ PCS2_a063_L1L3AvailableForChargi m63 : 52|1@1+ (1,0) [0|1] "" Vector__XXX
 SG_ PCS2_a063_L2L3AvailableForChargi m63 : 53|1@1+ (1,0) [0|1] "" Vector__XXX
 SG_ PCS2_a064_leakageInductance m64 : 16|11@1+ (0.1,0) [0|204.7] "uH" Vector__XXX
 SG_ PCS2_a064_leakageInductanceOutOf m64 : 27|1@1+ (1,0) [0|1] "" Vector__XXX
 SG_ PCS2_a064_magnetizingInductance m64 : 32|15@1+ (0.1,0) [0|3276.7] "uH" Vector__XXX
 SG_ PCS2_a064_magnetizingInductanceO m64 : 47|1@1+ (1,0) [0|1] "" Vector__XXX
 SG_ PCS2_a064_capacitance m64 : 48|9@1+ (0.05,15) [15|40.55] "nF" Vector__XXX
 SG_ PCS2_a064_capacitanceOutOfSpec m64 : 57|1@1+ (1,0) [0|1] "" Vector__XXX
 SG_ PCS2_a065_leakageInductance m65 : 16|11@1+ (0.1,0) [0|204.7] "uH" Vector__XXX
 SG_ PCS2_a065_leakageInductanceOutOf m65 : 27|1@1+ (1,0) [0|1] "" Vector__XXX
 SG_ PCS2_a065_magnetizingInductance m65 : 32|15@1+ (0.1,0) [0|3276.7] "uH" Vector__XXX
 SG_ PCS2_a065_magnetizingInductanceO m65 : 47|1@1+ (1,0) [0|1] "" Vector__XXX
 SG_ PCS2_a065_capacitance m65 : 48|9@1+ (0.05,15) [15|40.55] "nF" Vector__XXX
 SG_ PCS2_a065_capacitanceOutOfSpec m65 : 57|1@1+ (1,0) [0|1] "" Vector__XXX
 SG_ PCS2_a066_leakageInductance m66 : 16|11@1+ (0.1,0) [0|204.7] "uH" Vector__XXX
 SG_ PCS2_a066_leakageInductanceOutOf m66 : 27|1@1+ (1,0) [0|1] "" Vector__XXX
 SG_ PCS2_a066_magnetizingInductance m66 : 32|15@1+ (0.1,0) [0|3276.7] "uH" Vector__XXX
 SG_ PCS2_a066_magnetizingInductanceO m66 : 47|1@1+ (1,0) [0|1] "" Vector__XXX
 SG_ PCS2_a066_capacitance m66 : 48|10@1+ (0.1,50) [50|152.3] "nF" Vector__XXX
 SG_ PCS2_a066_capacitanceOutOfSpec m66 : 58|1@1+ (1,0) [0|1] "" Vector__XXX
 SG_ PCS2_a067_leakageInductance m67 : 16|11@1+ (0.1,0) [0|204.7] "uH" Vector__XXX
 SG_ PCS2_a067_leakageInductanceOutOf m67 : 27|1@1+ (1,0) [0|1] "" Vector__XXX
 SG_ PCS2_a067_magnetizingInductance m67 : 32|15@1+ (0.1,0) [0|3276.7] "uH" Vector__XXX
 SG_ PCS2_a067_magnetizingInductanceO m67 : 47|1@1+ (1,0) [0|1] "" Vector__XXX
 SG_ PCS2_a067_capacitance m67 : 48|10@1+ (0.1,50) [50|152.3] "nF" Vector__XXX
 SG_ PCS2_a067_capacitanceOutOfSpec m67 : 58|1@1+ (1,0) [0|1] "" Vector__XXX
 SG_ PCS2_a068_recordProblemBitfield m68 : 16|8@1+ (1,0) [0|255] "" Vector__XXX
 SG_ PCS2_a068_diagnosticWord m68 : 24|32@1+ (1,0) [0|4294967295] "" Vector__XXX
 SG_ PCS2_a069_recordNotFound m69 : 16|1@1+ (1,0) [0|1] "" Vector__XXX
 SG_ PCS2_a069_recordOversized m69 : 17|1@1+ (1,0) [0|1] "" Vector__XXX
 SG_ PCS2_a069_recordUndersized m69 : 18|1@1+ (1,0) [0|1] "" Vector__XXX
 SG_ PCS2_a069_recordVersionMismatch m69 : 19|1@1+ (1,0) [0|1] "" Vector__XXX
 SG_ PCS2_a069_recordCRCMismatch m69 : 20|1@1+ (1,0) [0|1] "" Vector__XXX
 SG_ PCS2_a070_recordNotFound m70 : 16|1@1+ (1,0) [0|1] "" Vector__XXX
 SG_ PCS2_a070_recordOversized m70 : 17|1@1+ (1,0) [0|1] "" Vector__XXX
 SG_ PCS2_a070_recordUndersized m70 : 18|1@1+ (1,0) [0|1] "" Vector__XXX
 SG_ PCS2_a070_recordVersionMismatch m70 : 19|1@1+ (1,0) [0|1] "" Vector__XXX
 SG_ PCS2_a070_recordCRCMismatch m70 : 20|1@1+ (1,0) [0|1] "" Vector__XXX
 SG_ PCS2_a071_hvBattBotSensorMeasure m71 : 16|12@1- (1,0) [-2048|2047] "V" Vector__XXX
 SG_ PCS2_a071_hvBattExternalRefValue m71 : 28|11@1+ (1,0) [0|2046] "V" Vector__XXX
 SG_ PCS2_a072_hvBattTopSensorMeasure m72 : 16|12@1- (1,0) [-2048|2047] "V" Vector__XXX
 SG_ PCS2_a072_hvBattExternalRefValue m72 : 28|11@1+ (1,0) [0|2046] "V" Vector__XXX
 SG_ PCS2_a073_hvBusBotSensorMeasurem m73 : 16|12@1- (1,0) [-2048|2047] "V" Vector__XXX
 SG_ PCS2_a073_hvBusExternalRefValue m73 : 28|11@1+ (1,0) [0|2046] "V" Vector__XXX
 SG_ PCS2_a074_hvBusTopSensorMeasurem m74 : 16|12@1- (1,0) [-2048|2047] "V" Vector__XXX
 SG_ PCS2_a074_hvBusExternalRefValue m74 : 28|11@1+ (1,0) [0|2046] "V" Vector__XXX
 SG_ PCS2_a075_hvBattFullSensorMeasur m75 : 16|12@1- (1,0) [-2048|2047] "V" Vector__XXX
 SG_ PCS2_a075_hvBattExternalRefValue m75 : 28|11@1+ (1,0) [0|2046] "V" Vector__XXX
 SG_ PCS2_a075_hvBattTopBottomVoltage m75 : 40|11@1+ (1,0) [0|2047] "V" Vector__XXX
 SG_ PCS2_a076_hvBusFullSensorMeasure m76 : 16|12@1- (1,0) [-2048|2047] "V" Vector__XXX
 SG_ PCS2_a076_hvBusExternalRefValue m76 : 28|11@1+ (1,0) [0|2046] "V" Vector__XXX
 SG_ PCS2_a076_hvBusTopBottomVoltageD m76 : 40|11@1+ (1,0) [0|2047] "V" Vector__XXX
 SG_ PCS2_a077_lvBusVoltageMeasuremen m77 : 16|13@1+ (0.01,0) [0|81.91] "V" Vector__XXX
 SG_ PCS2_a077_lvBusExternalRefValue m77 : 32|13@1+ (0.01,0) [0|81.91] "V" Vector__XXX
 SG_ PCS2_a078_acL1NVoltageOffset m78 : 16|13@1- (0.5,0) [-2048|2047.5] "V" Vector__XXX
 SG_ PCS2_a078_acL1NVoltageRMS m78 : 32|7@1+ (3,0) [0|381] "V" Vector__XXX
 SG_ PCS2_a079_acL2NVoltageOffset m79 : 16|13@1- (0.5,0) [-2048|2047.5] "V" Vector__XXX
 SG_ PCS2_a079_acL2NVoltageRMS m79 : 32|7@1+ (3,0) [0|381] "V" Vector__XXX
 SG_ PCS2_a080_acL3NVoltageOffset m80 : 16|13@1- (0.5,0) [-2048|2047.5] "V" Vector__XXX
 SG_ PCS2_a080_acL3NVoltageRMS m80 : 32|7@1+ (3,0) [0|381] "V" Vector__XXX
 SG_ PCS2_a081_acL1CurrentOffset m81 : 16|12@1- (0.5,0) [-1024|1023.5] "A" Vector__XXX
 SG_ PCS2_a081_acL1CurrentRMS m81 : 28|11@1- (0.1,0) [-102.4|102.3] "A" Vector__XXX
 SG_ PCS2_a082_acL2CurrentOffset m82 : 16|12@1- (0.5,0) [-1024|1023.5] "A" Vector__XXX
 SG_ PCS2_a082_acL2CurrentRMS m82 : 28|11@1- (0.1,0) [-102.4|102.3] "A" Vector__XXX
 SG_ PCS2_a083_acL3CurrentOffset m83 : 16|12@1- (0.5,0) [-1024|1023.5] "A" Vector__XXX
 SG_ PCS2_a083_acL3CurrentRMS m83 : 28|11@1- (0.1,0) [-102.4|102.3] "A" Vector__XXX
 SG_ PCS2_a084_acNCurrentOffset m84 : 16|12@1- (0.5,0) [-1024|1023.5] "A" Vector__XXX
 SG_ PCS2_a084_acNCurrentRMS m84 : 28|11@1- (0.1,0) [-102.4|102.3] "A" Vector__XXX
 SG_ PCS2_a085_dcacEnableLineStatus m85 : 16|1@1+ (1,0) [0|1] "" Vector__XXX
 SG_ PCS2_a085_dcacTZFlagStatus m85 : 17|1@1+ (1,0) [0|1] "" Vector__XXX
 SG_ PCS2_a085_bmsEnableRequest m85 : 18|1@1+ (1,0) [0|1] "" Vector__XXX
 SG_ PCS2_a085_outletGridFormEnableRe m85 : 19|1@1+ (1,0) [0|1] "" Vector__XXX
 SG_ PCS2_a085_cpGridFormEnableReques m85 : 20|1@1+ (1,0) [0|1] "" Vector__XXX
 SG_ PCS2_a085_packEOLGridFormEnableR m85 : 21|1@1+ (1,0) [0|1] "" Vector__XXX
 SG_ PCS2_a086_lvBusVoltage m86 : 16|13@1+ (0.01,0) [0|81.91] "V" Vector__XXX
 SG_ PCS2_a086_voltageFaultThreshold m86 : 32|13@1+ (0.01,0) [0|81.91] "V" Vector__XXX
 SG_ PCS2_a087_lvBusVoltage m87 : 16|13@1+ (0.01,0) [0|81.91] "V" Vector__XXX
 SG_ PCS2_a087_voltageFaultThreshold m87 : 32|13@1+ (0.01,0) [0|81.91] "V" Vector__XXX
 SG_ PCS2_a088_linesFaulted m88 : 16|3@1+ (1,0) [0|7] "" Vector__XXX
 SG_ PCS2_a088_startVoltageRms m88 : 24|7@1+ (3,0) [0|381] "V" Vector__XXX
 SG_ PCS2_a088_underVoltageRmsThresho m88 : 32|7@1+ (3,0) [0|381] "V" Vector__XXX
 SG_ PCS2_a088_presentVoltageRms m88 : 40|7@1+ (3,0) [0|381] "V" Vector__XXX
 SG_ PCS2_a088_presentCurrentRms m88 : 47|9@1+ (2,0) [0|1022] "A" Vector__XXX
 SG_ PCS2_a088_gridConfig m88 : 56|2@1+ (1,0) [1|3] "" Vector__XXX
 SG_ PCS2_a090_DcdcModelLvMosfetTemp m90 : 16|9@1- (1,106) [-150|361] "C" Vector__XXX
 SG_ PCS2_a090_DcdcModelLvMosfetCoola m90 : 25|9@1- (1,106) [-150|361] "C" Vector__XXX
 SG_ PCS2_a090_DcDcModelLvMosfetCoola m90 : 40|8@1+ (0.2,0) [0|51] "LPM" Vector__XXX
 SG_ PCS2_a090_DcDcModelLVMosfetCurre m90 : 48|7@1+ (1,0) [0|127] "A" Vector__XXX
 SG_ PCS2_a091_DcdcModelTxWindingTemp m91 : 16|9@1- (1,106) [-150|361] "C" Vector__XXX
 SG_ PCS2_a091_DcdcModelTxWindingCool m91 : 25|9@1- (1,106) [-150|361] "C" Vector__XXX
 SG_ PCS2_a091_DcDcModelTxWindingCool m91 : 40|8@1+ (0.2,0) [0|51] "LPM" Vector__XXX
 SG_ PCS2_a091_DcDcModelTxWindingCurr m91 : 48|7@1+ (1,0) [0|127] "A" Vector__XXX
 SG_ PCS2_a094_cycloABlockedReason m94 : 16|3@1+ (1,0) [0|7] "" Vector__XXX
 SG_ PCS2_a094_cycloBBlockedReason m94 : 19|3@1+ (1,0) [0|7] "" Vector__XXX
 SG_ PCS2_a095_cycloABlockedReason m95 : 16|3@1+ (1,0) [0|7] "" Vector__XXX
 SG_ PCS2_a095_cycloBBlockedReason m95 : 19|3@1+ (1,0) [0|7] "" Vector__XXX
 SG_ PCS2_a096_VCSUPER_thermalStatus1 m96 : 16|1@1+ (1,0) [0|1] "" Vector__XXX
 SG_ PCS2_a097_GTW_carState m97 : 16|1@1+ (1,0) [0|1] "" Vector__XXX
 SG_ PCS2_a098_EGGRIGHT3_thermalComma m98 : 16|1@1+ (1,0) [0|1] "" Vector__XXX
 SG_ PCS2_a099_lineFaulted m99 : 16|2@1+ (1,0) [0|3] "" Vector__XXX
 SG_ PCS2_a099_lineToChassisVoltageRm m99 : 24|7@1+ (3,0) [0|381] "V" Vector__XXX
 SG_ PCS2_a099_neutralToChassisVoltag m99 : 32|7@1+ (3,0) [0|381] "V" Vector__XXX
 SG_ PCS2_a099_overVoltageRmsThreshol m99 : 40|7@1+ (3,0) [0|381] "V" Vector__XXX
 SG_ PCS2_a099_iticCurveSection m99 : 48|3@1+ (1,0) [0|7] "" Vector__XXX
 SG_ PCS2_a100_linesFaulted m100 : 16|3@1+ (1,0) [0|7] "" Vector__XXX
 SG_ PCS2_a100_lineToLineVoltageRms m100 : 24|7@1+ (3,0) [0|381] "V" Vector__XXX
 SG_ PCS2_a100_overVoltageRmsThreshol m100 : 32|7@1+ (3,0) [0|381] "V" Vector__XXX
 SG_ PCS2_a100_iticCurveSection m100 : 40|3@1+ (1,0) [0|7] "" Vector__XXX
 SG_ PCS2_a101_lineFaulted m101 : 16|2@1+ (1,0) [0|3] "" Vector__XXX
 SG_ PCS2_a101_lineToChassisVoltage m101 : 18|11@1- (1,0) [-1024|1023] "V" Vector__XXX
 SG_ PCS2_a101_neutralToChassisVoltag m101 : 29|8@1- (5,0) [-640|635] "V" Vector__XXX
 SG_ PCS2_a101_lineToChassisVoltageRm m101 : 37|7@1+ (3,0) [0|381] "V" Vector__XXX
 SG_ PCS2_a101_overVoltageThreshold m101 : 44|11@1- (1,0) [-1024|1023] "V" Vector__XXX
 SG_ PCS2_a101_iticCurveSection m101 : 55|3@1+ (1,0) [0|7] "" Vector__XXX
 SG_ PCS2_a102_linesFaulted m102 : 16|3@1+ (1,0) [0|7] "" Vector__XXX
 SG_ PCS2_a102_lineToLineVoltage m102 : 19|11@1- (1,0) [-1024|1023] "V" Vector__XXX
 SG_ PCS2_a102_lineToLineVoltageRms m102 : 32|7@1+ (3,0) [0|381] "V" Vector__XXX
 SG_ PCS2_a102_overVoltageThreshold m102 : 40|11@1- (1,0) [-1024|1023] "V" Vector__XXX
 SG_ PCS2_a102_iticCurveSection m102 : 51|3@1+ (1,0) [0|7] "" Vector__XXX
 SG_ PCS2_a103_IsoTempSensor m103 : 16|4@1+ (1,0) [0|15] "" Vector__XXX
 SG_ PCS2_a103_IsoTempSenseIrrational m103 : 20|1@1+ (1,0) [0|1] "" Vector__XXX
 SG_ PCS2_a103_IsoTempSenseOutOfBound m103 : 21|1@1+ (1,0) [0|1] "" Vector__XXX
 SG_ PCS2_a103_IsoTempSensorFallTimeO m103 : 22|1@1+ (1,0) [0|1] "" Vector__XXX
 SG_ PCS2_a103_IsoTempSensorRiseTimeO m103 : 23|1@1+ (1,0) [0|1] "" Vector__XXX
 SG_ PCS2_a103_IsoTempSensorMIA m103 : 24|1@1+ (1,0) [0|1] "" Vector__XXX
 SG_ PCS2_a103_IsoTempSensorRiseFallM m103 : 25|1@1+ (1,0) [0|1] "" Vector__XXX
 SG_ PCS2_a103_RiseTimeOpenLoop m103 : 26|11@1+ (50,0) [0|102350] "nS" Vector__XXX
 SG_ PCS2_a103_FallTimeOpenLoop m103 : 37|11@1+ (50,0) [0|102350] "nS" Vector__XXX
 SG_ PCS2_a103_ClosedLoopTime m103 : 48|11@1+ (50,0) [0|102350] "nS" Vector__XXX
 SG_ PCS2_a104_lineFaulted m104 : 16|2@1+ (1,0) [0|3] "" Vector__XXX
 SG_ PCS2_a104_lineToChassisVoltageRm m104 : 24|7@1+ (3,0) [0|381] "V" Vector__XXX
 SG_ PCS2_a104_underVoltageRmsThresho m104 : 32|7@1+ (3,0) [0|381] "V" Vector__XXX
 SG_ PCS2_a104_iticCurveSection m104 : 40|2@1+ (1,0) [0|3] "" Vector__XXX
 SG_ PCS2_a105_linesFaulted m105 : 16|3@1+ (1,0) [0|7] "" Vector__XXX
 SG_ PCS2_a105_lineToLineVoltageRms m105 : 24|7@1+ (3,0) [0|381] "V" Vector__XXX
 SG_ PCS2_a105_underVoltageRmsThresho m105 : 32|7@1+ (3,0) [0|381] "V" Vector__XXX
 SG_ PCS2_a105_iticCurveSection m105 : 40|2@1+ (1,0) [0|3] "" Vector__XXX
 SG_ PCS2_a106_systemNeutral m106 : 16|2@1+ (1,0) [0|3] "" Vector__XXX
 SG_ PCS2_a106_systemNeutralToChassis m106 : 24|7@1+ (3,0) [0|381] "V" Vector__XXX
 SG_ PCS2_a106_overVoltageThreshold m106 : 32|7@1+ (3,0) [0|381] "V" Vector__XXX
 SG_ PCS2_a110_deratingFactorThreshol m110 : 16|7@1+ (0.01,0) [0|1.27] "-" Vector__XXX
 SG_ PCS2_a110_combinedDeratingFactor m110 : 24|7@1+ (0.01,0) [0|1.27] "-" Vector__XXX
 SG_ PCS2_a110_txTempDeratingFactor m110 : 32|7@1+ (0.01,0) [0|1.27] "-" Vector__XXX
 SG_ PCS2_a110_dcTempDeratingFactor m110 : 39|7@1+ (0.01,0) [0|1.27] "-" Vector__XXX
 SG_ PCS2_a110_inductorLossDeratingFa m110 : 46|7@1+ (0.01,0) [0|1.27] "-" Vector__XXX
 SG_ PCS2_a110_junctionTempDeratingFa m110 : 53|7@1+ (0.01,0) [0|1.27] "-" Vector__XXX
 SG_ PCS2_a112_linesFaulted m112 : 16|3@1+ (1,0) [0|7] "" Vector__XXX
 SG_ PCS2_a112_startVoltageRms m112 : 24|7@1+ (3,0) [0|381] "V" Vector__XXX
 SG_ PCS2_a112_underVoltageRmsThresho m112 : 32|7@1+ (3,0) [0|381] "V" Vector__XXX
 SG_ PCS2_a112_presentVoltageRms m112 : 40|7@1+ (3,0) [0|381] "V" Vector__XXX
 SG_ PCS2_a113_receivedCoolantFlow m113 : 16|9@1+ (0.1,0) [0|51.1] "LPM" Vector__XXX
 SG_ PCS2_a113_receivedCoolantTemp m113 : 25|11@1- (0.15,70.05) [-83.55|223.5] "C" Vector__XXX
 SG_ PCS2_a113_sensedCoolantTemp m113 : 36|11@1- (0.15,70.05) [-83.55|223.5] "C" Vector__XXX
 SG_ PCS2_a113_localNoFlowDetectionSt m113 : 47|1@1+ (1,0) [0|1] "" Vector__XXX
 SG_ PCS2_a113_remoteNoFlowDetectionS m113 : 48|1@1+ (1,0) [0|1] "" Vector__XXX
 SG_ PCS2_a114_estimatedHvbusCapacita m114 : 16|10@1+ (10,0) [0|10230] "uF" Vector__XXX
 SG_ PCS2_a114_estimatedResistanceLin m114 : 26|16@1+ (10,0) [0|655350] "ohm" Vector__XXX
 SG_ PCS2_a114_estimatedResistanceLog m114 : 42|16@1+ (10,0) [0|655350] "ohm" Vector__XXX
 SG_ PCS2_a114_useLinearResult m114 : 58|1@1+ (1,0) [0|1] "" Vector__XXX
 SG_ PCS2_a114_useLogarithmResult m114 : 59|1@1+ (1,0) [0|1] "" Vector__XXX
 SG_ PCS2_a115_lineVoltage m115 : 16|7@1+ (3,0) [0|381] "V" Vector__XXX
 SG_ PCS2_a116_chgRetryCount m116 : 16|9@1+ (0.1,0) [0|51.1] "-" Vector__XXX
 SG_ PCS2_a116_maxChgRetriesAllowed m116 : 25|9@1+ (0.1,0) [0|51.1] "-" Vector__XXX
 SG_ PCS2_a117_VCRIGHT_LVHealth m117 : 16|1@1+ (1,0) [0|1] "" Vector__XXX
 SG_ PCS2_a118_presentHvBusVoltage m118 : 16|11@1+ (1,0) [0|2047] "V" Vector__XXX
 SG_ PCS2_a118_hvVoltageTarget m118 : 27|11@1+ (1,0) [0|2047] "V" Vector__XXX
 SG_ PCS2_a118_presentLvBusVoltage m118 : 40|13@1+ (0.01,0) [0|81.91] "V" Vector__XXX
 SG_ PCS2_a118_failedToReachFixedTarg m118 : 53|1@1+ (1,0) [0|1] "" Vector__XXX
 SG_ PCS2_a119_presentHvBusVoltage m119 : 16|11@1+ (1,0) [0|2047] "V" Vector__XXX
 SG_ PCS2_a119_startUpHvVoltage m119 : 27|11@1+ (1,0) [0|2047] "V" Vector__XXX
 SG_ PCS2_a119_presentLvBusVoltage m119 : 40|13@1+ (0.01,0) [0|81.91] "V" Vector__XXX
 SG_ PCS2_a122_recordNotFound m122 : 16|1@1+ (1,0) [0|1] "" Vector__XXX
 SG_ PCS2_a122_recordOversized m122 : 17|1@1+ (1,0) [0|1] "" Vector__XXX
 SG_ PCS2_a122_recordUndersized m122 : 18|1@1+ (1,0) [0|1] "" Vector__XXX
 SG_ PCS2_a122_recordVersionMismatch m122 : 19|1@1+ (1,0) [0|1] "" Vector__XXX
 SG_ PCS2_a122_recordCRCMismatch m122 : 20|1@1+ (1,0) [0|1] "" Vector__XXX
 SG_ PCS2_a123_DcdcBHvTemp m123 : 16|11@1- (0.15,70.05) [-83.55|223.5] "C" Vector__XXX
 SG_ PCS2_a123_DcdcBHvTempUpperThresh m123 : 27|11@1- (0.15,70.05) [-83.55|223.5] "C" Vector__XXX
 SG_ PCS2_a127_acLineClkHealthStatus m127 : 16|2@1+ (1,0) [0|3] "" Vector__XXX
 SG_ PCS2_a127_dcac1_L1EnableHealthSt m127 : 18|2@1+ (1,0) [0|3] "" Vector__XXX
 SG_ PCS2_a127_dcac1_L2EnableHealthSt m127 : 20|2@1+ (1,0) [0|3] "" Vector__XXX
 SG_ PCS2_a127_dcac1_L3EnableHealthSt m127 : 22|2@1+ (1,0) [0|3] "" Vector__XXX
 SG_ PCS2_a127_dcac1_LNEnableHealthSt m127 : 24|2@1+ (1,0) [0|3] "" Vector__XXX
 SG_ PCS2_a127_dcac1_acTankClkHealthS m127 : 26|2@1+ (1,0) [0|3] "" Vector__XXX
 SG_ PCS2_a127_dcac1_dcTankClkHealthS m127 : 28|2@1+ (1,0) [0|3] "" Vector__XXX
 SG_ PCS2_a127_dcac1_hvEnableHealthSt m127 : 30|2@1+ (1,0) [0|3] "" Vector__XXX
 SG_ PCS2_a127_dcac1_HealthCheckRetry m127 : 32|5@1+ (1,0) [0|31] "" Vector__XXX
 SG_ PCS2_a127_dcac1_HealthCheckMaxRe m127 : 40|5@1+ (1,0) [0|31] "" Vector__XXX
 SG_ PCS2_a128_acLineClkHealthStatus m128 : 16|2@1+ (1,0) [0|3] "" Vector__XXX
 SG_ PCS2_a128_dcac2_L1EnableHealthSt m128 : 18|2@1+ (1,0) [0|3] "" Vector__XXX
 SG_ PCS2_a128_dcac2_L2EnableHealthSt m128 : 20|2@1+ (1,0) [0|3] "" Vector__XXX
 SG_ PCS2_a128_dcac2_L3EnableHealthSt m128 : 22|2@1+ (1,0) [0|3] "" Vector__XXX
 SG_ PCS2_a128_dcac2_LNEnableHealthSt m128 : 24|2@1+ (1,0) [0|3] "" Vector__XXX
 SG_ PCS2_a128_dcac2_acTankClkHealthS m128 : 26|2@1+ (1,0) [0|3] "" Vector__XXX
 SG_ PCS2_a128_dcac2_dcTankClkHealthS m128 : 28|2@1+ (1,0) [0|3] "" Vector__XXX
 SG_ PCS2_a128_dcac2_hvEnableHealthSt m128 : 30|2@1+ (1,0) [0|3] "" Vector__XXX
 SG_ PCS2_a128_dcac2_HealthCheckRetry m128 : 32|5@1+ (1,0) [0|31] "" Vector__XXX
 SG_ PCS2_a128_dcac2_HealthCheckMaxRe m128 : 40|5@1+ (1,0) [0|31] "" Vector__XXX
 SG_ PCS2_a129_hvBusVoltage m129 : 16|7@1+ (10,100) [100|1370] "V" Vector__XXX
 SG_ PCS2_a129_lvBusVoltage m129 : 24|10@1+ (0.1,0) [0|102.3] "V" Vector__XXX
 SG_ PCS2_a129_instantMeasuredZCDEven m129 : 34|9@1+ (5,-1000) [-1000|1555] "ns" Vector__XXX
 SG_ PCS2_a129_instantMeasuredZCDHalf m129 : 43|7@1+ (0.01,0) [0|1.27] "-" Vector__XXX
 SG_ PCS2_a129_commandedSwitchFreq m129 : 50|10@1+ (1,150) [150|1173] "kHz" Vector__XXX
 SG_ PCS2_a130_serverStateAtRetry m130 : 16|3@1+ (1,0) [0|7] "" Vector__XXX
 SG_ PCS2_a130_retriesAttempted m130 : 24|8@1+ (1,0) [0|255] "" Vector__XXX
 SG_ PCS2_a132_gridFrequency m132 : 16|13@1+ (0.01,0) [0|81.91] "Hz" Vector__XXX
 SG_ PCS2_a132_L1NGridVoltage m132 : 29|8@1+ (2,0) [0|510] "V" Vector__XXX
 SG_ PCS2_a132_L2NGridVoltage m132 : 37|8@1+ (2,0) [0|510] "V" Vector__XXX
 SG_ PCS2_a132_L3NGridVoltage m132 : 45|8@1+ (2,0) [0|510] "V" Vector__XXX
 SG_ PCS2_a132_currentLimit m132 : 53|7@1+ (1,0) [0|127] "A" Vector__XXX
 SG_ PCS2_a136_failedSequence m136 : 16|4@1+ (1,0) [0|15] "" Vector__XXX
 SG_ PCS2_a136_mosfetLegUnderTest m136 : 20|3@1+ (1,0) [0|7] "" Vector__XXX
 SG_ PCS2_a136_mosfetIndexUnderTest m136 : 24|4@1+ (1,0) [0|15] "" Vector__XXX
 SG_ PCS2_a136_measuredResonantFreque m136 : 28|15@1+ (0.1,0) [0|3276.7] "kHz" Vector__XXX
 SG_ PCS2_a136_retryCount m136 : 43|4@1+ (1,0) [0|15] "" Vector__XXX
 SG_ PCS2_a136_acVoltagePresent m136 : 47|1@1+ (1,0) [0|1] "" Vector__XXX
 SG_ PCS2_a136_pwmTrippedDuringHealth m136 : 48|1@1+ (1,0) [0|1] "" Vector__XXX
 SG_ PCS2_a136_dcacEnableLineDeassert m136 : 49|1@1+ (1,0) [0|1] "" Vector__XXX
 SG_ PCS2_a136_hvdcOverCurrentTripHas m136 : 50|1@1+ (1,0) [0|1] "" Vector__XXX
 SG_ PCS2_a136_lineOverCurrentTripHas m136 : 51|1@1+ (1,0) [0|1] "" Vector__XXX
 SG_ PCS2_a136_lineOverVoltageTripHas m136 : 52|1@1+ (1,0) [0|1] "" Vector__XXX
 SG_ PCS2_a136_powerRailTripHasOccurr m136 : 53|1@1+ (1,0) [0|1] "" Vector__XXX
 SG_ PCS2_a136_hvBusVoltageTripHasOcc m136 : 54|1@1+ (1,0) [0|1] "" Vector__XXX
 SG_ PCS2_a136_lvBusVoltageTripHasOcc m136 : 55|1@1+ (1,0) [0|1] "" Vector__XXX
 SG_ PCS2_a136_tankFreqZeroWithEdgeDe m136 : 56|1@1+ (1,0) [0|1] "" Vector__XXX
 SG_ PCS2_a136_resultExempted m136 : 57|1@1+ (1,0) [0|1] "" Vector__XXX
 SG_ PCS2_a137_failedSequence m137 : 16|4@1+ (1,0) [0|15] "" Vector__XXX
 SG_ PCS2_a137_mosfetLegUnderTest m137 : 20|3@1+ (1,0) [0|7] "" Vector__XXX
 SG_ PCS2_a137_mosfetIndexUnderTest m137 : 24|4@1+ (1,0) [0|15] "" Vector__XXX
 SG_ PCS2_a137_measuredResonantFreque m137 : 28|15@1+ (0.1,0) [0|3276.7] "kHz" Vector__XXX
 SG_ PCS2_a137_retryCount m137 : 43|4@1+ (1,0) [0|15] "" Vector__XXX
 SG_ PCS2_a137_acVoltagePresent m137 : 47|1@1+ (1,0) [0|1] "" Vector__XXX
 SG_ PCS2_a137_pwmTrippedDuringHealth m137 : 48|1@1+ (1,0) [0|1] "" Vector__XXX
 SG_ PCS2_a137_dcacEnableLineDeassert m137 : 49|1@1+ (1,0) [0|1] "" Vector__XXX
 SG_ PCS2_a137_hvdcOverCurrentTripHas m137 : 50|1@1+ (1,0) [0|1] "" Vector__XXX
 SG_ PCS2_a137_lineOverCurrentTripHas m137 : 51|1@1+ (1,0) [0|1] "" Vector__XXX
 SG_ PCS2_a137_lineOverVoltageTripHas m137 : 52|1@1+ (1,0) [0|1] "" Vector__XXX
 SG_ PCS2_a137_powerRailTripHasOccurr m137 : 53|1@1+ (1,0) [0|1] "" Vector__XXX
 SG_ PCS2_a137_hvBusVoltageTripHasOcc m137 : 54|1@1+ (1,0) [0|1] "" Vector__XXX
 SG_ PCS2_a137_lvBusVoltageTripHasOcc m137 : 55|1@1+ (1,0) [0|1] "" Vector__XXX
 SG_ PCS2_a137_tankFreqZeroWithEdgeDe m137 : 56|1@1+ (1,0) [0|1] "" Vector__XXX
 SG_ PCS2_a137_resultExempted m137 : 57|1@1+ (1,0) [0|1] "" Vector__XXX
 SG_ PCS2_a138_hvdcCurrentOffset m138 : 16|10@1- (0.1,0) [-51.2|51.1] "A" Vector__XXX
 SG_ PCS2_a138_hvdcCurrentOffsetThres m138 : 26|10@1- (0.1,0) [-51.2|51.1] "A" Vector__XXX
 SG_ PCS2_a141_boostOverCurrentThresh m141 : 16|13@1- (0.1,0) [-409.6|409.5] "A" Vector__XXX
 SG_ PCS2_a142_AcLineGdpsDataMissing m142 : 16|1@1+ (1,0) [0|1] "" Vector__XXX
 SG_ PCS2_a142_AcLineGdpsDataOutOfSpe m142 : 17|1@1+ (1,0) [0|1] "" Vector__XXX
 SG_ PCS2_a142_AcLineGdpsDataStale m142 : 18|1@1+ (1,0) [0|1] "" Vector__XXX
 SG_ PCS2_a143_AcTankGdpsDataMissing m143 : 16|1@1+ (1,0) [0|1] "" Vector__XXX
 SG_ PCS2_a143_AcTankGdpsDataOutOfSpe m143 : 17|1@1+ (1,0) [0|1] "" Vector__XXX
 SG_ PCS2_a143_AcTankGdpsDataStale m143 : 18|1@1+ (1,0) [0|1] "" Vector__XXX
 SG_ PCS2_a144_DcTankGdpsDataMissing m144 : 16|1@1+ (1,0) [0|1] "" Vector__XXX
 SG_ PCS2_a144_DcTankGdpsDataOutOfSpe m144 : 17|1@1+ (1,0) [0|1] "" Vector__XXX
 SG_ PCS2_a144_DcTankGdpsDataStale m144 : 18|1@1+ (1,0) [0|1] "" Vector__XXX
 SG_ PCS2_a145_DcdcHvdcGdpsDataMissin m145 : 16|1@1+ (1,0) [0|1] "" Vector__XXX
 SG_ PCS2_a145_DcdcHvdcGdpsDataOutOfS m145 : 17|1@1+ (1,0) [0|1] "" Vector__XXX
 SG_ PCS2_a145_DcdcHvdcGdpsDataStale m145 : 18|1@1+ (1,0) [0|1] "" Vector__XXX
 SG_ PCS2_a146_leg1_Irms m146 : 16|10@1+ (0.1,0) [0|102.3] "A" Vector__XXX
 SG_ PCS2_a146_leg2_Irms m146 : 26|10@1+ (0.1,0) [0|102.3] "A" Vector__XXX
 SG_ PCS2_a146_leg3_Irms m146 : 36|10@1+ (0.1,0) [0|102.3] "A" Vector__XXX
 SG_ PCS2_a146_legN_Irms m146 : 46|10@1+ (0.1,0) [0|102.3] "A" Vector__XXX
 SG_ PCS2_a146_legs_paralleled_by_rel m146 : 56|1@1+ (1,0) [0|1] "" Vector__XXX
 SG_ PCS2_a146_ac_harness_l2_l3_short m146 : 57|1@1+ (1,0) [0|1] "" Vector__XXX
 SG_ PCS2_a147_4V5RailOverVoltageTrip m147 : 16|1@1+ (1,0) [0|1] "" Vector__XXX
 SG_ PCS2_a147_10V0RailOverVoltageTri m147 : 17|1@1+ (1,0) [0|1] "" Vector__XXX
 SG_ PCS2_a147_13V5RailOverVoltageTri m147 : 18|1@1+ (1,0) [0|1] "" Vector__XXX
 SG_ PCS2_a147_18V0RailOverVoltageTri m147 : 19|1@1+ (1,0) [0|1] "" Vector__XXX
 SG_ PCS2_a147_48V0RailOverVoltageTri m147 : 20|1@1+ (1,0) [0|1] "" Vector__XXX
 SG_ PCS2_a147_BuckBoostLVInputOVTrip m147 : 21|1@1+ (1,0) [0|1] "" Vector__XXX
 SG_ PCS2_a147_4V5RailOverVoltageThre m147 : 24|5@1+ (1,0) [0|31] "V" Vector__XXX
 SG_ PCS2_a147_10V0RailOverVoltageThr m147 : 32|5@1+ (1,0) [0|31] "V" Vector__XXX
 SG_ PCS2_a147_13V5RailOverVoltageThr m147 : 37|5@1+ (1,0) [0|31] "V" Vector__XXX
 SG_ PCS2_a147_18V0RailOverVoltageThr m147 : 42|5@1+ (1,0) [0|31] "V" Vector__XXX
 SG_ PCS2_a147_48V0RailOverVoltageThr m147 : 47|7@1+ (1,0) [0|127] "V" Vector__XXX
 SG_ PCS2_a147_BuckBoostLVInputOVThre m147 : 54|5@1+ (1,0) [0|31] "V" Vector__XXX
 SG_ PCS2_a148_l1nPostRelayVoltage m148 : 16|7@1- (10,0) [-640|630] "V" Vector__XXX
 SG_ PCS2_a148_l2nPostRelayVoltage m148 : 24|7@1- (10,0) [-640|630] "V" Vector__XXX
 SG_ PCS2_a148_l3nPostRelayVoltage m148 : 32|7@1- (10,0) [-640|630] "V" Vector__XXX
 SG_ PCS2_a148_l2nPreRelayVoltage m148 : 40|7@1- (10,0) [-640|630] "V" Vector__XXX
 SG_ PCS2_a148_l3nPreRelayVoltage m148 : 48|7@1- (10,0) [-640|630] "V" Vector__XXX
 SG_ PCS2_a148_acRelayState m148 : 56|3@1+ (1,0) [0|7] "" Vector__XXX
 SG_ PCS2_a149_buckBoostPermanentFaul m149 : 16|1@1+ (1,0) [0|1] "" Vector__XXX
 SG_ PCS2_a149_buckBoostRampFaultCoun m149 : 17|5@1+ (1,0) [0|31] "" Vector__XXX
 SG_ PCS2_a149_buckBoostCmpssFaultCou m149 : 24|5@1+ (1,0) [0|31] "" Vector__XXX
 SG_ PCS2_a149_buckBoost18VOVFault m149 : 29|1@1+ (1,0) [0|1] "" Vector__XXX
 SG_ PCS2_a149_buckBoostInputOVFault m149 : 30|1@1+ (1,0) [0|1] "" Vector__XXX
 SG_ PCS2_a149_buckBoost18VLeakyBucke m149 : 31|1@1+ (1,0) [0|1] "" Vector__XXX
 SG_ PCS2_a149_buckBoost18VUVCmpssFau m149 : 32|1@1+ (1,0) [0|1] "" Vector__XXX
 SG_ PCS2_a149_buckBoostLVOVCmpssFaul m149 : 33|1@1+ (1,0) [0|1] "" Vector__XXX
 SG_ PCS2_a149_buckBoostLVUVCmpssFaul m149 : 34|1@1+ (1,0) [0|1] "" Vector__XXX
 SG_ PCS2_a149_buckBoostRetryPrevente m149 : 35|1@1+ (1,0) [0|1] "" Vector__XXX
 SG_ PCS2_a149_buckBoostRampTarget m149 : 36|12@1+ (0.01,0) [0|40.94] "V" Vector__XXX
 SG_ PCS2_a150_presentBurstMode m150 : 16|2@1+ (1,0) [0|3] "" Vector__XXX
 SG_ PCS2_a150_previousBurstMode m150 : 18|2@1+ (1,0) [0|3] "" Vector__XXX
 SG_ PCS2_a150_levelNotFinishedCounts m150 : 24|6@1+ (1,0) [0|63] "" Vector__XXX
 SG_ PCS2_a150_burstOnCycles m150 : 32|3@1+ (1,0) [0|7] "" Vector__XXX
 SG_ PCS2_a151_DcdcBLv1Temp m151 : 16|11@1- (0.15,70.05) [-83.55|223.5] "C" Vector__XXX
 SG_ PCS2_a151_DcdcBLv1TempUpperThres m151 : 27|11@1- (0.15,70.05) [-83.55|223.5] "C" Vector__XXX
 SG_ PCS2_a152_DcdcBLv3Temp m152 : 16|11@1- (0.15,70.05) [-83.55|223.5] "C" Vector__XXX
 SG_ PCS2_a152_DcdcBLv3TempUpperThres m152 : 27|11@1- (0.15,70.05) [-83.55|223.5] "C" Vector__XXX
 SG_ PCS2_a154_adcReferenceDataMissin m154 : 16|1@1+ (1,0) [0|1] "" Vector__XXX
 SG_ PCS2_a154_adcReferenceOutOfSpec m154 : 17|1@1+ (1,0) [0|1] "" Vector__XXX
 SG_ PCS2_a155_VC_LVHealth m155 : 16|1@1+ (1,0) [0|1] "" Vector__XXX
 SG_ PCS2_a156_VCFRONT_coolant m156 : 16|1@1+ (1,0) [0|1] "" Vector__XXX
 SG_ PCS2_a156_VCFRONT_sensors m156 : 17|1@1+ (1,0) [0|1] "" Vector__XXX
 SG_ PCS2_a157_VC_pcsManagement m157 : 16|1@1+ (1,0) [0|1] "" Vector__XXX
 SG_ PCS2_a158_DcdcModelHvMosfetTemp m158 : 16|9@1- (1,106) [-150|361] "C" Vector__XXX
 SG_ PCS2_a158_DcdcModelHvMosfetCoola m158 : 25|9@1- (1,106) [-150|361] "C" Vector__XXX
 SG_ PCS2_a158_DcDcModelHvMosfetCoola m158 : 40|8@1+ (0.2,0) [0|51] "LPM" Vector__XXX
 SG_ PCS2_a158_DcDcModelHvMosfetCurre m158 : 48|7@1+ (1,0) [0|127] "A" Vector__XXX
 SG_ PCS2_a159_HVDCGdpsHealthStatus m159 : 16|2@1+ (1,0) [0|3] "" Vector__XXX
 SG_ PCS2_a160_VCLEFT_networkManageme m160 : 16|1@1+ (1,0) [0|1] "" Vector__XXX
 SG_ PCS2_a161_VCREAR_networkManageme m161 : 16|1@1+ (1,0) [0|1] "" Vector__XXX
 SG_ PCS2_a170_pcsMaxAcPowerAvailable m170 : 16|8@1+ (0.1,0) [0|25.5] "kW" Vector__XXX
 SG_ PCS2_a170_pcsMaxAcPowerCapabilit m170 : 24|8@1+ (0.1,0) [0|25.5] "kW" Vector__XXX
 SG_ PCS2_a170_numberOfCycloStagesAva m170 : 32|2@1+ (1,0) [0|3] "-" Vector__XXX
 SG_ PCS2_a170_detectedPhaseConfig m170 : 34|3@1+ (1,0) [0|7] "" Vector__XXX
 SG_ PCS2_a173_DcdcALv1Temp m173 : 16|11@1- (0.15,70.05) [-83.55|223.5] "C" Vector__XXX
 SG_ PCS2_a173_DcdcALv1TempUpperThres m173 : 27|11@1- (0.15,70.05) [-83.55|223.5] "C" Vector__XXX
 SG_ PCS2_a174_llc48V0RailOverCurrent m174 : 16|1@1+ (1,0) [0|1] "" Vector__XXX
 SG_ PCS2_a174_llc48V0RailMaxThreshol m174 : 17|9@1+ (0.01,0) [0|5.11] "A" Vector__XXX
 SG_ PCS2_a177_latchMotorRailOverCurr m177 : 16|1@1+ (1,0) [0|1] "" Vector__XXX
 SG_ PCS2_a177_latchMotorRailMaxThres m177 : 17|9@1+ (0.01,0) [0|5.11] "A" Vector__XXX
 SG_ PCS2_a180_DcdcModelTxHATTemp m180 : 16|9@1- (1,106) [-150|361] "C" Vector__XXX
 SG_ PCS2_a180_DcdcModelTxHATCoolantT m180 : 25|9@1- (1,106) [-150|361] "C" Vector__XXX
 SG_ PCS2_a180_DcDcModelTxHATCoolantF m180 : 40|8@1+ (0.2,0) [0|51] "LPM" Vector__XXX
 SG_ PCS2_a180_DcDcModelTxHATCurrent m180 : 48|7@1+ (1,0) [0|127] "A" Vector__XXX

BO_ 996 PCS2_alertMatrix: 8 PCS2
 SG_ PCS2_matrixIndex M : 0|4@1+ (1,0) [0|15] "" Vector__XXX
 SG_ PCS2_a001_watchdogAlarmed m0 : 4|1@1+ (1,0) [0|1] "" Vector__XXX
 SG_ PCS2_a002_canRationality m0 : 5|1@1+ (1,0) [0|1] "" Vector__XXX
 SG_ PCS2_a003_softwareAssertion m0 : 6|1@1+ (1,0) [0|1] "" Vector__XXX
 SG_ PCS2_a004_acL1NOverVoltage m0 : 7|1@1+ (1,0) [0|1] "" Vector__XXX
 SG_ PCS2_a005_acL1OverCurrent m0 : 8|1@1+ (1,0) [0|1] "" Vector__XXX
 SG_ PCS2_a006_acL2NOverVoltage m0 : 9|1@1+ (1,0) [0|1] "" Vector__XXX
 SG_ PCS2_a007_acL2OverCurrent m0 : 10|1@1+ (1,0) [0|1] "" Vector__XXX
 SG_ PCS2_a008_acL3NOverVoltage m0 : 11|1@1+ (1,0) [0|1] "" Vector__XXX
 SG_ PCS2_a009_acL3OverCurrent m0 : 12|1@1+ (1,0) [0|1] "" Vector__XXX
 SG_ PCS2_a010_acLNOverCurrent m0 : 13|1@1+ (1,0) [0|1] "" Vector__XXX
 SG_ PCS2_a011_hvdcOverCurrent m0 : 14|1@1+ (1,0) [0|1] "" Vector__XXX
 SG_ PCS2_a012_cycloATankOverCurrent m0 : 15|1@1+ (1,0) [0|1] "" Vector__XXX
 SG_ PCS2_a013_DcdcALv2OverTemp m0 : 16|1@1+ (1,0) [0|1] "" Vector__XXX
 SG_ PCS2_a014_cycloBTankOverCurrent m0 : 17|1@1+ (1,0) [0|1] "" Vector__XXX
 SG_ PCS2_a015_DcdcAHvOverTemp m0 : 18|1@1+ (1,0) [0|1] "" Vector__XXX
 SG_ PCS2_a016_dcdcATankOverCurrent m0 : 19|1@1+ (1,0) [0|1] "" Vector__XXX
 SG_ PCS2_a017_DcdcBLv2OverTemp m0 : 20|1@1+ (1,0) [0|1] "" Vector__XXX
 SG_ PCS2_a018_dcdcBTankOverCurrent m0 : 21|1@1+ (1,0) [0|1] "" Vector__XXX
 SG_ PCS2_a019_DcacADcTempTooHigh m0 : 22|1@1+ (1,0) [0|1] "" Vector__XXX
 SG_ PCS2_a020_DcacBDcTempTooHigh m0 : 23|1@1+ (1,0) [0|1] "" Vector__XXX
 SG_ PCS2_a021_powerRailUnderVoltage m0 : 24|1@1+ (1,0) [0|1] "" Vector__XXX
 SG_ PCS2_a022_dcacEnableFunctionalit m0 : 25|1@1+ (1,0) [0|1] "" Vector__XXX
 SG_ PCS2_a023_dcdcEnableFunctionalit m0 : 26|1@1+ (1,0) [0|1] "" Vector__XXX
 SG_ PCS2_a024_DcacATxTempTooHigh m0 : 27|1@1+ (1,0) [0|1] "" Vector__XXX
 SG_ PCS2_a025_DcacBTxTempTooHigh m0 : 28|1@1+ (1,0) [0|1] "" Vector__XXX
 SG_ PCS2_a026_AcConnectorTempTooHigh m0 : 29|1@1+ (1,0) [0|1] "" Vector__XXX
 SG_ PCS2_a027_AmbientTempTooHigh m0 : 30|1@1+ (1,0) [0|1] "" Vector__XXX
 SG_ PCS2_a028_CoolantTempTooHigh m0 : 31|1@1+ (1,0) [0|1] "" Vector__XXX
 SG_ PCS2_a029_DcacAAc1TempTooHigh m0 : 32|1@1+ (1,0) [0|1] "" Vector__XXX
 SG_ PCS2_a030_DcacAAc2TempTooHigh m0 : 33|1@1+ (1,0) [0|1] "" Vector__XXX
 SG_ PCS2_a031_DcacBAc1TempTooHigh m0 : 34|1@1+ (1,0) [0|1] "" Vector__XXX
 SG_ PCS2_a032_DcacBAc2TempTooHigh m0 : 35|1@1+ (1,0) [0|1] "" Vector__XXX
 SG_ PCS2_a033_swCoreExcessiveUsage m0 : 36|1@1+ (1,0) [0|1] "" Vector__XXX
 SG_ PCS2_a034_lvBusOverVoltage m0 : 37|1@1+ (1,0) [0|1] "" Vector__XXX
 SG_ PCS2_a035_lvBusUnderVoltage m0 : 38|1@1+ (1,0) [0|1] "" Vector__XXX
 SG_ PCS2_a036_hvBusOverVoltage m0 : 39|1@1+ (1,0) [0|1] "" Vector__XXX
 SG_ PCS2_a037_hvBusUnderVoltage m0 : 40|1@1+ (1,0) [0|1] "" Vector__XXX
 SG_ PCS2_a038_hvBusTopOverVoltage m0 : 41|1@1+ (1,0) [0|1] "" Vector__XXX
 SG_ PCS2_a039_hvBusTopUnderVoltage m0 : 42|1@1+ (1,0) [0|1] "" Vector__XXX
 SG_ PCS2_a040_hvBusBotOverVoltage m0 : 43|1@1+ (1,0) [0|1] "" Vector__XXX
 SG_ PCS2_a041_hvBusBotUnderVoltage m0 : 44|1@1+ (1,0) [0|1] "" Vector__XXX
 SG_ PCS2_a042_hvBattOverVoltage m0 : 45|1@1+ (1,0) [0|1] "" Vector__XXX
 SG_ PCS2_a043_hvBattUnderVoltage m0 : 46|1@1+ (1,0) [0|1] "" Vector__XXX
 SG_ PCS2_a044_hvBattTopOverVoltage m0 : 47|1@1+ (1,0) [0|1] "" Vector__XXX
 SG_ PCS2_a045_hvBattTopUnderVoltage m0 : 48|1@1+ (1,0) [0|1] "" Vector__XXX
 SG_ PCS2_a046_hvBattBotOverVoltage m0 : 49|1@1+ (1,0) [0|1] "" Vector__XXX
 SG_ PCS2_a047_hvBattBotUnderVoltage m0 : 50|1@1+ (1,0) [0|1] "" Vector__XXX
 SG_ PCS2_a048_dcacOverVoltage m0 : 51|1@1+ (1,0) [0|1] "" Vector__XXX
 SG_ PCS2_a049_dcacUnderVoltage m0 : 52|1@1+ (1,0) [0|1] "" Vector__XXX
 SG_ PCS2_a050_vcPcsDCDCInterfaceMia m0 : 53|1@1+ (1,0) [0|1] "" Vector__XXX
 SG_ PCS2_a051_bmsMia m0 : 54|1@1+ (1,0) [0|1] "" Vector__XXX
 SG_ PCS2_a052_cpMia m0 : 55|1@1+ (1,0) [0|1] "" Vector__XXX
 SG_ PCS2_a053_hvDcdcControlMIA m0 : 56|1@1+ (1,0) [0|1] "" Vector__XXX
 SG_ PCS2_a054_uiMia m0 : 57|1@1+ (1,0) [0|1] "" Vector__XXX
 SG_ PCS2_a055_dcdcATankUncalibrated m0 : 58|1@1+ (1,0) [0|1] "" Vector__XXX
 SG_ PCS2_a056_dcdcBTankUncalibrated m0 : 59|1@1+ (1,0) [0|1] "" Vector__XXX
 SG_ PCS2_a057_cycloATankUncalibrated m0 : 60|1@1+ (1,0) [0|1] "" Vector__XXX
 SG_ PCS2_a058_cycloBTankUncalibrated m0 : 61|1@1+ (1,0) [0|1] "" Vector__XXX
 SG_ PCS2_a059_dcdcEnableLineDeassert m0 : 62|1@1+ (1,0) [0|1] "" Vector__XXX
 SG_ PCS2_a060_cycloAFaulted m0 : 63|1@1+ (1,0) [0|1] "" Vector__XXX
 SG_ PCS2_a061_cycloBFaulted m1 : 4|1@1+ (1,0) [0|1] "" Vector__XXX
 SG_ PCS2_a062_acVoltageNotPresent m1 : 5|1@1+ (1,0) [0|1] "" Vector__XXX
 SG_ PCS2_a063_chgUnknownGridConfig m1 : 6|1@1+ (1,0) [0|1] "" Vector__XXX
 SG_ PCS2_a064_dcdcATankParametersOut m1 : 7|1@1+ (1,0) [0|1] "" Vector__XXX
 SG_ PCS2_a065_dcdcBTankParametersOut m1 : 8|1@1+ (1,0) [0|1] "" Vector__XXX
 SG_ PCS2_a066_cycloATankParametersOu m1 : 9|1@1+ (1,0) [0|1] "" Vector__XXX
 SG_ PCS2_a067_cycloBTankParametersOu m1 : 10|1@1+ (1,0) [0|1] "" Vector__XXX
 SG_ PCS2_a068_nvmSubsystemStalled m1 : 11|1@1+ (1,0) [0|1] "" Vector__XXX
 SG_ PCS2_a069_dcdcAlifetimeEnergyRec m1 : 12|1@1+ (1,0) [0|1] "" Vector__XXX
 SG_ PCS2_a070_dcdcBlifetimeEnergyRec m1 : 13|1@1+ (1,0) [0|1] "" Vector__XXX
 SG_ PCS2_a071_hvBattBotSensorIrratio m1 : 14|1@1+ (1,0) [0|1] "" Vector__XXX
 SG_ PCS2_a072_hvBattTopSensorIrratio m1 : 15|1@1+ (1,0) [0|1] "" Vector__XXX
 SG_ PCS2_a073_hvBusBotSensorIrration m1 : 16|1@1+ (1,0) [0|1] "" Vector__XXX
 SG_ PCS2_a074_hvBusTopSensorIrration m1 : 17|1@1+ (1,0) [0|1] "" Vector__XXX
 SG_ PCS2_a075_hvBattFullSensorIrrati m1 : 18|1@1+ (1,0) [0|1] "" Vector__XXX
 SG_ PCS2_a076_hvBusFullSensorIrratio m1 : 19|1@1+ (1,0) [0|1] "" Vector__XXX
 SG_ PCS2_a077_lvBusVoltSensorIrratio m1 : 20|1@1+ (1,0) [0|1] "" Vector__XXX
 SG_ PCS2_a078_acL1NVoltageOffsetIrra m1 : 21|1@1+ (1,0) [0|1] "" Vector__XXX
 SG_ PCS2_a079_acL2NVoltageOffsetIrra m1 : 22|1@1+ (1,0) [0|1] "" Vector__XXX
 SG_ PCS2_a080_acL3NVoltageOffsetIrra m1 : 23|1@1+ (1,0) [0|1] "" Vector__XXX
 SG_ PCS2_a081_acL1CurrentOffsetIrrat m1 : 24|1@1+ (1,0) [0|1] "" Vector__XXX
 SG_ PCS2_a082_acL2CurrentOffsetIrrat m1 : 25|1@1+ (1,0) [0|1] "" Vector__XXX
 SG_ PCS2_a083_acL3CurrentOffsetIrrat m1 : 26|1@1+ (1,0) [0|1] "" Vector__XXX
 SG_ PCS2_a084_acNCurrentOffsetIrrati m1 : 27|1@1+ (1,0) [0|1] "" Vector__XXX
 SG_ PCS2_a085_dcacEnableLineDeassert m1 : 28|1@1+ (1,0) [0|1] "" Vector__XXX
 SG_ PCS2_a086_dcacLVUnderVoltage m1 : 29|1@1+ (1,0) [0|1] "" Vector__XXX
 SG_ PCS2_a087_dcacLVOverVoltage m1 : 30|1@1+ (1,0) [0|1] "" Vector__XXX
 SG_ PCS2_a088_chgInputVDropHigh m1 : 31|1@1+ (1,0) [0|1] "" Vector__XXX
 SG_ PCS2_a089_EndOfLineModeActivated m1 : 32|1@1+ (1,0) [0|1] "" Vector__XXX
 SG_ PCS2_a090_DcdcLvMosfetTempTooHig m1 : 33|1@1+ (1,0) [0|1] "" Vector__XXX
 SG_ PCS2_a091_DcdcTxWindingTempTooHi m1 : 34|1@1+ (1,0) [0|1] "" Vector__XXX
 SG_ PCS2_a092_dcdc_itankZcdIrrationa m1 : 35|1@1+ (1,0) [0|1] "" Vector__XXX
 SG_ PCS2_a093_cycloPwmsNotInterleave m1 : 36|1@1+ (1,0) [0|1] "" Vector__XXX
 SG_ PCS2_a094_acChargingUnavailable m1 : 37|1@1+ (1,0) [0|1] "" Vector__XXX
 SG_ PCS2_a095_powershareUnavailable m1 : 38|1@1+ (1,0) [0|1] "" Vector__XXX
 SG_ PCS2_a096_vcsuperMia m1 : 39|1@1+ (1,0) [0|1] "" Vector__XXX
 SG_ PCS2_a097_gtwMia m1 : 40|1@1+ (1,0) [0|1] "" Vector__XXX
 SG_ PCS2_a098_eggright3Mia m1 : 41|1@1+ (1,0) [0|1] "" Vector__XXX
 SG_ PCS2_a099_LineChassisRmsOV m1 : 42|1@1+ (1,0) [0|1] "" Vector__XXX
 SG_ PCS2_a100_LineToLineRmsOV m1 : 43|1@1+ (1,0) [0|1] "" Vector__XXX
 SG_ PCS2_a101_LineChassisInstantaneo m1 : 44|1@1+ (1,0) [0|1] "" Vector__XXX
 SG_ PCS2_a102_LineToLineInstantaneou m1 : 45|1@1+ (1,0) [0|1] "" Vector__XXX
 SG_ PCS2_a103_IsoTempSensorIrrationa m1 : 46|1@1+ (1,0) [0|1] "" Vector__XXX
 SG_ PCS2_a104_LineChassisRmsUV m1 : 47|1@1+ (1,0) [0|1] "" Vector__XXX
 SG_ PCS2_a105_LineToLineRmsUV m1 : 48|1@1+ (1,0) [0|1] "" Vector__XXX
 SG_ PCS2_a106_systemNeutralChassisRm m1 : 49|1@1+ (1,0) [0|1] "" Vector__XXX
 SG_ PCS2_a107_cycloLostCurrentContro m1 : 50|1@1+ (1,0) [0|1] "" Vector__XXX
 SG_ PCS2_a108_FunctionalTestModeActi m1 : 51|1@1+ (1,0) [0|1] "" Vector__XXX
 SG_ PCS2_a109_ACSurgeProtectionTrigg m1 : 52|1@1+ (1,0) [0|1] "" Vector__XXX
 SG_ PCS2_a110_acCurrentIsLimited m1 : 53|1@1+ (1,0) [0|1] "" Vector__XXX
 SG_ PCS2_a111_microgridHeartbeatMiss m1 : 54|1@1+ (1,0) [0|1] "" Vector__XXX
 SG_ PCS2_a112_chgInputVDropTooHigh m1 : 55|1@1+ (1,0) [0|1] "" Vector__XXX
 SG_ PCS2_a113_dcdcTransientCapabilit m1 : 56|1@1+ (1,0) [0|1] "" Vector__XXX
 SG_ PCS2_a114_hvBusEstimatedImpedanc m1 : 57|1@1+ (1,0) [0|1] "" Vector__XXX
 SG_ PCS2_a115_chgWallPowerRemoval m1 : 58|1@1+ (1,0) [0|1] "" Vector__XXX
 SG_ PCS2_a116_chgPersistentFault m1 : 59|1@1+ (1,0) [0|1] "" Vector__XXX
 SG_ PCS2_a117_vcrightMia m1 : 60|1@1+ (1,0) [0|1] "" Vector__XXX
 SG_ PCS2_a118_dcdcFailedToPrechargeT m1 : 61|1@1+ (1,0) [0|1] "" Vector__XXX
 SG_ PCS2_a119_useMaxCapForHvImpedanc m1 : 62|1@1+ (1,0) [0|1] "" Vector__XXX
 SG_ PCS2_a120_triggerOdin m1 : 63|1@1+ (1,0) [0|1] "" Vector__XXX
 SG_ PCS2_a121_insufficientCoolingDet m2 : 4|1@1+ (1,0) [0|1] "" Vector__XXX
 SG_ PCS2_a122_dcacLifetimekVAhRecord m2 : 5|1@1+ (1,0) [0|1] "" Vector__XXX
 SG_ PCS2_a123_DcdcBHvOverTemp m2 : 6|1@1+ (1,0) [0|1] "" Vector__XXX
 SG_ PCS2_a124_dcacItankSoftwareOC m2 : 7|1@1+ (1,0) [0|1] "" Vector__XXX
 SG_ PCS2_a125_cycloIdleShortingNeutr m2 : 8|1@1+ (1,0) [0|1] "" Vector__XXX
 SG_ PCS2_a126_ipcSuccessiveLockGrabF m2 : 9|1@1+ (1,0) [0|1] "" Vector__XXX
 SG_ PCS2_a127_cycloAgdpsHealthCheckF m2 : 10|1@1+ (1,0) [0|1] "" Vector__XXX
 SG_ PCS2_a128_cycloBgdpsHealthCheckF m2 : 11|1@1+ (1,0) [0|1] "" Vector__XXX
 SG_ PCS2_a129_lossOfZcdEventControl m2 : 12|1@1+ (1,0) [0|1] "" Vector__XXX
 SG_ PCS2_a130_IONVMMServerRetryEvent m2 : 13|1@1+ (1,0) [0|1] "" Vector__XXX
 SG_ PCS2_a131_microgridHeartbeatDete m2 : 14|1@1+ (1,0) [0|1] "" Vector__XXX
 SG_ PCS2_a132_microgridDroopDetected m2 : 15|1@1+ (1,0) [0|1] "" Vector__XXX
 SG_ PCS2_a133_unused m2 : 16|1@1+ (1,0) [0|1] "" Vector__XXX
 SG_ PCS2_a134_unused m2 : 17|1@1+ (1,0) [0|1] "" Vector__XXX
 SG_ PCS2_a135_backgroundTaskOverRun m2 : 18|1@1+ (1,0) [0|1] "" Vector__XXX
 SG_ PCS2_a136_cycloAMosfetHealthChec m2 : 19|1@1+ (1,0) [0|1] "" Vector__XXX
 SG_ PCS2_a137_cycloBMosfetHealthChec m2 : 20|1@1+ (1,0) [0|1] "" Vector__XXX
 SG_ PCS2_a138_hvdcCurrentSensorOffse m2 : 21|1@1+ (1,0) [0|1] "" Vector__XXX
 SG_ PCS2_a139_unused m2 : 22|1@1+ (1,0) [0|1] "" Vector__XXX
 SG_ PCS2_a140_dcdcHalfBusBalancerSat m2 : 23|1@1+ (1,0) [0|1] "" Vector__XXX
 SG_ PCS2_a141_boostOverCurrent m2 : 24|1@1+ (1,0) [0|1] "" Vector__XXX
 SG_ PCS2_a142_AcLineGdpsUncalibrated m2 : 25|1@1+ (1,0) [0|1] "" Vector__XXX
 SG_ PCS2_a143_AcTankGdpsUncalibrated m2 : 26|1@1+ (1,0) [0|1] "" Vector__XXX
 SG_ PCS2_a144_DcTankGdpsUncalibrated m2 : 27|1@1+ (1,0) [0|1] "" Vector__XXX
 SG_ PCS2_a145_DcdcHvdcGdpsUncalibrat m2 : 28|1@1+ (1,0) [0|1] "" Vector__XXX
 SG_ PCS2_a146_acLineSharedCurrentCon m2 : 29|1@1+ (1,0) [0|1] "" Vector__XXX
 SG_ PCS2_a147_powerRailOverVoltage m2 : 30|1@1+ (1,0) [0|1] "" Vector__XXX
 SG_ PCS2_a148_acRelayVoltageIrration m2 : 31|1@1+ (1,0) [0|1] "" Vector__XXX
 SG_ PCS2_a149_buckBoostFault m2 : 32|1@1+ (1,0) [0|1] "" Vector__XXX
 SG_ PCS2_a150_dcdcBurstTimingNotMet m2 : 33|1@1+ (1,0) [0|1] "" Vector__XXX
 SG_ PCS2_a151_DcdcBLv1OverTemp m2 : 34|1@1+ (1,0) [0|1] "" Vector__XXX
 SG_ PCS2_a152_DcdcBLv3OverTemp m2 : 35|1@1+ (1,0) [0|1] "" Vector__XXX
 SG_ PCS2_a153_cyclo_itankZcdIrration m2 : 36|1@1+ (1,0) [0|1] "" Vector__XXX
 SG_ PCS2_a154_adcReferenceUncalibrat m2 : 37|1@1+ (1,0) [0|1] "" Vector__XXX
 SG_ PCS2_a155_vcbatteryMia m2 : 38|1@1+ (1,0) [0|1] "" Vector__XXX
 SG_ PCS2_a156_vcfrontMia m2 : 39|1@1+ (1,0) [0|1] "" Vector__XXX
 SG_ PCS2_a157_VC_pcsManagementMia m2 : 40|1@1+ (1,0) [0|1] "" Vector__XXX
 SG_ PCS2_a158_DcdcHvMosfetTempTooHig m2 : 41|1@1+ (1,0) [0|1] "" Vector__XXX
 SG_ PCS2_a159_dcdcGdpsHealthCheckFai m2 : 42|1@1+ (1,0) [0|1] "" Vector__XXX
 SG_ PCS2_a160_vcleftMia m2 : 43|1@1+ (1,0) [0|1] "" Vector__XXX
 SG_ PCS2_a161_vcrearMia m2 : 44|1@1+ (1,0) [0|1] "" Vector__XXX
 SG_ PCS2_a162_cycloARoutineTankInduc m2 : 45|1@1+ (1,0) [0|1] "" Vector__XXX
 SG_ PCS2_a163_cycloBRoutineTankInduc m2 : 46|1@1+ (1,0) [0|1] "" Vector__XXX
 SG_ PCS2_a164_dcdc_hwZcdFault1 m2 : 47|1@1+ (1,0) [0|1] "" Vector__XXX
 SG_ PCS2_a165_dcdc_hwZcdFault2 m2 : 48|1@1+ (1,0) [0|1] "" Vector__XXX
 SG_ PCS2_a166_dcdcEnableLinePWMTripM m2 : 49|1@1+ (1,0) [0|1] "" Vector__XXX
 SG_ PCS2_a167_unused m2 : 50|1@1+ (1,0) [0|1] "" Vector__XXX
 SG_ PCS2_a168_gridFormVoltageDropped m2 : 51|1@1+ (1,0) [0|1] "" Vector__XXX
 SG_ PCS2_a169_cycloMosfetHealthCheck m2 : 52|1@1+ (1,0) [0|1] "" Vector__XXX
 SG_ PCS2_a170_acChargePowerIsLimited m2 : 53|1@1+ (1,0) [0|1] "" Vector__XXX
 SG_ PCS2_a171_unused m2 : 54|1@1+ (1,0) [0|1] "" Vector__XXX
 SG_ PCS2_a172_unused m2 : 55|1@1+ (1,0) [0|1] "" Vector__XXX
 SG_ PCS2_a173_DcdcALv1OverTemp m2 : 56|1@1+ (1,0) [0|1] "" Vector__XXX
 SG_ PCS2_a174_llc48V0RailOverCurrent m2 : 57|1@1+ (1,0) [0|1] "" Vector__XXX
 SG_ PCS2_a175_LVUVSurgePowerEvent m2 : 58|1@1+ (1,0) [0|1] "" Vector__XXX
 SG_ PCS2_a176_cpLatchMotorUnavailabl m2 : 59|1@1+ (1,0) [0|1] "" Vector__XXX
 SG_ PCS2_a177_latchMotorRailOverCurr m2 : 60|1@1+ (1,0) [0|1] "" Vector__XXX
 SG_ PCS2_a178_eculogAborted m2 : 61|1@1+ (1,0) [0|1] "" Vector__XXX
 SG_ PCS2_a179_standbyPowerUnavailabl m2 : 62|1@1+ (1,0) [0|1] "" Vector__XXX
 SG_ PCS2_a180_DcdcTxHATTempTooHigh m2 : 63|1@1+ (1,0) [0|1] "" Vector__XXX
 SG_ PCS2_d181_dcdcConverterVoltSenso m3 : 4|1@1+ (1,0) [0|1] "" Vector__XXX
 SG_ PCS2_d182_dcdcConverterTempSenso m3 : 5|1@1+ (1,0) [0|1] "" Vector__XXX
 SG_ PCS2_d183_batteryChargerAInputVo m3 : 6|1@1+ (1,0) [0|1] "" Vector__XXX
 SG_ PCS2_d184_batteryChargerAInputCu m3 : 7|1@1+ (1,0) [0|1] "" Vector__XXX
 SG_ PCS2_d185_dcdcConverterANeedsSer m3 : 8|1@1+ (1,0) [0|1] "" Vector__XXX
 SG_ PCS2_d186_batteryChargerAInterna m3 : 9|1@1+ (1,0) [0|1] "" Vector__XXX
 SG_ PCS2_d187_batteryChargerModuleAN m3 : 10|1@1+ (1,0) [0|1] "" Vector__XXX
 SG_ PCS2_a188_prechargeWithLowLVDete m3 : 11|1@1+ (1,0) [0|1] "" Vector__XXX
 SG_ PCS2_a192_otherPcsMia m3 : 12|1@1+ (1,0) [0|1] "" Vector__XXX
 SG_ PCS2_a193_unknownPcsID m3 : 13|1@1+ (1,0) [0|1] "" Vector__XXX
 SG_ PCS2_a194_poorGridSync m3 : 14|1@1+ (1,0) [0|1] "" Vector__XXX
 SG_ PCS2_a197_dcdcEnableLineTransien m3 : 15|1@1+ (1,0) [0|1] "" Vector__XXX

BO_TX_BU_ 1092 : PCS2;
BO_TX_BU_ 996 : PCS2;
CM_ BO_ 1092 "PCS2 ECU message: alert log";
CM_ SG_ 1092 PCS2_alertID "PCS2 ECU: alert ID";
CM_ SG_ 1092 PCS2_alertSet "PCS2 ECU: alert set";
CM_ SG_ 1092 PCS2_alertSource "PCS2 ECU: alert source";
CM_ SG_ 1092 PCS2_a003_assertionCode "PCS2 ECU: a003 assertion code";
CM_ SG_ 1092 PCS2_a005_acL1OverCurrentTrip "PCS2 ECU: a005 ac L1 over current trip";
CM_ SG_ 1092 PCS2_a005_chgMainStateMachineSta "PCS2 ECU: a005 chg main state machine state";
CM_ SG_ 1092 PCS2_a005_gridFormStateMachineSt "PCS2 ECU: a005 grid form state machine state";
CM_ SG_ 1092 PCS2_a005_acManagerOperatingMode "PCS2 ECU: a005 ac manager operating mode";
CM_ SG_ 1092 PCS2_a005_acL1MaxThreshold "PCS2 ECU: a005 ac L1 max threshold";
CM_ SG_ 1092 PCS2_a005_acL1MinThreshold "PCS2 ECU: a005 ac L1 min threshold";
CM_ SG_ 1092 PCS2_a006_acL2NOverVoltageTrip "PCS2 ECU: a006 ac L2 n over voltage trip";
CM_ SG_ 1092 PCS2_a006_chgMainStateMachineSta "PCS2 ECU: a006 chg main state machine state";
CM_ SG_ 1092 PCS2_a006_gridFormStateMachineSt "PCS2 ECU: a006 grid form state machine state";
CM_ SG_ 1092 PCS2_a006_acManagerOperatingMode "PCS2 ECU: a006 ac manager operating mode";
CM_ SG_ 1092 PCS2_a007_acL2OverCurrentTrip "PCS2 ECU: a007 ac L2 over current trip";
CM_ SG_ 1092 PCS2_a007_chgMainStateMachineSta "PCS2 ECU: a007 chg main state machine state";
CM_ SG_ 1092 PCS2_a007_gridFormStateMachineSt "PCS2 ECU: a007 grid form state machine state";
CM_ SG_ 1092 PCS2_a007_acManagerOperatingMode "PCS2 ECU: a007 ac manager operating mode";
CM_ SG_ 1092 PCS2_a007_acL2MaxThreshold "PCS2 ECU: a007 ac L2 max threshold";
CM_ SG_ 1092 PCS2_a007_acL2MinThreshold "PCS2 ECU: a007 ac L2 min threshold";
CM_ SG_ 1092 PCS2_a008_acL3NOverVoltageTrip "PCS2 ECU: a008 ac L3 n over voltage trip";
CM_ SG_ 1092 PCS2_a008_chgMainStateMachineSta "PCS2 ECU: a008 chg main state machine state";
CM_ SG_ 1092 PCS2_a008_gridFormStateMachineSt "PCS2 ECU: a008 grid form state machine state";
CM_ SG_ 1092 PCS2_a008_acManagerOperatingMode "PCS2 ECU: a008 ac manager operating mode";
CM_ SG_ 1092 PCS2_a009_acL3OverCurrentTrip "PCS2 ECU: a009 ac L3 over current trip";
CM_ SG_ 1092 PCS2_a009_chgMainStateMachineSta "PCS2 ECU: a009 chg main state machine state";
CM_ SG_ 1092 PCS2_a009_gridFormStateMachineSt "PCS2 ECU: a009 grid form state machine state";
CM_ SG_ 1092 PCS2_a009_acManagerOperatingMode "PCS2 ECU: a009 ac manager operating mode";
CM_ SG_ 1092 PCS2_a009_acL3MaxThreshold "PCS2 ECU: a009 ac L3 max threshold";
CM_ SG_ 1092 PCS2_a009_acL3MinThreshold "PCS2 ECU: a009 ac L3 min threshold";
CM_ SG_ 1092 PCS2_a010_acLNOverCurrentTrip "PCS2 ECU: a010 ac LN over current trip";
CM_ SG_ 1092 PCS2_a010_chgMainStateMachineSta "PCS2 ECU: a010 chg main state machine state";
CM_ SG_ 1092 PCS2_a010_gridFormStateMachineSt "PCS2 ECU: a010 grid form state machine state";
CM_ SG_ 1092 PCS2_a010_acManagerOperatingMode "PCS2 ECU: a010 ac manager operating mode";
CM_ SG_ 1092 PCS2_a011_hvdcOverCurrentTrip "PCS2 ECU: a011 hvdc over current trip";
CM_ SG_ 1092 PCS2_a011_hvdcMaxThreshold "PCS2 ECU: a011 hvdc max threshold";
CM_ SG_ 1092 PCS2_a011_hvdcMinThreshold "PCS2 ECU: a011 hvdc min threshold";
CM_ SG_ 1092 PCS2_a012_cycloATankOverCurrentT "PCS2 ECU: a012 cyclo a tank over current trip";
CM_ SG_ 1092 PCS2_a013_DcdcALv2Temp "PCS2 ECU: a013 dcdc a lv2 temp; raw 1025 = signal not available (SNA)";
CM_ SG_ 1092 PCS2_a013_DcdcALv2TempUpperThres "PCS2 ECU: a013 dcdc a lv2 temp upper threshold; raw 1025 = signal not available (SNA)";
CM_ SG_ 1092 PCS2_a014_cycloBTankOverCurrentT "PCS2 ECU: a014 cyclo b tank over current trip";
CM_ SG_ 1092 PCS2_a015_DcdcAHvTemp "PCS2 ECU: a015 dcdc a hv temp; raw 1025 = signal not available (SNA)";
CM_ SG_ 1092 PCS2_a015_DcdcAHvTempUpperThresh "PCS2 ECU: a015 dcdc a hv temp upper threshold; raw 1025 = signal not available (SNA)";
CM_ SG_ 1092 PCS2_a016_dcdcATankOverCurrentTr "PCS2 ECU: a016 dcdc a tank over current trip";
CM_ SG_ 1092 PCS2_a017_DcdcBLv2Temp "PCS2 ECU: a017 dcdc b lv2 temp; raw 1025 = signal not available (SNA)";
CM_ SG_ 1092 PCS2_a017_DcdcBLv2TempUpperThres "PCS2 ECU: a017 dcdc b lv2 temp upper threshold; raw 1025 = signal not available (SNA)";
CM_ SG_ 1092 PCS2_a018_dcdcBTankOverCurrentTr "PCS2 ECU: a018 dcdc b tank over current trip";
CM_ SG_ 1092 PCS2_a019_DcacADcTemp "PCS2 ECU: a019 dcac a dc temp; raw 1025 = signal not available (SNA)";
CM_ SG_ 1092 PCS2_a019_DcacADcTempUpperThresh "PCS2 ECU: a019 dcac a dc temp upper threshold; raw 1025 = signal not available (SNA)";
CM_ SG_ 1092 PCS2_a020_DcacBDcTemp "PCS2 ECU: a020 dcac b dc temp; raw 1025 = signal not available (SNA)";
CM_ SG_ 1092 PCS2_a020_DcacBDcTempUpperThresh "PCS2 ECU: a020 dcac b dc temp upper threshold; raw 1025 = signal not available (SNA)";
CM_ SG_ 1092 PCS2_a021_4V5RailUnderVoltageTri "PCS2 ECU: a021 4 V5 rail under voltage trip";
CM_ SG_ 1092 PCS2_a021_10V0RailUnderVoltageTr "PCS2 ECU: a021 10 V0 rail under voltage trip";
CM_ SG_ 1092 PCS2_a021_13V5RailUnderVoltageTr "PCS2 ECU: a021 13 V5 rail under voltage trip";
CM_ SG_ 1092 PCS2_a021_18V0RailUnderVoltageTr "PCS2 ECU: a021 18 V0 rail under voltage trip";
CM_ SG_ 1092 PCS2_a021_48V0RailUnderVoltageTr "PCS2 ECU: a021 48 V0 rail under voltage trip";
CM_ SG_ 1092 PCS2_a021_4V5RailUnderVoltageThr "PCS2 ECU: a021 4 V5 rail under voltage threshold";
CM_ SG_ 1092 PCS2_a021_10V0RailUnderVoltageTh "PCS2 ECU: a021 10 V0 rail under voltage threshold";
CM_ SG_ 1092 PCS2_a021_13V5RailUnderVoltageTh "PCS2 ECU: a021 13 V5 rail under voltage threshold";
CM_ SG_ 1092 PCS2_a021_18V0RailUnderVoltageTh "PCS2 ECU: a021 18 V0 rail under voltage threshold";
CM_ SG_ 1092 PCS2_a021_48V0RailUnderVoltageTh "PCS2 ECU: a021 48 V0 rail under voltage threshold";
CM_ SG_ 1092 PCS2_a024_DcacATxTemp "PCS2 ECU: a024 dcac a tx temp; raw 1025 = signal not available (SNA)";
CM_ SG_ 1092 PCS2_a024_DcacATxTempUpperThresh "PCS2 ECU: a024 dcac a tx temp upper threshold; raw 1025 = signal not available (SNA)";
CM_ SG_ 1092 PCS2_a025_DcacBTxTemp "PCS2 ECU: a025 dcac b tx temp; raw 1025 = signal not available (SNA)";
CM_ SG_ 1092 PCS2_a025_DcacBTxTempUpperThresh "PCS2 ECU: a025 dcac b tx temp upper threshold; raw 1025 = signal not available (SNA)";
CM_ SG_ 1092 PCS2_a026_AcConnectorTemp "PCS2 ECU: a026 ac connector temp; raw 1025 = signal not available (SNA)";
CM_ SG_ 1092 PCS2_a026_AcConnectorTempUpperTh "PCS2 ECU: a026 ac connector temp upper threshold; raw 1025 = signal not available (SNA)";
CM_ SG_ 1092 PCS2_a027_AmbientTemp "PCS2 ECU: a027 ambient temp; raw 1025 = signal not available (SNA)";
CM_ SG_ 1092 PCS2_a027_AmbientTempUpperThresh "PCS2 ECU: a027 ambient temp upper threshold; raw 1025 = signal not available (SNA)";
CM_ SG_ 1092 PCS2_a028_CoolantTemp "PCS2 ECU: a028 coolant temp; raw 1025 = signal not available (SNA)";
CM_ SG_ 1092 PCS2_a028_CoolantTempUpperThresh "PCS2 ECU: a028 coolant temp upper threshold; raw 1025 = signal not available (SNA)";
CM_ SG_ 1092 PCS2_a028_CoolantSensorSource "PCS2 ECU: a028 coolant sensor source";
CM_ SG_ 1092 PCS2_a029_DcacAAc1Temp "PCS2 ECU: a029 dcac a ac1 temp; raw 1025 = signal not available (SNA)";
CM_ SG_ 1092 PCS2_a029_DcacAAc1TempUpperThres "PCS2 ECU: a029 dcac a ac1 temp upper threshold; raw 1025 = signal not available (SNA)";
CM_ SG_ 1092 PCS2_a030_DcacAAc2Temp "PCS2 ECU: a030 dcac a ac2 temp; raw 1025 = signal not available (SNA)";
CM_ SG_ 1092 PCS2_a030_DcacAAc2TempUpperThres "PCS2 ECU: a030 dcac a ac2 temp upper threshold; raw 1025 = signal not available (SNA)";
CM_ SG_ 1092 PCS2_a031_DcacBAc1Temp "PCS2 ECU: a031 dcac b ac1 temp; raw 1025 = signal not available (SNA)";
CM_ SG_ 1092 PCS2_a031_DcacBAc1TempUpperThres "PCS2 ECU: a031 dcac b ac1 temp upper threshold; raw 1025 = signal not available (SNA)";
CM_ SG_ 1092 PCS2_a032_DcacBAc2Temp "PCS2 ECU: a032 dcac b ac2 temp; raw 1025 = signal not available (SNA)";
CM_ SG_ 1092 PCS2_a032_DcacBAc2TempUpperThres "PCS2 ECU: a032 dcac b ac2 temp upper threshold; raw 1025 = signal not available (SNA)";
CM_ SG_ 1092 PCS2_a034_lvBusVoltage "PCS2 ECU: a034 lv bus voltage";
CM_ SG_ 1092 PCS2_a034_voltageFaultThreshold "PCS2 ECU: a034 voltage fault threshold";
CM_ SG_ 1092 PCS2_a035_lvBusVoltage "PCS2 ECU: a035 lv bus voltage";
CM_ SG_ 1092 PCS2_a035_voltageFaultThreshold "PCS2 ECU: a035 voltage fault threshold";
CM_ SG_ 1092 PCS2_a036_hvBusVoltage "PCS2 ECU: a036 hv bus voltage";
CM_ SG_ 1092 PCS2_a036_hvBusTopVoltage "PCS2 ECU: a036 hv bus top voltage";
CM_ SG_ 1092 PCS2_a036_hvBusBotVoltage "PCS2 ECU: a036 hv bus bot voltage";
CM_ SG_ 1092 PCS2_a036_voltageFaultThreshold "PCS2 ECU: a036 voltage fault threshold";
CM_ SG_ 1092 PCS2_a037_hvBusVoltage "PCS2 ECU: a037 hv bus voltage";
CM_ SG_ 1092 PCS2_a037_hvBusTopVoltage "PCS2 ECU: a037 hv bus top voltage";
CM_ SG_ 1092 PCS2_a037_hvBusBotVoltage "PCS2 ECU: a037 hv bus bot voltage";
CM_ SG_ 1092 PCS2_a037_voltageFaultThreshold "PCS2 ECU: a037 voltage fault threshold";
CM_ SG_ 1092 PCS2_a038_hvBusVoltage "PCS2 ECU: a038 hv bus voltage";
CM_ SG_ 1092 PCS2_a038_hvBusTopVoltage "PCS2 ECU: a038 hv bus top voltage";
CM_ SG_ 1092 PCS2_a038_hvBusBotVoltage "PCS2 ECU: a038 hv bus bot voltage";
CM_ SG_ 1092 PCS2_a038_voltageFaultThreshold "PCS2 ECU: a038 voltage fault threshold";
CM_ SG_ 1092 PCS2_a039_hvBusVoltage "PCS2 ECU: a039 hv bus voltage";
CM_ SG_ 1092 PCS2_a039_hvBusTopVoltage "PCS2 ECU: a039 hv bus top voltage";
CM_ SG_ 1092 PCS2_a039_hvBusBotVoltage "PCS2 ECU: a039 hv bus bot voltage";
CM_ SG_ 1092 PCS2_a039_voltageFaultThreshold "PCS2 ECU: a039 voltage fault threshold";
CM_ SG_ 1092 PCS2_a040_hvBusVoltage "PCS2 ECU: a040 hv bus voltage";
CM_ SG_ 1092 PCS2_a040_hvBusTopVoltage "PCS2 ECU: a040 hv bus top voltage";
CM_ SG_ 1092 PCS2_a040_hvBusBotVoltage "PCS2 ECU: a040 hv bus bot voltage";
CM_ SG_ 1092 PCS2_a040_voltageFaultThreshold "PCS2 ECU: a040 voltage fault threshold";
CM_ SG_ 1092 PCS2_a041_hvBusVoltage "PCS2 ECU: a041 hv bus voltage";
CM_ SG_ 1092 PCS2_a041_hvBusTopVoltage "PCS2 ECU: a041 hv bus top voltage";
CM_ SG_ 1092 PCS2_a041_hvBusBotVoltage "PCS2 ECU: a041 hv bus bot voltage";
CM_ SG_ 1092 PCS2_a041_voltageFaultThreshold "PCS2 ECU: a041 voltage fault threshold";
CM_ SG_ 1092 PCS2_a043_hvBattVoltage "PCS2 ECU: a043 hv batt voltage";
CM_ SG_ 1092 PCS2_a043_hvBattTopVoltage "PCS2 ECU: a043 hv batt top voltage";
CM_ SG_ 1092 PCS2_a043_hvBattBotVoltage "PCS2 ECU: a043 hv batt bot voltage";
CM_ SG_ 1092 PCS2_a043_voltageFaultThreshold "PCS2 ECU: a043 voltage fault threshold";
CM_ SG_ 1092 PCS2_a044_hvBattVoltage "PCS2 ECU: a044 hv batt voltage";
CM_ SG_ 1092 PCS2_a044_hvBattTopVoltage "PCS2 ECU: a044 hv batt top voltage";
CM_ SG_ 1092 PCS2_a044_hvBattBotVoltage "PCS2 ECU: a044 hv batt bot voltage";
CM_ SG_ 1092 PCS2_a044_voltageFaultThreshold "PCS2 ECU: a044 voltage fault threshold";
CM_ SG_ 1092 PCS2_a045_hvBattVoltage "PCS2 ECU: a045 hv batt voltage";
CM_ SG_ 1092 PCS2_a045_hvBattTopVoltage "PCS2 ECU: a045 hv batt top voltage";
CM_ SG_ 1092 PCS2_a045_hvBattBotVoltage "PCS2 ECU: a045 hv batt bot voltage";
CM_ SG_ 1092 PCS2_a045_voltageFaultThreshold "PCS2 ECU: a045 voltage fault threshold";
CM_ SG_ 1092 PCS2_a046_hvBattVoltage "PCS2 ECU: a046 hv batt voltage";
CM_ SG_ 1092 PCS2_a046_hvBattTopVoltage "PCS2 ECU: a046 hv batt top voltage";
CM_ SG_ 1092 PCS2_a046_hvBattBotVoltage "PCS2 ECU: a046 hv batt bot voltage";
CM_ SG_ 1092 PCS2_a046_voltageFaultThreshold "PCS2 ECU: a046 voltage fault threshold";
CM_ SG_ 1092 PCS2_a047_hvBattVoltage "PCS2 ECU: a047 hv batt voltage";
CM_ SG_ 1092 PCS2_a047_hvBattTopVoltage "PCS2 ECU: a047 hv batt top voltage";
CM_ SG_ 1092 PCS2_a047_hvBattBotVoltage "PCS2 ECU: a047 hv batt bot voltage";
CM_ SG_ 1092 PCS2_a047_voltageFaultThreshold "PCS2 ECU: a047 voltage fault threshold";
CM_ SG_ 1092 PCS2_a048_hvBusVoltage "PCS2 ECU: a048 hv bus voltage";
CM_ SG_ 1092 PCS2_a048_hvBusTopVoltage "PCS2 ECU: a048 hv bus top voltage";
CM_ SG_ 1092 PCS2_a048_hvBusBotVoltage "PCS2 ECU: a048 hv bus bot voltage";
CM_ SG_ 1092 PCS2_a048_voltageFaultThreshold "PCS2 ECU: a048 voltage fault threshold";
CM_ SG_ 1092 PCS2_a049_hvBusVoltage "PCS2 ECU: a049 hv bus voltage";
CM_ SG_ 1092 PCS2_a049_hvBusTopVoltage "PCS2 ECU: a049 hv bus top voltage";
CM_ SG_ 1092 PCS2_a049_hvBusBotVoltage "PCS2 ECU: a049 hv bus bot voltage";
CM_ SG_ 1092 PCS2_a049_voltageFaultThreshold "PCS2 ECU: a049 voltage fault threshold";
CM_ SG_ 1092 PCS2_a050_VC_pcsInterface "PCS2 ECU: a050 VC pcs interface";
CM_ SG_ 1092 PCS2_a052_CP_chargeStatus "PCS2 ECU: a052 CP charge status";
CM_ SG_ 1092 PCS2_a052_CP_status "PCS2 ECU: a052 CP status";
CM_ SG_ 1092 PCS2_a052_CP_gridFormControl "PCS2 ECU: a052 CP grid form control";
CM_ SG_ 1092 PCS2_a052_CP_eptoStatus "PCS2 ECU: a052 CP epto status";
CM_ SG_ 1092 PCS2_a053_HV_dcdcControl "PCS2 ECU: a053 HV dcdc control";
CM_ SG_ 1092 PCS2_a053_HVP_hvsControl "PCS2 ECU: a053 HVP hvs control";
CM_ SG_ 1092 PCS2_a054_UI_chargeRequest "PCS2 ECU: a054 UI charge request";
CM_ SG_ 1092 PCS2_a055_tankCapacitanceDefined "PCS2 ECU: a055 tank capacitance defined";
CM_ SG_ 1092 PCS2_a055_leakageInductanceDefin "PCS2 ECU: a055 leakage inductance defined";
CM_ SG_ 1092 PCS2_a055_magnetizingInductanceD "PCS2 ECU: a055 magnetizing inductance defined";
CM_ SG_ 1092 PCS2_a056_tankCapacitanceDefined "PCS2 ECU: a056 tank capacitance defined";
CM_ SG_ 1092 PCS2_a056_leakageInductanceDefin "PCS2 ECU: a056 leakage inductance defined";
CM_ SG_ 1092 PCS2_a056_magnetizingInductanceD "PCS2 ECU: a056 magnetizing inductance defined";
CM_ SG_ 1092 PCS2_a057_tankCapacitanceDefined "PCS2 ECU: a057 tank capacitance defined";
CM_ SG_ 1092 PCS2_a057_leakageInductanceDefin "PCS2 ECU: a057 leakage inductance defined";
CM_ SG_ 1092 PCS2_a057_magnetizingInductanceD "PCS2 ECU: a057 magnetizing inductance defined";
CM_ SG_ 1092 PCS2_a058_tankCapacitanceDefined "PCS2 ECU: a058 tank capacitance defined";
CM_ SG_ 1092 PCS2_a058_leakageInductanceDefin "PCS2 ECU: a058 leakage inductance defined";
CM_ SG_ 1092 PCS2_a058_magnetizingInductanceD "PCS2 ECU: a058 magnetizing inductance defined";
CM_ SG_ 1092 PCS2_a059_dcdcHvcEnableLineTZLat "PCS2 ECU: a059 dcdc hvc enable line TZ latched bit";
CM_ SG_ 1092 PCS2_a059_dcdcHvcEnableLineStatu "PCS2 ECU: a059 dcdc hvc enable line status";
CM_ SG_ 1092 PCS2_a059_dcdcVcrEnableLineTZLat "PCS2 ECU: a059 dcdc vcr enable line TZ latched bit";
CM_ SG_ 1092 PCS2_a059_dcdcVcrEnableLineStatu "PCS2 ECU: a059 dcdc vcr enable line status";
CM_ SG_ 1092 PCS2_a059_dcdcStageState "PCS2 ECU: a059 dcdc stage state";
CM_ SG_ 1092 PCS2_a059_dcdcStageRequestProces "PCS2 ECU: a059 dcdc stage request processed";
CM_ SG_ 1092 PCS2_a059_dcdcRequest "PCS2 ECU: a059 dcdc request";
CM_ SG_ 1092 PCS2_a060_maxRetriesAllowed "PCS2 ECU: a060 max retries allowed";
CM_ SG_ 1092 PCS2_a060_retryCount "PCS2 ECU: a060 retry count";
CM_ SG_ 1092 PCS2_a060_pauseRequestedByDcdc "PCS2 ECU: a060 pause requested by dcdc";
CM_ SG_ 1092 PCS2_a061_maxRetriesAllowed "PCS2 ECU: a061 max retries allowed";
CM_ SG_ 1092 PCS2_a061_retryCount "PCS2 ECU: a061 retry count";
CM_ SG_ 1092 PCS2_a061_pauseRequestedByDcdc "PCS2 ECU: a061 pause requested by dcdc";
CM_ SG_ 1092 PCS2_a062_acL1NVrms "PCS2 ECU: a062 ac L1 n vrms";
CM_ SG_ 1092 PCS2_a062_acL2NVrms "PCS2 ECU: a062 ac L2 n vrms";
CM_ SG_ 1092 PCS2_a062_acL3NVrms "PCS2 ECU: a062 ac L3 n vrms";
CM_ SG_ 1092 PCS2_a062_acL1L2Vrms "PCS2 ECU: a062 ac L1 L2 vrms";
CM_ SG_ 1092 PCS2_a062_acL1L3Vrms "PCS2 ECU: a062 ac L1 L3 vrms";
CM_ SG_ 1092 PCS2_a062_acL2L3Vrms "PCS2 ECU: a062 ac L2 L3 vrms";
CM_ SG_ 1092 PCS2_a063_phase_diff_L1N_L2N "PCS2 ECU: a063 phase diff L1 n L2 n";
CM_ SG_ 1092 PCS2_a063_phase_diff_L1N_L3N "PCS2 ECU: a063 phase diff L1 n L3 n";
CM_ SG_ 1092 PCS2_a063_phase_diff_L2N_L3N "PCS2 ECU: a063 phase diff L2 n L3 n";
CM_ SG_ 1092 PCS2_a063_phase_diff_L1L3_L2L3 "PCS2 ECU: a063 phase diff L1 L3 L2 L3";
CM_ SG_ 1092 PCS2_a063_L1NAvailableForChargin "PCS2 ECU: a063 L1 n available for charging";
CM_ SG_ 1092 PCS2_a063_L2NAvailableForChargin "PCS2 ECU: a063 L2 n available for charging";
CM_ SG_ 1092 PCS2_a063_L3NAvailableForChargin "PCS2 ECU: a063 L3 n available for charging";
CM_ SG_ 1092 PCS2_a063_L1L2AvailableForChargi "PCS2 ECU: a063 L1 L2 available for charging";
CM_ SG_ 1092 PCS2_a063_L1L3AvailableForChargi "PCS2 ECU: a063 L1 L3 available for charging";
CM_ SG_ 1092 PCS2_a063_L2L3AvailableForChargi "PCS2 ECU: a063 L2 L3 available for charging";
CM_ SG_ 1092 PCS2_a064_leakageInductance "PCS2 ECU: a064 leakage inductance";
CM_ SG_ 1092 PCS2_a064_leakageInductanceOutOf "PCS2 ECU: a064 leakage inductance out of spec";
CM_ SG_ 1092 PCS2_a064_magnetizingInductance "PCS2 ECU: a064 magnetizing inductance";
CM_ SG_ 1092 PCS2_a064_magnetizingInductanceO "PCS2 ECU: a064 magnetizing inductance out of spec";
CM_ SG_ 1092 PCS2_a064_capacitance "PCS2 ECU: a064 capacitance";
CM_ SG_ 1092 PCS2_a064_capacitanceOutOfSpec "PCS2 ECU: a064 capacitance out of spec";
CM_ SG_ 1092 PCS2_a065_leakageInductance "PCS2 ECU: a065 leakage inductance";
CM_ SG_ 1092 PCS2_a065_leakageInductanceOutOf "PCS2 ECU: a065 leakage inductance out of spec";
CM_ SG_ 1092 PCS2_a065_magnetizingInductance "PCS2 ECU: a065 magnetizing inductance";
CM_ SG_ 1092 PCS2_a065_magnetizingInductanceO "PCS2 ECU: a065 magnetizing inductance out of spec";
CM_ SG_ 1092 PCS2_a065_capacitance "PCS2 ECU: a065 capacitance";
CM_ SG_ 1092 PCS2_a065_capacitanceOutOfSpec "PCS2 ECU: a065 capacitance out of spec";
CM_ SG_ 1092 PCS2_a066_leakageInductance "PCS2 ECU: a066 leakage inductance";
CM_ SG_ 1092 PCS2_a066_leakageInductanceOutOf "PCS2 ECU: a066 leakage inductance out of spec";
CM_ SG_ 1092 PCS2_a066_magnetizingInductance "PCS2 ECU: a066 magnetizing inductance";
CM_ SG_ 1092 PCS2_a066_magnetizingInductanceO "PCS2 ECU: a066 magnetizing inductance out of spec";
CM_ SG_ 1092 PCS2_a066_capacitance "PCS2 ECU: a066 capacitance";
CM_ SG_ 1092 PCS2_a066_capacitanceOutOfSpec "PCS2 ECU: a066 capacitance out of spec";
CM_ SG_ 1092 PCS2_a067_leakageInductance "PCS2 ECU: a067 leakage inductance";
CM_ SG_ 1092 PCS2_a067_leakageInductanceOutOf "PCS2 ECU: a067 leakage inductance out of spec";
CM_ SG_ 1092 PCS2_a067_magnetizingInductance "PCS2 ECU: a067 magnetizing inductance";
CM_ SG_ 1092 PCS2_a067_magnetizingInductanceO "PCS2 ECU: a067 magnetizing inductance out of spec";
CM_ SG_ 1092 PCS2_a067_capacitance "PCS2 ECU: a067 capacitance";
CM_ SG_ 1092 PCS2_a067_capacitanceOutOfSpec "PCS2 ECU: a067 capacitance out of spec";
CM_ SG_ 1092 PCS2_a068_recordProblemBitfield "PCS2 ECU: a068 record problem bitfield";
CM_ SG_ 1092 PCS2_a068_diagnosticWord "PCS2 ECU: a068 diagnostic word";
CM_ SG_ 1092 PCS2_a069_recordNotFound "PCS2 ECU: a069 record not found";
CM_ SG_ 1092 PCS2_a069_recordOversized "PCS2 ECU: a069 record oversized";
CM_ SG_ 1092 PCS2_a069_recordUndersized "PCS2 ECU: a069 record undersized";
CM_ SG_ 1092 PCS2_a069_recordVersionMismatch "PCS2 ECU: a069 record version mismatch";
CM_ SG_ 1092 PCS2_a069_recordCRCMismatch "PCS2 ECU: a069 record CRC mismatch";
CM_ SG_ 1092 PCS2_a070_recordNotFound "PCS2 ECU: a070 record not found";
CM_ SG_ 1092 PCS2_a070_recordOversized "PCS2 ECU: a070 record oversized";
CM_ SG_ 1092 PCS2_a070_recordUndersized "PCS2 ECU: a070 record undersized";
CM_ SG_ 1092 PCS2_a070_recordVersionMismatch "PCS2 ECU: a070 record version mismatch";
CM_ SG_ 1092 PCS2_a070_recordCRCMismatch "PCS2 ECU: a070 record CRC mismatch";
CM_ SG_ 1092 PCS2_a071_hvBattBotSensorMeasure "PCS2 ECU: a071 hv batt bot sensor measurement";
CM_ SG_ 1092 PCS2_a071_hvBattExternalRefValue "PCS2 ECU: a071 hv batt external ref value; raw 2047 = signal not available (SNA)";
CM_ SG_ 1092 PCS2_a072_hvBattTopSensorMeasure "PCS2 ECU: a072 hv batt top sensor measurement";
CM_ SG_ 1092 PCS2_a072_hvBattExternalRefValue "PCS2 ECU: a072 hv batt external ref value; raw 2047 = signal not available (SNA)";
CM_ SG_ 1092 PCS2_a073_hvBusBotSensorMeasurem "PCS2 ECU: a073 hv bus bot sensor measurement";
CM_ SG_ 1092 PCS2_a073_hvBusExternalRefValue "PCS2 ECU: a073 hv bus external ref value; raw 2047 = signal not available (SNA)";
CM_ SG_ 1092 PCS2_a074_hvBusTopSensorMeasurem "PCS2 ECU: a074 hv bus top sensor measurement";
CM_ SG_ 1092 PCS2_a074_hvBusExternalRefValue "PCS2 ECU: a074 hv bus external ref value; raw 2047 = signal not available (SNA)";
CM_ SG_ 1092 PCS2_a075_hvBattFullSensorMeasur "PCS2 ECU: a075 hv batt full sensor measurement";
CM_ SG_ 1092 PCS2_a075_hvBattExternalRefValue "PCS2 ECU: a075 hv batt external ref value; raw 2047 = signal not available (SNA)";
CM_ SG_ 1092 PCS2_a075_hvBattTopBottomVoltage "PCS2 ECU: a075 hv batt top bottom voltage delta";
CM_ SG_ 1092 PCS2_a076_hvBusFullSensorMeasure "PCS2 ECU: a076 hv bus full sensor measurement";
CM_ SG_ 1092 PCS2_a076_hvBusExternalRefValue "PCS2 ECU: a076 hv bus external ref value; raw 2047 = signal not available (SNA)";
CM_ SG_ 1092 PCS2_a076_hvBusTopBottomVoltageD "PCS2 ECU: a076 hv bus top bottom voltage delta";
CM_ SG_ 1092 PCS2_a077_lvBusVoltageMeasuremen "PCS2 ECU: a077 lv bus voltage measurement";
CM_ SG_ 1092 PCS2_a077_lvBusExternalRefValue "PCS2 ECU: a077 lv bus external ref value";
CM_ SG_ 1092 PCS2_a078_acL1NVoltageOffset "PCS2 ECU: a078 ac L1 n voltage offset";
CM_ SG_ 1092 PCS2_a078_acL1NVoltageRMS "PCS2 ECU: a078 ac L1 n voltage RMS";
CM_ SG_ 1092 PCS2_a079_acL2NVoltageOffset "PCS2 ECU: a079 ac L2 n voltage offset";
CM_ SG_ 1092 PCS2_a079_acL2NVoltageRMS "PCS2 ECU: a079 ac L2 n voltage RMS";
CM_ SG_ 1092 PCS2_a080_acL3NVoltageOffset "PCS2 ECU: a080 ac L3 n voltage offset";
CM_ SG_ 1092 PCS2_a080_acL3NVoltageRMS "PCS2 ECU: a080 ac L3 n voltage RMS";
CM_ SG_ 1092 PCS2_a081_acL1CurrentOffset "PCS2 ECU: a081 ac L1 current offset";
CM_ SG_ 1092 PCS2_a081_acL1CurrentRMS "PCS2 ECU: a081 ac L1 current RMS";
CM_ SG_ 1092 PCS2_a082_acL2CurrentOffset "PCS2 ECU: a082 ac L2 current offset";
CM_ SG_ 1092 PCS2_a082_acL2CurrentRMS "PCS2 ECU: a082 ac L2 current RMS";
CM_ SG_ 1092 PCS2_a083_acL3CurrentOffset "PCS2 ECU: a083 ac L3 current offset";
CM_ SG_ 1092 PCS2_a083_acL3CurrentRMS "PCS2 ECU: a083 ac L3 current RMS";
CM_ SG_ 1092 PCS2_a084_acNCurrentOffset "PCS2 ECU: a084 ac n current offset";
CM_ SG_ 1092 PCS2_a084_acNCurrentRMS "PCS2 ECU: a084 ac n current RMS";
CM_ SG_ 1092 PCS2_a085_dcacEnableLineStatus "PCS2 ECU: a085 dcac enable line status";
CM_ SG_ 1092 PCS2_a085_dcacTZFlagStatus "PCS2 ECU: a085 dcac TZ flag status";
CM_ SG_ 1092 PCS2_a085_bmsEnableRequest "PCS2 ECU: a085 bms enable request";
CM_ SG_ 1092 PCS2_a085_outletGridFormEnableRe "PCS2 ECU: a085 outlet grid form enable request";
CM_ SG_ 1092 PCS2_a085_cpGridFormEnableReques "PCS2 ECU: a085 cp grid form enable request";
CM_ SG_ 1092 PCS2_a085_packEOLGridFormEnableR "PCS2 ECU: a085 pack EOL grid form enable request";
CM_ SG_ 1092 PCS2_a086_lvBusVoltage "PCS2 ECU: a086 lv bus voltage";
CM_ SG_ 1092 PCS2_a086_voltageFaultThreshold "PCS2 ECU: a086 voltage fault threshold";
CM_ SG_ 1092 PCS2_a087_lvBusVoltage "PCS2 ECU: a087 lv bus voltage";
CM_ SG_ 1092 PCS2_a087_voltageFaultThreshold "PCS2 ECU: a087 voltage fault threshold";
CM_ SG_ 1092 PCS2_a088_linesFaulted "PCS2 ECU: a088 lines faulted";
CM_ SG_ 1092 PCS2_a088_startVoltageRms "PCS2 ECU: a088 start voltage rms";
CM_ SG_ 1092 PCS2_a088_underVoltageRmsThresho "PCS2 ECU: a088 under voltage rms threshold";
CM_ SG_ 1092 PCS2_a088_presentVoltageRms "PCS2 ECU: a088 present voltage rms";
CM_ SG_ 1092 PCS2_a088_presentCurrentRms "PCS2 ECU: a088 present current rms";
CM_ SG_ 1092 PCS2_a088_gridConfig "PCS2 ECU: a088 grid config; raw 0 = signal not available (SNA)";
CM_ SG_ 1092 PCS2_a090_DcdcModelLvMosfetTemp "PCS2 ECU: a090 dcdc model lv mosfet temp";
CM_ SG_ 1092 PCS2_a090_DcdcModelLvMosfetCoola "PCS2 ECU: a090 dcdc model lv mosfet coolant temp";
CM_ SG_ 1092 PCS2_a090_DcDcModelLvMosfetCoola "PCS2 ECU: a090 dc dc model lv mosfet coolant flow rate";
CM_ SG_ 1092 PCS2_a090_DcDcModelLVMosfetCurre "PCS2 ECU: a090 dc dc model LV mosfet current";
CM_ SG_ 1092 PCS2_a091_DcdcModelTxWindingTemp "PCS2 ECU: a091 dcdc model tx winding temp";
CM_ SG_ 1092 PCS2_a091_DcdcModelTxWindingCool "PCS2 ECU: a091 dcdc model tx winding coolant temp";
CM_ SG_ 1092 PCS2_a091_DcDcModelTxWindingCool "PCS2 ECU: a091 dc dc model tx winding coolant flow rate";
CM_ SG_ 1092 PCS2_a091_DcDcModelTxWindingCurr "PCS2 ECU: a091 dc dc model tx winding current";
CM_ SG_ 1092 PCS2_a094_cycloABlockedReason "PCS2 ECU: a094 cyclo a blocked reason";
CM_ SG_ 1092 PCS2_a094_cycloBBlockedReason "PCS2 ECU: a094 cyclo b blocked reason";
CM_ SG_ 1092 PCS2_a095_cycloABlockedReason "PCS2 ECU: a095 cyclo a blocked reason";
CM_ SG_ 1092 PCS2_a095_cycloBBlockedReason "PCS2 ECU: a095 cyclo b blocked reason";
CM_ SG_ 1092 PCS2_a096_VCSUPER_thermalStatus1 "PCS2 ECU: a096 VCSUPER thermal status10 hz";
CM_ SG_ 1092 PCS2_a097_GTW_carState "PCS2 ECU: a097 GTW car state";
CM_ SG_ 1092 PCS2_a098_EGGRIGHT3_thermalComma "PCS2 ECU: a098 EGGRIGHT3 thermal command10 hz";
CM_ SG_ 1092 PCS2_a099_lineFaulted "PCS2 ECU: a099 line faulted";
CM_ SG_ 1092 PCS2_a099_lineToChassisVoltageRm "PCS2 ECU: a099 line to chassis voltage rms";
CM_ SG_ 1092 PCS2_a099_neutralToChassisVoltag "PCS2 ECU: a099 neutral to chassis voltage rms";
CM_ SG_ 1092 PCS2_a099_overVoltageRmsThreshol "PCS2 ECU: a099 over voltage rms threshold";
CM_ SG_ 1092 PCS2_a099_iticCurveSection "PCS2 ECU: a099 itic curve section";
CM_ SG_ 1092 PCS2_a100_linesFaulted "PCS2 ECU: a100 lines faulted";
CM_ SG_ 1092 PCS2_a100_lineToLineVoltageRms "PCS2 ECU: a100 line to line voltage rms";
CM_ SG_ 1092 PCS2_a100_overVoltageRmsThreshol "PCS2 ECU: a100 over voltage rms threshold";
CM_ SG_ 1092 PCS2_a100_iticCurveSection "PCS2 ECU: a100 itic curve section";
CM_ SG_ 1092 PCS2_a101_lineFaulted "PCS2 ECU: a101 line faulted";
CM_ SG_ 1092 PCS2_a101_lineToChassisVoltage "PCS2 ECU: a101 line to chassis voltage";
CM_ SG_ 1092 PCS2_a101_neutralToChassisVoltag "PCS2 ECU: a101 neutral to chassis voltage";
CM_ SG_ 1092 PCS2_a101_lineToChassisVoltageRm "PCS2 ECU: a101 line to chassis voltage rms";
CM_ SG_ 1092 PCS2_a101_overVoltageThreshold "PCS2 ECU: a101 over voltage threshold";
CM_ SG_ 1092 PCS2_a101_iticCurveSection "PCS2 ECU: a101 itic curve section";
CM_ SG_ 1092 PCS2_a102_linesFaulted "PCS2 ECU: a102 lines faulted";
CM_ SG_ 1092 PCS2_a102_lineToLineVoltage "PCS2 ECU: a102 line to line voltage";
CM_ SG_ 1092 PCS2_a102_lineToLineVoltageRms "PCS2 ECU: a102 line to line voltage rms";
CM_ SG_ 1092 PCS2_a102_overVoltageThreshold "PCS2 ECU: a102 over voltage threshold";
CM_ SG_ 1092 PCS2_a102_iticCurveSection "PCS2 ECU: a102 itic curve section";
CM_ SG_ 1092 PCS2_a103_IsoTempSensor "PCS2 ECU: a103 iso temp sensor";
CM_ SG_ 1092 PCS2_a103_IsoTempSenseIrrational "PCS2 ECU: a103 iso temp sense irrational";
CM_ SG_ 1092 PCS2_a103_IsoTempSenseOutOfBound "PCS2 ECU: a103 iso temp sense out of bounds";
CM_ SG_ 1092 PCS2_a103_IsoTempSensorFallTimeO "PCS2 ECU: a103 iso temp sensor fall time out of bounds";
CM_ SG_ 1092 PCS2_a103_IsoTempSensorRiseTimeO "PCS2 ECU: a103 iso temp sensor rise time out of bounds";
CM_ SG_ 1092 PCS2_a103_IsoTempSensorMIA "PCS2 ECU: a103 iso temp sensor MIA";
CM_ SG_ 1092 PCS2_a103_IsoTempSensorRiseFallM "PCS2 ECU: a103 iso temp sensor rise fall mismatch";
CM_ SG_ 1092 PCS2_a103_RiseTimeOpenLoop "PCS2 ECU: a103 rise time open loop";
CM_ SG_ 1092 PCS2_a103_FallTimeOpenLoop "PCS2 ECU: a103 fall time open loop";
CM_ SG_ 1092 PCS2_a103_ClosedLoopTime "PCS2 ECU: a103 closed loop time";
CM_ SG_ 1092 PCS2_a104_lineFaulted "PCS2 ECU: a104 line faulted";
CM_ SG_ 1092 PCS2_a104_lineToChassisVoltageRm "PCS2 ECU: a104 line to chassis voltage rms";
CM_ SG_ 1092 PCS2_a104_underVoltageRmsThresho "PCS2 ECU: a104 under voltage rms threshold";
CM_ SG_ 1092 PCS2_a104_iticCurveSection "PCS2 ECU: a104 itic curve section";
CM_ SG_ 1092 PCS2_a105_linesFaulted "PCS2 ECU: a105 lines faulted";
CM_ SG_ 1092 PCS2_a105_lineToLineVoltageRms "PCS2 ECU: a105 line to line voltage rms";
CM_ SG_ 1092 PCS2_a105_underVoltageRmsThresho "PCS2 ECU: a105 under voltage rms threshold";
CM_ SG_ 1092 PCS2_a105_iticCurveSection "PCS2 ECU: a105 itic curve section";
CM_ SG_ 1092 PCS2_a106_systemNeutral "PCS2 ECU: a106 system neutral";
CM_ SG_ 1092 PCS2_a106_systemNeutralToChassis "PCS2 ECU: a106 system neutral to chassis voltage";
CM_ SG_ 1092 PCS2_a106_overVoltageThreshold "PCS2 ECU: a106 over voltage threshold";
CM_ SG_ 1092 PCS2_a110_deratingFactorThreshol "PCS2 ECU: a110 derating factor threshold";
CM_ SG_ 1092 PCS2_a110_combinedDeratingFactor "PCS2 ECU: a110 combined derating factor";
CM_ SG_ 1092 PCS2_a110_txTempDeratingFactor "PCS2 ECU: a110 tx temp derating factor";
CM_ SG_ 1092 PCS2_a110_dcTempDeratingFactor "PCS2 ECU: a110 dc temp derating factor";
CM_ SG_ 1092 PCS2_a110_inductorLossDeratingFa "PCS2 ECU: a110 inductor loss derating factor";
CM_ SG_ 1092 PCS2_a110_junctionTempDeratingFa "PCS2 ECU: a110 junction temp derating factor";
CM_ SG_ 1092 PCS2_a112_linesFaulted "PCS2 ECU: a112 lines faulted";
CM_ SG_ 1092 PCS2_a112_startVoltageRms "PCS2 ECU: a112 start voltage rms";
CM_ SG_ 1092 PCS2_a112_underVoltageRmsThresho "PCS2 ECU: a112 under voltage rms threshold";
CM_ SG_ 1092 PCS2_a112_presentVoltageRms "PCS2 ECU: a112 present voltage rms";
CM_ SG_ 1092 PCS2_a113_receivedCoolantFlow "PCS2 ECU: a113 received coolant flow";
CM_ SG_ 1092 PCS2_a113_receivedCoolantTemp "PCS2 ECU: a113 received coolant temp; raw 1025 = signal not available (SNA)";
CM_ SG_ 1092 PCS2_a113_sensedCoolantTemp "PCS2 ECU: a113 sensed coolant temp; raw 1025 = signal not available (SNA)";
CM_ SG_ 1092 PCS2_a113_localNoFlowDetectionSt "PCS2 ECU: a113 local no flow detection state";
CM_ SG_ 1092 PCS2_a113_remoteNoFlowDetectionS "PCS2 ECU: a113 remote no flow detection state";
CM_ SG_ 1092 PCS2_a114_estimatedHvbusCapacita "PCS2 ECU: a114 estimated hvbus capacitance";
CM_ SG_ 1092 PCS2_a114_estimatedResistanceLin "PCS2 ECU: a114 estimated resistance linear";
CM_ SG_ 1092 PCS2_a114_estimatedResistanceLog "PCS2 ECU: a114 estimated resistance logarithm";
CM_ SG_ 1092 PCS2_a114_useLinearResult "PCS2 ECU: a114 use linear result";
CM_ SG_ 1092 PCS2_a114_useLogarithmResult "PCS2 ECU: a114 use logarithm result";
CM_ SG_ 1092 PCS2_a115_lineVoltage "PCS2 ECU: a115 line voltage";
CM_ SG_ 1092 PCS2_a116_chgRetryCount "PCS2 ECU: a116 chg retry count";
CM_ SG_ 1092 PCS2_a116_maxChgRetriesAllowed "PCS2 ECU: a116 max chg retries allowed";
CM_ SG_ 1092 PCS2_a117_VCRIGHT_LVHealth "PCS2 ECU: a117 VCRIGHT LV health";
CM_ SG_ 1092 PCS2_a118_presentHvBusVoltage "PCS2 ECU: a118 present hv bus voltage";
CM_ SG_ 1092 PCS2_a118_hvVoltageTarget "PCS2 ECU: a118 hv voltage target";
CM_ SG_ 1092 PCS2_a118_presentLvBusVoltage "PCS2 ECU: a118 present lv bus voltage";
CM_ SG_ 1092 PCS2_a118_failedToReachFixedTarg "PCS2 ECU: a118 failed to reach fixed target";
CM_ SG_ 1092 PCS2_a119_presentHvBusVoltage "PCS2 ECU: a119 present hv bus voltage";
CM_ SG_ 1092 PCS2_a119_startUpHvVoltage "PCS2 ECU: a119 start up hv voltage";
CM_ SG_ 1092 PCS2_a119_presentLvBusVoltage "PCS2 ECU: a119 present lv bus voltage";
CM_ SG_ 1092 PCS2_a122_recordNotFound "PCS2 ECU: a122 record not found";
CM_ SG_ 1092 PCS2_a122_recordOversized "PCS2 ECU: a122 record oversized";
CM_ SG_ 1092 PCS2_a122_recordUndersized "PCS2 ECU: a122 record undersized";
CM_ SG_ 1092 PCS2_a122_recordVersionMismatch "PCS2 ECU: a122 record version mismatch";
CM_ SG_ 1092 PCS2_a122_recordCRCMismatch "PCS2 ECU: a122 record CRC mismatch";
CM_ SG_ 1092 PCS2_a123_DcdcBHvTemp "PCS2 ECU: a123 dcdc b hv temp; raw 1025 = signal not available (SNA)";
CM_ SG_ 1092 PCS2_a123_DcdcBHvTempUpperThresh "PCS2 ECU: a123 dcdc b hv temp upper threshold; raw 1025 = signal not available (SNA)";
CM_ SG_ 1092 PCS2_a127_acLineClkHealthStatus "PCS2 ECU: a127 ac line clk health status";
CM_ SG_ 1092 PCS2_a127_dcac1_L1EnableHealthSt "PCS2 ECU: a127 dcac1 L1 enable health status";
CM_ SG_ 1092 PCS2_a127_dcac1_L2EnableHealthSt "PCS2 ECU: a127 dcac1 L2 enable health status";
CM_ SG_ 1092 PCS2_a127_dcac1_L3EnableHealthSt "PCS2 ECU: a127 dcac1 L3 enable health status";
CM_ SG_ 1092 PCS2_a127_dcac1_LNEnableHealthSt "PCS2 ECU: a127 dcac1 LN enable health status";
CM_ SG_ 1092 PCS2_a127_dcac1_acTankClkHealthS "PCS2 ECU: a127 dcac1 ac tank clk health status";
CM_ SG_ 1092 PCS2_a127_dcac1_dcTankClkHealthS "PCS2 ECU: a127 dcac1 dc tank clk health status";
CM_ SG_ 1092 PCS2_a127_dcac1_hvEnableHealthSt "PCS2 ECU: a127 dcac1 hv enable health status";
CM_ SG_ 1092 PCS2_a127_dcac1_HealthCheckRetry "PCS2 ECU: a127 dcac1 health check retry cnt";
CM_ SG_ 1092 PCS2_a127_dcac1_HealthCheckMaxRe "PCS2 ECU: a127 dcac1 health check max retry";
CM_ SG_ 1092 PCS2_a128_acLineClkHealthStatus "PCS2 ECU: a128 ac line clk health status";
CM_ SG_ 1092 PCS2_a128_dcac2_L1EnableHealthSt "PCS2 ECU: a128 dcac2 L1 enable health status";
CM_ SG_ 1092 PCS2_a128_dcac2_L2EnableHealthSt "PCS2 ECU: a128 dcac2 L2 enable health status";
CM_ SG_ 1092 PCS2_a128_dcac2_L3EnableHealthSt "PCS2 ECU: a128 dcac2 L3 enable health status";
CM_ SG_ 1092 PCS2_a128_dcac2_LNEnableHealthSt "PCS2 ECU: a128 dcac2 LN enable health status";
CM_ SG_ 1092 PCS2_a128_dcac2_acTankClkHealthS "PCS2 ECU: a128 dcac2 ac tank clk health status";
CM_ SG_ 1092 PCS2_a128_dcac2_dcTankClkHealthS "PCS2 ECU: a128 dcac2 dc tank clk health status";
CM_ SG_ 1092 PCS2_a128_dcac2_hvEnableHealthSt "PCS2 ECU: a128 dcac2 hv enable health status";
CM_ SG_ 1092 PCS2_a128_dcac2_HealthCheckRetry "PCS2 ECU: a128 dcac2 health check retry cnt";
CM_ SG_ 1092 PCS2_a128_dcac2_HealthCheckMaxRe "PCS2 ECU: a128 dcac2 health check max retry";
CM_ SG_ 1092 PCS2_a129_hvBusVoltage "PCS2 ECU: a129 hv bus voltage";
CM_ SG_ 1092 PCS2_a129_lvBusVoltage "PCS2 ECU: a129 lv bus voltage";
CM_ SG_ 1092 PCS2_a129_instantMeasuredZCDEven "PCS2 ECU: a129 instant measured ZCD event";
CM_ SG_ 1092 PCS2_a129_instantMeasuredZCDHalf "PCS2 ECU: a129 instant measured ZCD half prd PU";
CM_ SG_ 1092 PCS2_a129_commandedSwitchFreq "PCS2 ECU: a129 commanded switch freq";
CM_ SG_ 1092 PCS2_a130_serverStateAtRetry "PCS2 ECU: a130 server state at retry";
CM_ SG_ 1092 PCS2_a130_retriesAttempted "PCS2 ECU: a130 retries attempted";
CM_ SG_ 1092 PCS2_a132_gridFrequency "PCS2 ECU: a132 grid frequency";
CM_ SG_ 1092 PCS2_a132_L1NGridVoltage "PCS2 ECU: a132 L1 n grid voltage";
CM_ SG_ 1092 PCS2_a132_L2NGridVoltage "PCS2 ECU: a132 L2 n grid voltage";
CM_ SG_ 1092 PCS2_a132_L3NGridVoltage "PCS2 ECU: a132 L3 n grid voltage";
CM_ SG_ 1092 PCS2_a132_currentLimit "PCS2 ECU: a132 current limit";
CM_ SG_ 1092 PCS2_a136_failedSequence "PCS2 ECU: a136 failed sequence";
CM_ SG_ 1092 PCS2_a136_mosfetLegUnderTest "PCS2 ECU: a136 mosfet leg under test";
CM_ SG_ 1092 PCS2_a136_mosfetIndexUnderTest "PCS2 ECU: a136 mosfet index under test";
CM_ SG_ 1092 PCS2_a136_measuredResonantFreque "PCS2 ECU: a136 measured resonant frequency";
CM_ SG_ 1092 PCS2_a136_retryCount "PCS2 ECU: a136 retry count";
CM_ SG_ 1092 PCS2_a136_acVoltagePresent "PCS2 ECU: a136 ac voltage present";
CM_ SG_ 1092 PCS2_a136_pwmTrippedDuringHealth "PCS2 ECU: a136 pwm tripped during health check";
CM_ SG_ 1092 PCS2_a136_dcacEnableLineDeassert "PCS2 ECU: a136 dcac enable line deasserted";
CM_ SG_ 1092 PCS2_a136_hvdcOverCurrentTripHas "PCS2 ECU: a136 hvdc over current trip has occurred";
CM_ SG_ 1092 PCS2_a136_lineOverCurrentTripHas "PCS2 ECU: a136 line over current trip has occurred";
CM_ SG_ 1092 PCS2_a136_lineOverVoltageTripHas "PCS2 ECU: a136 line over voltage trip has occurred";
CM_ SG_ 1092 PCS2_a136_powerRailTripHasOccurr "PCS2 ECU: a136 power rail trip has occurred";
CM_ SG_ 1092 PCS2_a136_hvBusVoltageTripHasOcc "PCS2 ECU: a136 hv bus voltage trip has occurred";
CM_ SG_ 1092 PCS2_a136_lvBusVoltageTripHasOcc "PCS2 ECU: a136 lv bus voltage trip has occurred";
CM_ SG_ 1092 PCS2_a136_tankFreqZeroWithEdgeDe "PCS2 ECU: a136 tank freq zero with edge detected";
CM_ SG_ 1092 PCS2_a136_resultExempted "PCS2 ECU: a136 result exempted";
CM_ SG_ 1092 PCS2_a137_failedSequence "PCS2 ECU: a137 failed sequence";
CM_ SG_ 1092 PCS2_a137_mosfetLegUnderTest "PCS2 ECU: a137 mosfet leg under test";
CM_ SG_ 1092 PCS2_a137_mosfetIndexUnderTest "PCS2 ECU: a137 mosfet index under test";
CM_ SG_ 1092 PCS2_a137_measuredResonantFreque "PCS2 ECU: a137 measured resonant frequency";
CM_ SG_ 1092 PCS2_a137_retryCount "PCS2 ECU: a137 retry count";
CM_ SG_ 1092 PCS2_a137_acVoltagePresent "PCS2 ECU: a137 ac voltage present";
CM_ SG_ 1092 PCS2_a137_pwmTrippedDuringHealth "PCS2 ECU: a137 pwm tripped during health check";
CM_ SG_ 1092 PCS2_a137_dcacEnableLineDeassert "PCS2 ECU: a137 dcac enable line deasserted";
CM_ SG_ 1092 PCS2_a137_hvdcOverCurrentTripHas "PCS2 ECU: a137 hvdc over current trip has occurred";
CM_ SG_ 1092 PCS2_a137_lineOverCurrentTripHas "PCS2 ECU: a137 line over current trip has occurred";
CM_ SG_ 1092 PCS2_a137_lineOverVoltageTripHas "PCS2 ECU: a137 line over voltage trip has occurred";
CM_ SG_ 1092 PCS2_a137_powerRailTripHasOccurr "PCS2 ECU: a137 power rail trip has occurred";
CM_ SG_ 1092 PCS2_a137_hvBusVoltageTripHasOcc "PCS2 ECU: a137 hv bus voltage trip has occurred";
CM_ SG_ 1092 PCS2_a137_lvBusVoltageTripHasOcc "PCS2 ECU: a137 lv bus voltage trip has occurred";
CM_ SG_ 1092 PCS2_a137_tankFreqZeroWithEdgeDe "PCS2 ECU: a137 tank freq zero with edge detected";
CM_ SG_ 1092 PCS2_a137_resultExempted "PCS2 ECU: a137 result exempted";
CM_ SG_ 1092 PCS2_a138_hvdcCurrentOffset "PCS2 ECU: a138 hvdc current offset";
CM_ SG_ 1092 PCS2_a138_hvdcCurrentOffsetThres "PCS2 ECU: a138 hvdc current offset threshold abs";
CM_ SG_ 1092 PCS2_a141_boostOverCurrentThresh "PCS2 ECU: a141 boost over current threshold";
CM_ SG_ 1092 PCS2_a142_AcLineGdpsDataMissing "PCS2 ECU: a142 ac line gdps data missing";
CM_ SG_ 1092 PCS2_a142_AcLineGdpsDataOutOfSpe "PCS2 ECU: a142 ac line gdps data out of spec";
CM_ SG_ 1092 PCS2_a142_AcLineGdpsDataStale "PCS2 ECU: a142 ac line gdps data stale";
CM_ SG_ 1092 PCS2_a143_AcTankGdpsDataMissing "PCS2 ECU: a143 ac tank gdps data missing";
CM_ SG_ 1092 PCS2_a143_AcTankGdpsDataOutOfSpe "PCS2 ECU: a143 ac tank gdps data out of spec";
CM_ SG_ 1092 PCS2_a143_AcTankGdpsDataStale "PCS2 ECU: a143 ac tank gdps data stale";
CM_ SG_ 1092 PCS2_a144_DcTankGdpsDataMissing "PCS2 ECU: a144 dc tank gdps data missing";
CM_ SG_ 1092 PCS2_a144_DcTankGdpsDataOutOfSpe "PCS2 ECU: a144 dc tank gdps data out of spec";
CM_ SG_ 1092 PCS2_a144_DcTankGdpsDataStale "PCS2 ECU: a144 dc tank gdps data stale";
CM_ SG_ 1092 PCS2_a145_DcdcHvdcGdpsDataMissin "PCS2 ECU: a145 dcdc hvdc gdps data missing";
CM_ SG_ 1092 PCS2_a145_DcdcHvdcGdpsDataOutOfS "PCS2 ECU: a145 dcdc hvdc gdps data out of spec";
CM_ SG_ 1092 PCS2_a145_DcdcHvdcGdpsDataStale "PCS2 ECU: a145 dcdc hvdc gdps data stale";
CM_ SG_ 1092 PCS2_a146_leg1_Irms "PCS2 ECU: a146 leg1 irms";
CM_ SG_ 1092 PCS2_a146_leg2_Irms "PCS2 ECU: a146 leg2 irms";
CM_ SG_ 1092 PCS2_a146_leg3_Irms "PCS2 ECU: a146 leg3 irms";
CM_ SG_ 1092 PCS2_a146_legN_Irms "PCS2 ECU: a146 leg n irms";
CM_ SG_ 1092 PCS2_a146_legs_paralleled_by_rel "PCS2 ECU: a146 legs paralleled by relay";
CM_ SG_ 1092 PCS2_a146_ac_harness_l2_l3_short "PCS2 ECU: a146 ac harness l2 l3 shorted";
CM_ SG_ 1092 PCS2_a147_4V5RailOverVoltageTrip "PCS2 ECU: a147 4 V5 rail over voltage trip";
CM_ SG_ 1092 PCS2_a147_10V0RailOverVoltageTri "PCS2 ECU: a147 10 V0 rail over voltage trip";
CM_ SG_ 1092 PCS2_a147_13V5RailOverVoltageTri "PCS2 ECU: a147 13 V5 rail over voltage trip";
CM_ SG_ 1092 PCS2_a147_18V0RailOverVoltageTri "PCS2 ECU: a147 18 V0 rail over voltage trip";
CM_ SG_ 1092 PCS2_a147_48V0RailOverVoltageTri "PCS2 ECU: a147 48 V0 rail over voltage trip";
CM_ SG_ 1092 PCS2_a147_BuckBoostLVInputOVTrip "PCS2 ECU: a147 buck boost LV input OV trip";
CM_ SG_ 1092 PCS2_a147_4V5RailOverVoltageThre "PCS2 ECU: a147 4 V5 rail over voltage threshold";
CM_ SG_ 1092 PCS2_a147_10V0RailOverVoltageThr "PCS2 ECU: a147 10 V0 rail over voltage threshold";
CM_ SG_ 1092 PCS2_a147_13V5RailOverVoltageThr "PCS2 ECU: a147 13 V5 rail over voltage threshold";
CM_ SG_ 1092 PCS2_a147_18V0RailOverVoltageThr "PCS2 ECU: a147 18 V0 rail over voltage threshold";
CM_ SG_ 1092 PCS2_a147_48V0RailOverVoltageThr "PCS2 ECU: a147 48 V0 rail over voltage threshold";
CM_ SG_ 1092 PCS2_a147_BuckBoostLVInputOVThre "PCS2 ECU: a147 buck boost LV input OV threshold";
CM_ SG_ 1092 PCS2_a148_l1nPostRelayVoltage "PCS2 ECU: a148 l1n post relay voltage";
CM_ SG_ 1092 PCS2_a148_l2nPostRelayVoltage "PCS2 ECU: a148 l2n post relay voltage";
CM_ SG_ 1092 PCS2_a148_l3nPostRelayVoltage "PCS2 ECU: a148 l3n post relay voltage";
CM_ SG_ 1092 PCS2_a148_l2nPreRelayVoltage "PCS2 ECU: a148 l2n pre relay voltage";
CM_ SG_ 1092 PCS2_a148_l3nPreRelayVoltage "PCS2 ECU: a148 l3n pre relay voltage";
CM_ SG_ 1092 PCS2_a148_acRelayState "PCS2 ECU: a148 ac relay state";
CM_ SG_ 1092 PCS2_a149_buckBoostPermanentFaul "PCS2 ECU: a149 buck boost permanent fault";
CM_ SG_ 1092 PCS2_a149_buckBoostRampFaultCoun "PCS2 ECU: a149 buck boost ramp fault count";
CM_ SG_ 1092 PCS2_a149_buckBoostCmpssFaultCou "PCS2 ECU: a149 buck boost cmpss fault count";
CM_ SG_ 1092 PCS2_a149_buckBoost18VOVFault "PCS2 ECU: a149 buck boost18 VOV fault";
CM_ SG_ 1092 PCS2_a149_buckBoostInputOVFault "PCS2 ECU: a149 buck boost input OV fault";
CM_ SG_ 1092 PCS2_a149_buckBoost18VLeakyBucke "PCS2 ECU: a149 buck boost18 v leaky bucket fault";
CM_ SG_ 1092 PCS2_a149_buckBoost18VUVCmpssFau "PCS2 ECU: a149 buck boost18 VUV cmpss fault";
CM_ SG_ 1092 PCS2_a149_buckBoostLVOVCmpssFaul "PCS2 ECU: a149 buck boost LVOV cmpss fault";
CM_ SG_ 1092 PCS2_a149_buckBoostLVUVCmpssFaul "PCS2 ECU: a149 buck boost LVUV cmpss fault";
CM_ SG_ 1092 PCS2_a149_buckBoostRetryPrevente "PCS2 ECU: a149 buck boost retry prevented fault";
CM_ SG_ 1092 PCS2_a149_buckBoostRampTarget "PCS2 ECU: a149 buck boost ramp target; raw 4095 = signal not available (SNA)";
CM_ SG_ 1092 PCS2_a150_presentBurstMode "PCS2 ECU: a150 present burst mode";
CM_ SG_ 1092 PCS2_a150_previousBurstMode "PCS2 ECU: a150 previous burst mode";
CM_ SG_ 1092 PCS2_a150_levelNotFinishedCounts "PCS2 ECU: a150 level not finished counts";
CM_ SG_ 1092 PCS2_a150_burstOnCycles "PCS2 ECU: a150 burst on cycles";
CM_ SG_ 1092 PCS2_a151_DcdcBLv1Temp "PCS2 ECU: a151 dcdc b lv1 temp; raw 1025 = signal not available (SNA)";
CM_ SG_ 1092 PCS2_a151_DcdcBLv1TempUpperThres "PCS2 ECU: a151 dcdc b lv1 temp upper threshold; raw 1025 = signal not available (SNA)";
CM_ SG_ 1092 PCS2_a152_DcdcBLv3Temp "PCS2 ECU: a152 dcdc b lv3 temp; raw 1025 = signal not available (SNA)";
CM_ SG_ 1092 PCS2_a152_DcdcBLv3TempUpperThres "PCS2 ECU: a152 dcdc b lv3 temp upper threshold; raw 1025 = signal not available (SNA)";
CM_ SG_ 1092 PCS2_a154_adcReferenceDataMissin "PCS2 ECU: a154 adc reference data missing";
CM_ SG_ 1092 PCS2_a154_adcReferenceOutOfSpec "PCS2 ECU: a154 adc reference out of spec";
CM_ SG_ 1092 PCS2_a155_VC_LVHealth "PCS2 ECU: a155 VC LV health";
CM_ SG_ 1092 PCS2_a156_VCFRONT_coolant "PCS2 ECU: a156 VCFRONT coolant";
CM_ SG_ 1092 PCS2_a156_VCFRONT_sensors "PCS2 ECU: a156 VCFRONT sensors";
CM_ SG_ 1092 PCS2_a157_VC_pcsManagement "PCS2 ECU: a157 VC pcs management";
CM_ SG_ 1092 PCS2_a158_DcdcModelHvMosfetTemp "PCS2 ECU: a158 dcdc model hv mosfet temp";
CM_ SG_ 1092 PCS2_a158_DcdcModelHvMosfetCoola "PCS2 ECU: a158 dcdc model hv mosfet coolant temp";
CM_ SG_ 1092 PCS2_a158_DcDcModelHvMosfetCoola "PCS2 ECU: a158 dc dc model hv mosfet coolant flow rate";
CM_ SG_ 1092 PCS2_a158_DcDcModelHvMosfetCurre "PCS2 ECU: a158 dc dc model hv mosfet current";
CM_ SG_ 1092 PCS2_a159_HVDCGdpsHealthStatus "PCS2 ECU: a159 HVDC gdps health status";
CM_ SG_ 1092 PCS2_a160_VCLEFT_networkManageme "PCS2 ECU: a160 VCLEFT network management";
CM_ SG_ 1092 PCS2_a161_VCREAR_networkManageme "PCS2 ECU: a161 VCREAR network management";
CM_ SG_ 1092 PCS2_a170_pcsMaxAcPowerAvailable "PCS2 ECU: a170 pcs max ac power available";
CM_ SG_ 1092 PCS2_a170_pcsMaxAcPowerCapabilit "PCS2 ECU: a170 pcs max ac power capability";
CM_ SG_ 1092 PCS2_a170_numberOfCycloStagesAva "PCS2 ECU: a170 number of cyclo stages available for operation";
CM_ SG_ 1092 PCS2_a170_detectedPhaseConfig "PCS2 ECU: a170 detected phase config";
CM_ SG_ 1092 PCS2_a173_DcdcALv1Temp "PCS2 ECU: a173 dcdc a lv1 temp; raw 1025 = signal not available (SNA)";
CM_ SG_ 1092 PCS2_a173_DcdcALv1TempUpperThres "PCS2 ECU: a173 dcdc a lv1 temp upper threshold; raw 1025 = signal not available (SNA)";
CM_ SG_ 1092 PCS2_a174_llc48V0RailOverCurrent "PCS2 ECU: a174 llc48 V0 rail over current trip";
CM_ SG_ 1092 PCS2_a174_llc48V0RailMaxThreshol "PCS2 ECU: a174 llc48 V0 rail max threshold";
CM_ SG_ 1092 PCS2_a177_latchMotorRailOverCurr "PCS2 ECU: a177 latch motor rail over current trip";
CM_ SG_ 1092 PCS2_a177_latchMotorRailMaxThres "PCS2 ECU: a177 latch motor rail max threshold";
CM_ SG_ 1092 PCS2_a180_DcdcModelTxHATTemp "PCS2 ECU: a180 dcdc model tx HAT temp";
CM_ SG_ 1092 PCS2_a180_DcdcModelTxHATCoolantT "PCS2 ECU: a180 dcdc model tx HAT coolant temp";
CM_ SG_ 1092 PCS2_a180_DcDcModelTxHATCoolantF "PCS2 ECU: a180 dc dc model tx HAT coolant flow rate";
CM_ SG_ 1092 PCS2_a180_DcDcModelTxHATCurrent "PCS2 ECU: a180 dc dc model tx HAT current";
CM_ BO_ 996 "PCS2 ECU message: alert matrix";
CM_ SG_ 996 PCS2_matrixIndex "PCS2 ECU: matrix index";
CM_ SG_ 996 PCS2_a001_watchdogAlarmed "PCS2 ECU: a001 watchdog alarmed";
CM_ SG_ 996 PCS2_a002_canRationality "PCS2 ECU: a002 can rationality";
CM_ SG_ 996 PCS2_a003_softwareAssertion "PCS2 ECU: a003 software assertion";
CM_ SG_ 996 PCS2_a004_acL1NOverVoltage "PCS2 ECU: a004 ac L1 n over voltage";
CM_ SG_ 996 PCS2_a005_acL1OverCurrent "PCS2 ECU: a005 ac L1 over current";
CM_ SG_ 996 PCS2_a006_acL2NOverVoltage "PCS2 ECU: a006 ac L2 n over voltage";
CM_ SG_ 996 PCS2_a007_acL2OverCurrent "PCS2 ECU: a007 ac L2 over current";
CM_ SG_ 996 PCS2_a008_acL3NOverVoltage "PCS2 ECU: a008 ac L3 n over voltage";
CM_ SG_ 996 PCS2_a009_acL3OverCurrent "PCS2 ECU: a009 ac L3 over current";
CM_ SG_ 996 PCS2_a010_acLNOverCurrent "PCS2 ECU: a010 ac LN over current";
CM_ SG_ 996 PCS2_a011_hvdcOverCurrent "PCS2 ECU: a011 hvdc over current";
CM_ SG_ 996 PCS2_a012_cycloATankOverCurrent "PCS2 ECU: a012 cyclo a tank over current";
CM_ SG_ 996 PCS2_a013_DcdcALv2OverTemp "PCS2 ECU: a013 dcdc a lv2 over temp";
CM_ SG_ 996 PCS2_a014_cycloBTankOverCurrent "PCS2 ECU: a014 cyclo b tank over current";
CM_ SG_ 996 PCS2_a015_DcdcAHvOverTemp "PCS2 ECU: a015 dcdc a hv over temp";
CM_ SG_ 996 PCS2_a016_dcdcATankOverCurrent "PCS2 ECU: a016 dcdc a tank over current";
CM_ SG_ 996 PCS2_a017_DcdcBLv2OverTemp "PCS2 ECU: a017 dcdc b lv2 over temp";
CM_ SG_ 996 PCS2_a018_dcdcBTankOverCurrent "PCS2 ECU: a018 dcdc b tank over current";
CM_ SG_ 996 PCS2_a019_DcacADcTempTooHigh "PCS2 ECU: a019 dcac a dc temp too high";
CM_ SG_ 996 PCS2_a020_DcacBDcTempTooHigh "PCS2 ECU: a020 dcac b dc temp too high";
CM_ SG_ 996 PCS2_a021_powerRailUnderVoltage "PCS2 ECU: a021 power rail under voltage";
CM_ SG_ 996 PCS2_a022_dcacEnableFunctionalit "PCS2 ECU: a022 dcac enable functionality disabled";
CM_ SG_ 996 PCS2_a023_dcdcEnableFunctionalit "PCS2 ECU: a023 dcdc enable functionality disabled";
CM_ SG_ 996 PCS2_a024_DcacATxTempTooHigh "PCS2 ECU: a024 dcac a tx temp too high";
CM_ SG_ 996 PCS2_a025_DcacBTxTempTooHigh "PCS2 ECU: a025 dcac b tx temp too high";
CM_ SG_ 996 PCS2_a026_AcConnectorTempTooHigh "PCS2 ECU: a026 ac connector temp too high";
CM_ SG_ 996 PCS2_a027_AmbientTempTooHigh "PCS2 ECU: a027 ambient temp too high";
CM_ SG_ 996 PCS2_a028_CoolantTempTooHigh "PCS2 ECU: a028 coolant temp too high";
CM_ SG_ 996 PCS2_a029_DcacAAc1TempTooHigh "PCS2 ECU: a029 dcac a ac1 temp too high";
CM_ SG_ 996 PCS2_a030_DcacAAc2TempTooHigh "PCS2 ECU: a030 dcac a ac2 temp too high";
CM_ SG_ 996 PCS2_a031_DcacBAc1TempTooHigh "PCS2 ECU: a031 dcac b ac1 temp too high";
CM_ SG_ 996 PCS2_a032_DcacBAc2TempTooHigh "PCS2 ECU: a032 dcac b ac2 temp too high";
CM_ SG_ 996 PCS2_a033_swCoreExcessiveUsage "PCS2 ECU: a033 sw core excessive usage";
CM_ SG_ 996 PCS2_a034_lvBusOverVoltage "PCS2 ECU: a034 lv bus over voltage";
CM_ SG_ 996 PCS2_a035_lvBusUnderVoltage "PCS2 ECU: a035 lv bus under voltage";
CM_ SG_ 996 PCS2_a036_hvBusOverVoltage "PCS2 ECU: a036 hv bus over voltage";
CM_ SG_ 996 PCS2_a037_hvBusUnderVoltage "PCS2 ECU: a037 hv bus under voltage";
CM_ SG_ 996 PCS2_a038_hvBusTopOverVoltage "PCS2 ECU: a038 hv bus top over voltage";
CM_ SG_ 996 PCS2_a039_hvBusTopUnderVoltage "PCS2 ECU: a039 hv bus top under voltage";
CM_ SG_ 996 PCS2_a040_hvBusBotOverVoltage "PCS2 ECU: a040 hv bus bot over voltage";
CM_ SG_ 996 PCS2_a041_hvBusBotUnderVoltage "PCS2 ECU: a041 hv bus bot under voltage";
CM_ SG_ 996 PCS2_a042_hvBattOverVoltage "PCS2 ECU: a042 hv batt over voltage";
CM_ SG_ 996 PCS2_a043_hvBattUnderVoltage "PCS2 ECU: a043 hv batt under voltage";
CM_ SG_ 996 PCS2_a044_hvBattTopOverVoltage "PCS2 ECU: a044 hv batt top over voltage";
CM_ SG_ 996 PCS2_a045_hvBattTopUnderVoltage "PCS2 ECU: a045 hv batt top under voltage";
CM_ SG_ 996 PCS2_a046_hvBattBotOverVoltage "PCS2 ECU: a046 hv batt bot over voltage";
CM_ SG_ 996 PCS2_a047_hvBattBotUnderVoltage "PCS2 ECU: a047 hv batt bot under voltage";
CM_ SG_ 996 PCS2_a048_dcacOverVoltage "PCS2 ECU: a048 dcac over voltage";
CM_ SG_ 996 PCS2_a049_dcacUnderVoltage "PCS2 ECU: a049 dcac under voltage";
CM_ SG_ 996 PCS2_a050_vcPcsDCDCInterfaceMia "PCS2 ECU: a050 vc pcs DCDC interface mia";
CM_ SG_ 996 PCS2_a051_bmsMia "PCS2 ECU: a051 bms mia";
CM_ SG_ 996 PCS2_a052_cpMia "PCS2 ECU: a052 cp mia";
CM_ SG_ 996 PCS2_a053_hvDcdcControlMIA "PCS2 ECU: a053 hv dcdc control MIA";
CM_ SG_ 996 PCS2_a054_uiMia "PCS2 ECU: a054 ui mia";
CM_ SG_ 996 PCS2_a055_dcdcATankUncalibrated "PCS2 ECU: a055 dcdc a tank uncalibrated";
CM_ SG_ 996 PCS2_a056_dcdcBTankUncalibrated "PCS2 ECU: a056 dcdc b tank uncalibrated";
CM_ SG_ 996 PCS2_a057_cycloATankUncalibrated "PCS2 ECU: a057 cyclo a tank uncalibrated";
CM_ SG_ 996 PCS2_a058_cycloBTankUncalibrated "PCS2 ECU: a058 cyclo b tank uncalibrated";
CM_ SG_ 996 PCS2_a059_dcdcEnableLineDeassert "PCS2 ECU: a059 dcdc enable line deasserted";
CM_ SG_ 996 PCS2_a060_cycloAFaulted "PCS2 ECU: a060 cyclo a faulted";
CM_ SG_ 996 PCS2_a061_cycloBFaulted "PCS2 ECU: a061 cyclo b faulted";
CM_ SG_ 996 PCS2_a062_acVoltageNotPresent "PCS2 ECU: a062 ac voltage not present";
CM_ SG_ 996 PCS2_a063_chgUnknownGridConfig "PCS2 ECU: a063 chg unknown grid config";
CM_ SG_ 996 PCS2_a064_dcdcATankParametersOut "PCS2 ECU: a064 dcdc a tank parameters out of spec";
CM_ SG_ 996 PCS2_a065_dcdcBTankParametersOut "PCS2 ECU: a065 dcdc b tank parameters out of spec";
CM_ SG_ 996 PCS2_a066_cycloATankParametersOu "PCS2 ECU: a066 cyclo a tank parameters out of spec";
CM_ SG_ 996 PCS2_a067_cycloBTankParametersOu "PCS2 ECU: a067 cyclo b tank parameters out of spec";
CM_ SG_ 996 PCS2_a068_nvmSubsystemStalled "PCS2 ECU: a068 nvm subsystem stalled";
CM_ SG_ 996 PCS2_a069_dcdcAlifetimeEnergyRec "PCS2 ECU: a069 dcdc alifetime energy record faulty";
CM_ SG_ 996 PCS2_a070_dcdcBlifetimeEnergyRec "PCS2 ECU: a070 dcdc blifetime energy record faulty";
CM_ SG_ 996 PCS2_a071_hvBattBotSensorIrratio "PCS2 ECU: a071 hv batt bot sensor irrational";
CM_ SG_ 996 PCS2_a072_hvBattTopSensorIrratio "PCS2 ECU: a072 hv batt top sensor irrational";
CM_ SG_ 996 PCS2_a073_hvBusBotSensorIrration "PCS2 ECU: a073 hv bus bot sensor irrational";
CM_ SG_ 996 PCS2_a074_hvBusTopSensorIrration "PCS2 ECU: a074 hv bus top sensor irrational";
CM_ SG_ 996 PCS2_a075_hvBattFullSensorIrrati "PCS2 ECU: a075 hv batt full sensor irrational";
CM_ SG_ 996 PCS2_a076_hvBusFullSensorIrratio "PCS2 ECU: a076 hv bus full sensor irrational";
CM_ SG_ 996 PCS2_a077_lvBusVoltSensorIrratio "PCS2 ECU: a077 lv bus volt sensor irrational";
CM_ SG_ 996 PCS2_a078_acL1NVoltageOffsetIrra "PCS2 ECU: a078 ac L1 n voltage offset irrational";
CM_ SG_ 996 PCS2_a079_acL2NVoltageOffsetIrra "PCS2 ECU: a079 ac L2 n voltage offset irrational";
CM_ SG_ 996 PCS2_a080_acL3NVoltageOffsetIrra "PCS2 ECU: a080 ac L3 n voltage offset irrational";
CM_ SG_ 996 PCS2_a081_acL1CurrentOffsetIrrat "PCS2 ECU: a081 ac L1 current offset irrational";
CM_ SG_ 996 PCS2_a082_acL2CurrentOffsetIrrat "PCS2 ECU: a082 ac L2 current offset irrational";
CM_ SG_ 996 PCS2_a083_acL3CurrentOffsetIrrat "PCS2 ECU: a083 ac L3 current offset irrational";
CM_ SG_ 996 PCS2_a084_acNCurrentOffsetIrrati "PCS2 ECU: a084 ac n current offset irrational";
CM_ SG_ 996 PCS2_a085_dcacEnableLineDeassert "PCS2 ECU: a085 dcac enable line deasserted";
CM_ SG_ 996 PCS2_a086_dcacLVUnderVoltage "PCS2 ECU: a086 dcac LV under voltage";
CM_ SG_ 996 PCS2_a087_dcacLVOverVoltage "PCS2 ECU: a087 dcac LV over voltage";
CM_ SG_ 996 PCS2_a088_chgInputVDropHigh "PCS2 ECU: a088 chg input v drop high";
CM_ SG_ 996 PCS2_a089_EndOfLineModeActivated "PCS2 ECU: a089 end of line mode activated";
CM_ SG_ 996 PCS2_a090_DcdcLvMosfetTempTooHig "PCS2 ECU: a090 dcdc lv mosfet temp too high";
CM_ SG_ 996 PCS2_a091_DcdcTxWindingTempTooHi "PCS2 ECU: a091 dcdc tx winding temp too high";
CM_ SG_ 996 PCS2_a092_dcdc_itankZcdIrrationa "PCS2 ECU: a092 dcdc itank zcd irrational";
CM_ SG_ 996 PCS2_a093_cycloPwmsNotInterleave "PCS2 ECU: a093 cyclo pwms not interleaved";
CM_ SG_ 996 PCS2_a094_acChargingUnavailable "PCS2 ECU: a094 ac charging unavailable";
CM_ SG_ 996 PCS2_a095_powershareUnavailable "PCS2 ECU: a095 powershare unavailable";
CM_ SG_ 996 PCS2_a096_vcsuperMia "PCS2 ECU: a096 vcsuper mia";
CM_ SG_ 996 PCS2_a097_gtwMia "PCS2 ECU: a097 gtw mia";
CM_ SG_ 996 PCS2_a098_eggright3Mia "PCS2 ECU: a098 eggright3 mia";
CM_ SG_ 996 PCS2_a099_LineChassisRmsOV "PCS2 ECU: a099 line chassis rms OV";
CM_ SG_ 996 PCS2_a100_LineToLineRmsOV "PCS2 ECU: a100 line to line rms OV";
CM_ SG_ 996 PCS2_a101_LineChassisInstantaneo "PCS2 ECU: a101 line chassis instantaneous OV";
CM_ SG_ 996 PCS2_a102_LineToLineInstantaneou "PCS2 ECU: a102 line to line instantaneous OV";
CM_ SG_ 996 PCS2_a103_IsoTempSensorIrrationa "PCS2 ECU: a103 iso temp sensor irrational";
CM_ SG_ 996 PCS2_a104_LineChassisRmsUV "PCS2 ECU: a104 line chassis rms UV";
CM_ SG_ 996 PCS2_a105_LineToLineRmsUV "PCS2 ECU: a105 line to line rms UV";
CM_ SG_ 996 PCS2_a106_systemNeutralChassisRm "PCS2 ECU: a106 system neutral chassis rms OV";
CM_ SG_ 996 PCS2_a107_cycloLostCurrentContro "PCS2 ECU: a107 cyclo lost current control";
CM_ SG_ 996 PCS2_a108_FunctionalTestModeActi "PCS2 ECU: a108 functional test mode activated";
CM_ SG_ 996 PCS2_a109_ACSurgeProtectionTrigg "PCS2 ECU: a109 AC surge protection triggered";
CM_ SG_ 996 PCS2_a110_acCurrentIsLimited "PCS2 ECU: a110 ac current is limited";
CM_ SG_ 996 PCS2_a111_microgridHeartbeatMiss "PCS2 ECU: a111 microgrid heartbeat missing";
CM_ SG_ 996 PCS2_a112_chgInputVDropTooHigh "PCS2 ECU: a112 chg input v drop too high";
CM_ SG_ 996 PCS2_a113_dcdcTransientCapabilit "PCS2 ECU: a113 dcdc transient capability impacted";
CM_ SG_ 996 PCS2_a114_hvBusEstimatedImpedanc "PCS2 ECU: a114 hv bus estimated impedance low";
CM_ SG_ 996 PCS2_a115_chgWallPowerRemoval "PCS2 ECU: a115 chg wall power removal";
CM_ SG_ 996 PCS2_a116_chgPersistentFault "PCS2 ECU: a116 chg persistent fault";
CM_ SG_ 996 PCS2_a117_vcrightMia "PCS2 ECU: a117 vcright mia";
CM_ SG_ 996 PCS2_a118_dcdcFailedToPrechargeT "PCS2 ECU: a118 dcdc failed to precharge to target";
CM_ SG_ 996 PCS2_a119_useMaxCapForHvImpedanc "PCS2 ECU: a119 use max cap for hv impedance estimation";
CM_ SG_ 996 PCS2_a120_triggerOdin "Signal reported by PCS2 ECU";
CM_ SG_ 996 PCS2_a121_insufficientCoolingDet "PCS2 ECU: a121 insufficient cooling detected";
CM_ SG_ 996 PCS2_a122_dcacLifetimekVAhRecord "PCS2 ECU: a122 dcac lifetimek v ah record error";
CM_ SG_ 996 PCS2_a123_DcdcBHvOverTemp "PCS2 ECU: a123 dcdc b hv over temp";
CM_ SG_ 996 PCS2_a124_dcacItankSoftwareOC "PCS2 ECU: a124 dcac itank software OC";
CM_ SG_ 996 PCS2_a125_cycloIdleShortingNeutr "PCS2 ECU: a125 cyclo idle shorting neutral";
CM_ SG_ 996 PCS2_a126_ipcSuccessiveLockGrabF "PCS2 ECU: a126 ipc successive lock grab failure";
CM_ SG_ 996 PCS2_a127_cycloAgdpsHealthCheckF "PCS2 ECU: a127 cyclo agdps health check failed";
CM_ SG_ 996 PCS2_a128_cycloBgdpsHealthCheckF "PCS2 ECU: a128 cyclo bgdps health check failed";
CM_ SG_ 996 PCS2_a129_lossOfZcdEventControl "PCS2 ECU: a129 loss of zcd event control";
CM_ SG_ 996 PCS2_a130_IONVMMServerRetryEvent "PCS2 ECU: a130 IONVMM server retry event";
CM_ SG_ 996 PCS2_a131_microgridHeartbeatDete "PCS2 ECU: a131 microgrid heartbeat detected";
CM_ SG_ 996 PCS2_a132_microgridDroopDetected "PCS2 ECU: a132 microgrid droop detected";
CM_ SG_ 996 PCS2_a133_unused "PCS2 ECU: a133 unused";
CM_ SG_ 996 PCS2_a134_unused "PCS2 ECU: a134 unused";
CM_ SG_ 996 PCS2_a135_backgroundTaskOverRun "PCS2 ECU: a135 background task over run";
CM_ SG_ 996 PCS2_a136_cycloAMosfetHealthChec "PCS2 ECU: a136 cyclo a mosfet health check failed";
CM_ SG_ 996 PCS2_a137_cycloBMosfetHealthChec "PCS2 ECU: a137 cyclo b mosfet health check failed";
CM_ SG_ 996 PCS2_a138_hvdcCurrentSensorOffse "PCS2 ECU: a138 hvdc current sensor offset irrational";
CM_ SG_ 996 PCS2_a139_unused "PCS2 ECU: a139 unused";
CM_ SG_ 996 PCS2_a140_dcdcHalfBusBalancerSat "PCS2 ECU: a140 dcdc half bus balancer saturated";
CM_ SG_ 996 PCS2_a141_boostOverCurrent "PCS2 ECU: a141 boost over current";
CM_ SG_ 996 PCS2_a142_AcLineGdpsUncalibrated "PCS2 ECU: a142 ac line gdps uncalibrated";
CM_ SG_ 996 PCS2_a143_AcTankGdpsUncalibrated "PCS2 ECU: a143 ac tank gdps uncalibrated";
CM_ SG_ 996 PCS2_a144_DcTankGdpsUncalibrated "PCS2 ECU: a144 dc tank gdps uncalibrated";
CM_ SG_ 996 PCS2_a145_DcdcHvdcGdpsUncalibrat "PCS2 ECU: a145 dcdc hvdc gdps uncalibrated";
CM_ SG_ 996 PCS2_a146_acLineSharedCurrentCon "PCS2 ECU: a146 ac line shared current connection issue";
CM_ SG_ 996 PCS2_a147_powerRailOverVoltage "PCS2 ECU: a147 power rail over voltage";
CM_ SG_ 996 PCS2_a148_acRelayVoltageIrration "PCS2 ECU: a148 ac relay voltage irrational";
CM_ SG_ 996 PCS2_a149_buckBoostFault "PCS2 ECU: a149 buck boost fault";
CM_ SG_ 996 PCS2_a150_dcdcBurstTimingNotMet "PCS2 ECU: a150 dcdc burst timing not met";
CM_ SG_ 996 PCS2_a151_DcdcBLv1OverTemp "PCS2 ECU: a151 dcdc b lv1 over temp";
CM_ SG_ 996 PCS2_a152_DcdcBLv3OverTemp "PCS2 ECU: a152 dcdc b lv3 over temp";
CM_ SG_ 996 PCS2_a153_cyclo_itankZcdIrration "PCS2 ECU: a153 cyclo itank zcd irrational";
CM_ SG_ 996 PCS2_a154_adcReferenceUncalibrat "PCS2 ECU: a154 adc reference uncalibrated";
CM_ SG_ 996 PCS2_a155_vcbatteryMia "PCS2 ECU: a155 vcbattery mia";
CM_ SG_ 996 PCS2_a156_vcfrontMia "PCS2 ECU: a156 vcfront mia";
CM_ SG_ 996 PCS2_a157_VC_pcsManagementMia "PCS2 ECU: a157 VC pcs management mia";
CM_ SG_ 996 PCS2_a158_DcdcHvMosfetTempTooHig "PCS2 ECU: a158 dcdc hv mosfet temp too high";
CM_ SG_ 996 PCS2_a159_dcdcGdpsHealthCheckFai "PCS2 ECU: a159 dcdc gdps health check failed";
CM_ SG_ 996 PCS2_a160_vcleftMia "PCS2 ECU: a160 vcleft mia";
CM_ SG_ 996 PCS2_a161_vcrearMia "PCS2 ECU: a161 vcrear mia";
CM_ SG_ 996 PCS2_a162_cycloARoutineTankInduc "PCS2 ECU: a162 cyclo a routine tank inductance measurement";
CM_ SG_ 996 PCS2_a163_cycloBRoutineTankInduc "PCS2 ECU: a163 cyclo b routine tank inductance measurement";
CM_ SG_ 996 PCS2_a164_dcdc_hwZcdFault1 "PCS2 ECU: a164 dcdc hw zcd fault1";
CM_ SG_ 996 PCS2_a165_dcdc_hwZcdFault2 "PCS2 ECU: a165 dcdc hw zcd fault2";
CM_ SG_ 996 PCS2_a166_dcdcEnableLinePWMTripM "PCS2 ECU: a166 dcdc enable line PWM trip misconfigured";
CM_ SG_ 996 PCS2_a167_unused "PCS2 ECU: a167 unused";
CM_ SG_ 996 PCS2_a168_gridFormVoltageDropped "PCS2 ECU: a168 grid form voltage dropped";
CM_ SG_ 996 PCS2_a169_cycloMosfetHealthCheck "PCS2 ECU: a169 cyclo mosfet health check measured half prd asymmetric";
CM_ SG_ 996 PCS2_a170_acChargePowerIsLimited "PCS2 ECU: a170 ac charge power is limited";
CM_ SG_ 996 PCS2_a171_unused "PCS2 ECU: a171 unused";
CM_ SG_ 996 PCS2_a172_unused "PCS2 ECU: a172 unused";
CM_ SG_ 996 PCS2_a173_DcdcALv1OverTemp "PCS2 ECU: a173 dcdc a lv1 over temp";
CM_ SG_ 996 PCS2_a174_llc48V0RailOverCurrent "PCS2 ECU: a174 llc48 V0 rail over current";
CM_ SG_ 996 PCS2_a175_LVUVSurgePowerEvent "PCS2 ECU: a175 LVUV surge power event";
CM_ SG_ 996 PCS2_a176_cpLatchMotorUnavailabl "PCS2 ECU: a176 cp latch motor unavailable";
CM_ SG_ 996 PCS2_a177_latchMotorRailOverCurr "PCS2 ECU: a177 latch motor rail over current";
CM_ SG_ 996 PCS2_a178_eculogAborted "PCS2 ECU: a178 eculog aborted";
CM_ SG_ 996 PCS2_a179_standbyPowerUnavailabl "PCS2 ECU: a179 standby power unavailable";
CM_ SG_ 996 PCS2_a180_DcdcTxHATTempTooHigh "PCS2 ECU: a180 dcdc tx HAT temp too high";
CM_ SG_ 996 PCS2_d181_dcdcConverterVoltSenso "PCS2 ECU: d181 dcdc converter volt sensor a fault";
CM_ SG_ 996 PCS2_d182_dcdcConverterTempSenso "PCS2 ECU: d182 dcdc converter temp sensor a fault";
CM_ SG_ 996 PCS2_d183_batteryChargerAInputVo "PCS2 ECU: d183 battery charger a input volt sensor fault";
CM_ SG_ 996 PCS2_d184_batteryChargerAInputCu "PCS2 ECU: d184 battery charger a input current sensor fault";
CM_ SG_ 996 PCS2_d185_dcdcConverterANeedsSer "PCS2 ECU: d185 dcdc converter a needs service";
CM_ SG_ 996 PCS2_d186_batteryChargerAInterna "PCS2 ECU: d186 battery charger a internal power supply fault";
CM_ SG_ 996 PCS2_d187_batteryChargerModuleAN "PCS2 ECU: d187 battery charger module a needs service";
CM_ SG_ 996 PCS2_a188_prechargeWithLowLVDete "PCS2 ECU: a188 precharge with low LV detected";
CM_ SG_ 996 PCS2_a192_otherPcsMia "PCS2 ECU: a192 other pcs mia";
CM_ SG_ 996 PCS2_a193_unknownPcsID "PCS2 ECU: a193 unknown pcs ID";
CM_ SG_ 996 PCS2_a194_poorGridSync "PCS2 ECU: a194 poor grid sync";
CM_ SG_ 996 PCS2_a197_dcdcEnableLineTransien "PCS2 ECU: a197 dcdc enable line transient";
BA_DEF_ BO_ "GenMsgCycleTime" INT 0 3600000;
BA_DEF_ BO_ "GenMsgSendType" ENUM "Cyclic","NotUsed","NotUsed","NotUsed","NotUsed","NotUsed","NotUsed","IfActive","NoMsgSendType","NotUsed";
BA_DEF_ BO_ "VFrameFormat" ENUM "StandardCAN","ExtendedCAN","reserved","J1939PG","reserved","reserved","reserved","reserved","reserved","reserved","reserved","reserved","reserved","reserved","StandardCAN_FD","ExtendedCAN_FD";
BA_DEF_ BO_ "CANFD_BRS" ENUM "0","1";
BA_DEF_ SG_ "GenSigSNA" STRING;
BA_DEF_ SG_ "SystemSignalLongSymbol" STRING;
BA_DEF_ SG_ "Confidence" ENUM "validated","plausible","layout-only","contradicted";
BA_DEF_DEF_ "GenMsgCycleTime" 0;
BA_DEF_DEF_ "GenMsgSendType" "NoMsgSendType";
BA_DEF_DEF_ "VFrameFormat" "StandardCAN";
BA_DEF_DEF_ "CANFD_BRS" "1";
BA_DEF_DEF_ "GenSigSNA" "";
BA_DEF_DEF_ "SystemSignalLongSymbol" "";
BA_DEF_DEF_ "Confidence" "layout-only";
BA_ "GenMsgCycleTime" BO_ 996 1000;
BA_ "GenMsgSendType" BO_ 996 0;
BA_ "Confidence" SG_ 1092 PCS2_alertID 1;
BA_ "Confidence" SG_ 1092 PCS2_alertSet 1;
BA_ "Confidence" SG_ 1092 PCS2_alertSource 1;
BA_ "Confidence" SG_ 1092 PCS2_a003_assertionCode 1;
BA_ "Confidence" SG_ 1092 PCS2_a005_acL1OverCurrentTrip 1;
BA_ "Confidence" SG_ 1092 PCS2_a005_chgMainStateMachineSta 1;
BA_ "SystemSignalLongSymbol" SG_ 1092 PCS2_a005_chgMainStateMachineSta "PCS2_a005_chgMainStateMachineState";
BA_ "Confidence" SG_ 1092 PCS2_a005_gridFormStateMachineSt 1;
BA_ "SystemSignalLongSymbol" SG_ 1092 PCS2_a005_gridFormStateMachineSt "PCS2_a005_gridFormStateMachineState";
BA_ "Confidence" SG_ 1092 PCS2_a005_acManagerOperatingMode 1;
BA_ "Confidence" SG_ 1092 PCS2_a005_acL1MaxThreshold 1;
BA_ "Confidence" SG_ 1092 PCS2_a005_acL1MinThreshold 1;
BA_ "Confidence" SG_ 1092 PCS2_a006_acL2NOverVoltageTrip 1;
BA_ "Confidence" SG_ 1092 PCS2_a006_chgMainStateMachineSta 1;
BA_ "SystemSignalLongSymbol" SG_ 1092 PCS2_a006_chgMainStateMachineSta "PCS2_a006_chgMainStateMachineState";
BA_ "Confidence" SG_ 1092 PCS2_a006_gridFormStateMachineSt 1;
BA_ "SystemSignalLongSymbol" SG_ 1092 PCS2_a006_gridFormStateMachineSt "PCS2_a006_gridFormStateMachineState";
BA_ "Confidence" SG_ 1092 PCS2_a006_acManagerOperatingMode 1;
BA_ "Confidence" SG_ 1092 PCS2_a007_acL2OverCurrentTrip 1;
BA_ "Confidence" SG_ 1092 PCS2_a007_chgMainStateMachineSta 1;
BA_ "SystemSignalLongSymbol" SG_ 1092 PCS2_a007_chgMainStateMachineSta "PCS2_a007_chgMainStateMachineState";
BA_ "Confidence" SG_ 1092 PCS2_a007_gridFormStateMachineSt 1;
BA_ "SystemSignalLongSymbol" SG_ 1092 PCS2_a007_gridFormStateMachineSt "PCS2_a007_gridFormStateMachineState";
BA_ "Confidence" SG_ 1092 PCS2_a007_acManagerOperatingMode 1;
BA_ "Confidence" SG_ 1092 PCS2_a007_acL2MaxThreshold 1;
BA_ "Confidence" SG_ 1092 PCS2_a007_acL2MinThreshold 1;
BA_ "Confidence" SG_ 1092 PCS2_a008_acL3NOverVoltageTrip 1;
BA_ "Confidence" SG_ 1092 PCS2_a008_chgMainStateMachineSta 1;
BA_ "SystemSignalLongSymbol" SG_ 1092 PCS2_a008_chgMainStateMachineSta "PCS2_a008_chgMainStateMachineState";
BA_ "Confidence" SG_ 1092 PCS2_a008_gridFormStateMachineSt 1;
BA_ "SystemSignalLongSymbol" SG_ 1092 PCS2_a008_gridFormStateMachineSt "PCS2_a008_gridFormStateMachineState";
BA_ "Confidence" SG_ 1092 PCS2_a008_acManagerOperatingMode 1;
BA_ "Confidence" SG_ 1092 PCS2_a009_acL3OverCurrentTrip 1;
BA_ "Confidence" SG_ 1092 PCS2_a009_chgMainStateMachineSta 1;
BA_ "SystemSignalLongSymbol" SG_ 1092 PCS2_a009_chgMainStateMachineSta "PCS2_a009_chgMainStateMachineState";
BA_ "Confidence" SG_ 1092 PCS2_a009_gridFormStateMachineSt 1;
BA_ "SystemSignalLongSymbol" SG_ 1092 PCS2_a009_gridFormStateMachineSt "PCS2_a009_gridFormStateMachineState";
BA_ "Confidence" SG_ 1092 PCS2_a009_acManagerOperatingMode 1;
BA_ "Confidence" SG_ 1092 PCS2_a009_acL3MaxThreshold 1;
BA_ "Confidence" SG_ 1092 PCS2_a009_acL3MinThreshold 1;
BA_ "Confidence" SG_ 1092 PCS2_a010_acLNOverCurrentTrip 1;
BA_ "Confidence" SG_ 1092 PCS2_a010_chgMainStateMachineSta 1;
BA_ "SystemSignalLongSymbol" SG_ 1092 PCS2_a010_chgMainStateMachineSta "PCS2_a010_chgMainStateMachineState";
BA_ "Confidence" SG_ 1092 PCS2_a010_gridFormStateMachineSt 1;
BA_ "SystemSignalLongSymbol" SG_ 1092 PCS2_a010_gridFormStateMachineSt "PCS2_a010_gridFormStateMachineState";
BA_ "Confidence" SG_ 1092 PCS2_a010_acManagerOperatingMode 1;
BA_ "Confidence" SG_ 1092 PCS2_a011_hvdcOverCurrentTrip 1;
BA_ "Confidence" SG_ 1092 PCS2_a011_hvdcMaxThreshold 1;
BA_ "Confidence" SG_ 1092 PCS2_a011_hvdcMinThreshold 1;
BA_ "Confidence" SG_ 1092 PCS2_a012_cycloATankOverCurrentT 1;
BA_ "SystemSignalLongSymbol" SG_ 1092 PCS2_a012_cycloATankOverCurrentT "PCS2_a012_cycloATankOverCurrentTrip";
BA_ "Confidence" SG_ 1092 PCS2_a013_DcdcALv2Temp 1;
BA_ "GenSigSNA" SG_ 1092 PCS2_a013_DcdcALv2Temp "1025";
BA_ "Confidence" SG_ 1092 PCS2_a013_DcdcALv2TempUpperThres 1;
BA_ "GenSigSNA" SG_ 1092 PCS2_a013_DcdcALv2TempUpperThres "1025";
BA_ "SystemSignalLongSymbol" SG_ 1092 PCS2_a013_DcdcALv2TempUpperThres "PCS2_a013_DcdcALv2TempUpperThreshold";
BA_ "Confidence" SG_ 1092 PCS2_a014_cycloBTankOverCurrentT 1;
BA_ "SystemSignalLongSymbol" SG_ 1092 PCS2_a014_cycloBTankOverCurrentT "PCS2_a014_cycloBTankOverCurrentTrip";
BA_ "Confidence" SG_ 1092 PCS2_a015_DcdcAHvTemp 1;
BA_ "GenSigSNA" SG_ 1092 PCS2_a015_DcdcAHvTemp "1025";
BA_ "Confidence" SG_ 1092 PCS2_a015_DcdcAHvTempUpperThresh 1;
BA_ "GenSigSNA" SG_ 1092 PCS2_a015_DcdcAHvTempUpperThresh "1025";
BA_ "SystemSignalLongSymbol" SG_ 1092 PCS2_a015_DcdcAHvTempUpperThresh "PCS2_a015_DcdcAHvTempUpperThreshold";
BA_ "Confidence" SG_ 1092 PCS2_a016_dcdcATankOverCurrentTr 1;
BA_ "SystemSignalLongSymbol" SG_ 1092 PCS2_a016_dcdcATankOverCurrentTr "PCS2_a016_dcdcATankOverCurrentTrip";
BA_ "Confidence" SG_ 1092 PCS2_a017_DcdcBLv2Temp 1;
BA_ "GenSigSNA" SG_ 1092 PCS2_a017_DcdcBLv2Temp "1025";
BA_ "Confidence" SG_ 1092 PCS2_a017_DcdcBLv2TempUpperThres 1;
BA_ "GenSigSNA" SG_ 1092 PCS2_a017_DcdcBLv2TempUpperThres "1025";
BA_ "SystemSignalLongSymbol" SG_ 1092 PCS2_a017_DcdcBLv2TempUpperThres "PCS2_a017_DcdcBLv2TempUpperThreshold";
BA_ "Confidence" SG_ 1092 PCS2_a018_dcdcBTankOverCurrentTr 1;
BA_ "SystemSignalLongSymbol" SG_ 1092 PCS2_a018_dcdcBTankOverCurrentTr "PCS2_a018_dcdcBTankOverCurrentTrip";
BA_ "Confidence" SG_ 1092 PCS2_a019_DcacADcTemp 1;
BA_ "GenSigSNA" SG_ 1092 PCS2_a019_DcacADcTemp "1025";
BA_ "Confidence" SG_ 1092 PCS2_a019_DcacADcTempUpperThresh 1;
BA_ "GenSigSNA" SG_ 1092 PCS2_a019_DcacADcTempUpperThresh "1025";
BA_ "SystemSignalLongSymbol" SG_ 1092 PCS2_a019_DcacADcTempUpperThresh "PCS2_a019_DcacADcTempUpperThreshold";
BA_ "Confidence" SG_ 1092 PCS2_a020_DcacBDcTemp 1;
BA_ "GenSigSNA" SG_ 1092 PCS2_a020_DcacBDcTemp "1025";
BA_ "Confidence" SG_ 1092 PCS2_a020_DcacBDcTempUpperThresh 1;
BA_ "GenSigSNA" SG_ 1092 PCS2_a020_DcacBDcTempUpperThresh "1025";
BA_ "SystemSignalLongSymbol" SG_ 1092 PCS2_a020_DcacBDcTempUpperThresh "PCS2_a020_DcacBDcTempUpperThreshold";
BA_ "SystemSignalLongSymbol" SG_ 1092 PCS2_a021_4V5RailUnderVoltageTri "PCS2_a021_4V5RailUnderVoltageTrip";
BA_ "SystemSignalLongSymbol" SG_ 1092 PCS2_a021_10V0RailUnderVoltageTr "PCS2_a021_10V0RailUnderVoltageTrip";
BA_ "SystemSignalLongSymbol" SG_ 1092 PCS2_a021_13V5RailUnderVoltageTr "PCS2_a021_13V5RailUnderVoltageTrip";
BA_ "SystemSignalLongSymbol" SG_ 1092 PCS2_a021_18V0RailUnderVoltageTr "PCS2_a021_18V0RailUnderVoltageTrip";
BA_ "SystemSignalLongSymbol" SG_ 1092 PCS2_a021_48V0RailUnderVoltageTr "PCS2_a021_48V0RailUnderVoltageTrip";
BA_ "Confidence" SG_ 1092 PCS2_a021_4V5RailUnderVoltageThr 1;
BA_ "SystemSignalLongSymbol" SG_ 1092 PCS2_a021_4V5RailUnderVoltageThr "PCS2_a021_4V5RailUnderVoltageThreshold";
BA_ "Confidence" SG_ 1092 PCS2_a021_10V0RailUnderVoltageTh 1;
BA_ "SystemSignalLongSymbol" SG_ 1092 PCS2_a021_10V0RailUnderVoltageTh "PCS2_a021_10V0RailUnderVoltageThreshold";
BA_ "Confidence" SG_ 1092 PCS2_a021_13V5RailUnderVoltageTh 1;
BA_ "SystemSignalLongSymbol" SG_ 1092 PCS2_a021_13V5RailUnderVoltageTh "PCS2_a021_13V5RailUnderVoltageThreshold";
BA_ "Confidence" SG_ 1092 PCS2_a021_18V0RailUnderVoltageTh 1;
BA_ "SystemSignalLongSymbol" SG_ 1092 PCS2_a021_18V0RailUnderVoltageTh "PCS2_a021_18V0RailUnderVoltageThreshold";
BA_ "Confidence" SG_ 1092 PCS2_a021_48V0RailUnderVoltageTh 1;
BA_ "SystemSignalLongSymbol" SG_ 1092 PCS2_a021_48V0RailUnderVoltageTh "PCS2_a021_48V0RailUnderVoltageThreshold";
BA_ "Confidence" SG_ 1092 PCS2_a024_DcacATxTemp 1;
BA_ "GenSigSNA" SG_ 1092 PCS2_a024_DcacATxTemp "1025";
BA_ "Confidence" SG_ 1092 PCS2_a024_DcacATxTempUpperThresh 1;
BA_ "GenSigSNA" SG_ 1092 PCS2_a024_DcacATxTempUpperThresh "1025";
BA_ "SystemSignalLongSymbol" SG_ 1092 PCS2_a024_DcacATxTempUpperThresh "PCS2_a024_DcacATxTempUpperThreshold";
BA_ "Confidence" SG_ 1092 PCS2_a025_DcacBTxTemp 1;
BA_ "GenSigSNA" SG_ 1092 PCS2_a025_DcacBTxTemp "1025";
BA_ "Confidence" SG_ 1092 PCS2_a025_DcacBTxTempUpperThresh 1;
BA_ "GenSigSNA" SG_ 1092 PCS2_a025_DcacBTxTempUpperThresh "1025";
BA_ "SystemSignalLongSymbol" SG_ 1092 PCS2_a025_DcacBTxTempUpperThresh "PCS2_a025_DcacBTxTempUpperThreshold";
BA_ "Confidence" SG_ 1092 PCS2_a026_AcConnectorTemp 1;
BA_ "GenSigSNA" SG_ 1092 PCS2_a026_AcConnectorTemp "1025";
BA_ "Confidence" SG_ 1092 PCS2_a026_AcConnectorTempUpperTh 1;
BA_ "GenSigSNA" SG_ 1092 PCS2_a026_AcConnectorTempUpperTh "1025";
BA_ "SystemSignalLongSymbol" SG_ 1092 PCS2_a026_AcConnectorTempUpperTh "PCS2_a026_AcConnectorTempUpperThreshold";
BA_ "Confidence" SG_ 1092 PCS2_a027_AmbientTemp 1;
BA_ "GenSigSNA" SG_ 1092 PCS2_a027_AmbientTemp "1025";
BA_ "Confidence" SG_ 1092 PCS2_a027_AmbientTempUpperThresh 1;
BA_ "GenSigSNA" SG_ 1092 PCS2_a027_AmbientTempUpperThresh "1025";
BA_ "SystemSignalLongSymbol" SG_ 1092 PCS2_a027_AmbientTempUpperThresh "PCS2_a027_AmbientTempUpperThreshold";
BA_ "Confidence" SG_ 1092 PCS2_a028_CoolantTemp 1;
BA_ "GenSigSNA" SG_ 1092 PCS2_a028_CoolantTemp "1025";
BA_ "Confidence" SG_ 1092 PCS2_a028_CoolantTempUpperThresh 1;
BA_ "GenSigSNA" SG_ 1092 PCS2_a028_CoolantTempUpperThresh "1025";
BA_ "SystemSignalLongSymbol" SG_ 1092 PCS2_a028_CoolantTempUpperThresh "PCS2_a028_CoolantTempUpperThreshold";
BA_ "Confidence" SG_ 1092 PCS2_a028_CoolantSensorSource 1;
BA_ "Confidence" SG_ 1092 PCS2_a029_DcacAAc1Temp 1;
BA_ "GenSigSNA" SG_ 1092 PCS2_a029_DcacAAc1Temp "1025";
BA_ "Confidence" SG_ 1092 PCS2_a029_DcacAAc1TempUpperThres 1;
BA_ "GenSigSNA" SG_ 1092 PCS2_a029_DcacAAc1TempUpperThres "1025";
BA_ "SystemSignalLongSymbol" SG_ 1092 PCS2_a029_DcacAAc1TempUpperThres "PCS2_a029_DcacAAc1TempUpperThreshold";
BA_ "Confidence" SG_ 1092 PCS2_a030_DcacAAc2Temp 1;
BA_ "GenSigSNA" SG_ 1092 PCS2_a030_DcacAAc2Temp "1025";
BA_ "Confidence" SG_ 1092 PCS2_a030_DcacAAc2TempUpperThres 1;
BA_ "GenSigSNA" SG_ 1092 PCS2_a030_DcacAAc2TempUpperThres "1025";
BA_ "SystemSignalLongSymbol" SG_ 1092 PCS2_a030_DcacAAc2TempUpperThres "PCS2_a030_DcacAAc2TempUpperThreshold";
BA_ "Confidence" SG_ 1092 PCS2_a031_DcacBAc1Temp 1;
BA_ "GenSigSNA" SG_ 1092 PCS2_a031_DcacBAc1Temp "1025";
BA_ "Confidence" SG_ 1092 PCS2_a031_DcacBAc1TempUpperThres 1;
BA_ "GenSigSNA" SG_ 1092 PCS2_a031_DcacBAc1TempUpperThres "1025";
BA_ "SystemSignalLongSymbol" SG_ 1092 PCS2_a031_DcacBAc1TempUpperThres "PCS2_a031_DcacBAc1TempUpperThreshold";
BA_ "Confidence" SG_ 1092 PCS2_a032_DcacBAc2Temp 1;
BA_ "GenSigSNA" SG_ 1092 PCS2_a032_DcacBAc2Temp "1025";
BA_ "Confidence" SG_ 1092 PCS2_a032_DcacBAc2TempUpperThres 1;
BA_ "GenSigSNA" SG_ 1092 PCS2_a032_DcacBAc2TempUpperThres "1025";
BA_ "SystemSignalLongSymbol" SG_ 1092 PCS2_a032_DcacBAc2TempUpperThres "PCS2_a032_DcacBAc2TempUpperThreshold";
BA_ "Confidence" SG_ 1092 PCS2_a034_lvBusVoltage 1;
BA_ "Confidence" SG_ 1092 PCS2_a034_voltageFaultThreshold 1;
BA_ "Confidence" SG_ 1092 PCS2_a035_lvBusVoltage 1;
BA_ "Confidence" SG_ 1092 PCS2_a035_voltageFaultThreshold 1;
BA_ "Confidence" SG_ 1092 PCS2_a036_hvBusVoltage 1;
BA_ "Confidence" SG_ 1092 PCS2_a036_hvBusTopVoltage 1;
BA_ "Confidence" SG_ 1092 PCS2_a036_hvBusBotVoltage 1;
BA_ "Confidence" SG_ 1092 PCS2_a036_voltageFaultThreshold 1;
BA_ "Confidence" SG_ 1092 PCS2_a037_hvBusVoltage 1;
BA_ "Confidence" SG_ 1092 PCS2_a037_hvBusTopVoltage 1;
BA_ "Confidence" SG_ 1092 PCS2_a037_hvBusBotVoltage 1;
BA_ "Confidence" SG_ 1092 PCS2_a037_voltageFaultThreshold 1;
BA_ "Confidence" SG_ 1092 PCS2_a038_hvBusVoltage 1;
BA_ "Confidence" SG_ 1092 PCS2_a038_hvBusTopVoltage 1;
BA_ "Confidence" SG_ 1092 PCS2_a038_hvBusBotVoltage 1;
BA_ "Confidence" SG_ 1092 PCS2_a038_voltageFaultThreshold 1;
BA_ "Confidence" SG_ 1092 PCS2_a039_hvBusVoltage 1;
BA_ "Confidence" SG_ 1092 PCS2_a039_hvBusTopVoltage 1;
BA_ "Confidence" SG_ 1092 PCS2_a039_hvBusBotVoltage 1;
BA_ "Confidence" SG_ 1092 PCS2_a039_voltageFaultThreshold 1;
BA_ "Confidence" SG_ 1092 PCS2_a040_hvBusVoltage 1;
BA_ "Confidence" SG_ 1092 PCS2_a040_hvBusTopVoltage 1;
BA_ "Confidence" SG_ 1092 PCS2_a040_hvBusBotVoltage 1;
BA_ "Confidence" SG_ 1092 PCS2_a040_voltageFaultThreshold 1;
BA_ "Confidence" SG_ 1092 PCS2_a041_hvBusVoltage 1;
BA_ "Confidence" SG_ 1092 PCS2_a041_hvBusTopVoltage 1;
BA_ "Confidence" SG_ 1092 PCS2_a041_hvBusBotVoltage 1;
BA_ "Confidence" SG_ 1092 PCS2_a041_voltageFaultThreshold 1;
BA_ "Confidence" SG_ 1092 PCS2_a043_hvBattVoltage 1;
BA_ "Confidence" SG_ 1092 PCS2_a043_hvBattTopVoltage 1;
BA_ "Confidence" SG_ 1092 PCS2_a043_hvBattBotVoltage 1;
BA_ "Confidence" SG_ 1092 PCS2_a043_voltageFaultThreshold 1;
BA_ "Confidence" SG_ 1092 PCS2_a044_hvBattVoltage 1;
BA_ "Confidence" SG_ 1092 PCS2_a044_hvBattTopVoltage 1;
BA_ "Confidence" SG_ 1092 PCS2_a044_hvBattBotVoltage 1;
BA_ "Confidence" SG_ 1092 PCS2_a044_voltageFaultThreshold 1;
BA_ "Confidence" SG_ 1092 PCS2_a045_hvBattVoltage 1;
BA_ "Confidence" SG_ 1092 PCS2_a045_hvBattTopVoltage 1;
BA_ "Confidence" SG_ 1092 PCS2_a045_hvBattBotVoltage 1;
BA_ "Confidence" SG_ 1092 PCS2_a045_voltageFaultThreshold 1;
BA_ "Confidence" SG_ 1092 PCS2_a046_hvBattVoltage 1;
BA_ "Confidence" SG_ 1092 PCS2_a046_hvBattTopVoltage 1;
BA_ "Confidence" SG_ 1092 PCS2_a046_hvBattBotVoltage 1;
BA_ "Confidence" SG_ 1092 PCS2_a046_voltageFaultThreshold 1;
BA_ "Confidence" SG_ 1092 PCS2_a047_hvBattVoltage 1;
BA_ "Confidence" SG_ 1092 PCS2_a047_hvBattTopVoltage 1;
BA_ "Confidence" SG_ 1092 PCS2_a047_hvBattBotVoltage 1;
BA_ "Confidence" SG_ 1092 PCS2_a047_voltageFaultThreshold 1;
BA_ "Confidence" SG_ 1092 PCS2_a048_hvBusVoltage 1;
BA_ "Confidence" SG_ 1092 PCS2_a048_hvBusTopVoltage 1;
BA_ "Confidence" SG_ 1092 PCS2_a048_hvBusBotVoltage 1;
BA_ "Confidence" SG_ 1092 PCS2_a048_voltageFaultThreshold 1;
BA_ "Confidence" SG_ 1092 PCS2_a049_hvBusVoltage 1;
BA_ "Confidence" SG_ 1092 PCS2_a049_hvBusTopVoltage 1;
BA_ "Confidence" SG_ 1092 PCS2_a049_hvBusBotVoltage 1;
BA_ "Confidence" SG_ 1092 PCS2_a049_voltageFaultThreshold 1;
BA_ "SystemSignalLongSymbol" SG_ 1092 PCS2_a055_leakageInductanceDefin "PCS2_a055_leakageInductanceDefined";
BA_ "SystemSignalLongSymbol" SG_ 1092 PCS2_a055_magnetizingInductanceD "PCS2_a055_magnetizingInductanceDefined";
BA_ "SystemSignalLongSymbol" SG_ 1092 PCS2_a056_leakageInductanceDefin "PCS2_a056_leakageInductanceDefined";
BA_ "SystemSignalLongSymbol" SG_ 1092 PCS2_a056_magnetizingInductanceD "PCS2_a056_magnetizingInductanceDefined";
BA_ "SystemSignalLongSymbol" SG_ 1092 PCS2_a057_leakageInductanceDefin "PCS2_a057_leakageInductanceDefined";
BA_ "SystemSignalLongSymbol" SG_ 1092 PCS2_a057_magnetizingInductanceD "PCS2_a057_magnetizingInductanceDefined";
BA_ "SystemSignalLongSymbol" SG_ 1092 PCS2_a058_leakageInductanceDefin "PCS2_a058_leakageInductanceDefined";
BA_ "SystemSignalLongSymbol" SG_ 1092 PCS2_a058_magnetizingInductanceD "PCS2_a058_magnetizingInductanceDefined";
BA_ "SystemSignalLongSymbol" SG_ 1092 PCS2_a059_dcdcHvcEnableLineTZLat "PCS2_a059_dcdcHvcEnableLineTZLatchedBit";
BA_ "SystemSignalLongSymbol" SG_ 1092 PCS2_a059_dcdcHvcEnableLineStatu "PCS2_a059_dcdcHvcEnableLineStatus";
BA_ "SystemSignalLongSymbol" SG_ 1092 PCS2_a059_dcdcVcrEnableLineTZLat "PCS2_a059_dcdcVcrEnableLineTZLatchedBit";
BA_ "SystemSignalLongSymbol" SG_ 1092 PCS2_a059_dcdcVcrEnableLineStatu "PCS2_a059_dcdcVcrEnableLineStatus";
BA_ "Confidence" SG_ 1092 PCS2_a059_dcdcStageState 1;
BA_ "Confidence" SG_ 1092 PCS2_a059_dcdcStageRequestProces 1;
BA_ "SystemSignalLongSymbol" SG_ 1092 PCS2_a059_dcdcStageRequestProces "PCS2_a059_dcdcStageRequestProcessed";
BA_ "Confidence" SG_ 1092 PCS2_a059_dcdcRequest 1;
BA_ "Confidence" SG_ 1092 PCS2_a062_acL1NVrms 1;
BA_ "Confidence" SG_ 1092 PCS2_a062_acL2NVrms 1;
BA_ "Confidence" SG_ 1092 PCS2_a062_acL3NVrms 1;
BA_ "Confidence" SG_ 1092 PCS2_a062_acL1L2Vrms 1;
BA_ "Confidence" SG_ 1092 PCS2_a062_acL1L3Vrms 1;
BA_ "Confidence" SG_ 1092 PCS2_a062_acL2L3Vrms 1;
BA_ "Confidence" SG_ 1092 PCS2_a063_phase_diff_L1N_L2N 1;
BA_ "Confidence" SG_ 1092 PCS2_a063_phase_diff_L1N_L3N 1;
BA_ "Confidence" SG_ 1092 PCS2_a063_phase_diff_L2N_L3N 1;
BA_ "Confidence" SG_ 1092 PCS2_a063_phase_diff_L1L3_L2L3 1;
BA_ "SystemSignalLongSymbol" SG_ 1092 PCS2_a063_L1NAvailableForChargin "PCS2_a063_L1NAvailableForCharging";
BA_ "SystemSignalLongSymbol" SG_ 1092 PCS2_a063_L2NAvailableForChargin "PCS2_a063_L2NAvailableForCharging";
BA_ "SystemSignalLongSymbol" SG_ 1092 PCS2_a063_L3NAvailableForChargin "PCS2_a063_L3NAvailableForCharging";
BA_ "SystemSignalLongSymbol" SG_ 1092 PCS2_a063_L1L2AvailableForChargi "PCS2_a063_L1L2AvailableForCharging";
BA_ "SystemSignalLongSymbol" SG_ 1092 PCS2_a063_L1L3AvailableForChargi "PCS2_a063_L1L3AvailableForCharging";
BA_ "SystemSignalLongSymbol" SG_ 1092 PCS2_a063_L2L3AvailableForChargi "PCS2_a063_L2L3AvailableForCharging";
BA_ "Confidence" SG_ 1092 PCS2_a064_leakageInductance 1;
BA_ "SystemSignalLongSymbol" SG_ 1092 PCS2_a064_leakageInductanceOutOf "PCS2_a064_leakageInductanceOutOfSpec";
BA_ "Confidence" SG_ 1092 PCS2_a064_magnetizingInductance 1;
BA_ "SystemSignalLongSymbol" SG_ 1092 PCS2_a064_magnetizingInductanceO "PCS2_a064_magnetizingInductanceOutOfSpec";
BA_ "Confidence" SG_ 1092 PCS2_a064_capacitance 1;
BA_ "Confidence" SG_ 1092 PCS2_a065_leakageInductance 1;
BA_ "SystemSignalLongSymbol" SG_ 1092 PCS2_a065_leakageInductanceOutOf "PCS2_a065_leakageInductanceOutOfSpec";
BA_ "Confidence" SG_ 1092 PCS2_a065_magnetizingInductance 1;
BA_ "SystemSignalLongSymbol" SG_ 1092 PCS2_a065_magnetizingInductanceO "PCS2_a065_magnetizingInductanceOutOfSpec";
BA_ "Confidence" SG_ 1092 PCS2_a065_capacitance 1;
BA_ "Confidence" SG_ 1092 PCS2_a066_leakageInductance 1;
BA_ "SystemSignalLongSymbol" SG_ 1092 PCS2_a066_leakageInductanceOutOf "PCS2_a066_leakageInductanceOutOfSpec";
BA_ "Confidence" SG_ 1092 PCS2_a066_magnetizingInductance 1;
BA_ "SystemSignalLongSymbol" SG_ 1092 PCS2_a066_magnetizingInductanceO "PCS2_a066_magnetizingInductanceOutOfSpec";
BA_ "Confidence" SG_ 1092 PCS2_a066_capacitance 1;
BA_ "Confidence" SG_ 1092 PCS2_a067_leakageInductance 1;
BA_ "SystemSignalLongSymbol" SG_ 1092 PCS2_a067_leakageInductanceOutOf "PCS2_a067_leakageInductanceOutOfSpec";
BA_ "Confidence" SG_ 1092 PCS2_a067_magnetizingInductance 1;
BA_ "SystemSignalLongSymbol" SG_ 1092 PCS2_a067_magnetizingInductanceO "PCS2_a067_magnetizingInductanceOutOfSpec";
BA_ "Confidence" SG_ 1092 PCS2_a067_capacitance 1;
BA_ "Confidence" SG_ 1092 PCS2_a071_hvBattBotSensorMeasure 1;
BA_ "SystemSignalLongSymbol" SG_ 1092 PCS2_a071_hvBattBotSensorMeasure "PCS2_a071_hvBattBotSensorMeasurement";
BA_ "Confidence" SG_ 1092 PCS2_a071_hvBattExternalRefValue 1;
BA_ "GenSigSNA" SG_ 1092 PCS2_a071_hvBattExternalRefValue "2047";
BA_ "Confidence" SG_ 1092 PCS2_a072_hvBattTopSensorMeasure 1;
BA_ "SystemSignalLongSymbol" SG_ 1092 PCS2_a072_hvBattTopSensorMeasure "PCS2_a072_hvBattTopSensorMeasurement";
BA_ "Confidence" SG_ 1092 PCS2_a072_hvBattExternalRefValue 1;
BA_ "GenSigSNA" SG_ 1092 PCS2_a072_hvBattExternalRefValue "2047";
BA_ "Confidence" SG_ 1092 PCS2_a073_hvBusBotSensorMeasurem 1;
BA_ "SystemSignalLongSymbol" SG_ 1092 PCS2_a073_hvBusBotSensorMeasurem "PCS2_a073_hvBusBotSensorMeasurement";
BA_ "Confidence" SG_ 1092 PCS2_a073_hvBusExternalRefValue 1;
BA_ "GenSigSNA" SG_ 1092 PCS2_a073_hvBusExternalRefValue "2047";
BA_ "Confidence" SG_ 1092 PCS2_a074_hvBusTopSensorMeasurem 1;
BA_ "SystemSignalLongSymbol" SG_ 1092 PCS2_a074_hvBusTopSensorMeasurem "PCS2_a074_hvBusTopSensorMeasurement";
BA_ "Confidence" SG_ 1092 PCS2_a074_hvBusExternalRefValue 1;
BA_ "GenSigSNA" SG_ 1092 PCS2_a074_hvBusExternalRefValue "2047";
BA_ "Confidence" SG_ 1092 PCS2_a075_hvBattFullSensorMeasur 1;
BA_ "SystemSignalLongSymbol" SG_ 1092 PCS2_a075_hvBattFullSensorMeasur "PCS2_a075_hvBattFullSensorMeasurement";
BA_ "Confidence" SG_ 1092 PCS2_a075_hvBattExternalRefValue 1;
BA_ "GenSigSNA" SG_ 1092 PCS2_a075_hvBattExternalRefValue "2047";
BA_ "Confidence" SG_ 1092 PCS2_a075_hvBattTopBottomVoltage 1;
BA_ "SystemSignalLongSymbol" SG_ 1092 PCS2_a075_hvBattTopBottomVoltage "PCS2_a075_hvBattTopBottomVoltageDelta";
BA_ "Confidence" SG_ 1092 PCS2_a076_hvBusFullSensorMeasure 1;
BA_ "SystemSignalLongSymbol" SG_ 1092 PCS2_a076_hvBusFullSensorMeasure "PCS2_a076_hvBusFullSensorMeasurement";
BA_ "Confidence" SG_ 1092 PCS2_a076_hvBusExternalRefValue 1;
BA_ "GenSigSNA" SG_ 1092 PCS2_a076_hvBusExternalRefValue "2047";
BA_ "Confidence" SG_ 1092 PCS2_a076_hvBusTopBottomVoltageD 1;
BA_ "SystemSignalLongSymbol" SG_ 1092 PCS2_a076_hvBusTopBottomVoltageD "PCS2_a076_hvBusTopBottomVoltageDelta";
BA_ "Confidence" SG_ 1092 PCS2_a077_lvBusVoltageMeasuremen 1;
BA_ "SystemSignalLongSymbol" SG_ 1092 PCS2_a077_lvBusVoltageMeasuremen "PCS2_a077_lvBusVoltageMeasurement";
BA_ "Confidence" SG_ 1092 PCS2_a077_lvBusExternalRefValue 1;
BA_ "Confidence" SG_ 1092 PCS2_a078_acL1NVoltageOffset 1;
BA_ "Confidence" SG_ 1092 PCS2_a078_acL1NVoltageRMS 1;
BA_ "Confidence" SG_ 1092 PCS2_a079_acL2NVoltageOffset 1;
BA_ "Confidence" SG_ 1092 PCS2_a079_acL2NVoltageRMS 1;
BA_ "Confidence" SG_ 1092 PCS2_a080_acL3NVoltageOffset 1;
BA_ "Confidence" SG_ 1092 PCS2_a080_acL3NVoltageRMS 1;
BA_ "Confidence" SG_ 1092 PCS2_a081_acL1CurrentOffset 1;
BA_ "Confidence" SG_ 1092 PCS2_a081_acL1CurrentRMS 1;
BA_ "Confidence" SG_ 1092 PCS2_a082_acL2CurrentOffset 1;
BA_ "Confidence" SG_ 1092 PCS2_a082_acL2CurrentRMS 1;
BA_ "Confidence" SG_ 1092 PCS2_a083_acL3CurrentOffset 1;
BA_ "Confidence" SG_ 1092 PCS2_a083_acL3CurrentRMS 1;
BA_ "Confidence" SG_ 1092 PCS2_a084_acNCurrentOffset 1;
BA_ "Confidence" SG_ 1092 PCS2_a084_acNCurrentRMS 1;
BA_ "SystemSignalLongSymbol" SG_ 1092 PCS2_a085_outletGridFormEnableRe "PCS2_a085_outletGridFormEnableRequest";
BA_ "SystemSignalLongSymbol" SG_ 1092 PCS2_a085_cpGridFormEnableReques "PCS2_a085_cpGridFormEnableRequest";
BA_ "SystemSignalLongSymbol" SG_ 1092 PCS2_a085_packEOLGridFormEnableR "PCS2_a085_packEOLGridFormEnableRequest";
BA_ "Confidence" SG_ 1092 PCS2_a086_lvBusVoltage 1;
BA_ "Confidence" SG_ 1092 PCS2_a086_voltageFaultThreshold 1;
BA_ "Confidence" SG_ 1092 PCS2_a087_lvBusVoltage 1;
BA_ "Confidence" SG_ 1092 PCS2_a087_voltageFaultThreshold 1;
BA_ "Confidence" SG_ 1092 PCS2_a088_linesFaulted 1;
BA_ "Confidence" SG_ 1092 PCS2_a088_startVoltageRms 1;
BA_ "Confidence" SG_ 1092 PCS2_a088_underVoltageRmsThresho 1;
BA_ "SystemSignalLongSymbol" SG_ 1092 PCS2_a088_underVoltageRmsThresho "PCS2_a088_underVoltageRmsThreshold";
BA_ "Confidence" SG_ 1092 PCS2_a088_presentVoltageRms 1;
BA_ "Confidence" SG_ 1092 PCS2_a088_presentCurrentRms 1;
BA_ "Confidence" SG_ 1092 PCS2_a088_gridConfig 1;
BA_ "GenSigSNA" SG_ 1092 PCS2_a088_gridConfig "0";
BA_ "Confidence" SG_ 1092 PCS2_a090_DcdcModelLvMosfetTemp 1;
BA_ "Confidence" SG_ 1092 PCS2_a090_DcdcModelLvMosfetCoola 1;
BA_ "SystemSignalLongSymbol" SG_ 1092 PCS2_a090_DcdcModelLvMosfetCoola "PCS2_a090_DcdcModelLvMosfetCoolantTemp";
BA_ "Confidence" SG_ 1092 PCS2_a090_DcDcModelLvMosfetCoola 1;
BA_ "SystemSignalLongSymbol" SG_ 1092 PCS2_a090_DcDcModelLvMosfetCoola "PCS2_a090_DcDcModelLvMosfetCoolantFlowRate";
BA_ "Confidence" SG_ 1092 PCS2_a090_DcDcModelLVMosfetCurre 1;
BA_ "SystemSignalLongSymbol" SG_ 1092 PCS2_a090_DcDcModelLVMosfetCurre "PCS2_a090_DcDcModelLVMosfetCurrent";
BA_ "Confidence" SG_ 1092 PCS2_a091_DcdcModelTxWindingTemp 1;
BA_ "Confidence" SG_ 1092 PCS2_a091_DcdcModelTxWindingCool 1;
BA_ "SystemSignalLongSymbol" SG_ 1092 PCS2_a091_DcdcModelTxWindingCool "PCS2_a091_DcdcModelTxWindingCoolantTemp";
BA_ "Confidence" SG_ 1092 PCS2_a091_DcDcModelTxWindingCool 1;
BA_ "SystemSignalLongSymbol" SG_ 1092 PCS2_a091_DcDcModelTxWindingCool "PCS2_a091_DcDcModelTxWindingCoolantFlowRate";
BA_ "Confidence" SG_ 1092 PCS2_a091_DcDcModelTxWindingCurr 1;
BA_ "SystemSignalLongSymbol" SG_ 1092 PCS2_a091_DcDcModelTxWindingCurr "PCS2_a091_DcDcModelTxWindingCurrent";
BA_ "Confidence" SG_ 1092 PCS2_a094_cycloABlockedReason 1;
BA_ "Confidence" SG_ 1092 PCS2_a094_cycloBBlockedReason 1;
BA_ "Confidence" SG_ 1092 PCS2_a095_cycloABlockedReason 1;
BA_ "Confidence" SG_ 1092 PCS2_a095_cycloBBlockedReason 1;
BA_ "SystemSignalLongSymbol" SG_ 1092 PCS2_a096_VCSUPER_thermalStatus1 "PCS2_a096_VCSUPER_thermalStatus10Hz";
BA_ "SystemSignalLongSymbol" SG_ 1092 PCS2_a098_EGGRIGHT3_thermalComma "PCS2_a098_EGGRIGHT3_thermalCommand10Hz";
BA_ "Confidence" SG_ 1092 PCS2_a099_lineFaulted 1;
BA_ "Confidence" SG_ 1092 PCS2_a099_lineToChassisVoltageRm 1;
BA_ "SystemSignalLongSymbol" SG_ 1092 PCS2_a099_lineToChassisVoltageRm "PCS2_a099_lineToChassisVoltageRms";
BA_ "Confidence" SG_ 1092 PCS2_a099_neutralToChassisVoltag 1;
BA_ "SystemSignalLongSymbol" SG_ 1092 PCS2_a099_neutralToChassisVoltag "PCS2_a099_neutralToChassisVoltageRms";
BA_ "Confidence" SG_ 1092 PCS2_a099_overVoltageRmsThreshol 1;
BA_ "SystemSignalLongSymbol" SG_ 1092 PCS2_a099_overVoltageRmsThreshol "PCS2_a099_overVoltageRmsThreshold";
BA_ "Confidence" SG_ 1092 PCS2_a099_iticCurveSection 1;
BA_ "Confidence" SG_ 1092 PCS2_a100_linesFaulted 1;
BA_ "Confidence" SG_ 1092 PCS2_a100_lineToLineVoltageRms 1;
BA_ "Confidence" SG_ 1092 PCS2_a100_overVoltageRmsThreshol 1;
BA_ "SystemSignalLongSymbol" SG_ 1092 PCS2_a100_overVoltageRmsThreshol "PCS2_a100_overVoltageRmsThreshold";
BA_ "Confidence" SG_ 1092 PCS2_a100_iticCurveSection 1;
BA_ "Confidence" SG_ 1092 PCS2_a101_lineFaulted 1;
BA_ "Confidence" SG_ 1092 PCS2_a101_lineToChassisVoltage 1;
BA_ "Confidence" SG_ 1092 PCS2_a101_neutralToChassisVoltag 1;
BA_ "SystemSignalLongSymbol" SG_ 1092 PCS2_a101_neutralToChassisVoltag "PCS2_a101_neutralToChassisVoltage";
BA_ "Confidence" SG_ 1092 PCS2_a101_lineToChassisVoltageRm 1;
BA_ "SystemSignalLongSymbol" SG_ 1092 PCS2_a101_lineToChassisVoltageRm "PCS2_a101_lineToChassisVoltageRms";
BA_ "Confidence" SG_ 1092 PCS2_a101_overVoltageThreshold 1;
BA_ "Confidence" SG_ 1092 PCS2_a101_iticCurveSection 1;
BA_ "Confidence" SG_ 1092 PCS2_a102_linesFaulted 1;
BA_ "Confidence" SG_ 1092 PCS2_a102_lineToLineVoltage 1;
BA_ "Confidence" SG_ 1092 PCS2_a102_lineToLineVoltageRms 1;
BA_ "Confidence" SG_ 1092 PCS2_a102_overVoltageThreshold 1;
BA_ "Confidence" SG_ 1092 PCS2_a102_iticCurveSection 1;
BA_ "Confidence" SG_ 1092 PCS2_a103_IsoTempSensor 1;
BA_ "SystemSignalLongSymbol" SG_ 1092 PCS2_a103_IsoTempSenseOutOfBound "PCS2_a103_IsoTempSenseOutOfBounds";
BA_ "SystemSignalLongSymbol" SG_ 1092 PCS2_a103_IsoTempSensorFallTimeO "PCS2_a103_IsoTempSensorFallTimeOutOfBounds";
BA_ "SystemSignalLongSymbol" SG_ 1092 PCS2_a103_IsoTempSensorRiseTimeO "PCS2_a103_IsoTempSensorRiseTimeOutOfBounds";
BA_ "SystemSignalLongSymbol" SG_ 1092 PCS2_a103_IsoTempSensorRiseFallM "PCS2_a103_IsoTempSensorRiseFallMismatch";
BA_ "Confidence" SG_ 1092 PCS2_a103_RiseTimeOpenLoop 1;
BA_ "Confidence" SG_ 1092 PCS2_a103_FallTimeOpenLoop 1;
BA_ "Confidence" SG_ 1092 PCS2_a103_ClosedLoopTime 1;
BA_ "Confidence" SG_ 1092 PCS2_a104_lineFaulted 1;
BA_ "Confidence" SG_ 1092 PCS2_a104_lineToChassisVoltageRm 1;
BA_ "SystemSignalLongSymbol" SG_ 1092 PCS2_a104_lineToChassisVoltageRm "PCS2_a104_lineToChassisVoltageRms";
BA_ "Confidence" SG_ 1092 PCS2_a104_underVoltageRmsThresho 1;
BA_ "SystemSignalLongSymbol" SG_ 1092 PCS2_a104_underVoltageRmsThresho "PCS2_a104_underVoltageRmsThreshold";
BA_ "Confidence" SG_ 1092 PCS2_a104_iticCurveSection 1;
BA_ "Confidence" SG_ 1092 PCS2_a105_linesFaulted 1;
BA_ "Confidence" SG_ 1092 PCS2_a105_lineToLineVoltageRms 1;
BA_ "Confidence" SG_ 1092 PCS2_a105_underVoltageRmsThresho 1;
BA_ "SystemSignalLongSymbol" SG_ 1092 PCS2_a105_underVoltageRmsThresho "PCS2_a105_underVoltageRmsThreshold";
BA_ "Confidence" SG_ 1092 PCS2_a105_iticCurveSection 1;
BA_ "Confidence" SG_ 1092 PCS2_a106_systemNeutral 1;
BA_ "Confidence" SG_ 1092 PCS2_a106_systemNeutralToChassis 1;
BA_ "SystemSignalLongSymbol" SG_ 1092 PCS2_a106_systemNeutralToChassis "PCS2_a106_systemNeutralToChassisVoltage";
BA_ "Confidence" SG_ 1092 PCS2_a106_overVoltageThreshold 1;
BA_ "Confidence" SG_ 1092 PCS2_a110_deratingFactorThreshol 1;
BA_ "SystemSignalLongSymbol" SG_ 1092 PCS2_a110_deratingFactorThreshol "PCS2_a110_deratingFactorThreshold";
BA_ "Confidence" SG_ 1092 PCS2_a110_combinedDeratingFactor 1;
BA_ "Confidence" SG_ 1092 PCS2_a110_txTempDeratingFactor 1;
BA_ "Confidence" SG_ 1092 PCS2_a110_dcTempDeratingFactor 1;
BA_ "Confidence" SG_ 1092 PCS2_a110_inductorLossDeratingFa 1;
BA_ "SystemSignalLongSymbol" SG_ 1092 PCS2_a110_inductorLossDeratingFa "PCS2_a110_inductorLossDeratingFactor";
BA_ "Confidence" SG_ 1092 PCS2_a110_junctionTempDeratingFa 1;
BA_ "SystemSignalLongSymbol" SG_ 1092 PCS2_a110_junctionTempDeratingFa "PCS2_a110_junctionTempDeratingFactor";
BA_ "Confidence" SG_ 1092 PCS2_a112_linesFaulted 1;
BA_ "Confidence" SG_ 1092 PCS2_a112_startVoltageRms 1;
BA_ "Confidence" SG_ 1092 PCS2_a112_underVoltageRmsThresho 1;
BA_ "SystemSignalLongSymbol" SG_ 1092 PCS2_a112_underVoltageRmsThresho "PCS2_a112_underVoltageRmsThreshold";
BA_ "Confidence" SG_ 1092 PCS2_a112_presentVoltageRms 1;
BA_ "Confidence" SG_ 1092 PCS2_a113_receivedCoolantFlow 1;
BA_ "Confidence" SG_ 1092 PCS2_a113_receivedCoolantTemp 1;
BA_ "GenSigSNA" SG_ 1092 PCS2_a113_receivedCoolantTemp "1025";
BA_ "Confidence" SG_ 1092 PCS2_a113_sensedCoolantTemp 1;
BA_ "GenSigSNA" SG_ 1092 PCS2_a113_sensedCoolantTemp "1025";
BA_ "SystemSignalLongSymbol" SG_ 1092 PCS2_a113_localNoFlowDetectionSt "PCS2_a113_localNoFlowDetectionState";
BA_ "SystemSignalLongSymbol" SG_ 1092 PCS2_a113_remoteNoFlowDetectionS "PCS2_a113_remoteNoFlowDetectionState";
BA_ "Confidence" SG_ 1092 PCS2_a114_estimatedHvbusCapacita 1;
BA_ "SystemSignalLongSymbol" SG_ 1092 PCS2_a114_estimatedHvbusCapacita "PCS2_a114_estimatedHvbusCapacitance";
BA_ "Confidence" SG_ 1092 PCS2_a114_estimatedResistanceLin 1;
BA_ "SystemSignalLongSymbol" SG_ 1092 PCS2_a114_estimatedResistanceLin "PCS2_a114_estimatedResistanceLinear";
BA_ "Confidence" SG_ 1092 PCS2_a114_estimatedResistanceLog 1;
BA_ "SystemSignalLongSymbol" SG_ 1092 PCS2_a114_estimatedResistanceLog "PCS2_a114_estimatedResistanceLogarithm";
BA_ "Confidence" SG_ 1092 PCS2_a115_lineVoltage 1;
BA_ "Confidence" SG_ 1092 PCS2_a116_chgRetryCount 1;
BA_ "Confidence" SG_ 1092 PCS2_a116_maxChgRetriesAllowed 1;
BA_ "Confidence" SG_ 1092 PCS2_a118_presentHvBusVoltage 1;
BA_ "Confidence" SG_ 1092 PCS2_a118_hvVoltageTarget 1;
BA_ "Confidence" SG_ 1092 PCS2_a118_presentLvBusVoltage 1;
BA_ "SystemSignalLongSymbol" SG_ 1092 PCS2_a118_failedToReachFixedTarg "PCS2_a118_failedToReachFixedTarget";
BA_ "Confidence" SG_ 1092 PCS2_a119_presentHvBusVoltage 1;
BA_ "Confidence" SG_ 1092 PCS2_a119_startUpHvVoltage 1;
BA_ "Confidence" SG_ 1092 PCS2_a119_presentLvBusVoltage 1;
BA_ "Confidence" SG_ 1092 PCS2_a123_DcdcBHvTemp 1;
BA_ "GenSigSNA" SG_ 1092 PCS2_a123_DcdcBHvTemp "1025";
BA_ "Confidence" SG_ 1092 PCS2_a123_DcdcBHvTempUpperThresh 1;
BA_ "GenSigSNA" SG_ 1092 PCS2_a123_DcdcBHvTempUpperThresh "1025";
BA_ "SystemSignalLongSymbol" SG_ 1092 PCS2_a123_DcdcBHvTempUpperThresh "PCS2_a123_DcdcBHvTempUpperThreshold";
BA_ "Confidence" SG_ 1092 PCS2_a127_acLineClkHealthStatus 1;
BA_ "Confidence" SG_ 1092 PCS2_a127_dcac1_L1EnableHealthSt 1;
BA_ "SystemSignalLongSymbol" SG_ 1092 PCS2_a127_dcac1_L1EnableHealthSt "PCS2_a127_dcac1_L1EnableHealthStatus";
BA_ "Confidence" SG_ 1092 PCS2_a127_dcac1_L2EnableHealthSt 1;
BA_ "SystemSignalLongSymbol" SG_ 1092 PCS2_a127_dcac1_L2EnableHealthSt "PCS2_a127_dcac1_L2EnableHealthStatus";
BA_ "Confidence" SG_ 1092 PCS2_a127_dcac1_L3EnableHealthSt 1;
BA_ "SystemSignalLongSymbol" SG_ 1092 PCS2_a127_dcac1_L3EnableHealthSt "PCS2_a127_dcac1_L3EnableHealthStatus";
BA_ "Confidence" SG_ 1092 PCS2_a127_dcac1_LNEnableHealthSt 1;
BA_ "SystemSignalLongSymbol" SG_ 1092 PCS2_a127_dcac1_LNEnableHealthSt "PCS2_a127_dcac1_LNEnableHealthStatus";
BA_ "Confidence" SG_ 1092 PCS2_a127_dcac1_acTankClkHealthS 1;
BA_ "SystemSignalLongSymbol" SG_ 1092 PCS2_a127_dcac1_acTankClkHealthS "PCS2_a127_dcac1_acTankClkHealthStatus";
BA_ "Confidence" SG_ 1092 PCS2_a127_dcac1_dcTankClkHealthS 1;
BA_ "SystemSignalLongSymbol" SG_ 1092 PCS2_a127_dcac1_dcTankClkHealthS "PCS2_a127_dcac1_dcTankClkHealthStatus";
BA_ "Confidence" SG_ 1092 PCS2_a127_dcac1_hvEnableHealthSt 1;
BA_ "SystemSignalLongSymbol" SG_ 1092 PCS2_a127_dcac1_hvEnableHealthSt "PCS2_a127_dcac1_hvEnableHealthStatus";
BA_ "SystemSignalLongSymbol" SG_ 1092 PCS2_a127_dcac1_HealthCheckRetry "PCS2_a127_dcac1_HealthCheckRetryCnt";
BA_ "SystemSignalLongSymbol" SG_ 1092 PCS2_a127_dcac1_HealthCheckMaxRe "PCS2_a127_dcac1_HealthCheckMaxRetry";
BA_ "Confidence" SG_ 1092 PCS2_a128_acLineClkHealthStatus 1;
BA_ "Confidence" SG_ 1092 PCS2_a128_dcac2_L1EnableHealthSt 1;
BA_ "SystemSignalLongSymbol" SG_ 1092 PCS2_a128_dcac2_L1EnableHealthSt "PCS2_a128_dcac2_L1EnableHealthStatus";
BA_ "Confidence" SG_ 1092 PCS2_a128_dcac2_L2EnableHealthSt 1;
BA_ "SystemSignalLongSymbol" SG_ 1092 PCS2_a128_dcac2_L2EnableHealthSt "PCS2_a128_dcac2_L2EnableHealthStatus";
BA_ "Confidence" SG_ 1092 PCS2_a128_dcac2_L3EnableHealthSt 1;
BA_ "SystemSignalLongSymbol" SG_ 1092 PCS2_a128_dcac2_L3EnableHealthSt "PCS2_a128_dcac2_L3EnableHealthStatus";
BA_ "Confidence" SG_ 1092 PCS2_a128_dcac2_LNEnableHealthSt 1;
BA_ "SystemSignalLongSymbol" SG_ 1092 PCS2_a128_dcac2_LNEnableHealthSt "PCS2_a128_dcac2_LNEnableHealthStatus";
BA_ "Confidence" SG_ 1092 PCS2_a128_dcac2_acTankClkHealthS 1;
BA_ "SystemSignalLongSymbol" SG_ 1092 PCS2_a128_dcac2_acTankClkHealthS "PCS2_a128_dcac2_acTankClkHealthStatus";
BA_ "Confidence" SG_ 1092 PCS2_a128_dcac2_dcTankClkHealthS 1;
BA_ "SystemSignalLongSymbol" SG_ 1092 PCS2_a128_dcac2_dcTankClkHealthS "PCS2_a128_dcac2_dcTankClkHealthStatus";
BA_ "Confidence" SG_ 1092 PCS2_a128_dcac2_hvEnableHealthSt 1;
BA_ "SystemSignalLongSymbol" SG_ 1092 PCS2_a128_dcac2_hvEnableHealthSt "PCS2_a128_dcac2_hvEnableHealthStatus";
BA_ "SystemSignalLongSymbol" SG_ 1092 PCS2_a128_dcac2_HealthCheckRetry "PCS2_a128_dcac2_HealthCheckRetryCnt";
BA_ "SystemSignalLongSymbol" SG_ 1092 PCS2_a128_dcac2_HealthCheckMaxRe "PCS2_a128_dcac2_HealthCheckMaxRetry";
BA_ "Confidence" SG_ 1092 PCS2_a129_hvBusVoltage 1;
BA_ "Confidence" SG_ 1092 PCS2_a129_lvBusVoltage 1;
BA_ "Confidence" SG_ 1092 PCS2_a129_instantMeasuredZCDEven 1;
BA_ "SystemSignalLongSymbol" SG_ 1092 PCS2_a129_instantMeasuredZCDEven "PCS2_a129_instantMeasuredZCDEvent";
BA_ "Confidence" SG_ 1092 PCS2_a129_instantMeasuredZCDHalf 1;
BA_ "SystemSignalLongSymbol" SG_ 1092 PCS2_a129_instantMeasuredZCDHalf "PCS2_a129_instantMeasuredZCDHalfPrdPU";
BA_ "Confidence" SG_ 1092 PCS2_a129_commandedSwitchFreq 1;
BA_ "Confidence" SG_ 1092 PCS2_a130_serverStateAtRetry 1;
BA_ "Confidence" SG_ 1092 PCS2_a132_gridFrequency 1;
BA_ "Confidence" SG_ 1092 PCS2_a132_L1NGridVoltage 1;
BA_ "Confidence" SG_ 1092 PCS2_a132_L2NGridVoltage 1;
BA_ "Confidence" SG_ 1092 PCS2_a132_L3NGridVoltage 1;
BA_ "Confidence" SG_ 1092 PCS2_a132_currentLimit 1;
BA_ "Confidence" SG_ 1092 PCS2_a136_failedSequence 1;
BA_ "Confidence" SG_ 1092 PCS2_a136_mosfetLegUnderTest 1;
BA_ "Confidence" SG_ 1092 PCS2_a136_mosfetIndexUnderTest 1;
BA_ "Confidence" SG_ 1092 PCS2_a136_measuredResonantFreque 1;
BA_ "SystemSignalLongSymbol" SG_ 1092 PCS2_a136_measuredResonantFreque "PCS2_a136_measuredResonantFrequency";
BA_ "SystemSignalLongSymbol" SG_ 1092 PCS2_a136_pwmTrippedDuringHealth "PCS2_a136_pwmTrippedDuringHealthCheck";
BA_ "SystemSignalLongSymbol" SG_ 1092 PCS2_a136_dcacEnableLineDeassert "PCS2_a136_dcacEnableLineDeasserted";
BA_ "SystemSignalLongSymbol" SG_ 1092 PCS2_a136_hvdcOverCurrentTripHas "PCS2_a136_hvdcOverCurrentTripHasOccurred";
BA_ "SystemSignalLongSymbol" SG_ 1092 PCS2_a136_lineOverCurrentTripHas "PCS2_a136_lineOverCurrentTripHasOccurred";
BA_ "SystemSignalLongSymbol" SG_ 1092 PCS2_a136_lineOverVoltageTripHas "PCS2_a136_lineOverVoltageTripHasOccurred";
BA_ "SystemSignalLongSymbol" SG_ 1092 PCS2_a136_powerRailTripHasOccurr "PCS2_a136_powerRailTripHasOccurred";
BA_ "SystemSignalLongSymbol" SG_ 1092 PCS2_a136_hvBusVoltageTripHasOcc "PCS2_a136_hvBusVoltageTripHasOccurred";
BA_ "SystemSignalLongSymbol" SG_ 1092 PCS2_a136_lvBusVoltageTripHasOcc "PCS2_a136_lvBusVoltageTripHasOccurred";
BA_ "SystemSignalLongSymbol" SG_ 1092 PCS2_a136_tankFreqZeroWithEdgeDe "PCS2_a136_tankFreqZeroWithEdgeDetected";
BA_ "Confidence" SG_ 1092 PCS2_a137_failedSequence 1;
BA_ "Confidence" SG_ 1092 PCS2_a137_mosfetLegUnderTest 1;
BA_ "Confidence" SG_ 1092 PCS2_a137_mosfetIndexUnderTest 1;
BA_ "Confidence" SG_ 1092 PCS2_a137_measuredResonantFreque 1;
BA_ "SystemSignalLongSymbol" SG_ 1092 PCS2_a137_measuredResonantFreque "PCS2_a137_measuredResonantFrequency";
BA_ "SystemSignalLongSymbol" SG_ 1092 PCS2_a137_pwmTrippedDuringHealth "PCS2_a137_pwmTrippedDuringHealthCheck";
BA_ "SystemSignalLongSymbol" SG_ 1092 PCS2_a137_dcacEnableLineDeassert "PCS2_a137_dcacEnableLineDeasserted";
BA_ "SystemSignalLongSymbol" SG_ 1092 PCS2_a137_hvdcOverCurrentTripHas "PCS2_a137_hvdcOverCurrentTripHasOccurred";
BA_ "SystemSignalLongSymbol" SG_ 1092 PCS2_a137_lineOverCurrentTripHas "PCS2_a137_lineOverCurrentTripHasOccurred";
BA_ "SystemSignalLongSymbol" SG_ 1092 PCS2_a137_lineOverVoltageTripHas "PCS2_a137_lineOverVoltageTripHasOccurred";
BA_ "SystemSignalLongSymbol" SG_ 1092 PCS2_a137_powerRailTripHasOccurr "PCS2_a137_powerRailTripHasOccurred";
BA_ "SystemSignalLongSymbol" SG_ 1092 PCS2_a137_hvBusVoltageTripHasOcc "PCS2_a137_hvBusVoltageTripHasOccurred";
BA_ "SystemSignalLongSymbol" SG_ 1092 PCS2_a137_lvBusVoltageTripHasOcc "PCS2_a137_lvBusVoltageTripHasOccurred";
BA_ "SystemSignalLongSymbol" SG_ 1092 PCS2_a137_tankFreqZeroWithEdgeDe "PCS2_a137_tankFreqZeroWithEdgeDetected";
BA_ "Confidence" SG_ 1092 PCS2_a138_hvdcCurrentOffset 1;
BA_ "Confidence" SG_ 1092 PCS2_a138_hvdcCurrentOffsetThres 1;
BA_ "SystemSignalLongSymbol" SG_ 1092 PCS2_a138_hvdcCurrentOffsetThres "PCS2_a138_hvdcCurrentOffsetThresholdAbs";
BA_ "Confidence" SG_ 1092 PCS2_a141_boostOverCurrentThresh 1;
BA_ "SystemSignalLongSymbol" SG_ 1092 PCS2_a141_boostOverCurrentThresh "PCS2_a141_boostOverCurrentThreshold";
BA_ "SystemSignalLongSymbol" SG_ 1092 PCS2_a142_AcLineGdpsDataOutOfSpe "PCS2_a142_AcLineGdpsDataOutOfSpec";
BA_ "SystemSignalLongSymbol" SG_ 1092 PCS2_a143_AcTankGdpsDataOutOfSpe "PCS2_a143_AcTankGdpsDataOutOfSpec";
BA_ "SystemSignalLongSymbol" SG_ 1092 PCS2_a144_DcTankGdpsDataOutOfSpe "PCS2_a144_DcTankGdpsDataOutOfSpec";
BA_ "SystemSignalLongSymbol" SG_ 1092 PCS2_a145_DcdcHvdcGdpsDataMissin "PCS2_a145_DcdcHvdcGdpsDataMissing";
BA_ "SystemSignalLongSymbol" SG_ 1092 PCS2_a145_DcdcHvdcGdpsDataOutOfS "PCS2_a145_DcdcHvdcGdpsDataOutOfSpec";
BA_ "Confidence" SG_ 1092 PCS2_a146_leg1_Irms 1;
BA_ "Confidence" SG_ 1092 PCS2_a146_leg2_Irms 1;
BA_ "Confidence" SG_ 1092 PCS2_a146_leg3_Irms 1;
BA_ "Confidence" SG_ 1092 PCS2_a146_legN_Irms 1;
BA_ "SystemSignalLongSymbol" SG_ 1092 PCS2_a146_legs_paralleled_by_rel "PCS2_a146_legs_paralleled_by_relay";
BA_ "SystemSignalLongSymbol" SG_ 1092 PCS2_a146_ac_harness_l2_l3_short "PCS2_a146_ac_harness_l2_l3_shorted";
BA_ "SystemSignalLongSymbol" SG_ 1092 PCS2_a147_10V0RailOverVoltageTri "PCS2_a147_10V0RailOverVoltageTrip";
BA_ "SystemSignalLongSymbol" SG_ 1092 PCS2_a147_13V5RailOverVoltageTri "PCS2_a147_13V5RailOverVoltageTrip";
BA_ "SystemSignalLongSymbol" SG_ 1092 PCS2_a147_18V0RailOverVoltageTri "PCS2_a147_18V0RailOverVoltageTrip";
BA_ "SystemSignalLongSymbol" SG_ 1092 PCS2_a147_48V0RailOverVoltageTri "PCS2_a147_48V0RailOverVoltageTrip";
BA_ "Confidence" SG_ 1092 PCS2_a147_4V5RailOverVoltageThre 1;
BA_ "SystemSignalLongSymbol" SG_ 1092 PCS2_a147_4V5RailOverVoltageThre "PCS2_a147_4V5RailOverVoltageThreshold";
BA_ "Confidence" SG_ 1092 PCS2_a147_10V0RailOverVoltageThr 1;
BA_ "SystemSignalLongSymbol" SG_ 1092 PCS2_a147_10V0RailOverVoltageThr "PCS2_a147_10V0RailOverVoltageThreshold";
BA_ "Confidence" SG_ 1092 PCS2_a147_13V5RailOverVoltageThr 1;
BA_ "SystemSignalLongSymbol" SG_ 1092 PCS2_a147_13V5RailOverVoltageThr "PCS2_a147_13V5RailOverVoltageThreshold";
BA_ "Confidence" SG_ 1092 PCS2_a147_18V0RailOverVoltageThr 1;
BA_ "SystemSignalLongSymbol" SG_ 1092 PCS2_a147_18V0RailOverVoltageThr "PCS2_a147_18V0RailOverVoltageThreshold";
BA_ "Confidence" SG_ 1092 PCS2_a147_48V0RailOverVoltageThr 1;
BA_ "SystemSignalLongSymbol" SG_ 1092 PCS2_a147_48V0RailOverVoltageThr "PCS2_a147_48V0RailOverVoltageThreshold";
BA_ "Confidence" SG_ 1092 PCS2_a147_BuckBoostLVInputOVThre 1;
BA_ "SystemSignalLongSymbol" SG_ 1092 PCS2_a147_BuckBoostLVInputOVThre "PCS2_a147_BuckBoostLVInputOVThreshold";
BA_ "Confidence" SG_ 1092 PCS2_a148_l1nPostRelayVoltage 1;
BA_ "Confidence" SG_ 1092 PCS2_a148_l2nPostRelayVoltage 1;
BA_ "Confidence" SG_ 1092 PCS2_a148_l3nPostRelayVoltage 1;
BA_ "Confidence" SG_ 1092 PCS2_a148_l2nPreRelayVoltage 1;
BA_ "Confidence" SG_ 1092 PCS2_a148_l3nPreRelayVoltage 1;
BA_ "Confidence" SG_ 1092 PCS2_a148_acRelayState 1;
BA_ "SystemSignalLongSymbol" SG_ 1092 PCS2_a149_buckBoostPermanentFaul "PCS2_a149_buckBoostPermanentFault";
BA_ "SystemSignalLongSymbol" SG_ 1092 PCS2_a149_buckBoostRampFaultCoun "PCS2_a149_buckBoostRampFaultCount";
BA_ "SystemSignalLongSymbol" SG_ 1092 PCS2_a149_buckBoostCmpssFaultCou "PCS2_a149_buckBoostCmpssFaultCount";
BA_ "SystemSignalLongSymbol" SG_ 1092 PCS2_a149_buckBoost18VLeakyBucke "PCS2_a149_buckBoost18VLeakyBucketFault";
BA_ "SystemSignalLongSymbol" SG_ 1092 PCS2_a149_buckBoost18VUVCmpssFau "PCS2_a149_buckBoost18VUVCmpssFault";
BA_ "SystemSignalLongSymbol" SG_ 1092 PCS2_a149_buckBoostLVOVCmpssFaul "PCS2_a149_buckBoostLVOVCmpssFault";
BA_ "SystemSignalLongSymbol" SG_ 1092 PCS2_a149_buckBoostLVUVCmpssFaul "PCS2_a149_buckBoostLVUVCmpssFault";
BA_ "SystemSignalLongSymbol" SG_ 1092 PCS2_a149_buckBoostRetryPrevente "PCS2_a149_buckBoostRetryPreventedFault";
BA_ "Confidence" SG_ 1092 PCS2_a149_buckBoostRampTarget 1;
BA_ "GenSigSNA" SG_ 1092 PCS2_a149_buckBoostRampTarget "4095";
BA_ "Confidence" SG_ 1092 PCS2_a150_presentBurstMode 1;
BA_ "Confidence" SG_ 1092 PCS2_a150_previousBurstMode 1;
BA_ "Confidence" SG_ 1092 PCS2_a151_DcdcBLv1Temp 1;
BA_ "GenSigSNA" SG_ 1092 PCS2_a151_DcdcBLv1Temp "1025";
BA_ "Confidence" SG_ 1092 PCS2_a151_DcdcBLv1TempUpperThres 1;
BA_ "GenSigSNA" SG_ 1092 PCS2_a151_DcdcBLv1TempUpperThres "1025";
BA_ "SystemSignalLongSymbol" SG_ 1092 PCS2_a151_DcdcBLv1TempUpperThres "PCS2_a151_DcdcBLv1TempUpperThreshold";
BA_ "Confidence" SG_ 1092 PCS2_a152_DcdcBLv3Temp 1;
BA_ "GenSigSNA" SG_ 1092 PCS2_a152_DcdcBLv3Temp "1025";
BA_ "Confidence" SG_ 1092 PCS2_a152_DcdcBLv3TempUpperThres 1;
BA_ "GenSigSNA" SG_ 1092 PCS2_a152_DcdcBLv3TempUpperThres "1025";
BA_ "SystemSignalLongSymbol" SG_ 1092 PCS2_a152_DcdcBLv3TempUpperThres "PCS2_a152_DcdcBLv3TempUpperThreshold";
BA_ "SystemSignalLongSymbol" SG_ 1092 PCS2_a154_adcReferenceDataMissin "PCS2_a154_adcReferenceDataMissing";
BA_ "Confidence" SG_ 1092 PCS2_a158_DcdcModelHvMosfetTemp 1;
BA_ "Confidence" SG_ 1092 PCS2_a158_DcdcModelHvMosfetCoola 1;
BA_ "SystemSignalLongSymbol" SG_ 1092 PCS2_a158_DcdcModelHvMosfetCoola "PCS2_a158_DcdcModelHvMosfetCoolantTemp";
BA_ "Confidence" SG_ 1092 PCS2_a158_DcDcModelHvMosfetCoola 1;
BA_ "SystemSignalLongSymbol" SG_ 1092 PCS2_a158_DcDcModelHvMosfetCoola "PCS2_a158_DcDcModelHvMosfetCoolantFlowRate";
BA_ "Confidence" SG_ 1092 PCS2_a158_DcDcModelHvMosfetCurre 1;
BA_ "SystemSignalLongSymbol" SG_ 1092 PCS2_a158_DcDcModelHvMosfetCurre "PCS2_a158_DcDcModelHvMosfetCurrent";
BA_ "Confidence" SG_ 1092 PCS2_a159_HVDCGdpsHealthStatus 1;
BA_ "SystemSignalLongSymbol" SG_ 1092 PCS2_a160_VCLEFT_networkManageme "PCS2_a160_VCLEFT_networkManagement";
BA_ "SystemSignalLongSymbol" SG_ 1092 PCS2_a161_VCREAR_networkManageme "PCS2_a161_VCREAR_networkManagement";
BA_ "Confidence" SG_ 1092 PCS2_a170_pcsMaxAcPowerAvailable 1;
BA_ "Confidence" SG_ 1092 PCS2_a170_pcsMaxAcPowerCapabilit 1;
BA_ "SystemSignalLongSymbol" SG_ 1092 PCS2_a170_pcsMaxAcPowerCapabilit "PCS2_a170_pcsMaxAcPowerCapability";
BA_ "Confidence" SG_ 1092 PCS2_a170_numberOfCycloStagesAva 1;
BA_ "SystemSignalLongSymbol" SG_ 1092 PCS2_a170_numberOfCycloStagesAva "PCS2_a170_numberOfCycloStagesAvailableForOperation";
BA_ "Confidence" SG_ 1092 PCS2_a170_detectedPhaseConfig 1;
BA_ "Confidence" SG_ 1092 PCS2_a173_DcdcALv1Temp 1;
BA_ "GenSigSNA" SG_ 1092 PCS2_a173_DcdcALv1Temp "1025";
BA_ "Confidence" SG_ 1092 PCS2_a173_DcdcALv1TempUpperThres 1;
BA_ "GenSigSNA" SG_ 1092 PCS2_a173_DcdcALv1TempUpperThres "1025";
BA_ "SystemSignalLongSymbol" SG_ 1092 PCS2_a173_DcdcALv1TempUpperThres "PCS2_a173_DcdcALv1TempUpperThreshold";
BA_ "Confidence" SG_ 1092 PCS2_a174_llc48V0RailOverCurrent 1;
BA_ "SystemSignalLongSymbol" SG_ 1092 PCS2_a174_llc48V0RailOverCurrent "PCS2_a174_llc48V0RailOverCurrentTrip";
BA_ "Confidence" SG_ 1092 PCS2_a174_llc48V0RailMaxThreshol 1;
BA_ "SystemSignalLongSymbol" SG_ 1092 PCS2_a174_llc48V0RailMaxThreshol "PCS2_a174_llc48V0RailMaxThreshold";
BA_ "Confidence" SG_ 1092 PCS2_a177_latchMotorRailOverCurr 1;
BA_ "SystemSignalLongSymbol" SG_ 1092 PCS2_a177_latchMotorRailOverCurr "PCS2_a177_latchMotorRailOverCurrentTrip";
BA_ "Confidence" SG_ 1092 PCS2_a177_latchMotorRailMaxThres 1;
BA_ "SystemSignalLongSymbol" SG_ 1092 PCS2_a177_latchMotorRailMaxThres "PCS2_a177_latchMotorRailMaxThreshold";
BA_ "Confidence" SG_ 1092 PCS2_a180_DcdcModelTxHATTemp 1;
BA_ "Confidence" SG_ 1092 PCS2_a180_DcdcModelTxHATCoolantT 1;
BA_ "SystemSignalLongSymbol" SG_ 1092 PCS2_a180_DcdcModelTxHATCoolantT "PCS2_a180_DcdcModelTxHATCoolantTemp";
BA_ "Confidence" SG_ 1092 PCS2_a180_DcDcModelTxHATCoolantF 1;
BA_ "SystemSignalLongSymbol" SG_ 1092 PCS2_a180_DcDcModelTxHATCoolantF "PCS2_a180_DcDcModelTxHATCoolantFlowRate";
BA_ "Confidence" SG_ 1092 PCS2_a180_DcDcModelTxHATCurrent 1;
BA_ "Confidence" SG_ 996 PCS2_matrixIndex 1;
BA_ "SystemSignalLongSymbol" SG_ 996 PCS2_a022_dcacEnableFunctionalit "PCS2_a022_dcacEnableFunctionalityDisabled";
BA_ "SystemSignalLongSymbol" SG_ 996 PCS2_a023_dcdcEnableFunctionalit "PCS2_a023_dcdcEnableFunctionalityDisabled";
BA_ "SystemSignalLongSymbol" SG_ 996 PCS2_a059_dcdcEnableLineDeassert "PCS2_a059_dcdcEnableLineDeasserted";
BA_ "SystemSignalLongSymbol" SG_ 996 PCS2_a064_dcdcATankParametersOut "PCS2_a064_dcdcATankParametersOutOfSpec";
BA_ "SystemSignalLongSymbol" SG_ 996 PCS2_a065_dcdcBTankParametersOut "PCS2_a065_dcdcBTankParametersOutOfSpec";
BA_ "SystemSignalLongSymbol" SG_ 996 PCS2_a066_cycloATankParametersOu "PCS2_a066_cycloATankParametersOutOfSpec";
BA_ "SystemSignalLongSymbol" SG_ 996 PCS2_a067_cycloBTankParametersOu "PCS2_a067_cycloBTankParametersOutOfSpec";
BA_ "SystemSignalLongSymbol" SG_ 996 PCS2_a069_dcdcAlifetimeEnergyRec "PCS2_a069_dcdcAlifetimeEnergyRecordFaulty";
BA_ "SystemSignalLongSymbol" SG_ 996 PCS2_a070_dcdcBlifetimeEnergyRec "PCS2_a070_dcdcBlifetimeEnergyRecordFaulty";
BA_ "SystemSignalLongSymbol" SG_ 996 PCS2_a071_hvBattBotSensorIrratio "PCS2_a071_hvBattBotSensorIrrational";
BA_ "SystemSignalLongSymbol" SG_ 996 PCS2_a072_hvBattTopSensorIrratio "PCS2_a072_hvBattTopSensorIrrational";
BA_ "SystemSignalLongSymbol" SG_ 996 PCS2_a073_hvBusBotSensorIrration "PCS2_a073_hvBusBotSensorIrrational";
BA_ "SystemSignalLongSymbol" SG_ 996 PCS2_a074_hvBusTopSensorIrration "PCS2_a074_hvBusTopSensorIrrational";
BA_ "SystemSignalLongSymbol" SG_ 996 PCS2_a075_hvBattFullSensorIrrati "PCS2_a075_hvBattFullSensorIrrational";
BA_ "SystemSignalLongSymbol" SG_ 996 PCS2_a076_hvBusFullSensorIrratio "PCS2_a076_hvBusFullSensorIrrational";
BA_ "SystemSignalLongSymbol" SG_ 996 PCS2_a077_lvBusVoltSensorIrratio "PCS2_a077_lvBusVoltSensorIrrational";
BA_ "SystemSignalLongSymbol" SG_ 996 PCS2_a078_acL1NVoltageOffsetIrra "PCS2_a078_acL1NVoltageOffsetIrrational";
BA_ "SystemSignalLongSymbol" SG_ 996 PCS2_a079_acL2NVoltageOffsetIrra "PCS2_a079_acL2NVoltageOffsetIrrational";
BA_ "SystemSignalLongSymbol" SG_ 996 PCS2_a080_acL3NVoltageOffsetIrra "PCS2_a080_acL3NVoltageOffsetIrrational";
BA_ "SystemSignalLongSymbol" SG_ 996 PCS2_a081_acL1CurrentOffsetIrrat "PCS2_a081_acL1CurrentOffsetIrrational";
BA_ "SystemSignalLongSymbol" SG_ 996 PCS2_a082_acL2CurrentOffsetIrrat "PCS2_a082_acL2CurrentOffsetIrrational";
BA_ "SystemSignalLongSymbol" SG_ 996 PCS2_a083_acL3CurrentOffsetIrrat "PCS2_a083_acL3CurrentOffsetIrrational";
BA_ "SystemSignalLongSymbol" SG_ 996 PCS2_a084_acNCurrentOffsetIrrati "PCS2_a084_acNCurrentOffsetIrrational";
BA_ "SystemSignalLongSymbol" SG_ 996 PCS2_a085_dcacEnableLineDeassert "PCS2_a085_dcacEnableLineDeasserted";
BA_ "SystemSignalLongSymbol" SG_ 996 PCS2_a090_DcdcLvMosfetTempTooHig "PCS2_a090_DcdcLvMosfetTempTooHigh";
BA_ "SystemSignalLongSymbol" SG_ 996 PCS2_a091_DcdcTxWindingTempTooHi "PCS2_a091_DcdcTxWindingTempTooHigh";
BA_ "SystemSignalLongSymbol" SG_ 996 PCS2_a092_dcdc_itankZcdIrrationa "PCS2_a092_dcdc_itankZcdIrrational";
BA_ "SystemSignalLongSymbol" SG_ 996 PCS2_a093_cycloPwmsNotInterleave "PCS2_a093_cycloPwmsNotInterleaved";
BA_ "SystemSignalLongSymbol" SG_ 996 PCS2_a101_LineChassisInstantaneo "PCS2_a101_LineChassisInstantaneousOV";
BA_ "SystemSignalLongSymbol" SG_ 996 PCS2_a102_LineToLineInstantaneou "PCS2_a102_LineToLineInstantaneousOV";
BA_ "SystemSignalLongSymbol" SG_ 996 PCS2_a103_IsoTempSensorIrrationa "PCS2_a103_IsoTempSensorIrrational";
BA_ "SystemSignalLongSymbol" SG_ 996 PCS2_a106_systemNeutralChassisRm "PCS2_a106_systemNeutralChassisRmsOV";
BA_ "SystemSignalLongSymbol" SG_ 996 PCS2_a107_cycloLostCurrentContro "PCS2_a107_cycloLostCurrentControl";
BA_ "SystemSignalLongSymbol" SG_ 996 PCS2_a108_FunctionalTestModeActi "PCS2_a108_FunctionalTestModeActivated";
BA_ "SystemSignalLongSymbol" SG_ 996 PCS2_a109_ACSurgeProtectionTrigg "PCS2_a109_ACSurgeProtectionTriggered";
BA_ "SystemSignalLongSymbol" SG_ 996 PCS2_a111_microgridHeartbeatMiss "PCS2_a111_microgridHeartbeatMissing";
BA_ "SystemSignalLongSymbol" SG_ 996 PCS2_a113_dcdcTransientCapabilit "PCS2_a113_dcdcTransientCapabilityImpacted";
BA_ "SystemSignalLongSymbol" SG_ 996 PCS2_a114_hvBusEstimatedImpedanc "PCS2_a114_hvBusEstimatedImpedanceLow";
BA_ "SystemSignalLongSymbol" SG_ 996 PCS2_a118_dcdcFailedToPrechargeT "PCS2_a118_dcdcFailedToPrechargeToTarget";
BA_ "SystemSignalLongSymbol" SG_ 996 PCS2_a119_useMaxCapForHvImpedanc "PCS2_a119_useMaxCapForHvImpedanceEstimation";
BA_ "SystemSignalLongSymbol" SG_ 996 PCS2_a121_insufficientCoolingDet "PCS2_a121_insufficientCoolingDetected";
BA_ "SystemSignalLongSymbol" SG_ 996 PCS2_a122_dcacLifetimekVAhRecord "PCS2_a122_dcacLifetimekVAhRecordError";
BA_ "SystemSignalLongSymbol" SG_ 996 PCS2_a125_cycloIdleShortingNeutr "PCS2_a125_cycloIdleShortingNeutral";
BA_ "SystemSignalLongSymbol" SG_ 996 PCS2_a126_ipcSuccessiveLockGrabF "PCS2_a126_ipcSuccessiveLockGrabFailure";
BA_ "SystemSignalLongSymbol" SG_ 996 PCS2_a127_cycloAgdpsHealthCheckF "PCS2_a127_cycloAgdpsHealthCheckFailed";
BA_ "SystemSignalLongSymbol" SG_ 996 PCS2_a128_cycloBgdpsHealthCheckF "PCS2_a128_cycloBgdpsHealthCheckFailed";
BA_ "SystemSignalLongSymbol" SG_ 996 PCS2_a131_microgridHeartbeatDete "PCS2_a131_microgridHeartbeatDetected";
BA_ "SystemSignalLongSymbol" SG_ 996 PCS2_a136_cycloAMosfetHealthChec "PCS2_a136_cycloAMosfetHealthCheckFailed";
BA_ "SystemSignalLongSymbol" SG_ 996 PCS2_a137_cycloBMosfetHealthChec "PCS2_a137_cycloBMosfetHealthCheckFailed";
BA_ "SystemSignalLongSymbol" SG_ 996 PCS2_a138_hvdcCurrentSensorOffse "PCS2_a138_hvdcCurrentSensorOffsetIrrational";
BA_ "SystemSignalLongSymbol" SG_ 996 PCS2_a140_dcdcHalfBusBalancerSat "PCS2_a140_dcdcHalfBusBalancerSaturated";
BA_ "SystemSignalLongSymbol" SG_ 996 PCS2_a145_DcdcHvdcGdpsUncalibrat "PCS2_a145_DcdcHvdcGdpsUncalibrated";
BA_ "SystemSignalLongSymbol" SG_ 996 PCS2_a146_acLineSharedCurrentCon "PCS2_a146_acLineSharedCurrentConnectionIssue";
BA_ "SystemSignalLongSymbol" SG_ 996 PCS2_a148_acRelayVoltageIrration "PCS2_a148_acRelayVoltageIrrational";
BA_ "SystemSignalLongSymbol" SG_ 996 PCS2_a153_cyclo_itankZcdIrration "PCS2_a153_cyclo_itankZcdIrrational";
BA_ "SystemSignalLongSymbol" SG_ 996 PCS2_a154_adcReferenceUncalibrat "PCS2_a154_adcReferenceUncalibrated";
BA_ "SystemSignalLongSymbol" SG_ 996 PCS2_a158_DcdcHvMosfetTempTooHig "PCS2_a158_DcdcHvMosfetTempTooHigh";
BA_ "SystemSignalLongSymbol" SG_ 996 PCS2_a159_dcdcGdpsHealthCheckFai "PCS2_a159_dcdcGdpsHealthCheckFailed";
BA_ "SystemSignalLongSymbol" SG_ 996 PCS2_a162_cycloARoutineTankInduc "PCS2_a162_cycloARoutineTankInductanceMeasurement";
BA_ "SystemSignalLongSymbol" SG_ 996 PCS2_a163_cycloBRoutineTankInduc "PCS2_a163_cycloBRoutineTankInductanceMeasurement";
BA_ "SystemSignalLongSymbol" SG_ 996 PCS2_a166_dcdcEnableLinePWMTripM "PCS2_a166_dcdcEnableLinePWMTripMisconfigured";
BA_ "SystemSignalLongSymbol" SG_ 996 PCS2_a169_cycloMosfetHealthCheck "PCS2_a169_cycloMosfetHealthCheckMeasuredHalfPrdAsymmetric";
BA_ "SystemSignalLongSymbol" SG_ 996 PCS2_a176_cpLatchMotorUnavailabl "PCS2_a176_cpLatchMotorUnavailable";
BA_ "SystemSignalLongSymbol" SG_ 996 PCS2_a177_latchMotorRailOverCurr "PCS2_a177_latchMotorRailOverCurrent";
BA_ "SystemSignalLongSymbol" SG_ 996 PCS2_a179_standbyPowerUnavailabl "PCS2_a179_standbyPowerUnavailable";
BA_ "SystemSignalLongSymbol" SG_ 996 PCS2_d181_dcdcConverterVoltSenso "PCS2_d181_dcdcConverterVoltSensorAFault";
BA_ "SystemSignalLongSymbol" SG_ 996 PCS2_d182_dcdcConverterTempSenso "PCS2_d182_dcdcConverterTempSensorAFault";
BA_ "SystemSignalLongSymbol" SG_ 996 PCS2_d183_batteryChargerAInputVo "PCS2_d183_batteryChargerAInputVoltSensorFault";
BA_ "SystemSignalLongSymbol" SG_ 996 PCS2_d184_batteryChargerAInputCu "PCS2_d184_batteryChargerAInputCurrentSensorFault";
BA_ "SystemSignalLongSymbol" SG_ 996 PCS2_d185_dcdcConverterANeedsSer "PCS2_d185_dcdcConverterANeedsService";
BA_ "SystemSignalLongSymbol" SG_ 996 PCS2_d186_batteryChargerAInterna "PCS2_d186_batteryChargerAInternalPowerSupplyFault";
BA_ "SystemSignalLongSymbol" SG_ 996 PCS2_d187_batteryChargerModuleAN "PCS2_d187_batteryChargerModuleANeedsService";
BA_ "SystemSignalLongSymbol" SG_ 996 PCS2_a188_prechargeWithLowLVDete "PCS2_a188_prechargeWithLowLVDetected";
BA_ "SystemSignalLongSymbol" SG_ 996 PCS2_a197_dcdcEnableLineTransien "PCS2_a197_dcdcEnableLineTransient";
VAL_ 1092 PCS2_alertID 197 "a197_dcdcEnableLineTransient" 194 "a194_poorGridSync" 193 "a193_unknownPcsID" 192 "a192_otherPcsMia" 188 "a188_prechargeWithLowLVDetected" 187 "d187_batteryChargerModuleANeedsService" 186 "d186_batteryChargerAInternalPowerSupplyFault" 185 "d185_dcdcConverterANeedsService" 184 "d184_batteryChargerAInputCurrentSensorFault" 183 "d183_batteryChargerAInputVoltSensorFault" 182 "d182_dcdcConverterTempSensorAFault" 181 "d181_dcdcConverterVoltSensorAFault" 180 "a180_DcdcTxHATTempTooHigh" 179 "a179_standbyPowerUnavailable" 178 "a178_eculogAborted" 177 "a177_latchMotorRailOverCurrent" 176 "a176_cpLatchMotorUnavailable" 175 "a175_LVUVSurgePowerEvent" 174 "a174_llc48V0RailOverCurrent" 173 "a173_DcdcALv1OverTemp" 172 "a172_unused" 171 "a171_unused" 170 "a170_acChargePowerIsLimited" 169 "a169_cycloMosfetHealthCheckMeasuredHalfPrdAsymmetric" 168 "a168_gridFormVoltageDropped" 167 "a167_unused" 166 "a166_dcdcEnableLinePWMTripMisconfigured" 165 "a165_dcdc_hwZcdFault2" 164 "a164_dcdc_hwZcdFault1" 163 "a163_cycloBRoutineTankInductanceMeasurement" 162 "a162_cycloARoutineTankInductanceMeasurement" 161 "a161_vcrearMia" 160 "a160_vcleftMia" 159 "a159_dcdcGdpsHealthCheckFailed" 158 "a158_DcdcHvMosfetTempTooHigh" 157 "a157_VC_pcsManagementMia" 156 "a156_vcfrontMia" 155 "a155_vcbatteryMia" 154 "a154_adcReferenceUncalibrated" 153 "a153_cyclo_itankZcdIrrational" 152 "a152_DcdcBLv3OverTemp" 151 "a151_DcdcBLv1OverTemp" 150 "a150_dcdcBurstTimingNotMet" 149 "a149_buckBoostFault" 148 "a148_acRelayVoltageIrrational" 147 "a147_powerRailOverVoltage" 146 "a146_acLineSharedCurrentConnectionIssue" 145 "a145_DcdcHvdcGdpsUncalibrated" 144 "a144_DcTankGdpsUncalibrated" 143 "a143_AcTankGdpsUncalibrated" 142 "a142_AcLineGdpsUncalibrated" 141 "a141_boostOverCurrent" 140 "a140_dcdcHalfBusBalancerSaturated" 139 "a139_unused" 138 "a138_hvdcCurrentSensorOffsetIrrational" 137 "a137_cycloBMosfetHealthCheckFailed" 136 "a136_cycloAMosfetHealthCheckFailed" 135 "a135_backgroundTaskOverRun" 134 "a134_unused" 133 "a133_unused" 132 "a132_microgridDroopDetected" 131 "a131_microgridHeartbeatDetected" 130 "a130_IONVMMServerRetryEvent" 129 "a129_lossOfZcdEventControl" 128 "a128_cycloBgdpsHealthCheckFailed" 127 "a127_cycloAgdpsHealthCheckFailed" 126 "a126_ipcSuccessiveLockGrabFailure" 125 "a125_cycloIdleShortingNeutral" 124 "a124_dcacItankSoftwareOC" 123 "a123_DcdcBHvOverTemp" 122 "a122_dcacLifetimekVAhRecordError" 121 "a121_insufficientCoolingDetected" 120 "a120_triggerOdin" 119 "a119_useMaxCapForHvImpedanceEstimation" 118 "a118_dcdcFailedToPrechargeToTarget" 117 "a117_vcrightMia" 116 "a116_chgPersistentFault" 115 "a115_chgWallPowerRemoval" 114 "a114_hvBusEstimatedImpedanceLow" 113 "a113_dcdcTransientCapabilityImpacted" 112 "a112_chgInputVDropTooHigh" 111 "a111_microgridHeartbeatMissing" 110 "a110_acCurrentIsLimited" 109 "a109_ACSurgeProtectionTriggered" 108 "a108_FunctionalTestModeActivated" 107 "a107_cycloLostCurrentControl" 106 "a106_systemNeutralChassisRmsOV" 105 "a105_LineToLineRmsUV" 104 "a104_LineChassisRmsUV" 103 "a103_IsoTempSensorIrrational" 102 "a102_LineToLineInstantaneousOV" 101 "a101_LineChassisInstantaneousOV" 100 "a100_LineToLineRmsOV" 99 "a099_LineChassisRmsOV" 98 "a098_eggright3Mia" 97 "a097_gtwMia" 96 "a096_vcsuperMia" 95 "a095_powershareUnavailable" 94 "a094_acChargingUnavailable" 93 "a093_cycloPwmsNotInterleaved" 92 "a092_dcdc_itankZcdIrrational" 91 "a091_DcdcTxWindingTempTooHigh" 90 "a090_DcdcLvMosfetTempTooHigh" 89 "a089_EndOfLineModeActivated" 88 "a088_chgInputVDropHigh" 87 "a087_dcacLVOverVoltage" 86 "a086_dcacLVUnderVoltage" 85 "a085_dcacEnableLineDeasserted" 84 "a084_acNCurrentOffsetIrrational" 83 "a083_acL3CurrentOffsetIrrational" 82 "a082_acL2CurrentOffsetIrrational" 81 "a081_acL1CurrentOffsetIrrational" 80 "a080_acL3NVoltageOffsetIrrational" 79 "a079_acL2NVoltageOffsetIrrational" 78 "a078_acL1NVoltageOffsetIrrational" 77 "a077_lvBusVoltSensorIrrational" 76 "a076_hvBusFullSensorIrrational" 75 "a075_hvBattFullSensorIrrational" 74 "a074_hvBusTopSensorIrrational" 73 "a073_hvBusBotSensorIrrational" 72 "a072_hvBattTopSensorIrrational" 71 "a071_hvBattBotSensorIrrational" 70 "a070_dcdcBlifetimeEnergyRecordFaulty" 69 "a069_dcdcAlifetimeEnergyRecordFaulty" 68 "a068_nvmSubsystemStalled" 67 "a067_cycloBTankParametersOutOfSpec" 66 "a066_cycloATankParametersOutOfSpec" 65 "a065_dcdcBTankParametersOutOfSpec" 64 "a064_dcdcATankParametersOutOfSpec" 63 "a063_chgUnknownGridConfig" 62 "a062_acVoltageNotPresent" 61 "a061_cycloBFaulted" 60 "a060_cycloAFaulted" 59 "a059_dcdcEnableLineDeasserted" 58 "a058_cycloBTankUncalibrated" 57 "a057_cycloATankUncalibrated" 56 "a056_dcdcBTankUncalibrated" 55 "a055_dcdcATankUncalibrated" 54 "a054_uiMia" 53 "a053_hvDcdcControlMIA" 52 "a052_cpMia" 51 "a051_bmsMia" 50 "a050_vcPcsDCDCInterfaceMia" 49 "a049_dcacUnderVoltage" 48 "a048_dcacOverVoltage" 47 "a047_hvBattBotUnderVoltage" 46 "a046_hvBattBotOverVoltage" 45 "a045_hvBattTopUnderVoltage" 44 "a044_hvBattTopOverVoltage" 43 "a043_hvBattUnderVoltage" 42 "a042_hvBattOverVoltage" 41 "a041_hvBusBotUnderVoltage" 40 "a040_hvBusBotOverVoltage" 39 "a039_hvBusTopUnderVoltage" 38 "a038_hvBusTopOverVoltage" 37 "a037_hvBusUnderVoltage" 36 "a036_hvBusOverVoltage" 35 "a035_lvBusUnderVoltage" 34 "a034_lvBusOverVoltage" 33 "a033_swCoreExcessiveUsage" 32 "a032_DcacBAc2TempTooHigh" 31 "a031_DcacBAc1TempTooHigh" 30 "a030_DcacAAc2TempTooHigh" 29 "a029_DcacAAc1TempTooHigh" 28 "a028_CoolantTempTooHigh" 27 "a027_AmbientTempTooHigh" 26 "a026_AcConnectorTempTooHigh" 25 "a025_DcacBTxTempTooHigh" 24 "a024_DcacATxTempTooHigh" 23 "a023_dcdcEnableFunctionalityDisabled" 22 "a022_dcacEnableFunctionalityDisabled" 21 "a021_powerRailUnderVoltage" 20 "a020_DcacBDcTempTooHigh" 19 "a019_DcacADcTempTooHigh" 18 "a018_dcdcBTankOverCurrent" 17 "a017_DcdcBLv2OverTemp" 16 "a016_dcdcATankOverCurrent" 15 "a015_DcdcAHvOverTemp" 14 "a014_cycloBTankOverCurrent" 13 "a013_DcdcALv2OverTemp" 12 "a012_cycloATankOverCurrent" 11 "a011_hvdcOverCurrent" 10 "a010_acLNOverCurrent" 9 "a009_acL3OverCurrent" 8 "a008_acL3NOverVoltage" 7 "a007_acL2OverCurrent" 6 "a006_acL2NOverVoltage" 5 "a005_acL1OverCurrent" 4 "a004_acL1NOverVoltage" 3 "a003_softwareAssertion" 2 "a002_canRationality" 1 "a001_watchdogAlarmed" 0 "ALERT_DO_NOT_USE_ZERO" ;
VAL_ 1092 PCS2_alertSet 1 "SET" 0 "CLEARED" ;
VAL_ 1092 PCS2_alertSource 9 "DCDC_SYSTEM" 8 "DCAC_SYSTEM" 7 "DCAC_B" 6 "DCAC_A" 5 "DCDC_B" 4 "DCDC_A" 3 "CPU3" 2 "CPU2" 1 "CPU1" 0 "CPU0" ;
VAL_ 1092 PCS2_a003_assertionCode 2 "CAN_TX_QUEUE_FULL" 1 "UNABLE_TO_CREATE_RTOS_QUEUE" 0 "SWITCH_STATEMENT_REACH_DEFAULT" ;
VAL_ 1092 PCS2_a005_acL1OverCurrentTrip 1 "COMPL_TRIP" 0 "COMPH_TRIP" ;
VAL_ 1092 PCS2_a005_chgMainStateMachineSta 10 "NUM_STATES" 9 "RETRY" 8 "BLOCKED" 7 "FAULTED" 6 "SHUTDOWN" 5 "ENABLE" 4 "SYSTEM_CONFIG_CHARGE" 3 "QUALIFY_LINE_CONFIG" 2 "WELD_CHECK" 1 "IDLE" 0 "POWER_UP_INIT" ;
VAL_ 1092 PCS2_a005_gridFormStateMachineSt 9 "NUM_STATES" 8 "RETRY" 7 "BLOCKED" 6 "FAULTED" 5 "SHUTDOWN" 4 "ENABLED" 3 "READY_TO_ENABLE" 2 "SYSTEM_CONFIG" 1 "IDLE" 0 "POWER_UP_INIT" ;
VAL_ 1092 PCS2_a005_acManagerOperatingMode 14 "BIDIRECTIONAL_GRID_FOLLOW" 13 "EPTO_GRIDFORM" 12 "FC_LINK_DISCHARGE" 11 "AC_RELAY_STATE_CHANGE" 10 "DISCHARGE_L3_N_LINES" 9 "DISCHARGE_L2_N_LINES" 8 "DISCHARGE_L1_N_LINES" 7 "BED_RELAY_WELD_CHECK" 6 "PACK_EOL_GRID_FORM" 5 "CHARGE_PORT_RELAY_WELD_CHECK" 4 "CHARGE_PORT_GRID_FORM" 3 "CABIN_AND_BED_GRID_FORM" 2 "CABIN_ONLY_GRID_FORM" 1 "AC_CHARGE_ONLY" 0 "IDLE" ;
VAL_ 1092 PCS2_a006_acL2NOverVoltageTrip 1 "COMPL_TRIP" 0 "COMPH_TRIP" ;
VAL_ 1092 PCS2_a006_chgMainStateMachineSta 10 "NUM_STATES" 9 "RETRY" 8 "BLOCKED" 7 "FAULTED" 6 "SHUTDOWN" 5 "ENABLE" 4 "SYSTEM_CONFIG_CHARGE" 3 "QUALIFY_LINE_CONFIG" 2 "WELD_CHECK" 1 "IDLE" 0 "POWER_UP_INIT" ;
VAL_ 1092 PCS2_a006_gridFormStateMachineSt 9 "NUM_STATES" 8 "RETRY" 7 "BLOCKED" 6 "FAULTED" 5 "SHUTDOWN" 4 "ENABLED" 3 "READY_TO_ENABLE" 2 "SYSTEM_CONFIG" 1 "IDLE" 0 "POWER_UP_INIT" ;
VAL_ 1092 PCS2_a006_acManagerOperatingMode 14 "BIDIRECTIONAL_GRID_FOLLOW" 13 "EPTO_GRIDFORM" 12 "FC_LINK_DISCHARGE" 11 "AC_RELAY_STATE_CHANGE" 10 "DISCHARGE_L3_N_LINES" 9 "DISCHARGE_L2_N_LINES" 8 "DISCHARGE_L1_N_LINES" 7 "BED_RELAY_WELD_CHECK" 6 "PACK_EOL_GRID_FORM" 5 "CHARGE_PORT_RELAY_WELD_CHECK" 4 "CHARGE_PORT_GRID_FORM" 3 "CABIN_AND_BED_GRID_FORM" 2 "CABIN_ONLY_GRID_FORM" 1 "AC_CHARGE_ONLY" 0 "IDLE" ;
VAL_ 1092 PCS2_a007_acL2OverCurrentTrip 1 "COMPL_TRIP" 0 "COMPH_TRIP" ;
VAL_ 1092 PCS2_a007_chgMainStateMachineSta 10 "NUM_STATES" 9 "RETRY" 8 "BLOCKED" 7 "FAULTED" 6 "SHUTDOWN" 5 "ENABLE" 4 "SYSTEM_CONFIG_CHARGE" 3 "QUALIFY_LINE_CONFIG" 2 "WELD_CHECK" 1 "IDLE" 0 "POWER_UP_INIT" ;
VAL_ 1092 PCS2_a007_gridFormStateMachineSt 9 "NUM_STATES" 8 "RETRY" 7 "BLOCKED" 6 "FAULTED" 5 "SHUTDOWN" 4 "ENABLED" 3 "READY_TO_ENABLE" 2 "SYSTEM_CONFIG" 1 "IDLE" 0 "POWER_UP_INIT" ;
VAL_ 1092 PCS2_a007_acManagerOperatingMode 14 "BIDIRECTIONAL_GRID_FOLLOW" 13 "EPTO_GRIDFORM" 12 "FC_LINK_DISCHARGE" 11 "AC_RELAY_STATE_CHANGE" 10 "DISCHARGE_L3_N_LINES" 9 "DISCHARGE_L2_N_LINES" 8 "DISCHARGE_L1_N_LINES" 7 "BED_RELAY_WELD_CHECK" 6 "PACK_EOL_GRID_FORM" 5 "CHARGE_PORT_RELAY_WELD_CHECK" 4 "CHARGE_PORT_GRID_FORM" 3 "CABIN_AND_BED_GRID_FORM" 2 "CABIN_ONLY_GRID_FORM" 1 "AC_CHARGE_ONLY" 0 "IDLE" ;
VAL_ 1092 PCS2_a008_acL3NOverVoltageTrip 1 "COMPL_TRIP" 0 "COMPH_TRIP" ;
VAL_ 1092 PCS2_a008_chgMainStateMachineSta 10 "NUM_STATES" 9 "RETRY" 8 "BLOCKED" 7 "FAULTED" 6 "SHUTDOWN" 5 "ENABLE" 4 "SYSTEM_CONFIG_CHARGE" 3 "QUALIFY_LINE_CONFIG" 2 "WELD_CHECK" 1 "IDLE" 0 "POWER_UP_INIT" ;
VAL_ 1092 PCS2_a008_gridFormStateMachineSt 9 "NUM_STATES" 8 "RETRY" 7 "BLOCKED" 6 "FAULTED" 5 "SHUTDOWN" 4 "ENABLED" 3 "READY_TO_ENABLE" 2 "SYSTEM_CONFIG" 1 "IDLE" 0 "POWER_UP_INIT" ;
VAL_ 1092 PCS2_a008_acManagerOperatingMode 14 "BIDIRECTIONAL_GRID_FOLLOW" 13 "EPTO_GRIDFORM" 12 "FC_LINK_DISCHARGE" 11 "AC_RELAY_STATE_CHANGE" 10 "DISCHARGE_L3_N_LINES" 9 "DISCHARGE_L2_N_LINES" 8 "DISCHARGE_L1_N_LINES" 7 "BED_RELAY_WELD_CHECK" 6 "PACK_EOL_GRID_FORM" 5 "CHARGE_PORT_RELAY_WELD_CHECK" 4 "CHARGE_PORT_GRID_FORM" 3 "CABIN_AND_BED_GRID_FORM" 2 "CABIN_ONLY_GRID_FORM" 1 "AC_CHARGE_ONLY" 0 "IDLE" ;
VAL_ 1092 PCS2_a009_acL3OverCurrentTrip 1 "COMPL_TRIP" 0 "COMPH_TRIP" ;
VAL_ 1092 PCS2_a009_chgMainStateMachineSta 10 "NUM_STATES" 9 "RETRY" 8 "BLOCKED" 7 "FAULTED" 6 "SHUTDOWN" 5 "ENABLE" 4 "SYSTEM_CONFIG_CHARGE" 3 "QUALIFY_LINE_CONFIG" 2 "WELD_CHECK" 1 "IDLE" 0 "POWER_UP_INIT" ;
VAL_ 1092 PCS2_a009_gridFormStateMachineSt 9 "NUM_STATES" 8 "RETRY" 7 "BLOCKED" 6 "FAULTED" 5 "SHUTDOWN" 4 "ENABLED" 3 "READY_TO_ENABLE" 2 "SYSTEM_CONFIG" 1 "IDLE" 0 "POWER_UP_INIT" ;
VAL_ 1092 PCS2_a009_acManagerOperatingMode 14 "BIDIRECTIONAL_GRID_FOLLOW" 13 "EPTO_GRIDFORM" 12 "FC_LINK_DISCHARGE" 11 "AC_RELAY_STATE_CHANGE" 10 "DISCHARGE_L3_N_LINES" 9 "DISCHARGE_L2_N_LINES" 8 "DISCHARGE_L1_N_LINES" 7 "BED_RELAY_WELD_CHECK" 6 "PACK_EOL_GRID_FORM" 5 "CHARGE_PORT_RELAY_WELD_CHECK" 4 "CHARGE_PORT_GRID_FORM" 3 "CABIN_AND_BED_GRID_FORM" 2 "CABIN_ONLY_GRID_FORM" 1 "AC_CHARGE_ONLY" 0 "IDLE" ;
VAL_ 1092 PCS2_a010_acLNOverCurrentTrip 1 "COMPL_TRIP" 0 "COMPH_TRIP" ;
VAL_ 1092 PCS2_a010_chgMainStateMachineSta 10 "NUM_STATES" 9 "RETRY" 8 "BLOCKED" 7 "FAULTED" 6 "SHUTDOWN" 5 "ENABLE" 4 "SYSTEM_CONFIG_CHARGE" 3 "QUALIFY_LINE_CONFIG" 2 "WELD_CHECK" 1 "IDLE" 0 "POWER_UP_INIT" ;
VAL_ 1092 PCS2_a010_gridFormStateMachineSt 9 "NUM_STATES" 8 "RETRY" 7 "BLOCKED" 6 "FAULTED" 5 "SHUTDOWN" 4 "ENABLED" 3 "READY_TO_ENABLE" 2 "SYSTEM_CONFIG" 1 "IDLE" 0 "POWER_UP_INIT" ;
VAL_ 1092 PCS2_a010_acManagerOperatingMode 14 "BIDIRECTIONAL_GRID_FOLLOW" 13 "EPTO_GRIDFORM" 12 "FC_LINK_DISCHARGE" 11 "AC_RELAY_STATE_CHANGE" 10 "DISCHARGE_L3_N_LINES" 9 "DISCHARGE_L2_N_LINES" 8 "DISCHARGE_L1_N_LINES" 7 "BED_RELAY_WELD_CHECK" 6 "PACK_EOL_GRID_FORM" 5 "CHARGE_PORT_RELAY_WELD_CHECK" 4 "CHARGE_PORT_GRID_FORM" 3 "CABIN_AND_BED_GRID_FORM" 2 "CABIN_ONLY_GRID_FORM" 1 "AC_CHARGE_ONLY" 0 "IDLE" ;
VAL_ 1092 PCS2_a011_hvdcOverCurrentTrip 1 "COMPL_TRIP" 0 "COMPH_TRIP" ;
VAL_ 1092 PCS2_a012_cycloATankOverCurrentT 1 "COMPL_TRIP" 0 "COMPH_TRIP" ;
VAL_ 1092 PCS2_a013_DcdcALv2Temp -1023 "SNA" ;
VAL_ 1092 PCS2_a013_DcdcALv2TempUpperThres -1023 "SNA" ;
VAL_ 1092 PCS2_a014_cycloBTankOverCurrentT 1 "COMPL_TRIP" 0 "COMPH_TRIP" ;
VAL_ 1092 PCS2_a015_DcdcAHvTemp -1023 "SNA" ;
VAL_ 1092 PCS2_a015_DcdcAHvTempUpperThresh -1023 "SNA" ;
VAL_ 1092 PCS2_a016_dcdcATankOverCurrentTr 1 "COMPL_TRIP" 0 "COMPH_TRIP" ;
VAL_ 1092 PCS2_a017_DcdcBLv2Temp -1023 "SNA" ;
VAL_ 1092 PCS2_a017_DcdcBLv2TempUpperThres -1023 "SNA" ;
VAL_ 1092 PCS2_a018_dcdcBTankOverCurrentTr 1 "COMPL_TRIP" 0 "COMPH_TRIP" ;
VAL_ 1092 PCS2_a019_DcacADcTemp -1023 "SNA" ;
VAL_ 1092 PCS2_a019_DcacADcTempUpperThresh -1023 "SNA" ;
VAL_ 1092 PCS2_a020_DcacBDcTemp -1023 "SNA" ;
VAL_ 1092 PCS2_a020_DcacBDcTempUpperThresh -1023 "SNA" ;
VAL_ 1092 PCS2_a024_DcacATxTemp -1023 "SNA" ;
VAL_ 1092 PCS2_a024_DcacATxTempUpperThresh -1023 "SNA" ;
VAL_ 1092 PCS2_a025_DcacBTxTemp -1023 "SNA" ;
VAL_ 1092 PCS2_a025_DcacBTxTempUpperThresh -1023 "SNA" ;
VAL_ 1092 PCS2_a026_AcConnectorTemp -1023 "SNA" ;
VAL_ 1092 PCS2_a026_AcConnectorTempUpperTh -1023 "SNA" ;
VAL_ 1092 PCS2_a027_AmbientTemp -1023 "SNA" ;
VAL_ 1092 PCS2_a027_AmbientTempUpperThresh -1023 "SNA" ;
VAL_ 1092 PCS2_a028_CoolantTemp -1023 "SNA" ;
VAL_ 1092 PCS2_a028_CoolantTempUpperThresh -1023 "SNA" ;
VAL_ 1092 PCS2_a028_CoolantSensorSource 1 "OUTLET" 0 "INLET" ;
VAL_ 1092 PCS2_a029_DcacAAc1Temp -1023 "SNA" ;
VAL_ 1092 PCS2_a029_DcacAAc1TempUpperThres -1023 "SNA" ;
VAL_ 1092 PCS2_a030_DcacAAc2Temp -1023 "SNA" ;
VAL_ 1092 PCS2_a030_DcacAAc2TempUpperThres -1023 "SNA" ;
VAL_ 1092 PCS2_a031_DcacBAc1Temp -1023 "SNA" ;
VAL_ 1092 PCS2_a031_DcacBAc1TempUpperThres -1023 "SNA" ;
VAL_ 1092 PCS2_a032_DcacBAc2Temp -1023 "SNA" ;
VAL_ 1092 PCS2_a032_DcacBAc2TempUpperThres -1023 "SNA" ;
VAL_ 1092 PCS2_a059_dcdcStageState 5 "NUM_STATES" 4 "FAULTED" 3 "ACTIVE" 2 "PRECONDITION" 1 "STANDBY" 0 "POWER_UP_INIT" ;
VAL_ 1092 PCS2_a059_dcdcStageRequestProces 3 "HV_DISCHARGE" 2 "HV_PRECHARGE" 1 "LV_REGULATION" 0 "DISABLE" ;
VAL_ 1092 PCS2_a059_dcdcRequest 2 "HV_REGULATION" 1 "LV_REGULATION" 0 "OFF" ;
VAL_ 1092 PCS2_a071_hvBattExternalRefValue 2047 "SNA" ;
VAL_ 1092 PCS2_a072_hvBattExternalRefValue 2047 "SNA" ;
VAL_ 1092 PCS2_a073_hvBusExternalRefValue 2047 "SNA" ;
VAL_ 1092 PCS2_a074_hvBusExternalRefValue 2047 "SNA" ;
VAL_ 1092 PCS2_a075_hvBattExternalRefValue 2047 "SNA" ;
VAL_ 1092 PCS2_a076_hvBusExternalRefValue 2047 "SNA" ;
VAL_ 1092 PCS2_a088_linesFaulted 6 "NUM_AC_LINE_TO_LINE" 5 "L2L3" 4 "L1L3" 3 "L1L2" 2 "L3LN" 1 "L2LN" 0 "L1LN" ;
VAL_ 1092 PCS2_a088_gridConfig 3 "THREE_PHASE_DELTA" 2 "THREE_PHASE" 1 "SINGLE_PHASE" 0 "SNA" ;
VAL_ 1092 PCS2_a094_cycloABlockedReason 5 "NUM_BLOCKED_REASONS" 4 "BLOCKED_DUE_TO_AUX_RAIL_PERMANENT_FAULT" 3 "BLOCKED_DUE_TO_HEALTH_CHECK_FAILED" 2 "BLOCKED_DUE_TO_HVDC_OVER_CURRENT" 1 "BLOCKED_DUE_TO_OVER_TEMP" 0 "NOT_BLOCKED" ;
VAL_ 1092 PCS2_a094_cycloBBlockedReason 5 "NUM_BLOCKED_REASONS" 4 "BLOCKED_DUE_TO_AUX_RAIL_PERMANENT_FAULT" 3 "BLOCKED_DUE_TO_HEALTH_CHECK_FAILED" 2 "BLOCKED_DUE_TO_HVDC_OVER_CURRENT" 1 "BLOCKED_DUE_TO_OVER_TEMP" 0 "NOT_BLOCKED" ;
VAL_ 1092 PCS2_a095_cycloABlockedReason 5 "NUM_BLOCKED_REASONS" 4 "BLOCKED_DUE_TO_AUX_RAIL_PERMANENT_FAULT" 3 "BLOCKED_DUE_TO_HEALTH_CHECK_FAILED" 2 "BLOCKED_DUE_TO_HVDC_OVER_CURRENT" 1 "BLOCKED_DUE_TO_OVER_TEMP" 0 "NOT_BLOCKED" ;
VAL_ 1092 PCS2_a095_cycloBBlockedReason 5 "NUM_BLOCKED_REASONS" 4 "BLOCKED_DUE_TO_AUX_RAIL_PERMANENT_FAULT" 3 "BLOCKED_DUE_TO_HEALTH_CHECK_FAILED" 2 "BLOCKED_DUE_TO_HVDC_OVER_CURRENT" 1 "BLOCKED_DUE_TO_OVER_TEMP" 0 "NOT_BLOCKED" ;
VAL_ 1092 PCS2_a099_lineFaulted 3 "N" 2 "3" 1 "2" 0 "1" ;
VAL_ 1092 PCS2_a099_iticCurveSection 6 "NUM_ITIC_CURVE_OV_SECTIONS" 5 "ITIC_CURVE_SECTION_STEADY_STATE_OV" 4 "ITIC_CURVE_SECTION_LINE_VOLTAGE_SWELL_OV" 3 "ITIC_CURVE_SECTION_LOWER_LOW_FREQUENCY_DECAYING_RINGWAVE_OV" 2 "ITIC_CURVE_SECTION_UPPER_LOW_FREQUENCY_DECAYING_RINGWAVE_OV" 1 "ITIC_CURVE_SECTION_LOWER_HIGH_FREQUENCY_IMPULSE_AND_RINGWAVE_OV" 0 "ITIC_CURVE_SECTION_UPPER_HIGH_FREQUENCY_IMPULSE_AND_RINGWAVE_OV" ;
VAL_ 1092 PCS2_a100_linesFaulted 6 "NUM_AC_LINE_TO_LINE" 5 "L2L3" 4 "L1L3" 3 "L1L2" 2 "L3LN" 1 "L2LN" 0 "L1LN" ;
VAL_ 1092 PCS2_a100_iticCurveSection 6 "NUM_ITIC_CURVE_OV_SECTIONS" 5 "ITIC_CURVE_SECTION_STEADY_STATE_OV" 4 "ITIC_CURVE_SECTION_LINE_VOLTAGE_SWELL_OV" 3 "ITIC_CURVE_SECTION_LOWER_LOW_FREQUENCY_DECAYING_RINGWAVE_OV" 2 "ITIC_CURVE_SECTION_UPPER_LOW_FREQUENCY_DECAYING_RINGWAVE_OV" 1 "ITIC_CURVE_SECTION_LOWER_HIGH_FREQUENCY_IMPULSE_AND_RINGWAVE_OV" 0 "ITIC_CURVE_SECTION_UPPER_HIGH_FREQUENCY_IMPULSE_AND_RINGWAVE_OV" ;
VAL_ 1092 PCS2_a101_lineFaulted 3 "N" 2 "3" 1 "2" 0 "1" ;
VAL_ 1092 PCS2_a101_iticCurveSection 6 "NUM_ITIC_CURVE_OV_SECTIONS" 5 "ITIC_CURVE_SECTION_STEADY_STATE_OV" 4 "ITIC_CURVE_SECTION_LINE_VOLTAGE_SWELL_OV" 3 "ITIC_CURVE_SECTION_LOWER_LOW_FREQUENCY_DECAYING_RINGWAVE_OV" 2 "ITIC_CURVE_SECTION_UPPER_LOW_FREQUENCY_DECAYING_RINGWAVE_OV" 1 "ITIC_CURVE_SECTION_LOWER_HIGH_FREQUENCY_IMPULSE_AND_RINGWAVE_OV" 0 "ITIC_CURVE_SECTION_UPPER_HIGH_FREQUENCY_IMPULSE_AND_RINGWAVE_OV" ;
VAL_ 1092 PCS2_a102_linesFaulted 6 "NUM_AC_LINE_TO_LINE" 5 "L2L3" 4 "L1L3" 3 "L1L2" 2 "L3LN" 1 "L2LN" 0 "L1LN" ;
VAL_ 1092 PCS2_a102_iticCurveSection 6 "NUM_ITIC_CURVE_OV_SECTIONS" 5 "ITIC_CURVE_SECTION_STEADY_STATE_OV" 4 "ITIC_CURVE_SECTION_LINE_VOLTAGE_SWELL_OV" 3 "ITIC_CURVE_SECTION_LOWER_LOW_FREQUENCY_DECAYING_RINGWAVE_OV" 2 "ITIC_CURVE_SECTION_UPPER_LOW_FREQUENCY_DECAYING_RINGWAVE_OV" 1 "ITIC_CURVE_SECTION_LOWER_HIGH_FREQUENCY_IMPULSE_AND_RINGWAVE_OV" 0 "ITIC_CURVE_SECTION_UPPER_HIGH_FREQUENCY_IMPULSE_AND_RINGWAVE_OV" ;
VAL_ 1092 PCS2_a103_IsoTempSensor 12 "ISO_TEMPSENSORS_MAX" 11 "DCDC2_LV1_TEMP_N" 10 "DCDC1_LV1_TEMP_N" 9 "DCDC2_HV_TEMP_N" 8 "DCDC2_LV2_TEMP_N" 7 "DCDC1_HV_TEMP_N" 6 "DCDC1_LV2_TEMP_N" 5 "DCAC2_DC_TEMP_N" 4 "DCAC2_AC2_TEMP_N" 3 "DCAC2_AC1_TEMP_N" 2 "DCAC1_DC_TEMP_N" 1 "DCAC1_AC2_TEMP_N" 0 "DCAC1_AC1_TEMP_N" ;
VAL_ 1092 PCS2_a104_lineFaulted 3 "N" 2 "3" 1 "2" 0 "1" ;
VAL_ 1092 PCS2_a104_iticCurveSection 3 "NUM_ITIC_CURVE_UV_SECTIONS" 2 "ITIC_CURVE_SECTION_LINE_VOLTAGE_SAG_LEVEL_2_UV" 1 "ITIC_CURVE_SECTION_LINE_VOLTAGE_SAG_LEVEL_1_UV" 0 "ITIC_CURVE_SECTION_STEADY_STATE_UV" ;
VAL_ 1092 PCS2_a105_linesFaulted 6 "NUM_AC_LINE_TO_LINE" 5 "L2L3" 4 "L1L3" 3 "L1L2" 2 "L3LN" 1 "L2LN" 0 "L1LN" ;
VAL_ 1092 PCS2_a105_iticCurveSection 3 "NUM_ITIC_CURVE_UV_SECTIONS" 2 "ITIC_CURVE_SECTION_LINE_VOLTAGE_SAG_LEVEL_2_UV" 1 "ITIC_CURVE_SECTION_LINE_VOLTAGE_SAG_LEVEL_1_UV" 0 "ITIC_CURVE_SECTION_STEADY_STATE_UV" ;
VAL_ 1092 PCS2_a106_systemNeutral 3 "N" 2 "3" 1 "2" 0 "1" ;
VAL_ 1092 PCS2_a112_linesFaulted 6 "NUM_AC_LINE_TO_LINE" 5 "L2L3" 4 "L1L3" 3 "L1L2" 2 "L3LN" 1 "L2LN" 0 "L1LN" ;
VAL_ 1092 PCS2_a113_receivedCoolantTemp -1023 "SNA" ;
VAL_ 1092 PCS2_a113_sensedCoolantTemp -1023 "SNA" ;
VAL_ 1092 PCS2_a123_DcdcBHvTemp -1023 "SNA" ;
VAL_ 1092 PCS2_a123_DcdcBHvTempUpperThresh -1023 "SNA" ;
VAL_ 1092 PCS2_a127_acLineClkHealthStatus 3 "UNHEALTHY_ISOTEMPSENSE" 2 "UNHEALTHY_POWER_RAIL_UV" 1 "HEALTHY" 0 "UNDETERMINED" ;
VAL_ 1092 PCS2_a127_dcac1_L1EnableHealthSt 3 "UNHEALTHY_ISOTEMPSENSE" 2 "UNHEALTHY_POWER_RAIL_UV" 1 "HEALTHY" 0 "UNDETERMINED" ;
VAL_ 1092 PCS2_a127_dcac1_L2EnableHealthSt 3 "UNHEALTHY_ISOTEMPSENSE" 2 "UNHEALTHY_POWER_RAIL_UV" 1 "HEALTHY" 0 "UNDETERMINED" ;
VAL_ 1092 PCS2_a127_dcac1_L3EnableHealthSt 3 "UNHEALTHY_ISOTEMPSENSE" 2 "UNHEALTHY_POWER_RAIL_UV" 1 "HEALTHY" 0 "UNDETERMINED" ;
VAL_ 1092 PCS2_a127_dcac1_LNEnableHealthSt 3 "UNHEALTHY_ISOTEMPSENSE" 2 "UNHEALTHY_POWER_RAIL_UV" 1 "HEALTHY" 0 "UNDETERMINED" ;
VAL_ 1092 PCS2_a127_dcac1_acTankClkHealthS 3 "UNHEALTHY_ISOTEMPSENSE" 2 "UNHEALTHY_POWER_RAIL_UV" 1 "HEALTHY" 0 "UNDETERMINED" ;
VAL_ 1092 PCS2_a127_dcac1_dcTankClkHealthS 3 "UNHEALTHY_ISOTEMPSENSE" 2 "UNHEALTHY_POWER_RAIL_UV" 1 "HEALTHY" 0 "UNDETERMINED" ;
VAL_ 1092 PCS2_a127_dcac1_hvEnableHealthSt 3 "UNHEALTHY_ISOTEMPSENSE" 2 "UNHEALTHY_POWER_RAIL_UV" 1 "HEALTHY" 0 "UNDETERMINED" ;
VAL_ 1092 PCS2_a128_acLineClkHealthStatus 3 "UNHEALTHY_ISOTEMPSENSE" 2 "UNHEALTHY_POWER_RAIL_UV" 1 "HEALTHY" 0 "UNDETERMINED" ;
VAL_ 1092 PCS2_a128_dcac2_L1EnableHealthSt 3 "UNHEALTHY_ISOTEMPSENSE" 2 "UNHEALTHY_POWER_RAIL_UV" 1 "HEALTHY" 0 "UNDETERMINED" ;
VAL_ 1092 PCS2_a128_dcac2_L2EnableHealthSt 3 "UNHEALTHY_ISOTEMPSENSE" 2 "UNHEALTHY_POWER_RAIL_UV" 1 "HEALTHY" 0 "UNDETERMINED" ;
VAL_ 1092 PCS2_a128_dcac2_L3EnableHealthSt 3 "UNHEALTHY_ISOTEMPSENSE" 2 "UNHEALTHY_POWER_RAIL_UV" 1 "HEALTHY" 0 "UNDETERMINED" ;
VAL_ 1092 PCS2_a128_dcac2_LNEnableHealthSt 3 "UNHEALTHY_ISOTEMPSENSE" 2 "UNHEALTHY_POWER_RAIL_UV" 1 "HEALTHY" 0 "UNDETERMINED" ;
VAL_ 1092 PCS2_a128_dcac2_acTankClkHealthS 3 "UNHEALTHY_ISOTEMPSENSE" 2 "UNHEALTHY_POWER_RAIL_UV" 1 "HEALTHY" 0 "UNDETERMINED" ;
VAL_ 1092 PCS2_a128_dcac2_dcTankClkHealthS 3 "UNHEALTHY_ISOTEMPSENSE" 2 "UNHEALTHY_POWER_RAIL_UV" 1 "HEALTHY" 0 "UNDETERMINED" ;
VAL_ 1092 PCS2_a128_dcac2_hvEnableHealthSt 3 "UNHEALTHY_ISOTEMPSENSE" 2 "UNHEALTHY_POWER_RAIL_UV" 1 "HEALTHY" 0 "UNDETERMINED" ;
VAL_ 1092 PCS2_a130_serverStateAtRetry 6 "RETRIES_EXPIRED_POST_NVMM_INIT" 5 "RETRIES_EXPIRED_PRE_NVMM_INIT" 4 "REFORMAT_REQUEST_PENDING" 3 "READY_TO_RUN" 2 "NVMM_LAYER_INITIALIZED" 1 "SPI_INITIALIZED" 0 "SYSTEM_START" ;
VAL_ 1092 PCS2_a136_failedSequence 8 "HEALTH_CHECK_NUM_SEQUENCES" 7 "HEALTH_CHECK_COMPLETED" 6 "HEALTH_CHECK_XCAP_FAILURE_TEST" 5 "XCAP_HEALTH_CHECK_NOT_YET_RUN" 4 "HEALTH_CHECK_PRIMARY_SIDE_SHORT_CIRCUIT_FAILURE_TEST" 3 "HEALTH_CHECK_SECONDARY_SIDE_GATE_SOURCE_FAILURE_TEST" 2 "HEALTH_CHECK_PRIMARY_SIDE_OPEN_CIRCUIT_FAILURE_TEST" 1 "HEALTH_CHECK_SECONDARY_SIDE_SHORT_CIRCUIT_FAILURE_TEST" 0 "HEALTH_CHECK_NOT_YET_RUN" ;
VAL_ 1092 PCS2_a136_mosfetLegUnderTest 5 "DC_LEG_2" 4 "DC_LEG_1" 3 "AC_LEG_N" 2 "AC_LEG_3" 1 "AC_LEG_2" 0 "AC_LEG_1" ;
VAL_ 1092 PCS2_a136_mosfetIndexUnderTest 8 "SWITCH_INDEX_NOT_APPLICABLE" 7 "CYCLO_DC_LxSB_SWITCH" 6 "CYCLO_DC_LxST_SWITCH" 5 "CYCLO_AC_BN_SWITCH" 4 "CYCLO_AC_BP_SWITCH" 3 "CYCLO_AC_TP_SWITCH" 2 "CYCLO_AC_TN_SWITCH" 1 "NEGATIVE_PULSE_INDEX" 0 "POSITIVE_PULSE_INDEX" ;
VAL_ 1092 PCS2_a137_failedSequence 8 "HEALTH_CHECK_NUM_SEQUENCES" 7 "HEALTH_CHECK_COMPLETED" 6 "HEALTH_CHECK_XCAP_FAILURE_TEST" 5 "XCAP_HEALTH_CHECK_NOT_YET_RUN" 4 "HEALTH_CHECK_PRIMARY_SIDE_SHORT_CIRCUIT_FAILURE_TEST" 3 "HEALTH_CHECK_SECONDARY_SIDE_GATE_SOURCE_FAILURE_TEST" 2 "HEALTH_CHECK_PRIMARY_SIDE_OPEN_CIRCUIT_FAILURE_TEST" 1 "HEALTH_CHECK_SECONDARY_SIDE_SHORT_CIRCUIT_FAILURE_TEST" 0 "HEALTH_CHECK_NOT_YET_RUN" ;
VAL_ 1092 PCS2_a137_mosfetLegUnderTest 5 "DC_LEG_2" 4 "DC_LEG_1" 3 "AC_LEG_N" 2 "AC_LEG_3" 1 "AC_LEG_2" 0 "AC_LEG_1" ;
VAL_ 1092 PCS2_a137_mosfetIndexUnderTest 8 "SWITCH_INDEX_NOT_APPLICABLE" 7 "CYCLO_DC_LxSB_SWITCH" 6 "CYCLO_DC_LxST_SWITCH" 5 "CYCLO_AC_BN_SWITCH" 4 "CYCLO_AC_BP_SWITCH" 3 "CYCLO_AC_TP_SWITCH" 2 "CYCLO_AC_TN_SWITCH" 1 "NEGATIVE_PULSE_INDEX" 0 "POSITIVE_PULSE_INDEX" ;
VAL_ 1092 PCS2_a148_acRelayState 4 "DRIVEN" 3 "DRIVE_STARTUP_RAMP_DOWN" 2 "DRIVE_STARTUP" 1 "NOT_DRIVE_STARTUP" 0 "NOT_DRIVEN" ;
VAL_ 1092 PCS2_a149_buckBoostRampTarget 4095 "SNA" ;
VAL_ 1092 PCS2_a150_presentBurstMode 3 "FULLY_ON" 2 "OFF_ON_BURST" 1 "ON_OFF_BURST" 0 "FULLY_OFF" ;
VAL_ 1092 PCS2_a150_previousBurstMode 3 "FULLY_ON" 2 "OFF_ON_BURST" 1 "ON_OFF_BURST" 0 "FULLY_OFF" ;
VAL_ 1092 PCS2_a151_DcdcBLv1Temp -1023 "SNA" ;
VAL_ 1092 PCS2_a151_DcdcBLv1TempUpperThres -1023 "SNA" ;
VAL_ 1092 PCS2_a152_DcdcBLv3Temp -1023 "SNA" ;
VAL_ 1092 PCS2_a152_DcdcBLv3TempUpperThres -1023 "SNA" ;
VAL_ 1092 PCS2_a159_HVDCGdpsHealthStatus 3 "UNHEALTHY_ISOTEMPSENSE" 2 "UNHEALTHY_POWER_RAIL_UV" 1 "HEALTHY" 0 "UNDETERMINED" ;
VAL_ 1092 PCS2_a170_detectedPhaseConfig 4 "SPLIT_PHASE" 3 "THREE_PHASE_DELTA" 2 "THREE_PHASE_WYE" 1 "SINGLE_PHASE" 0 "UNKNOWN" ;
VAL_ 1092 PCS2_a173_DcdcALv1Temp -1023 "SNA" ;
VAL_ 1092 PCS2_a173_DcdcALv1TempUpperThres -1023 "SNA" ;
VAL_ 1092 PCS2_a174_llc48V0RailOverCurrent 1 "COMPL_TRIP" 0 "COMPH_TRIP" ;
VAL_ 1092 PCS2_a177_latchMotorRailOverCurr 1 "COMPL_TRIP" 0 "COMPH_TRIP" ;
VAL_ 996 PCS2_matrixIndex 3 "AlertMatrix3" 2 "AlertMatrix2" 1 "AlertMatrix1" 0 "AlertMatrix0" ;
