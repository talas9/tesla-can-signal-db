VERSION "dbc-export 1 2026.26.6.5"

NS_ :

BS_:

BU_: ADSP APB APP APS APSB BB BMS CC CMP CMPD CP DAS DI DIF DIR DPB EPAS3P EPAS3S EPASTP EPASTS EPBL EPBR ESP EVSE FC GTW HCML HCMR HVP IBST ICR IDB LS OCS1P PARK PCS PCS2 PM PMF PMR PNCD PTC RADC RCM RCM2 RCM3 RCU SCCM SCM SCS SDCR TAS TCU TCU2 TPMS TRCM UI UIS UMC USM V2G VC VCBATT VCBATT0 VCBATT1 VCBATT2 VCCC VCFRONT VCFRONT1 VCFRONT2 VCLEFT VCRIGHT VCSEAT2L VCSEAT2R VCSEC VEH

BO_ 2011 VCRIGHT_alertLog: 8 VCRIGHT
 SG_ VCRIGHT_alertID M : 0|10@1+ (1,0) [0|1023] "" Vector__XXX
 SG_ VCRIGHT_a146_snsRateChangeUp m146 : 18|1@1+ (1,0) [0|1] "" Vector__XXX
 SG_ VCRIGHT_a146_snsRateChangeDown m146 : 19|1@1+ (1,0) [0|1] "" Vector__XXX
 SG_ VCRIGHT_a147_snsShortCircuit m147 : 16|1@1+ (1,0) [0|1] "" Vector__XXX
 SG_ VCRIGHT_a147_snsDisconnect m147 : 17|1@1+ (1,0) [0|1] "" Vector__XXX
 SG_ VCRIGHT_a147_snsRateChangeUp m147 : 18|1@1+ (1,0) [0|1] "" Vector__XXX
 SG_ VCRIGHT_a147_snsRateChangeDown m147 : 19|1@1+ (1,0) [0|1] "" Vector__XXX
 SG_ VCRIGHT_a148_snsShortCircuit m148 : 16|1@1+ (1,0) [0|1] "" Vector__XXX
 SG_ VCRIGHT_a148_snsDisconnect m148 : 17|1@1+ (1,0) [0|1] "" Vector__XXX
 SG_ VCRIGHT_a148_snsRateChangeUp m148 : 18|1@1+ (1,0) [0|1] "" Vector__XXX
 SG_ VCRIGHT_a148_snsRateChangeDown m148 : 19|1@1+ (1,0) [0|1] "" Vector__XXX
 SG_ VCRIGHT_a149_snsShortCircuit m149 : 16|1@1+ (1,0) [0|1] "" Vector__XXX
 SG_ VCRIGHT_a149_snsDisconnect m149 : 17|1@1+ (1,0) [0|1] "" Vector__XXX
 SG_ VCRIGHT_a149_snsRateChangeUp m149 : 18|1@1+ (1,0) [0|1] "" Vector__XXX
 SG_ VCRIGHT_a149_snsRateChangeDown m149 : 19|1@1+ (1,0) [0|1] "" Vector__XXX
 SG_ VCRIGHT_a150_windowPosition m150 : 16|9@1- (1.43137252331,197.529418945) [-168.901947022|562.529412389] "mm" Vector__XXX
 SG_ VCRIGHT_a150_movementTimeMs m150 : 25|7@1+ (50,0) [0|6350] "ms" Vector__XXX
 SG_ VCRIGHT_a150_windowPinchReason m150 : 32|3@1+ (1,0) [0|7] "" Vector__XXX
 SG_ VCRIGHT_a150_lookbackIndex m150 : 35|6@1+ (1,0) [0|63] "" Vector__XXX
 SG_ VCRIGHT_a150_absAccelExceedance m150 : 41|8@1+ (0.09803922,0) [0|25.0000011] "%" Vector__XXX
 SG_ VCRIGHT_a150_relAccelExceedance m150 : 49|8@1+ (0.09803922,0) [0|25.0000011] "%" Vector__XXX
 SG_ VCRIGHT_a150_speedExpScore m150 : 57|6@1- (0.0006451613,-0.009677419) [-0.0303225806|0.0103225813] "-" Vector__XXX
 SG_ VCRIGHT_a150_treatedInGear m150 : 63|1@1+ (1,0) [0|1] "" Vector__XXX
 SG_ VCRIGHT_a151_windowPosition m151 : 16|9@1- (1.43137252331,197.529418945) [-168.901947022|562.529412389] "mm" Vector__XXX
 SG_ VCRIGHT_a151_movementTimeMs m151 : 25|7@1+ (50,0) [0|6350] "ms" Vector__XXX
 SG_ VCRIGHT_a151_windowPinchReason m151 : 32|3@1+ (1,0) [0|7] "" Vector__XXX
 SG_ VCRIGHT_a151_lookbackIndex m151 : 35|6@1+ (1,0) [0|63] "" Vector__XXX
 SG_ VCRIGHT_a151_absAccelExceedance m151 : 41|8@1+ (0.09803922,0) [0|25.0000011] "%" Vector__XXX
 SG_ VCRIGHT_a151_relAccelExceedance m151 : 49|8@1+ (0.09803922,0) [0|25.0000011] "%" Vector__XXX
 SG_ VCRIGHT_a151_speedExpScore m151 : 57|6@1- (0.0006451613,-0.009677419) [-0.0303225806|0.0103225813] "-" Vector__XXX
 SG_ VCRIGHT_a151_treatedInGear m151 : 63|1@1+ (1,0) [0|1] "" Vector__XXX
 SG_ VCRIGHT_a152_zeroed m152 : 16|1@1+ (1,0) [0|1] "" Vector__XXX
 SG_ VCRIGHT_a152_endStopTrusted m152 : 17|1@1+ (1,0) [0|1] "" Vector__XXX
 SG_ VCRIGHT_a152_speedTableStatus m152 : 18|2@1+ (1,0) [1|3] "" Vector__XXX
 SG_ VCRIGHT_a152_causedByBackoffs m152 : 20|1@1+ (1,0) [0|1] "" Vector__XXX
 SG_ VCRIGHT_a153_zeroed m153 : 16|1@1+ (1,0) [0|1] "" Vector__XXX
 SG_ VCRIGHT_a153_endStopTrusted m153 : 17|1@1+ (1,0) [0|1] "" Vector__XXX
 SG_ VCRIGHT_a153_speedTableStatus m153 : 18|2@1+ (1,0) [1|3] "" Vector__XXX
 SG_ VCRIGHT_a153_causedByBackoffs m153 : 20|1@1+ (1,0) [0|1] "" Vector__XXX
 SG_ VCRIGHT_a154_windowThermalMode m154 : 16|2@1+ (1,0) [1|3] "" Vector__XXX
 SG_ VCRIGHT_a154_lightShowActive m154 : 18|1@1+ (1,0) [0|1] "" Vector__XXX
 SG_ VCRIGHT_a155_windowThermalMode m155 : 16|2@1+ (1,0) [1|3] "" Vector__XXX
 SG_ VCRIGHT_a155_lightShowActive m155 : 18|1@1+ (1,0) [0|1] "" Vector__XXX
 SG_ VCRIGHT_a177_hvacRearStall m177 : 16|1@1+ (1,0) [0|1] "" Vector__XXX
 SG_ VCRIGHT_a180_intButtonPressed m180 : 16|1@1+ (1,0) [0|1] "" Vector__XXX
 SG_ VCRIGHT_a180_extHandlePWM m180 : 24|8@1+ (1,0) [0|255] "%" Vector__XXX
 SG_ VCRIGHT_a180_extHandlePulled m180 : 32|1@1+ (1,0) [0|1] "" Vector__XXX
 SG_ VCRIGHT_a180_releasePWM m180 : 40|8@1+ (1,0) [0|255] "%" Vector__XXX
 SG_ VCRIGHT_a180_latchStatus m180 : 48|4@1+ (1,0) [1|15] "" Vector__XXX
 SG_ VCRIGHT_a180_latchClawStatus m180 : 52|1@1+ (1,0) [0|1] "" Vector__XXX
 SG_ VCRIGHT_a181_intButtonPressed m181 : 16|1@1+ (1,0) [0|1] "" Vector__XXX
 SG_ VCRIGHT_a181_extHandlePWM m181 : 24|8@1+ (1,0) [0|255] "%" Vector__XXX
 SG_ VCRIGHT_a181_extHandlePulled m181 : 32|1@1+ (1,0) [0|1] "" Vector__XXX
 SG_ VCRIGHT_a181_releasePWM m181 : 40|8@1+ (1,0) [0|255] "%" Vector__XXX
 SG_ VCRIGHT_a181_latchStatus m181 : 48|4@1+ (1,0) [1|15] "" Vector__XXX
 SG_ VCRIGHT_a181_latchClawStatus m181 : 52|1@1+ (1,0) [0|1] "" Vector__XXX
 SG_ VCRIGHT_a184_voltage m184 : 16|7@1+ (0.15,0) [0|19.05] "V" Vector__XXX
 SG_ VCRIGHT_a184_temperature m184 : 24|8@1+ (0.5,-40) [-40|87.5] "degC" Vector__XXX
 SG_ VCRIGHT_a184_trunkCurrent m184 : 32|8@1+ (0.05,0) [0|12.75] "A" Vector__XXX
 SG_ VCRIGHT_a186_voltage m186 : 16|7@1+ (0.15,0) [0|19.05] "V" Vector__XXX
 SG_ VCRIGHT_a186_temperature m186 : 24|8@1+ (0.5,-40) [-40|87.5] "degC" Vector__XXX
 SG_ VCRIGHT_a187_voltage m187 : 16|7@1+ (0.15,0) [0|19.05] "V" Vector__XXX
 SG_ VCRIGHT_a187_temperature m187 : 24|8@1+ (0.5,-40) [-40|87.5] "degC" Vector__XXX
 SG_ VCRIGHT_a188_voltage m188 : 16|7@1+ (0.15,0) [0|19.05] "V" Vector__XXX
 SG_ VCRIGHT_a188_temperature m188 : 24|8@1+ (0.5,-40) [-40|87.5] "degC" Vector__XXX
 SG_ VCRIGHT_a189_voltage m189 : 16|7@1+ (0.15,0) [0|19.05] "V" Vector__XXX
 SG_ VCRIGHT_a189_temperature m189 : 24|8@1+ (0.5,-40) [-40|87.5] "degC" Vector__XXX
 SG_ VCRIGHT_a190_eFuseTripCount m190 : 16|8@1+ (1,0) [0|255] "" Vector__XXX
 SG_ VCRIGHT_a193_amplifierCurrent m193 : 16|10@1+ (0.1,0) [0|102.3] "A" Vector__XXX
 SG_ VCRIGHT_a194_cntctrPwrCurrent m194 : 16|10@1+ (0.1,0) [0|102.3] "A" Vector__XXX
 SG_ VCRIGHT_a195_hvcCurrent m195 : 16|10@1+ (0.1,0) [0|102.3] "A" Vector__XXX
 SG_ VCRIGHT_a196_outputState m196 : 16|1@1+ (1,0) [0|1] "" Vector__XXX
 SG_ VCRIGHT_a196_NVRAMState m196 : 17|1@1+ (1,0) [0|1] "" Vector__XXX
 SG_ VCRIGHT_a196_lockoutState m196 : 18|1@1+ (1,0) [0|1] "" Vector__XXX
 SG_ VCRIGHT_a197_outputState m197 : 16|1@1+ (1,0) [0|1] "" Vector__XXX
 SG_ VCRIGHT_a197_NVRAMState m197 : 17|1@1+ (1,0) [0|1] "" Vector__XXX
 SG_ VCRIGHT_a197_lockoutState m197 : 18|1@1+ (1,0) [0|1] "" Vector__XXX
 SG_ VCRIGHT_a198_outputState m198 : 16|1@1+ (1,0) [0|1] "" Vector__XXX
 SG_ VCRIGHT_a198_NVRAMState m198 : 17|1@1+ (1,0) [0|1] "" Vector__XXX
 SG_ VCRIGHT_a198_lockoutState m198 : 18|1@1+ (1,0) [0|1] "" Vector__XXX
 SG_ VCRIGHT_a199_outputState m199 : 16|1@1+ (1,0) [0|1] "" Vector__XXX
 SG_ VCRIGHT_a199_NVRAMState m199 : 17|1@1+ (1,0) [0|1] "" Vector__XXX
 SG_ VCRIGHT_a199_lockoutState m199 : 18|1@1+ (1,0) [0|1] "" Vector__XXX
 SG_ VCRIGHT_a202_unknownAllowed m202 : 16|1@1+ (1,0) [0|1] "" Vector__XXX
 SG_ VCRIGHT_a202_openAllowed m202 : 17|1@1+ (1,0) [0|1] "" Vector__XXX
 SG_ VCRIGHT_a202_dynamicAllowed m202 : 18|1@1+ (1,0) [0|1] "" Vector__XXX
 SG_ VCRIGHT_a202_parkAllowed m202 : 19|1@1+ (1,0) [0|1] "" Vector__XXX
 SG_ VCRIGHT_a202_startAllowed m202 : 20|1@1+ (1,0) [0|1] "" Vector__XXX
 SG_ VCRIGHT_a202_serviceAllowed m202 : 21|1@1+ (1,0) [0|1] "" Vector__XXX
 SG_ VCRIGHT_a202_winchAllowed m202 : 22|1@1+ (1,0) [0|1] "" Vector__XXX
 SG_ VCRIGHT_a202_winchReleaseAllowed m202 : 23|1@1+ (1,0) [0|1] "" Vector__XXX
 SG_ VCRIGHT_a202_parkingAllowed m202 : 24|1@1+ (1,0) [0|1] "" Vector__XXX
 SG_ VCRIGHT_a202_dynApplyAllowed m202 : 25|1@1+ (1,0) [0|1] "" Vector__XXX
 SG_ VCRIGHT_a202_releaseAllowed m202 : 26|1@1+ (1,0) [0|1] "" Vector__XXX
 SG_ VCRIGHT_a202_parkPendingAllowed m202 : 27|1@1+ (1,0) [0|1] "" Vector__XXX
 SG_ VCRIGHT_a202_wenchPendingAllowed m202 : 28|1@1+ (1,0) [0|1] "" Vector__XXX
 SG_ VCRIGHT_a202_desyncCount m202 : 32|6@1+ (1,0) [0|63] "" Vector__XXX
 SG_ VCRIGHT_a202_current m202 : 38|10@1+ (0.05,0) [0|51.15] "A" Vector__XXX
 SG_ VCRIGHT_a202_epbConfig m202 : 48|4@1+ (1,0) [0|15] "" Vector__XXX
 SG_ VCRIGHT_a203_unknownAllowed m203 : 16|1@1+ (1,0) [0|1] "" Vector__XXX
 SG_ VCRIGHT_a203_openAllowed m203 : 17|1@1+ (1,0) [0|1] "" Vector__XXX
 SG_ VCRIGHT_a203_dynamicAllowed m203 : 18|1@1+ (1,0) [0|1] "" Vector__XXX
 SG_ VCRIGHT_a203_parkAllowed m203 : 19|1@1+ (1,0) [0|1] "" Vector__XXX
 SG_ VCRIGHT_a203_startAllowed m203 : 20|1@1+ (1,0) [0|1] "" Vector__XXX
 SG_ VCRIGHT_a203_serviceAllowed m203 : 21|1@1+ (1,0) [0|1] "" Vector__XXX
 SG_ VCRIGHT_a203_winchAllowed m203 : 22|1@1+ (1,0) [0|1] "" Vector__XXX
 SG_ VCRIGHT_a203_winchReleaseAllowed m203 : 23|1@1+ (1,0) [0|1] "" Vector__XXX
 SG_ VCRIGHT_a203_parkingAllowed m203 : 24|1@1+ (1,0) [0|1] "" Vector__XXX
 SG_ VCRIGHT_a203_dynApplyAllowed m203 : 25|1@1+ (1,0) [0|1] "" Vector__XXX
 SG_ VCRIGHT_a203_releaseAllowed m203 : 26|1@1+ (1,0) [0|1] "" Vector__XXX
 SG_ VCRIGHT_a203_parkPendingAllowed m203 : 27|1@1+ (1,0) [0|1] "" Vector__XXX
 SG_ VCRIGHT_a203_wenchPendingAllowed m203 : 28|1@1+ (1,0) [0|1] "" Vector__XXX
 SG_ VCRIGHT_a203_desyncCount m203 : 32|6@1+ (1,0) [0|63] "" Vector__XXX
 SG_ VCRIGHT_a203_current m203 : 38|10@1+ (0.05,0) [0|51.15] "A" Vector__XXX
 SG_ VCRIGHT_a203_epbConfig m203 : 48|4@1+ (1,0) [0|15] "" Vector__XXX
 SG_ VCRIGHT_a204_unknownAllowed m204 : 16|1@1+ (1,0) [0|1] "" Vector__XXX
 SG_ VCRIGHT_a204_openAllowed m204 : 17|1@1+ (1,0) [0|1] "" Vector__XXX
 SG_ VCRIGHT_a204_dynamicAllowed m204 : 18|1@1+ (1,0) [0|1] "" Vector__XXX
 SG_ VCRIGHT_a204_parkAllowed m204 : 19|1@1+ (1,0) [0|1] "" Vector__XXX
 SG_ VCRIGHT_a204_startAllowed m204 : 20|1@1+ (1,0) [0|1] "" Vector__XXX
 SG_ VCRIGHT_a204_serviceAllowed m204 : 21|1@1+ (1,0) [0|1] "" Vector__XXX
 SG_ VCRIGHT_a204_winchAllowed m204 : 22|1@1+ (1,0) [0|1] "" Vector__XXX
 SG_ VCRIGHT_a204_winchReleaseAllowed m204 : 23|1@1+ (1,0) [0|1] "" Vector__XXX
 SG_ VCRIGHT_a204_parkingAllowed m204 : 24|1@1+ (1,0) [0|1] "" Vector__XXX
 SG_ VCRIGHT_a204_dynApplyAllowed m204 : 25|1@1+ (1,0) [0|1] "" Vector__XXX
 SG_ VCRIGHT_a204_releaseAllowed m204 : 26|1@1+ (1,0) [0|1] "" Vector__XXX
 SG_ VCRIGHT_a204_parkPendingAllowed m204 : 27|1@1+ (1,0) [0|1] "" Vector__XXX
 SG_ VCRIGHT_a204_wenchPendingAllowed m204 : 28|1@1+ (1,0) [0|1] "" Vector__XXX
 SG_ VCRIGHT_a204_desyncCount m204 : 32|6@1+ (1,0) [0|63] "" Vector__XXX
 SG_ VCRIGHT_a204_current m204 : 38|10@1+ (0.05,0) [0|51.15] "A" Vector__XXX
 SG_ VCRIGHT_a204_epbConfig m204 : 48|4@1+ (1,0) [0|15] "" Vector__XXX
 SG_ VCRIGHT_a205_unknownAllowed m205 : 16|1@1+ (1,0) [0|1] "" Vector__XXX
 SG_ VCRIGHT_a205_openAllowed m205 : 17|1@1+ (1,0) [0|1] "" Vector__XXX
 SG_ VCRIGHT_a205_dynamicAllowed m205 : 18|1@1+ (1,0) [0|1] "" Vector__XXX
 SG_ VCRIGHT_a205_parkAllowed m205 : 19|1@1+ (1,0) [0|1] "" Vector__XXX
 SG_ VCRIGHT_a205_startAllowed m205 : 20|1@1+ (1,0) [0|1] "" Vector__XXX
 SG_ VCRIGHT_a205_serviceAllowed m205 : 21|1@1+ (1,0) [0|1] "" Vector__XXX
 SG_ VCRIGHT_a205_winchAllowed m205 : 22|1@1+ (1,0) [0|1] "" Vector__XXX
 SG_ VCRIGHT_a205_winchReleaseAllowed m205 : 23|1@1+ (1,0) [0|1] "" Vector__XXX
 SG_ VCRIGHT_a205_parkingAllowed m205 : 24|1@1+ (1,0) [0|1] "" Vector__XXX
 SG_ VCRIGHT_a205_dynApplyAllowed m205 : 25|1@1+ (1,0) [0|1] "" Vector__XXX
 SG_ VCRIGHT_a205_releaseAllowed m205 : 26|1@1+ (1,0) [0|1] "" Vector__XXX
 SG_ VCRIGHT_a205_parkPendingAllowed m205 : 27|1@1+ (1,0) [0|1] "" Vector__XXX
 SG_ VCRIGHT_a205_wenchPendingAllowed m205 : 28|1@1+ (1,0) [0|1] "" Vector__XXX
 SG_ VCRIGHT_a205_desyncCount m205 : 32|6@1+ (1,0) [0|63] "" Vector__XXX
 SG_ VCRIGHT_a205_current m205 : 38|10@1+ (0.05,0) [0|51.15] "A" Vector__XXX
 SG_ VCRIGHT_a205_epbConfig m205 : 48|4@1+ (1,0) [0|15] "" Vector__XXX
 SG_ VCRIGHT_a206_unknownAllowed m206 : 16|1@1+ (1,0) [0|1] "" Vector__XXX
 SG_ VCRIGHT_a206_openAllowed m206 : 17|1@1+ (1,0) [0|1] "" Vector__XXX
 SG_ VCRIGHT_a206_dynamicAllowed m206 : 18|1@1+ (1,0) [0|1] "" Vector__XXX
 SG_ VCRIGHT_a206_parkAllowed m206 : 19|1@1+ (1,0) [0|1] "" Vector__XXX
 SG_ VCRIGHT_a206_startAllowed m206 : 20|1@1+ (1,0) [0|1] "" Vector__XXX
 SG_ VCRIGHT_a206_serviceAllowed m206 : 21|1@1+ (1,0) [0|1] "" Vector__XXX
 SG_ VCRIGHT_a206_winchAllowed m206 : 22|1@1+ (1,0) [0|1] "" Vector__XXX
 SG_ VCRIGHT_a206_winchReleaseAllowed m206 : 23|1@1+ (1,0) [0|1] "" Vector__XXX
 SG_ VCRIGHT_a206_parkingAllowed m206 : 24|1@1+ (1,0) [0|1] "" Vector__XXX
 SG_ VCRIGHT_a206_dynApplyAllowed m206 : 25|1@1+ (1,0) [0|1] "" Vector__XXX
 SG_ VCRIGHT_a206_releaseAllowed m206 : 26|1@1+ (1,0) [0|1] "" Vector__XXX
 SG_ VCRIGHT_a206_parkPendingAllowed m206 : 27|1@1+ (1,0) [0|1] "" Vector__XXX
 SG_ VCRIGHT_a206_wenchPendingAllowed m206 : 28|1@1+ (1,0) [0|1] "" Vector__XXX
 SG_ VCRIGHT_a206_unitStatusEPB m206 : 32|5@1+ (1,0) [0|31] "" Vector__XXX
 SG_ VCRIGHT_a206_unitStatusEPBM m206 : 40|5@1+ (1,0) [0|31] "" Vector__XXX
 SG_ VCRIGHT_a207_unknownAllowed m207 : 16|1@1+ (1,0) [0|1] "" Vector__XXX
 SG_ VCRIGHT_a207_openAllowed m207 : 17|1@1+ (1,0) [0|1] "" Vector__XXX
 SG_ VCRIGHT_a207_dynamicAllowed m207 : 18|1@1+ (1,0) [0|1] "" Vector__XXX
 SG_ VCRIGHT_a207_parkAllowed m207 : 19|1@1+ (1,0) [0|1] "" Vector__XXX
 SG_ VCRIGHT_a207_startAllowed m207 : 20|1@1+ (1,0) [0|1] "" Vector__XXX
 SG_ VCRIGHT_a207_serviceAllowed m207 : 21|1@1+ (1,0) [0|1] "" Vector__XXX
 SG_ VCRIGHT_a207_winchAllowed m207 : 22|1@1+ (1,0) [0|1] "" Vector__XXX
 SG_ VCRIGHT_a207_winchReleaseAllowed m207 : 23|1@1+ (1,0) [0|1] "" Vector__XXX
 SG_ VCRIGHT_a207_parkingAllowed m207 : 24|1@1+ (1,0) [0|1] "" Vector__XXX
 SG_ VCRIGHT_a207_dynApplyAllowed m207 : 25|1@1+ (1,0) [0|1] "" Vector__XXX
 SG_ VCRIGHT_a207_releaseAllowed m207 : 26|1@1+ (1,0) [0|1] "" Vector__XXX
 SG_ VCRIGHT_a207_parkPendingAllowed m207 : 27|1@1+ (1,0) [0|1] "" Vector__XXX
 SG_ VCRIGHT_a207_wenchPendingAllowed m207 : 28|1@1+ (1,0) [0|1] "" Vector__XXX
 SG_ VCRIGHT_a207_unitStatusEPB m207 : 32|5@1+ (1,0) [0|31] "" Vector__XXX
 SG_ VCRIGHT_a207_unitStatusEPBM m207 : 40|5@1+ (1,0) [0|31] "" Vector__XXX
 SG_ VCRIGHT_a208_unknownAllowed m208 : 16|1@1+ (1,0) [0|1] "" Vector__XXX
 SG_ VCRIGHT_a208_openAllowed m208 : 17|1@1+ (1,0) [0|1] "" Vector__XXX
 SG_ VCRIGHT_a208_dynamicAllowed m208 : 18|1@1+ (1,0) [0|1] "" Vector__XXX
 SG_ VCRIGHT_a208_parkAllowed m208 : 19|1@1+ (1,0) [0|1] "" Vector__XXX
 SG_ VCRIGHT_a208_startAllowed m208 : 20|1@1+ (1,0) [0|1] "" Vector__XXX
 SG_ VCRIGHT_a208_serviceAllowed m208 : 21|1@1+ (1,0) [0|1] "" Vector__XXX
 SG_ VCRIGHT_a208_winchAllowed m208 : 22|1@1+ (1,0) [0|1] "" Vector__XXX
 SG_ VCRIGHT_a208_winchReleaseAllowed m208 : 23|1@1+ (1,0) [0|1] "" Vector__XXX
 SG_ VCRIGHT_a208_parkingAllowed m208 : 24|1@1+ (1,0) [0|1] "" Vector__XXX
 SG_ VCRIGHT_a208_dynApplyAllowed m208 : 25|1@1+ (1,0) [0|1] "" Vector__XXX
 SG_ VCRIGHT_a208_releaseAllowed m208 : 26|1@1+ (1,0) [0|1] "" Vector__XXX
 SG_ VCRIGHT_a208_parkPendingAllowed m208 : 27|1@1+ (1,0) [0|1] "" Vector__XXX
 SG_ VCRIGHT_a208_wenchPendingAllowed m208 : 28|1@1+ (1,0) [0|1] "" Vector__XXX
 SG_ VCRIGHT_a208_unitStatusEPB m208 : 32|5@1+ (1,0) [0|31] "" Vector__XXX
 SG_ VCRIGHT_a208_unitStatusEPBM m208 : 40|5@1+ (1,0) [0|31] "" Vector__XXX
 SG_ VCRIGHT_a209_unknownAllowed m209 : 16|1@1+ (1,0) [0|1] "" Vector__XXX
 SG_ VCRIGHT_a209_openAllowed m209 : 17|1@1+ (1,0) [0|1] "" Vector__XXX
 SG_ VCRIGHT_a209_dynamicAllowed m209 : 18|1@1+ (1,0) [0|1] "" Vector__XXX
 SG_ VCRIGHT_a209_parkAllowed m209 : 19|1@1+ (1,0) [0|1] "" Vector__XXX
 SG_ VCRIGHT_a209_startAllowed m209 : 20|1@1+ (1,0) [0|1] "" Vector__XXX
 SG_ VCRIGHT_a209_serviceAllowed m209 : 21|1@1+ (1,0) [0|1] "" Vector__XXX
 SG_ VCRIGHT_a209_winchAllowed m209 : 22|1@1+ (1,0) [0|1] "" Vector__XXX
 SG_ VCRIGHT_a209_winchReleaseAllowed m209 : 23|1@1+ (1,0) [0|1] "" Vector__XXX
 SG_ VCRIGHT_a209_parkingAllowed m209 : 24|1@1+ (1,0) [0|1] "" Vector__XXX
 SG_ VCRIGHT_a209_dynApplyAllowed m209 : 25|1@1+ (1,0) [0|1] "" Vector__XXX
 SG_ VCRIGHT_a209_releaseAllowed m209 : 26|1@1+ (1,0) [0|1] "" Vector__XXX
 SG_ VCRIGHT_a209_parkPendingAllowed m209 : 27|1@1+ (1,0) [0|1] "" Vector__XXX
 SG_ VCRIGHT_a209_wenchPendingAllowed m209 : 28|1@1+ (1,0) [0|1] "" Vector__XXX
 SG_ VCRIGHT_a209_unitStatusEPB m209 : 32|5@1+ (1,0) [0|31] "" Vector__XXX
 SG_ VCRIGHT_a209_unitStatusEPBM m209 : 40|5@1+ (1,0) [0|31] "" Vector__XXX
 SG_ VCRIGHT_a210_unknownAllowed m210 : 16|1@1+ (1,0) [0|1] "" Vector__XXX
 SG_ VCRIGHT_a210_openAllowed m210 : 17|1@1+ (1,0) [0|1] "" Vector__XXX
 SG_ VCRIGHT_a210_dynamicAllowed m210 : 18|1@1+ (1,0) [0|1] "" Vector__XXX
 SG_ VCRIGHT_a210_parkAllowed m210 : 19|1@1+ (1,0) [0|1] "" Vector__XXX
 SG_ VCRIGHT_a210_startAllowed m210 : 20|1@1+ (1,0) [0|1] "" Vector__XXX
 SG_ VCRIGHT_a210_serviceAllowed m210 : 21|1@1+ (1,0) [0|1] "" Vector__XXX
 SG_ VCRIGHT_a210_winchAllowed m210 : 22|1@1+ (1,0) [0|1] "" Vector__XXX
 SG_ VCRIGHT_a210_winchReleaseAllowed m210 : 23|1@1+ (1,0) [0|1] "" Vector__XXX
 SG_ VCRIGHT_a210_parkingAllowed m210 : 24|1@1+ (1,0) [0|1] "" Vector__XXX
 SG_ VCRIGHT_a210_dynApplyAllowed m210 : 25|1@1+ (1,0) [0|1] "" Vector__XXX
 SG_ VCRIGHT_a210_releaseAllowed m210 : 26|1@1+ (1,0) [0|1] "" Vector__XXX
 SG_ VCRIGHT_a210_parkPendingAllowed m210 : 27|1@1+ (1,0) [0|1] "" Vector__XXX
 SG_ VCRIGHT_a210_wenchPendingAllowed m210 : 28|1@1+ (1,0) [0|1] "" Vector__XXX
 SG_ VCRIGHT_a210_unitStatusEPB m210 : 32|5@1+ (1,0) [0|31] "" Vector__XXX
 SG_ VCRIGHT_a210_unitStatusEPBM m210 : 40|5@1+ (1,0) [0|31] "" Vector__XXX
 SG_ VCRIGHT_a221_vbatProtVoltage m221 : 16|8@1+ (0.1,0) [0|25.5] "V" Vector__XXX
 SG_ VCRIGHT_a221_vbatProtCurrent m221 : 24|10@1+ (0.1,0) [0|102.3] "A" Vector__XXX
 SG_ VCRIGHT_a221_uvLoadshedVoltage m221 : 40|8@1+ (0.1,0) [0|25.5] "V" Vector__XXX
 SG_ VCRIGHT_a221_uvLoadshedFromFront m221 : 48|8@1+ (0.02,0) [0|5.1] "V" Vector__XXX
 SG_ VCRIGHT_a221_faultInjectActive m221 : 56|1@1+ (1,0) [0|1] "" Vector__XXX
 SG_ VCRIGHT_a221_uvResetActive m221 : 57|1@1+ (1,0) [0|1] "" Vector__XXX
 SG_ VCRIGHT_a221_uvLoadshedArmPrimar m221 : 58|1@1+ (1,0) [0|1] "" Vector__XXX
 SG_ VCRIGHT_a224_seatMotorCalibrated m224 : 16|1@1+ (1,0) [0|1] "" Vector__XXX
 SG_ VCRIGHT_a224_seatMotorCurrent m224 : 17|12@1- (0.01,0) [-20.48|20.47] "A" Vector__XXX
 SG_ VCRIGHT_a224_seatMotorState m224 : 29|3@1+ (1,0) [0|7] "" Vector__XXX
 SG_ VCRIGHT_a224_seatSwitchBack m224 : 32|2@1+ (1,0) [1|3] "" Vector__XXX
 SG_ VCRIGHT_a224_seatSwitchForward m224 : 34|2@1+ (1,0) [1|3] "" Vector__XXX
 SG_ VCRIGHT_a225_seatMotorCalibrated m225 : 16|1@1+ (1,0) [0|1] "" Vector__XXX
 SG_ VCRIGHT_a225_seatMotorCurrent m225 : 17|12@1- (0.01,0) [-20.48|20.47] "A" Vector__XXX
 SG_ VCRIGHT_a225_seatMotorState m225 : 29|3@1+ (1,0) [0|7] "" Vector__XXX
 SG_ VCRIGHT_a225_seatSwitchBack m225 : 32|2@1+ (1,0) [1|3] "" Vector__XXX
 SG_ VCRIGHT_a225_seatSwitchForward m225 : 34|2@1+ (1,0) [1|3] "" Vector__XXX
 SG_ VCRIGHT_a226_seatMotorCalibrated m226 : 16|1@1+ (1,0) [0|1] "" Vector__XXX
 SG_ VCRIGHT_a226_seatMotorCurrent m226 : 17|12@1- (0.01,0) [-20.48|20.47] "A" Vector__XXX
 SG_ VCRIGHT_a226_seatMotorState m226 : 29|3@1+ (1,0) [0|7] "" Vector__XXX
 SG_ VCRIGHT_a226_seatSwitchBack m226 : 32|2@1+ (1,0) [1|3] "" Vector__XXX
 SG_ VCRIGHT_a226_seatSwitchForward m226 : 34|2@1+ (1,0) [1|3] "" Vector__XXX
 SG_ VCRIGHT_a227_seatMotorCalibrated m227 : 16|1@1+ (1,0) [0|1] "" Vector__XXX
 SG_ VCRIGHT_a227_seatMotorCurrent m227 : 17|12@1- (0.01,0) [-20.48|20.47] "A" Vector__XXX
 SG_ VCRIGHT_a227_seatMotorState m227 : 29|3@1+ (1,0) [0|7] "" Vector__XXX
 SG_ VCRIGHT_a227_seatSwitchBack m227 : 32|2@1+ (1,0) [1|3] "" Vector__XXX
 SG_ VCRIGHT_a227_seatSwitchForward m227 : 34|2@1+ (1,0) [1|3] "" Vector__XXX
 SG_ VCRIGHT_a228_seatMotorCalibrated m228 : 16|1@1+ (1,0) [0|1] "" Vector__XXX
 SG_ VCRIGHT_a228_seatMotorCurrent m228 : 17|12@1- (0.01,0) [-20.48|20.47] "A" Vector__XXX
 SG_ VCRIGHT_a228_seatMotorPosReal m228 : 32|12@1- (1,0) [-2048|2047] "mm" Vector__XXX
 SG_ VCRIGHT_a228_seatMotorState m228 : 44|3@1+ (1,0) [0|7] "" Vector__XXX
 SG_ VCRIGHT_a228_seatSwitchBack m228 : 48|2@1+ (1,0) [1|3] "" Vector__XXX
 SG_ VCRIGHT_a228_seatSwitchForward m228 : 50|2@1+ (1,0) [1|3] "" Vector__XXX
 SG_ VCRIGHT_a229_seatMotorCalibrated m229 : 16|1@1+ (1,0) [0|1] "" Vector__XXX
 SG_ VCRIGHT_a229_seatMotorCurrent m229 : 17|12@1- (0.01,0) [-20.48|20.47] "A" Vector__XXX
 SG_ VCRIGHT_a229_seatMotorPosReal m229 : 32|12@1- (1,0) [-2048|2047] "mm" Vector__XXX
 SG_ VCRIGHT_a229_seatMotorState m229 : 44|3@1+ (1,0) [0|7] "" Vector__XXX
 SG_ VCRIGHT_a229_seatSwitchBack m229 : 48|2@1+ (1,0) [1|3] "" Vector__XXX
 SG_ VCRIGHT_a229_seatSwitchForward m229 : 50|2@1+ (1,0) [1|3] "" Vector__XXX
 SG_ VCRIGHT_a230_seatMotorCalibrated m230 : 16|1@1+ (1,0) [0|1] "" Vector__XXX
 SG_ VCRIGHT_a230_seatMotorCurrent m230 : 17|12@1- (0.01,0) [-20.48|20.47] "A" Vector__XXX
 SG_ VCRIGHT_a230_seatMotorPosReal m230 : 32|12@1- (1,0) [-2048|2047] "mm" Vector__XXX
 SG_ VCRIGHT_a230_seatMotorState m230 : 44|3@1+ (1,0) [0|7] "" Vector__XXX
 SG_ VCRIGHT_a230_seatSwitchBack m230 : 48|2@1+ (1,0) [1|3] "" Vector__XXX
 SG_ VCRIGHT_a230_seatSwitchForward m230 : 50|2@1+ (1,0) [1|3] "" Vector__XXX
 SG_ VCRIGHT_a231_seatMotorCalibrated m231 : 16|1@1+ (1,0) [0|1] "" Vector__XXX
 SG_ VCRIGHT_a231_seatMotorCurrent m231 : 17|12@1- (0.01,0) [-20.48|20.47] "A" Vector__XXX
 SG_ VCRIGHT_a231_seatMotorPosReal m231 : 32|12@1- (1,0) [-2048|2047] "mm" Vector__XXX
 SG_ VCRIGHT_a231_seatMotorState m231 : 44|3@1+ (1,0) [0|7] "" Vector__XXX
 SG_ VCRIGHT_a231_seatSwitchBack m231 : 48|2@1+ (1,0) [1|3] "" Vector__XXX
 SG_ VCRIGHT_a231_seatSwitchForward m231 : 50|2@1+ (1,0) [1|3] "" Vector__XXX
 SG_ VCRIGHT_a232_seatMotorCurrent m232 : 16|12@1- (0.01,0) [-20.48|20.47] "A" Vector__XXX
 SG_ VCRIGHT_a232_seatMotorPosReal m232 : 28|12@1- (1,0) [-2048|2047] "mm" Vector__XXX
 SG_ VCRIGHT_a232_seatMotorState m232 : 40|3@1+ (1,0) [0|7] "" Vector__XXX
 SG_ VCRIGHT_a232_seatSwitchBack m232 : 43|2@1+ (1,0) [1|3] "" Vector__XXX
 SG_ VCRIGHT_a232_seatSwitchForward m232 : 45|2@1+ (1,0) [1|3] "" Vector__XXX
 SG_ VCRIGHT_a233_seatMotorCurrent m233 : 16|12@1- (0.01,0) [-20.48|20.47] "A" Vector__XXX
 SG_ VCRIGHT_a233_seatMotorPosReal m233 : 28|12@1- (1,0) [-2048|2047] "mm" Vector__XXX
 SG_ VCRIGHT_a233_seatMotorState m233 : 40|3@1+ (1,0) [0|7] "" Vector__XXX
 SG_ VCRIGHT_a233_seatSwitchBack m233 : 43|2@1+ (1,0) [1|3] "" Vector__XXX
 SG_ VCRIGHT_a233_seatSwitchForward m233 : 45|2@1+ (1,0) [1|3] "" Vector__XXX
 SG_ VCRIGHT_a234_seatMotorCurrent m234 : 16|12@1- (0.01,0) [-20.48|20.47] "A" Vector__XXX
 SG_ VCRIGHT_a234_seatMotorPosReal m234 : 28|12@1- (1,0) [-2048|2047] "mm" Vector__XXX
 SG_ VCRIGHT_a234_seatMotorState m234 : 40|3@1+ (1,0) [0|7] "" Vector__XXX
 SG_ VCRIGHT_a234_seatSwitchBack m234 : 43|2@1+ (1,0) [1|3] "" Vector__XXX
 SG_ VCRIGHT_a234_seatSwitchForward m234 : 45|2@1+ (1,0) [1|3] "" Vector__XXX
 SG_ VCRIGHT_a235_seatMotorCurrent m235 : 16|12@1- (0.01,0) [-20.48|20.47] "A" Vector__XXX
 SG_ VCRIGHT_a235_seatMotorPosReal m235 : 28|12@1- (1,0) [-2048|2047] "mm" Vector__XXX
 SG_ VCRIGHT_a235_seatMotorState m235 : 40|3@1+ (1,0) [0|7] "" Vector__XXX
 SG_ VCRIGHT_a235_seatSwitchBack m235 : 43|2@1+ (1,0) [1|3] "" Vector__XXX
 SG_ VCRIGHT_a235_seatSwitchForward m235 : 45|2@1+ (1,0) [1|3] "" Vector__XXX
 SG_ VCRIGHT_a236_lumbarAPressureHpa m236 : 16|16@1+ (1,0) [0|65535] "" Vector__XXX
 SG_ VCRIGHT_a236_lumbarBPressureHpa m236 : 32|16@1+ (1,0) [0|65535] "" Vector__XXX
 SG_ VCRIGHT_a236_lumbarDiagStatus m236 : 48|1@1+ (1,0) [0|1] "" Vector__XXX
 SG_ VCRIGHT_a236_lumbarAState m236 : 49|3@1+ (1,0) [0|7] "" Vector__XXX
 SG_ VCRIGHT_a236_lumbarBState m236 : 52|3@1+ (1,0) [0|7] "" Vector__XXX
 SG_ VCRIGHT_a237_lumbarAPressureHpa m237 : 16|16@1+ (1,0) [0|65535] "" Vector__XXX
 SG_ VCRIGHT_a237_lumbarBPressureHpa m237 : 32|16@1+ (1,0) [0|65535] "" Vector__XXX
 SG_ VCRIGHT_a237_lumbarDiagStatus m237 : 48|1@1+ (1,0) [0|1] "" Vector__XXX
 SG_ VCRIGHT_a237_lumbarAState m237 : 49|3@1+ (1,0) [0|7] "" Vector__XXX
 SG_ VCRIGHT_a237_lumbarBState m237 : 52|3@1+ (1,0) [0|7] "" Vector__XXX
 SG_ VCRIGHT_a238_lumbarAPressureHpa m238 : 16|16@1+ (1,0) [0|65535] "" Vector__XXX
 SG_ VCRIGHT_a238_lumbarBPressureHpa m238 : 32|16@1+ (1,0) [0|65535] "" Vector__XXX
 SG_ VCRIGHT_a238_lumbarDiagStatus m238 : 48|1@1+ (1,0) [0|1] "" Vector__XXX
 SG_ VCRIGHT_a238_lumbarAState m238 : 49|3@1+ (1,0) [0|7] "" Vector__XXX
 SG_ VCRIGHT_a238_lumbarBState m238 : 52|3@1+ (1,0) [0|7] "" Vector__XXX
 SG_ VCRIGHT_a239_seatHeatCurrent m239 : 16|12@1+ (0.01,0) [0|40.95] "A" Vector__XXX
 SG_ VCRIGHT_a239_seatHeatTmp m239 : 28|12@1- (0.05,0) [-102.4|102.35] "degC" Vector__XXX
 SG_ VCRIGHT_a239_seatHeatTmpTarget m239 : 40|8@1- (0.5,0) [-64|63.5] "degC" Vector__XXX
 SG_ VCRIGHT_a240_seatHeatCurrent m240 : 16|12@1+ (0.01,0) [0|40.95] "A" Vector__XXX
 SG_ VCRIGHT_a240_seatHeatTmp m240 : 28|12@1- (0.05,0) [-102.4|102.35] "degC" Vector__XXX
 SG_ VCRIGHT_a241_seatHeatCurrent m241 : 16|12@1+ (0.01,0) [0|40.95] "A" Vector__XXX
 SG_ VCRIGHT_a241_seatHeatTmp m241 : 28|12@1- (0.05,0) [-102.4|102.35] "degC" Vector__XXX
 SG_ VCRIGHT_a241_cushion m241 : 40|1@1+ (1,0) [0|1] "" Vector__XXX
 SG_ VCRIGHT_a241_backrest m241 : 41|1@1+ (1,0) [0|1] "" Vector__XXX
 SG_ VCRIGHT_a242_seatHeatCurrent m242 : 16|12@1+ (0.01,0) [0|40.95] "A" Vector__XXX
 SG_ VCRIGHT_a242_seatHeatTmp m242 : 28|12@1- (0.05,0) [-102.4|102.35] "degC" Vector__XXX
 SG_ VCRIGHT_a242_seatHeatTmpTarget m242 : 40|8@1- (0.5,0) [-64|63.5] "degC" Vector__XXX
 SG_ VCRIGHT_a243_seatHeatCurrent m243 : 16|12@1+ (0.01,0) [0|40.95] "A" Vector__XXX
 SG_ VCRIGHT_a243_seatHeatTmp m243 : 28|12@1- (0.05,0) [-102.4|102.35] "degC" Vector__XXX
 SG_ VCRIGHT_a244_seatHeatCurrent m244 : 16|12@1+ (0.01,0) [0|40.95] "A" Vector__XXX
 SG_ VCRIGHT_a244_seatHeatTmp m244 : 28|12@1- (0.05,0) [-102.4|102.35] "degC" Vector__XXX
 SG_ VCRIGHT_a244_cushion m244 : 40|1@1+ (1,0) [0|1] "" Vector__XXX
 SG_ VCRIGHT_a244_backrest m244 : 41|1@1+ (1,0) [0|1] "" Vector__XXX
 SG_ VCRIGHT_a245_seatHeatCurrent m245 : 16|12@1+ (0.01,0) [0|40.95] "A" Vector__XXX
 SG_ VCRIGHT_a245_seatHeatTmp m245 : 28|12@1- (0.05,0) [-102.4|102.35] "degC" Vector__XXX
 SG_ VCRIGHT_a245_seatHeatTmpTarget m245 : 40|8@1- (0.5,0) [-64|63.5] "degC" Vector__XXX
 SG_ VCRIGHT_a246_seatHeatCurrent m246 : 16|12@1+ (0.01,0) [0|40.95] "A" Vector__XXX
 SG_ VCRIGHT_a246_seatHeatTmp m246 : 28|12@1- (0.05,0) [-102.4|102.35] "degC" Vector__XXX
 SG_ VCRIGHT_a247_seatHeatCurrent m247 : 16|12@1+ (0.01,0) [0|40.95] "A" Vector__XXX
 SG_ VCRIGHT_a247_seatHeatTmp m247 : 28|12@1- (0.05,0) [-102.4|102.35] "degC" Vector__XXX
 SG_ VCRIGHT_a247_cushion m247 : 40|1@1+ (1,0) [0|1] "" Vector__XXX
 SG_ VCRIGHT_a247_backrest m247 : 41|1@1+ (1,0) [0|1] "" Vector__XXX
 SG_ VCRIGHT_a248_seatHeatCurrent m248 : 16|12@1+ (0.01,0) [0|40.95] "A" Vector__XXX
 SG_ VCRIGHT_a248_seatHeatTmp m248 : 28|12@1- (0.05,0) [-102.4|102.35] "degC" Vector__XXX
 SG_ VCRIGHT_a248_seatHeatTmpTarget m248 : 40|8@1- (0.5,0) [-64|63.5] "degC" Vector__XXX
 SG_ VCRIGHT_a249_seatHeatCurrent m249 : 16|12@1+ (0.01,0) [0|40.95] "A" Vector__XXX
 SG_ VCRIGHT_a249_seatHeatTmp m249 : 28|12@1- (0.05,0) [-102.4|102.35] "degC" Vector__XXX
 SG_ VCRIGHT_a250_seatHeatCurrent m250 : 16|12@1+ (0.01,0) [0|40.95] "A" Vector__XXX
 SG_ VCRIGHT_a250_seatHeatTmp m250 : 28|12@1- (0.05,0) [-102.4|102.35] "degC" Vector__XXX
 SG_ VCRIGHT_a250_cushion m250 : 40|1@1+ (1,0) [0|1] "" Vector__XXX
 SG_ VCRIGHT_a250_backrest m250 : 41|1@1+ (1,0) [0|1] "" Vector__XXX
 SG_ VCRIGHT_a251_seatMotorCurrent m251 : 16|12@1- (0.01,0) [-20.48|20.47] "A" Vector__XXX
 SG_ VCRIGHT_a251_seatMotorPosReal m251 : 28|12@1- (1,0) [-2048|2047] "mm" Vector__XXX
 SG_ VCRIGHT_a251_seatMotorState m251 : 40|3@1+ (1,0) [0|7] "" Vector__XXX
 SG_ VCRIGHT_a251_seatSwitchBack m251 : 43|2@1+ (1,0) [1|3] "" Vector__XXX
 SG_ VCRIGHT_a251_seatSwitchForward m251 : 45|2@1+ (1,0) [1|3] "" Vector__XXX
 SG_ VCRIGHT_a252_seatMotorCurrent m252 : 16|12@1- (0.01,0) [-20.48|20.47] "A" Vector__XXX
 SG_ VCRIGHT_a252_seatMotorPosReal m252 : 28|12@1- (1,0) [-2048|2047] "mm" Vector__XXX
 SG_ VCRIGHT_a252_seatMotorState m252 : 40|3@1+ (1,0) [0|7] "" Vector__XXX
 SG_ VCRIGHT_a252_seatSwitchBack m252 : 43|2@1+ (1,0) [1|3] "" Vector__XXX
 SG_ VCRIGHT_a252_seatSwitchForward m252 : 45|2@1+ (1,0) [1|3] "" Vector__XXX
 SG_ VCRIGHT_a253_seatMotorCurrent m253 : 16|12@1- (0.01,0) [-20.48|20.47] "A" Vector__XXX
 SG_ VCRIGHT_a253_seatMotorPosReal m253 : 28|12@1- (1,0) [-2048|2047] "mm" Vector__XXX
 SG_ VCRIGHT_a253_seatMotorState m253 : 40|3@1+ (1,0) [0|7] "" Vector__XXX
 SG_ VCRIGHT_a253_seatSwitchBack m253 : 43|2@1+ (1,0) [1|3] "" Vector__XXX
 SG_ VCRIGHT_a253_seatSwitchForward m253 : 45|2@1+ (1,0) [1|3] "" Vector__XXX
 SG_ VCRIGHT_a254_seatMotorCurrent m254 : 16|12@1- (0.01,0) [-20.48|20.47] "A" Vector__XXX
 SG_ VCRIGHT_a254_seatMotorPosReal m254 : 28|12@1- (1,0) [-2048|2047] "mm" Vector__XXX
 SG_ VCRIGHT_a254_seatMotorState m254 : 40|3@1+ (1,0) [0|7] "" Vector__XXX
 SG_ VCRIGHT_a254_seatSwitchBack m254 : 43|2@1+ (1,0) [1|3] "" Vector__XXX
 SG_ VCRIGHT_a254_seatSwitchForward m254 : 45|2@1+ (1,0) [1|3] "" Vector__XXX
 SG_ VCRIGHT_a255_leftIGBTTemp m255 : 16|8@1- (1,80) [-48|207] "degC" Vector__XXX
 SG_ VCRIGHT_a255_rightIGBTTemp m255 : 24|8@1- (1,80) [-48|207] "degC" Vector__XXX
 SG_ VCRIGHT_a255_OCPTemp m255 : 32|8@1- (1,80) [-48|207] "degC" Vector__XXX
 SG_ VCRIGHT_a255_PCBTemp m255 : 40|8@1- (1,80) [-48|207] "degC" Vector__XXX
 SG_ VCRIGHT_a256_leftCurrent m256 : 16|8@1+ (0.2,0) [0|51] "A" Vector__XXX
 SG_ VCRIGHT_a256_rightCurrent m256 : 24|8@1+ (0.2,0) [0|51] "A" Vector__XXX
 SG_ VCRIGHT_a257_MIAStatus m257 : 16|1@1+ (1,0) [0|1] "" Vector__XXX
 SG_ VCRIGHT_a258_bootIdFreq m258 : 16|8@1+ (0.02,0) [0|5.1] "Hz" Vector__XXX
 SG_ VCRIGHT_a262_LVLow m262 : 16|1@1+ (1,0) [0|1] "" Vector__XXX
 SG_ VCRIGHT_a262_LVHigh m262 : 17|1@1+ (1,0) [0|1] "" Vector__XXX
 SG_ VCRIGHT_a262_HVLow m262 : 18|1@1+ (1,0) [0|1] "" Vector__XXX
 SG_ VCRIGHT_a262_HVHigh m262 : 19|1@1+ (1,0) [0|1] "" Vector__XXX
 SG_ VCRIGHT_a262_LeftOverCurrent m262 : 20|1@1+ (1,0) [0|1] "" Vector__XXX
 SG_ VCRIGHT_a262_RightOverCurrent m262 : 21|1@1+ (1,0) [0|1] "" Vector__XXX
 SG_ VCRIGHT_a262_LeftShutOutlet m262 : 22|1@1+ (1,0) [0|1] "" Vector__XXX
 SG_ VCRIGHT_a262_RightShutOutlet m262 : 23|1@1+ (1,0) [0|1] "" Vector__XXX
 SG_ VCRIGHT_a262_ThermalShutPCB m262 : 24|1@1+ (1,0) [0|1] "" Vector__XXX
 SG_ VCRIGHT_a262_LeftThermalShutIGBT m262 : 25|1@1+ (1,0) [0|1] "" Vector__XXX
 SG_ VCRIGHT_a262_RightThermalShutIGB m262 : 26|1@1+ (1,0) [0|1] "" Vector__XXX
 SG_ VCRIGHT_a262_CANTimeout m262 : 27|1@1+ (1,0) [0|1] "" Vector__XXX
 SG_ VCRIGHT_a262_LowVoltageSensor m262 : 28|1@1+ (1,0) [0|1] "" Vector__XXX
 SG_ VCRIGHT_a262_HighVoltageSensor m262 : 29|1@1+ (1,0) [0|1] "" Vector__XXX
 SG_ VCRIGHT_a262_LeftCurrentHVSensor m262 : 30|1@1+ (1,0) [0|1] "" Vector__XXX
 SG_ VCRIGHT_a262_RightCurrentHVSenso m262 : 31|1@1+ (1,0) [0|1] "" Vector__XXX
 SG_ VCRIGHT_a262_LeftTempIGBT m262 : 32|1@1+ (1,0) [0|1] "" Vector__XXX
 SG_ VCRIGHT_a262_TempOCP m262 : 33|1@1+ (1,0) [0|1] "" Vector__XXX
 SG_ VCRIGHT_a262_RightTempIGBT m262 : 34|1@1+ (1,0) [0|1] "" Vector__XXX
 SG_ VCRIGHT_a262_TempPCB m262 : 35|1@1+ (1,0) [0|1] "" Vector__XXX
 SG_ VCRIGHT_a262_LeftIGBTShort m262 : 36|1@1+ (1,0) [0|1] "" Vector__XXX
 SG_ VCRIGHT_a262_RightIGBTShort m262 : 37|1@1+ (1,0) [0|1] "" Vector__XXX
 SG_ VCRIGHT_a262_IGBTDriverTemporary m262 : 38|1@1+ (1,0) [0|1] "" Vector__XXX
 SG_ VCRIGHT_a262_IGBTDriverPermanent m262 : 39|1@1+ (1,0) [0|1] "" Vector__XXX
 SG_ VCRIGHT_a262_LeftIGBTOpen m262 : 40|1@1+ (1,0) [0|1] "" Vector__XXX
 SG_ VCRIGHT_a262_RightIGBTOpen m262 : 41|1@1+ (1,0) [0|1] "" Vector__XXX
 SG_ VCRIGHT_a263_seatMotorCurrent m263 : 16|12@1- (0.01,0) [-20.48|20.47] "A" Vector__XXX
 SG_ VCRIGHT_a263_seatMotorDCurrent m263 : 28|12@1- (0.01,0) [-20.48|20.47] "A" Vector__XXX
 SG_ VCRIGHT_a263_seatMotorPosReal m263 : 40|12@1- (1,0) [-2048|2047] "mm" Vector__XXX
 SG_ VCRIGHT_a263_seatMotorState m263 : 52|3@1+ (1,0) [0|7] "" Vector__XXX
 SG_ VCRIGHT_a264_seatMotorCurrent m264 : 16|12@1- (0.01,0) [-20.48|20.47] "A" Vector__XXX
 SG_ VCRIGHT_a264_seatMotorDCurrent m264 : 28|12@1- (0.01,0) [-20.48|20.47] "A" Vector__XXX
 SG_ VCRIGHT_a264_seatMotorPosReal m264 : 40|12@1- (1,0) [-2048|2047] "mm" Vector__XXX
 SG_ VCRIGHT_a264_seatMotorState m264 : 52|3@1+ (1,0) [0|7] "" Vector__XXX
 SG_ VCRIGHT_a265_seatMotorCurrent m265 : 16|12@1- (0.01,0) [-20.48|20.47] "A" Vector__XXX
 SG_ VCRIGHT_a265_seatMotorDCurrent m265 : 28|12@1- (0.01,0) [-20.48|20.47] "A" Vector__XXX
 SG_ VCRIGHT_a265_seatMotorPosReal m265 : 40|12@1- (1,0) [-2048|2047] "mm" Vector__XXX
 SG_ VCRIGHT_a265_seatMotorState m265 : 52|3@1+ (1,0) [0|7] "" Vector__XXX
 SG_ VCRIGHT_a266_seatMotorCurrent m266 : 16|12@1- (0.01,0) [-20.48|20.47] "A" Vector__XXX
 SG_ VCRIGHT_a266_seatMotorDCurrent m266 : 28|12@1- (0.01,0) [-20.48|20.47] "A" Vector__XXX
 SG_ VCRIGHT_a266_seatMotorPosReal m266 : 40|12@1- (1,0) [-2048|2047] "mm" Vector__XXX
 SG_ VCRIGHT_a266_seatMotorState m266 : 52|3@1+ (1,0) [0|7] "" Vector__XXX
 SG_ VCRIGHT_a267_seatMotorCurrent m267 : 16|12@1- (0.01,0) [-20.48|20.47] "A" Vector__XXX
 SG_ VCRIGHT_a267_seatMotorDCurrent m267 : 28|12@1- (0.01,0) [-20.48|20.47] "A" Vector__XXX
 SG_ VCRIGHT_a267_seatMotorPosReal m267 : 40|12@1- (1,0) [-2048|2047] "mm" Vector__XXX
 SG_ VCRIGHT_a267_seatMotorState m267 : 52|3@1+ (1,0) [0|7] "" Vector__XXX
 SG_ VCRIGHT_a268_seatMotorCurrent m268 : 16|12@1- (0.01,0) [-20.48|20.47] "A" Vector__XXX
 SG_ VCRIGHT_a268_seatMotorDCurrent m268 : 28|12@1- (0.01,0) [-20.48|20.47] "A" Vector__XXX
 SG_ VCRIGHT_a268_seatMotorPosReal m268 : 40|12@1- (1,0) [-2048|2047] "mm" Vector__XXX
 SG_ VCRIGHT_a268_seatMotorState m268 : 52|3@1+ (1,0) [0|7] "" Vector__XXX
 SG_ VCRIGHT_a269_seatMotorCurrent m269 : 16|12@1- (0.01,0) [-20.48|20.47] "A" Vector__XXX
 SG_ VCRIGHT_a269_seatMotorDCurrent m269 : 28|12@1- (0.01,0) [-20.48|20.47] "A" Vector__XXX
 SG_ VCRIGHT_a269_seatMotorPosReal m269 : 40|12@1- (1,0) [-2048|2047] "mm" Vector__XXX
 SG_ VCRIGHT_a269_seatMotorState m269 : 52|3@1+ (1,0) [0|7] "" Vector__XXX
 SG_ VCRIGHT_a270_seatMotorCurrent m270 : 16|12@1- (0.01,0) [-20.48|20.47] "A" Vector__XXX
 SG_ VCRIGHT_a270_seatMotorDCurrent m270 : 28|12@1- (0.01,0) [-20.48|20.47] "A" Vector__XXX
 SG_ VCRIGHT_a270_seatMotorPosReal m270 : 40|12@1- (1,0) [-2048|2047] "mm" Vector__XXX
 SG_ VCRIGHT_a270_seatMotorState m270 : 52|3@1+ (1,0) [0|7] "" Vector__XXX
 SG_ VCRIGHT_a271_humiditySensorSNA m271 : 16|1@1+ (1,0) [0|1] "" Vector__XXX
 SG_ VCRIGHT_a271_temperatureSensorSN m271 : 17|1@1+ (1,0) [0|1] "" Vector__XXX
 SG_ VCRIGHT_a271_solarVisSensorSNA m271 : 18|1@1+ (1,0) [0|1] "" Vector__XXX
 SG_ VCRIGHT_a271_solarInfSensorSNA m271 : 19|1@1+ (1,0) [0|1] "" Vector__XXX
 SG_ VCRIGHT_a273_handlePWM m273 : 16|7@1+ (1,0) [0|127] "%" Vector__XXX
 SG_ VCRIGHT_a273_temperature m273 : 24|8@1+ (0.5,-40) [-40|87.5] "degC" Vector__XXX
 SG_ VCRIGHT_a274_handlePWM m274 : 16|7@1+ (1,0) [0|127] "%" Vector__XXX
 SG_ VCRIGHT_a274_temperature m274 : 24|8@1+ (0.5,-40) [-40|87.5] "degC" Vector__XXX
 SG_ VCRIGHT_a275_outputFaulted m275 : 16|1@1+ (1,0) [0|1] "" Vector__XXX
 SG_ VCRIGHT_a275_currentSenseFaulted m275 : 17|1@1+ (1,0) [0|1] "" Vector__XXX
 SG_ VCRIGHT_a275_tempSenseFaulted m275 : 18|1@1+ (1,0) [0|1] "" Vector__XXX
 SG_ VCRIGHT_a275_underCurrent m275 : 19|1@1+ (1,0) [0|1] "" Vector__XXX
 SG_ VCRIGHT_a275_overCurrent m275 : 20|1@1+ (1,0) [0|1] "" Vector__XXX
 SG_ VCRIGHT_a275_overTemperature m275 : 21|1@1+ (1,0) [0|1] "" Vector__XXX
 SG_ VCRIGHT_a278_HVLow m278 : 16|1@1+ (1,0) [0|1] "" Vector__XXX
 SG_ VCRIGHT_a278_PTCMIA m278 : 17|1@1+ (1,0) [0|1] "" Vector__XXX
 SG_ VCRIGHT_a282_voltage m282 : 16|7@1+ (0.15,0) [0|19.05] "V" Vector__XXX
 SG_ VCRIGHT_a282_temperature m282 : 24|8@1+ (0.5,-40) [-40|87.5] "degC" Vector__XXX
 SG_ VCRIGHT_a283_voltage m283 : 16|7@1+ (0.15,0) [0|19.05] "V" Vector__XXX
 SG_ VCRIGHT_a283_temperature m283 : 24|8@1+ (0.5,-40) [-40|87.5] "degC" Vector__XXX
 SG_ VCRIGHT_a284_gloveboxMinCurrent m284 : 16|8@1+ (0.1,0) [0|25.5] "A" Vector__XXX
 SG_ VCRIGHT_a284_gloveboxMaxCurrent m284 : 24|8@1+ (0.1,0) [0|25.5] "A" Vector__XXX
 SG_ VCRIGHT_a284_cabinTempInterior m284 : 32|8@1+ (0.5,-40) [-40|87] "degC" Vector__XXX
 SG_ VCRIGHT_a285_gloveboxMinCurrent m285 : 16|8@1+ (0.1,0) [0|25.5] "A" Vector__XXX
 SG_ VCRIGHT_a285_gloveboxMaxCurrent m285 : 24|8@1+ (0.1,0) [0|25.5] "A" Vector__XXX
 SG_ VCRIGHT_a285_cabinTempInterior m285 : 32|8@1+ (0.5,-40) [-40|87] "degC" Vector__XXX
 SG_ VCRIGHT_a290_isNetworkSwitch m290 : 16|1@1+ (1,0) [0|1] "" Vector__XXX
 SG_ VCRIGHT_a290_occupancySensorV m290 : 17|12@1- (0.01,0) [-20.48|20.47] "V" Vector__XXX
 SG_ VCRIGHT_a290_railVoltage m290 : 32|12@1- (0.01,0) [-20.48|20.47] "V" Vector__XXX
 SG_ VCRIGHT_a291_buckleSensorVoltage m291 : 16|12@1+ (0.01,0) [0|40.95] "V" Vector__XXX
 SG_ VCRIGHT_a291_railVoltage m291 : 28|12@1+ (0.01,0) [0|40.95] "V" Vector__XXX
 SG_ VCRIGHT_a292_buckleSensorVoltage m292 : 16|12@1- (0.01,0) [-20.48|20.47] "V" Vector__XXX
 SG_ VCRIGHT_a292_railV m292 : 28|12@1- (0.01,0) [-20.48|20.47] "V" Vector__XXX
 SG_ VCRIGHT_a293_buckleSensorVoltage m293 : 16|12@1- (0.01,0) [-20.48|20.47] "V" Vector__XXX
 SG_ VCRIGHT_a293_railV m293 : 28|12@1- (0.01,0) [-20.48|20.47] "V" Vector__XXX
 SG_ VCRIGHT_a294_isNetworkSwitch m294 : 16|1@1+ (1,0) [0|1] "" Vector__XXX
 SG_ VCRIGHT_a294_occupancySensorV m294 : 17|12@1- (0.01,0) [-20.48|20.47] "V" Vector__XXX
 SG_ VCRIGHT_a294_railV m294 : 32|12@1- (0.01,0) [-20.48|20.47] "V" Vector__XXX
 SG_ VCRIGHT_a295_isNetworkSwitch m295 : 16|1@1+ (1,0) [0|1] "" Vector__XXX
 SG_ VCRIGHT_a295_occupancySensorV m295 : 17|12@1- (0.01,0) [-20.48|20.47] "V" Vector__XXX
 SG_ VCRIGHT_a295_railV m295 : 32|12@1- (0.01,0) [-20.48|20.47] "V" Vector__XXX
 SG_ VCRIGHT_a296_isNetworkSwitch m296 : 16|1@1+ (1,0) [0|1] "" Vector__XXX
 SG_ VCRIGHT_a296_occupancySensorV m296 : 17|12@1- (0.01,0) [-20.48|20.47] "V" Vector__XXX
 SG_ VCRIGHT_a296_railV m296 : 32|12@1- (0.01,0) [-20.48|20.47] "V" Vector__XXX
 SG_ VCRIGHT_a297_cabinTmp m297 : 16|12@1- (0.1,0) [-204.8|204.7] "degC" Vector__XXX
 SG_ VCRIGHT_a298_buckleSensorVoltage m298 : 16|12@1- (0.01,0) [-20.48|20.47] "V" Vector__XXX
 SG_ VCRIGHT_a298_railV m298 : 28|12@1- (0.01,0) [-20.48|20.47] "V" Vector__XXX
 SG_ VCRIGHT_a299_buckleSensorVoltage m299 : 16|12@1- (0.01,0) [-20.48|20.47] "V" Vector__XXX
 SG_ VCRIGHT_a299_railV m299 : 28|12@1- (0.01,0) [-20.48|20.47] "V" Vector__XXX
 SG_ VCRIGHT_a302_calibrationPositive m302 : 16|1@1+ (1,0) [0|1] "" Vector__XXX
 SG_ VCRIGHT_a302_calibrationNegative m302 : 17|1@1+ (1,0) [0|1] "" Vector__XXX
 SG_ VCRIGHT_a302_uncalibrated m302 : 18|1@1+ (1,0) [0|1] "" Vector__XXX
 SG_ VCRIGHT_a302_driverFault m302 : 19|1@1+ (1,0) [0|1] "" Vector__XXX
 SG_ VCRIGHT_a302_connected m302 : 20|1@1+ (1,0) [0|1] "" Vector__XXX
 SG_ VCRIGHT_a302_targetMissed m302 : 21|1@1+ (1,0) [0|1] "" Vector__XXX
 SG_ VCRIGHT_a302_positionTarget m302 : 24|8@1+ (0.5,0) [0|127.5] "%" Vector__XXX
 SG_ VCRIGHT_a302_positionActual m302 : 32|8@1+ (0.5,0) [0|127.5] "%" Vector__XXX
 SG_ VCRIGHT_a303_eFuseTripCount m303 : 16|8@1+ (1,0) [0|255] "" Vector__XXX
 SG_ VCRIGHT_a306_disconnectedTime m306 : 16|10@1+ (1,0) [0|1023] "ms" Vector__XXX
 SG_ VCRIGHT_a307_disconnectedTime m307 : 16|10@1+ (1,0) [0|1023] "ms" Vector__XXX
 SG_ VCRIGHT_a308_calibrationPositive m308 : 16|1@1+ (1,0) [0|1] "" Vector__XXX
 SG_ VCRIGHT_a308_calibrationNegative m308 : 17|1@1+ (1,0) [0|1] "" Vector__XXX
 SG_ VCRIGHT_a308_uncalibrated m308 : 18|1@1+ (1,0) [0|1] "" Vector__XXX
 SG_ VCRIGHT_a308_driverFault m308 : 19|1@1+ (1,0) [0|1] "" Vector__XXX
 SG_ VCRIGHT_a308_connected m308 : 20|1@1+ (1,0) [0|1] "" Vector__XXX
 SG_ VCRIGHT_a308_targetMissed m308 : 21|1@1+ (1,0) [0|1] "" Vector__XXX
 SG_ VCRIGHT_a308_positionTarget m308 : 24|8@1+ (0.5,0) [0|127.5] "%" Vector__XXX
 SG_ VCRIGHT_a308_positionActual m308 : 32|8@1+ (0.5,0) [0|127.5] "%" Vector__XXX
 SG_ VCRIGHT_a310_mirrorFoldTime m310 : 16|9@1+ (10,0) [0|5110] "ms" Vector__XXX
 SG_ VCRIGHT_a310_foldingDirection m310 : 25|1@1+ (1,0) [0|1] "" Vector__XXX
 SG_ VCRIGHT_a310_mirrorMaxFoldCurren m310 : 32|7@1- (0.05,0) [-3.2|3.15] "A" Vector__XXX
 SG_ VCRIGHT_a310_ambientTemperature m310 : 40|8@1+ (0.5,-40) [-39.5|87.5] "degC" Vector__XXX
 SG_ VCRIGHT_a311_outputFaulted m311 : 16|1@1+ (1,0) [0|1] "" Vector__XXX
 SG_ VCRIGHT_a311_currentSenseFaulted m311 : 17|1@1+ (1,0) [0|1] "" Vector__XXX
 SG_ VCRIGHT_a311_tempSenseFaulted m311 : 18|1@1+ (1,0) [0|1] "" Vector__XXX
 SG_ VCRIGHT_a311_underCurrent m311 : 19|1@1+ (1,0) [0|1] "" Vector__XXX
 SG_ VCRIGHT_a311_overCurrent m311 : 20|1@1+ (1,0) [0|1] "" Vector__XXX
 SG_ VCRIGHT_a311_overTemperature m311 : 21|1@1+ (1,0) [0|1] "" Vector__XXX
 SG_ VCRIGHT_a312_outputFaulted m312 : 16|1@1+ (1,0) [0|1] "" Vector__XXX
 SG_ VCRIGHT_a312_currentSenseFaulted m312 : 17|1@1+ (1,0) [0|1] "" Vector__XXX
 SG_ VCRIGHT_a312_tempSenseFaulted m312 : 18|1@1+ (1,0) [0|1] "" Vector__XXX
 SG_ VCRIGHT_a312_underCurrent m312 : 19|1@1+ (1,0) [0|1] "" Vector__XXX
 SG_ VCRIGHT_a312_overCurrent m312 : 20|1@1+ (1,0) [0|1] "" Vector__XXX
 SG_ VCRIGHT_a312_overTemperature m312 : 21|1@1+ (1,0) [0|1] "" Vector__XXX
 SG_ VCRIGHT_a313_outputFaulted m313 : 16|1@1+ (1,0) [0|1] "" Vector__XXX
 SG_ VCRIGHT_a313_currentSenseFaulted m313 : 17|1@1+ (1,0) [0|1] "" Vector__XXX
 SG_ VCRIGHT_a313_tempSenseFaulted m313 : 18|1@1+ (1,0) [0|1] "" Vector__XXX
 SG_ VCRIGHT_a313_underCurrent m313 : 19|1@1+ (1,0) [0|1] "" Vector__XXX
 SG_ VCRIGHT_a313_overCurrent m313 : 20|1@1+ (1,0) [0|1] "" Vector__XXX
 SG_ VCRIGHT_a313_overTemperature m313 : 21|1@1+ (1,0) [0|1] "" Vector__XXX
 SG_ VCRIGHT_a314_outputFaulted m314 : 16|1@1+ (1,0) [0|1] "" Vector__XXX
 SG_ VCRIGHT_a314_currentSenseFaulted m314 : 17|1@1+ (1,0) [0|1] "" Vector__XXX
 SG_ VCRIGHT_a314_tempSenseFaulted m314 : 18|1@1+ (1,0) [0|1] "" Vector__XXX
 SG_ VCRIGHT_a314_underCurrent m314 : 19|1@1+ (1,0) [0|1] "" Vector__XXX
 SG_ VCRIGHT_a314_overCurrent m314 : 20|1@1+ (1,0) [0|1] "" Vector__XXX
 SG_ VCRIGHT_a314_overTemperature m314 : 21|1@1+ (1,0) [0|1] "" Vector__XXX
 SG_ VCRIGHT_a315_outputFaulted m315 : 16|1@1+ (1,0) [0|1] "" Vector__XXX
 SG_ VCRIGHT_a315_currentSenseFaulted m315 : 17|1@1+ (1,0) [0|1] "" Vector__XXX
 SG_ VCRIGHT_a315_tempSenseFaulted m315 : 18|1@1+ (1,0) [0|1] "" Vector__XXX
 SG_ VCRIGHT_a315_underCurrent m315 : 19|1@1+ (1,0) [0|1] "" Vector__XXX
 SG_ VCRIGHT_a315_overCurrent m315 : 20|1@1+ (1,0) [0|1] "" Vector__XXX
 SG_ VCRIGHT_a315_overTemperature m315 : 21|1@1+ (1,0) [0|1] "" Vector__XXX
 SG_ VCRIGHT_a316_foldState m316 : 16|3@1+ (1,0) [0|7] "" Vector__XXX
 SG_ VCRIGHT_a316_actuationDurationMs m316 : 19|10@1+ (10,0) [0|10230] "ms" Vector__XXX
 SG_ VCRIGHT_a316_maxCurrentAmps m316 : 32|12@1+ (0.01,0) [0|40.95] "A" Vector__XXX
 SG_ VCRIGHT_a316_averageCurrentAmps m316 : 44|12@1+ (0.01,0) [0|40.95] "A" Vector__XXX
 SG_ VCRIGHT_a316_ambientTemperatureD m316 : 56|8@1+ (0.5,-40) [-39.5|87.5] "degC" Vector__XXX
 SG_ VCRIGHT_a318_outputFaulted m318 : 16|1@1+ (1,0) [0|1] "" Vector__XXX
 SG_ VCRIGHT_a318_currentSenseFaulted m318 : 17|1@1+ (1,0) [0|1] "" Vector__XXX
 SG_ VCRIGHT_a318_tempSenseFaulted m318 : 18|1@1+ (1,0) [0|1] "" Vector__XXX
 SG_ VCRIGHT_a318_underCurrent m318 : 19|1@1+ (1,0) [0|1] "" Vector__XXX
 SG_ VCRIGHT_a318_overCurrent m318 : 20|1@1+ (1,0) [0|1] "" Vector__XXX
 SG_ VCRIGHT_a318_overTemperature m318 : 21|1@1+ (1,0) [0|1] "" Vector__XXX
 SG_ VCRIGHT_a319_outputFaulted m319 : 16|1@1+ (1,0) [0|1] "" Vector__XXX
 SG_ VCRIGHT_a319_currentSenseFaulted m319 : 17|1@1+ (1,0) [0|1] "" Vector__XXX
 SG_ VCRIGHT_a319_tempSenseFaulted m319 : 18|1@1+ (1,0) [0|1] "" Vector__XXX
 SG_ VCRIGHT_a319_underCurrent m319 : 19|1@1+ (1,0) [0|1] "" Vector__XXX
 SG_ VCRIGHT_a319_overCurrent m319 : 20|1@1+ (1,0) [0|1] "" Vector__XXX
 SG_ VCRIGHT_a319_overTemperature m319 : 21|1@1+ (1,0) [0|1] "" Vector__XXX
 SG_ VCRIGHT_a324_mirrorHeatCurrent m324 : 16|10@1+ (0.01,0) [0|10.23] "A" Vector__XXX
 SG_ VCRIGHT_a325_calibrationPositive m325 : 16|1@1+ (1,0) [0|1] "" Vector__XXX
 SG_ VCRIGHT_a325_calibrationNegative m325 : 17|1@1+ (1,0) [0|1] "" Vector__XXX
 SG_ VCRIGHT_a325_uncalibrated m325 : 18|1@1+ (1,0) [0|1] "" Vector__XXX
 SG_ VCRIGHT_a325_driverFault m325 : 19|1@1+ (1,0) [0|1] "" Vector__XXX
 SG_ VCRIGHT_a325_connected m325 : 20|1@1+ (1,0) [0|1] "" Vector__XXX
 SG_ VCRIGHT_a325_targetMissed m325 : 21|1@1+ (1,0) [0|1] "" Vector__XXX
 SG_ VCRIGHT_a325_positionTarget m325 : 24|8@1+ (0.5,0) [0|127.5] "%" Vector__XXX
 SG_ VCRIGHT_a325_positionActual m325 : 32|8@1+ (0.5,0) [0|127.5] "%" Vector__XXX
 SG_ VCRIGHT_a326_calibrationPositive m326 : 16|1@1+ (1,0) [0|1] "" Vector__XXX
 SG_ VCRIGHT_a326_calibrationNegative m326 : 17|1@1+ (1,0) [0|1] "" Vector__XXX
 SG_ VCRIGHT_a326_uncalibrated m326 : 18|1@1+ (1,0) [0|1] "" Vector__XXX
 SG_ VCRIGHT_a326_driverFault m326 : 19|1@1+ (1,0) [0|1] "" Vector__XXX
 SG_ VCRIGHT_a326_connected m326 : 20|1@1+ (1,0) [0|1] "" Vector__XXX
 SG_ VCRIGHT_a326_targetMissed m326 : 21|1@1+ (1,0) [0|1] "" Vector__XXX
 SG_ VCRIGHT_a326_positionTarget m326 : 24|8@1+ (0.5,0) [0|127.5] "%" Vector__XXX
 SG_ VCRIGHT_a326_positionActual m326 : 32|8@1+ (0.5,0) [0|127.5] "%" Vector__XXX
 SG_ VCRIGHT_a330_voltage m330 : 16|7@1+ (0.15,0) [0|19.05] "V" Vector__XXX
 SG_ VCRIGHT_a330_maxCurrent m330 : 24|7@1+ (0.25,0) [0|31.75] "A" Vector__XXX
 SG_ VCRIGHT_a330_temperature m330 : 32|8@1+ (0.5,-40) [-40|87.5] "degC" Vector__XXX
 SG_ VCRIGHT_a331_voltage m331 : 16|7@1+ (0.15,0) [0|19.05] "V" Vector__XXX
 SG_ VCRIGHT_a331_maxCurrent m331 : 24|7@1+ (0.25,0) [0|31.75] "A" Vector__XXX
 SG_ VCRIGHT_a331_temperature m331 : 32|8@1+ (0.5,-40) [-40|87.5] "degC" Vector__XXX
 SG_ VCRIGHT_a343_rearDefrostCurrent m343 : 16|9@1+ (0.1,0) [0|51.1] "A" Vector__XXX
 SG_ VCRIGHT_a343_batteryVoltage m343 : 25|7@1+ (0.15,0) [0|19.05] "V" Vector__XXX
 SG_ VCRIGHT_a343_ambientTemperature m343 : 32|8@1+ (0.5,-40) [-40|87.5] "degC" Vector__XXX
 SG_ VCRIGHT_a344_rearDefrostCurrent m344 : 16|9@1+ (0.1,0) [0|51.1] "A" Vector__XXX
 SG_ VCRIGHT_a344_batteryVoltage m344 : 25|7@1+ (0.15,0) [0|19.05] "V" Vector__XXX
 SG_ VCRIGHT_a344_ambientTemperature m344 : 32|8@1+ (0.5,-40) [-40|87.5] "degC" Vector__XXX
 SG_ VCRIGHT_a345_PTCTHSGBPwrCurrent m345 : 16|10@1+ (0.1,0) [0|102.3] "A" Vector__XXX
 SG_ VCRIGHT_a368_snsShortCircuit m368 : 16|1@1+ (1,0) [0|1] "" Vector__XXX
 SG_ VCRIGHT_a368_snsDisconnect m368 : 17|1@1+ (1,0) [0|1] "" Vector__XXX
 SG_ VCRIGHT_a368_snsRateChangeUp m368 : 18|1@1+ (1,0) [0|1] "" Vector__XXX
 SG_ VCRIGHT_a368_snsRateChangeDown m368 : 19|1@1+ (1,0) [0|1] "" Vector__XXX
 SG_ VCRIGHT_a369_snsShortCircuit m369 : 16|1@1+ (1,0) [0|1] "" Vector__XXX
 SG_ VCRIGHT_a369_snsDisconnect m369 : 17|1@1+ (1,0) [0|1] "" Vector__XXX
 SG_ VCRIGHT_a369_snsRateChangeUp m369 : 18|1@1+ (1,0) [0|1] "" Vector__XXX
 SG_ VCRIGHT_a369_snsRateChangeDown m369 : 19|1@1+ (1,0) [0|1] "" Vector__XXX
 SG_ VCRIGHT_a373_windowChannel m373 : 16|2@1+ (1,0) [0|3] "" Vector__XXX
 SG_ VCRIGHT_a375_windowFront m375 : 16|1@1+ (1,0) [0|1] "" Vector__XXX
 SG_ VCRIGHT_a376_2RowSeatTrackActuat m376 : 16|12@1- (0.01,0) [-20.48|20.47] "A" Vector__XXX
 SG_ VCRIGHT_a376_2RowSeatTrackA_0001 m376 : 28|12@1- (0.1,0) [-204.8|204.7] "%" Vector__XXX
 SG_ VCRIGHT_a376_2RowSeatEasyEntrySt m376 : 40|3@1+ (1,0) [0|7] "" Vector__XXX
 SG_ VCRIGHT_a376_2RowSeatTrackPositi m376 : 43|2@1+ (1,0) [1|3] "" Vector__XXX
 SG_ VCRIGHT_a377_snsShortCircuit m377 : 16|1@1+ (1,0) [0|1] "" Vector__XXX
 SG_ VCRIGHT_a377_snsDisconnect m377 : 17|1@1+ (1,0) [0|1] "" Vector__XXX
 SG_ VCRIGHT_a377_snsRateChangeUp m377 : 18|1@1+ (1,0) [0|1] "" Vector__XXX
 SG_ VCRIGHT_a377_snsRateChangeDown m377 : 19|1@1+ (1,0) [0|1] "" Vector__XXX
 SG_ VCRIGHT_a378_snsShortCircuit m378 : 16|1@1+ (1,0) [0|1] "" Vector__XXX
 SG_ VCRIGHT_a378_snsDisconnect m378 : 17|1@1+ (1,0) [0|1] "" Vector__XXX
 SG_ VCRIGHT_a378_snsRateChangeUp m378 : 18|1@1+ (1,0) [0|1] "" Vector__XXX
 SG_ VCRIGHT_a378_snsRateChangeDown m378 : 19|1@1+ (1,0) [0|1] "" Vector__XXX
 SG_ VCRIGHT_a379_snsShortCircuit m379 : 16|1@1+ (1,0) [0|1] "" Vector__XXX
 SG_ VCRIGHT_a379_snsDisconnect m379 : 17|1@1+ (1,0) [0|1] "" Vector__XXX
 SG_ VCRIGHT_a379_snsRateChangeUp m379 : 18|1@1+ (1,0) [0|1] "" Vector__XXX
 SG_ VCRIGHT_a379_snsRateChangeDown m379 : 19|1@1+ (1,0) [0|1] "" Vector__XXX
 SG_ VCRIGHT_a380_outputFaulted m380 : 16|1@1+ (1,0) [0|1] "" Vector__XXX
 SG_ VCRIGHT_a380_currentSenseFaulted m380 : 17|1@1+ (1,0) [0|1] "" Vector__XXX
 SG_ VCRIGHT_a380_tempSenseFaulted m380 : 18|1@1+ (1,0) [0|1] "" Vector__XXX
 SG_ VCRIGHT_a380_underCurrent m380 : 19|1@1+ (1,0) [0|1] "" Vector__XXX
 SG_ VCRIGHT_a380_overCurrent m380 : 20|1@1+ (1,0) [0|1] "" Vector__XXX
 SG_ VCRIGHT_a380_overTemperature m380 : 21|1@1+ (1,0) [0|1] "" Vector__XXX
 SG_ VCRIGHT_a381_outputFaulted m381 : 16|1@1+ (1,0) [0|1] "" Vector__XXX
 SG_ VCRIGHT_a381_currentSenseFaulted m381 : 17|1@1+ (1,0) [0|1] "" Vector__XXX
 SG_ VCRIGHT_a381_tempSenseFaulted m381 : 18|1@1+ (1,0) [0|1] "" Vector__XXX
 SG_ VCRIGHT_a381_underCurrent m381 : 19|1@1+ (1,0) [0|1] "" Vector__XXX
 SG_ VCRIGHT_a381_overCurrent m381 : 20|1@1+ (1,0) [0|1] "" Vector__XXX
 SG_ VCRIGHT_a381_overTemperature m381 : 21|1@1+ (1,0) [0|1] "" Vector__XXX
 SG_ VCRIGHT_a382_outputFaulted m382 : 16|1@1+ (1,0) [0|1] "" Vector__XXX
 SG_ VCRIGHT_a382_currentSenseFaulted m382 : 17|1@1+ (1,0) [0|1] "" Vector__XXX
 SG_ VCRIGHT_a382_tempSenseFaulted m382 : 18|1@1+ (1,0) [0|1] "" Vector__XXX
 SG_ VCRIGHT_a382_underCurrent m382 : 19|1@1+ (1,0) [0|1] "" Vector__XXX
 SG_ VCRIGHT_a382_overCurrent m382 : 20|1@1+ (1,0) [0|1] "" Vector__XXX
 SG_ VCRIGHT_a382_overTemperature m382 : 21|1@1+ (1,0) [0|1] "" Vector__XXX
 SG_ VCRIGHT_a385_current m385 : 16|11@1+ (0.001,0) [0|2.047] "A" Vector__XXX
 SG_ VCRIGHT_a385_voltage m385 : 32|8@1+ (0.1,0) [0|25.5] "V" Vector__XXX
 SG_ VCRIGHT_a385_resistance m385 : 40|8@1+ (1,0) [0|255] "ohm" Vector__XXX
 SG_ VCRIGHT_a385_reason m385 : 48|2@1+ (1,0) [0|3] "" Vector__XXX
 SG_ VCRIGHT_a406_frame1MIA m406 : 16|1@1+ (1,0) [0|1] "" Vector__XXX
 SG_ VCRIGHT_a406_frame2MIA m406 : 17|1@1+ (1,0) [0|1] "" Vector__XXX
 SG_ VCRIGHT_a407_configMismatch m407 : 16|1@1+ (1,0) [0|1] "" Vector__XXX
 SG_ VCRIGHT_a407_counterError m407 : 17|1@1+ (1,0) [0|1] "" Vector__XXX
 SG_ VCRIGHT_a407_checksumError m407 : 18|1@1+ (1,0) [0|1] "" Vector__XXX
 SG_ VCRIGHT_a407_linResponseError m407 : 19|1@1+ (1,0) [0|1] "" Vector__XXX
 SG_ VCRIGHT_a408_generalError m408 : 16|1@1+ (1,0) [0|1] "" Vector__XXX
 SG_ VCRIGHT_a408_seatbeltError m408 : 17|1@1+ (1,0) [0|1] "" Vector__XXX
 SG_ VCRIGHT_a408_doorError m408 : 18|1@1+ (1,0) [0|1] "" Vector__XXX
 SG_ VCRIGHT_a408_ALRError m408 : 19|1@1+ (1,0) [0|1] "" Vector__XXX
 SG_ VCRIGHT_a408_pressureError m408 : 20|1@1+ (1,0) [0|1] "" Vector__XXX
 SG_ VCRIGHT_a408_fluidLevelError m408 : 21|1@1+ (1,0) [0|1] "" Vector__XXX
 SG_ VCRIGHT_a408_temperatureError m408 : 22|1@1+ (1,0) [0|1] "" Vector__XXX
 SG_ VCRIGHT_a408_hardwareInternalErr m408 : 23|1@1+ (1,0) [0|1] "" Vector__XXX
 SG_ VCRIGHT_a408_overvoltageError m408 : 24|1@1+ (1,0) [0|1] "" Vector__XXX
 SG_ VCRIGHT_a408_overcurrentError m408 : 25|1@1+ (1,0) [0|1] "" Vector__XXX
 SG_ VCRIGHT_a408_ignitionError m408 : 26|1@1+ (1,0) [0|1] "" Vector__XXX
 SG_ VCRIGHT_a408_calibrationError m408 : 27|1@1+ (1,0) [0|1] "" Vector__XXX
 SG_ VCRIGHT_a408_trimError m408 : 28|1@1+ (1,0) [0|1] "" Vector__XXX
 SG_ VCRIGHT_a411_failureReason m411 : 16|6@1+ (1,0) [0|63] "" Vector__XXX
 SG_ VCRIGHT_a411_loadUnattemptedOnFa m411 : 22|1@1+ (1,0) [0|1] "" Vector__XXX
 SG_ VCRIGHT_a411_deviceStuckOnFailur m411 : 23|1@1+ (1,0) [0|1] "" Vector__XXX
 SG_ VCRIGHT_a411_uvLoadshedVsenseDig m411 : 24|1@1+ (1,0) [0|1] "" Vector__XXX
 SG_ VCRIGHT_a411_uvLoadshedVoltage m411 : 25|9@1+ (0.05,0) [0|25.55] "V" Vector__XXX
 SG_ VCRIGHT_a412_outputFaulted m412 : 16|1@1+ (1,0) [0|1] "" Vector__XXX
 SG_ VCRIGHT_a412_currentSenseFaulted m412 : 17|1@1+ (1,0) [0|1] "" Vector__XXX
 SG_ VCRIGHT_a412_tempSenseFaulted m412 : 18|1@1+ (1,0) [0|1] "" Vector__XXX
 SG_ VCRIGHT_a412_underCurrent m412 : 19|1@1+ (1,0) [0|1] "" Vector__XXX
 SG_ VCRIGHT_a412_overCurrent m412 : 20|1@1+ (1,0) [0|1] "" Vector__XXX
 SG_ VCRIGHT_a412_overTemperature m412 : 21|1@1+ (1,0) [0|1] "" Vector__XXX
 SG_ VCRIGHT_a413_outputFaulted m413 : 16|1@1+ (1,0) [0|1] "" Vector__XXX
 SG_ VCRIGHT_a413_currentSenseFaulted m413 : 17|1@1+ (1,0) [0|1] "" Vector__XXX
 SG_ VCRIGHT_a413_tempSenseFaulted m413 : 18|1@1+ (1,0) [0|1] "" Vector__XXX
 SG_ VCRIGHT_a413_underCurrent m413 : 19|1@1+ (1,0) [0|1] "" Vector__XXX
 SG_ VCRIGHT_a413_overCurrent m413 : 20|1@1+ (1,0) [0|1] "" Vector__XXX
 SG_ VCRIGHT_a413_overTemperature m413 : 21|1@1+ (1,0) [0|1] "" Vector__XXX
 SG_ VCRIGHT_a414_outputFaulted m414 : 16|1@1+ (1,0) [0|1] "" Vector__XXX
 SG_ VCRIGHT_a414_currentSenseFaulted m414 : 17|1@1+ (1,0) [0|1] "" Vector__XXX
 SG_ VCRIGHT_a414_tempSenseFaulted m414 : 18|1@1+ (1,0) [0|1] "" Vector__XXX
 SG_ VCRIGHT_a414_underCurrent m414 : 19|1@1+ (1,0) [0|1] "" Vector__XXX
 SG_ VCRIGHT_a414_overCurrent m414 : 20|1@1+ (1,0) [0|1] "" Vector__XXX
 SG_ VCRIGHT_a414_overTemperature m414 : 21|1@1+ (1,0) [0|1] "" Vector__XXX
 SG_ VCRIGHT_a415_outputFaulted m415 : 16|1@1+ (1,0) [0|1] "" Vector__XXX
 SG_ VCRIGHT_a415_currentSenseFaulted m415 : 17|1@1+ (1,0) [0|1] "" Vector__XXX
 SG_ VCRIGHT_a415_tempSenseFaulted m415 : 18|1@1+ (1,0) [0|1] "" Vector__XXX
 SG_ VCRIGHT_a415_underCurrent m415 : 19|1@1+ (1,0) [0|1] "" Vector__XXX
 SG_ VCRIGHT_a415_overCurrent m415 : 20|1@1+ (1,0) [0|1] "" Vector__XXX
 SG_ VCRIGHT_a415_overTemperature m415 : 21|1@1+ (1,0) [0|1] "" Vector__XXX
 SG_ VCRIGHT_a416_outputFaulted m416 : 16|1@1+ (1,0) [0|1] "" Vector__XXX
 SG_ VCRIGHT_a416_currentSenseFaulted m416 : 17|1@1+ (1,0) [0|1] "" Vector__XXX
 SG_ VCRIGHT_a416_tempSenseFaulted m416 : 18|1@1+ (1,0) [0|1] "" Vector__XXX
 SG_ VCRIGHT_a416_underCurrent m416 : 19|1@1+ (1,0) [0|1] "" Vector__XXX
 SG_ VCRIGHT_a416_overCurrent m416 : 20|1@1+ (1,0) [0|1] "" Vector__XXX
 SG_ VCRIGHT_a416_overTemperature m416 : 21|1@1+ (1,0) [0|1] "" Vector__XXX
 SG_ VCRIGHT_a417_outputFaulted m417 : 16|1@1+ (1,0) [0|1] "" Vector__XXX
 SG_ VCRIGHT_a417_currentSenseFaulted m417 : 17|1@1+ (1,0) [0|1] "" Vector__XXX
 SG_ VCRIGHT_a417_tempSenseFaulted m417 : 18|1@1+ (1,0) [0|1] "" Vector__XXX
 SG_ VCRIGHT_a417_underCurrent m417 : 19|1@1+ (1,0) [0|1] "" Vector__XXX
 SG_ VCRIGHT_a417_overCurrent m417 : 20|1@1+ (1,0) [0|1] "" Vector__XXX
 SG_ VCRIGHT_a417_overTemperature m417 : 21|1@1+ (1,0) [0|1] "" Vector__XXX
 SG_ VCRIGHT_a418_outputFaulted m418 : 16|1@1+ (1,0) [0|1] "" Vector__XXX
 SG_ VCRIGHT_a418_currentSenseFaulted m418 : 17|1@1+ (1,0) [0|1] "" Vector__XXX
 SG_ VCRIGHT_a418_tempSenseFaulted m418 : 18|1@1+ (1,0) [0|1] "" Vector__XXX
 SG_ VCRIGHT_a418_underCurrent m418 : 19|1@1+ (1,0) [0|1] "" Vector__XXX
 SG_ VCRIGHT_a418_overCurrent m418 : 20|1@1+ (1,0) [0|1] "" Vector__XXX
 SG_ VCRIGHT_a418_overTemperature m418 : 21|1@1+ (1,0) [0|1] "" Vector__XXX
 SG_ VCRIGHT_a419_outputFaulted m419 : 16|1@1+ (1,0) [0|1] "" Vector__XXX
 SG_ VCRIGHT_a419_currentSenseFaulted m419 : 17|1@1+ (1,0) [0|1] "" Vector__XXX
 SG_ VCRIGHT_a419_tempSenseFaulted m419 : 18|1@1+ (1,0) [0|1] "" Vector__XXX
 SG_ VCRIGHT_a419_underCurrent m419 : 19|1@1+ (1,0) [0|1] "" Vector__XXX
 SG_ VCRIGHT_a419_overCurrent m419 : 20|1@1+ (1,0) [0|1] "" Vector__XXX
 SG_ VCRIGHT_a419_overTemperature m419 : 21|1@1+ (1,0) [0|1] "" Vector__XXX
 SG_ VCRIGHT_a420_outputFaulted m420 : 16|1@1+ (1,0) [0|1] "" Vector__XXX
 SG_ VCRIGHT_a420_currentSenseFaulted m420 : 17|1@1+ (1,0) [0|1] "" Vector__XXX
 SG_ VCRIGHT_a420_tempSenseFaulted m420 : 18|1@1+ (1,0) [0|1] "" Vector__XXX
 SG_ VCRIGHT_a420_underCurrent m420 : 19|1@1+ (1,0) [0|1] "" Vector__XXX
 SG_ VCRIGHT_a420_overCurrent m420 : 20|1@1+ (1,0) [0|1] "" Vector__XXX
 SG_ VCRIGHT_a420_overTemperature m420 : 21|1@1+ (1,0) [0|1] "" Vector__XXX
 SG_ VCRIGHT_a421_outputFaulted m421 : 16|1@1+ (1,0) [0|1] "" Vector__XXX
 SG_ VCRIGHT_a421_currentSenseFaulted m421 : 17|1@1+ (1,0) [0|1] "" Vector__XXX
 SG_ VCRIGHT_a421_tempSenseFaulted m421 : 18|1@1+ (1,0) [0|1] "" Vector__XXX
 SG_ VCRIGHT_a421_underCurrent m421 : 19|1@1+ (1,0) [0|1] "" Vector__XXX
 SG_ VCRIGHT_a421_overCurrent m421 : 20|1@1+ (1,0) [0|1] "" Vector__XXX
 SG_ VCRIGHT_a421_overTemperature m421 : 21|1@1+ (1,0) [0|1] "" Vector__XXX
 SG_ VCRIGHT_a422_3rUsbPortsStuckOff m422 : 16|1@1+ (1,0) [0|1] "" Vector__XXX
 SG_ VCRIGHT_a422_lumbarEcuStuckOff m422 : 17|1@1+ (1,0) [0|1] "" Vector__XXX
 SG_ VCRIGHT_a422_oilPumpStuckOff m422 : 18|1@1+ (1,0) [0|1] "" Vector__XXX
 SG_ VCRIGHT_a422_vbusProtFusedMiscSt m422 : 19|1@1+ (1,0) [0|1] "" Vector__XXX
 SG_ VCRIGHT_a422_vbusProtFusedSeatSt m422 : 20|1@1+ (1,0) [0|1] "" Vector__XXX
 SG_ VCRIGHT_a422_seatFrontVentFanCus m422 : 21|1@1+ (1,0) [0|1] "" Vector__XXX
 SG_ VCRIGHT_a422_seatFrontVentFanBac m422 : 22|1@1+ (1,0) [0|1] "" Vector__XXX
 SG_ VCRIGHT_a422_doorRearRgbStuckOff m422 : 23|1@1+ (1,0) [0|1] "" Vector__XXX
 SG_ VCRIGHT_a422_radioTunerStuckOff m422 : 24|1@1+ (1,0) [0|1] "" Vector__XXX
 SG_ VCRIGHT_a422_seat2rControllerStu m422 : 25|1@1+ (1,0) [0|1] "" Vector__XXX
 SG_ VCRIGHT_a422_premiumAmpStuckOff m422 : 26|1@1+ (1,0) [0|1] "" Vector__XXX
 SG_ VCRIGHT_a422_rearGlassHeaterStuc m422 : 27|1@1+ (1,0) [0|1] "" Vector__XXX
 SG_ VCRIGHT_a426_seatMotorCalibrated m426 : 16|1@1+ (1,0) [0|1] "" Vector__XXX
 SG_ VCRIGHT_a426_seatMotorCurrent m426 : 17|12@1- (0.01,0) [-20.48|20.47] "A" Vector__XXX
 SG_ VCRIGHT_a426_seatMotorPosReal m426 : 32|12@1- (1,0) [-2048|2047] "mm" Vector__XXX
 SG_ VCRIGHT_a426_seatMotorState m426 : 44|3@1+ (1,0) [0|7] "" Vector__XXX
 SG_ VCRIGHT_a426_seatSwitchBack m426 : 48|2@1+ (1,0) [1|3] "" Vector__XXX
 SG_ VCRIGHT_a426_seatSwitchForward m426 : 50|2@1+ (1,0) [1|3] "" Vector__XXX
 SG_ VCRIGHT_a426_cabinTmp m426 : 52|12@1- (0.1,0) [-204.8|204.7] "degC" Vector__XXX
 SG_ VCRIGHT_a427_seatMotorCalibrated m427 : 16|1@1+ (1,0) [0|1] "" Vector__XXX
 SG_ VCRIGHT_a427_seatMotorCurrent m427 : 17|12@1- (0.01,0) [-20.48|20.47] "A" Vector__XXX
 SG_ VCRIGHT_a427_seatMotorPosReal m427 : 32|12@1- (1,0) [-2048|2047] "mm" Vector__XXX
 SG_ VCRIGHT_a427_seatMotorState m427 : 44|3@1+ (1,0) [0|7] "" Vector__XXX
 SG_ VCRIGHT_a427_seatSwitchBack m427 : 48|2@1+ (1,0) [1|3] "" Vector__XXX
 SG_ VCRIGHT_a427_seatSwitchForward m427 : 50|2@1+ (1,0) [1|3] "" Vector__XXX
 SG_ VCRIGHT_a427_cabinTmp m427 : 52|12@1- (0.1,0) [-204.8|204.7] "degC" Vector__XXX
 SG_ VCRIGHT_a428_seatMotorCalibrated m428 : 16|1@1+ (1,0) [0|1] "" Vector__XXX
 SG_ VCRIGHT_a428_seatMotorCurrent m428 : 17|12@1- (0.01,0) [-20.48|20.47] "A" Vector__XXX
 SG_ VCRIGHT_a428_seatMotorPosReal m428 : 32|12@1- (1,0) [-2048|2047] "mm" Vector__XXX
 SG_ VCRIGHT_a428_seatMotorState m428 : 44|3@1+ (1,0) [0|7] "" Vector__XXX
 SG_ VCRIGHT_a428_seatSwitchBack m428 : 48|2@1+ (1,0) [1|3] "" Vector__XXX
 SG_ VCRIGHT_a428_seatSwitchForward m428 : 50|2@1+ (1,0) [1|3] "" Vector__XXX
 SG_ VCRIGHT_a428_cabinTmp m428 : 52|12@1- (0.1,0) [-204.8|204.7] "degC" Vector__XXX
 SG_ VCRIGHT_a429_seatMotorCalibrated m429 : 16|1@1+ (1,0) [0|1] "" Vector__XXX
 SG_ VCRIGHT_a429_seatMotorCurrent m429 : 17|12@1- (0.01,0) [-20.48|20.47] "A" Vector__XXX
 SG_ VCRIGHT_a429_seatMotorPosReal m429 : 32|12@1- (1,0) [-2048|2047] "mm" Vector__XXX
 SG_ VCRIGHT_a429_seatMotorState m429 : 44|3@1+ (1,0) [0|7] "" Vector__XXX
 SG_ VCRIGHT_a429_seatSwitchBack m429 : 48|2@1+ (1,0) [1|3] "" Vector__XXX
 SG_ VCRIGHT_a429_seatSwitchForward m429 : 50|2@1+ (1,0) [1|3] "" Vector__XXX
 SG_ VCRIGHT_a429_cabinTmp m429 : 52|12@1- (0.1,0) [-204.8|204.7] "degC" Vector__XXX
 SG_ VCRIGHT_a444_retriesAvailable m444 : 16|8@1+ (1,0) [0|255] "" Vector__XXX
 SG_ VCRIGHT_a444_channel m444 : 24|8@1+ (1,0) [0|255] "" Vector__XXX
 SG_ VCRIGHT_a444_watchdog m444 : 32|1@1+ (1,0) [0|1] "" Vector__XXX
 SG_ VCRIGHT_a444_gateDriver m444 : 33|1@1+ (1,0) [0|1] "" Vector__XXX
 SG_ VCRIGHT_a444_overcurrent m444 : 34|1@1+ (1,0) [0|1] "" Vector__XXX
 SG_ VCRIGHT_a444_supplyUndervoltage m444 : 35|1@1+ (1,0) [0|1] "" Vector__XXX
 SG_ VCRIGHT_a444_cpUndervoltage m444 : 36|1@1+ (1,0) [0|1] "" Vector__XXX
 SG_ VCRIGHT_a444_overTempShutdown m444 : 37|1@1+ (1,0) [0|1] "" Vector__XXX
 SG_ VCRIGHT_a444_overTempWarning m444 : 38|1@1+ (1,0) [0|1] "" Vector__XXX
 SG_ VCRIGHT_a444_highSide2GateDriver m444 : 39|1@1+ (1,0) [0|1] "" Vector__XXX
 SG_ VCRIGHT_a444_lowSide2GateDriver m444 : 40|1@1+ (1,0) [0|1] "" Vector__XXX
 SG_ VCRIGHT_a444_highSide1GateDriver m444 : 41|1@1+ (1,0) [0|1] "" Vector__XXX
 SG_ VCRIGHT_a444_lowSide1GateDriver m444 : 42|1@1+ (1,0) [0|1] "" Vector__XXX
 SG_ VCRIGHT_a444_highSide2OverCurent m444 : 43|1@1+ (1,0) [0|1] "" Vector__XXX
 SG_ VCRIGHT_a444_lowSide2OverCurent m444 : 44|1@1+ (1,0) [0|1] "" Vector__XXX
 SG_ VCRIGHT_a444_highSide1OverCurent m444 : 45|1@1+ (1,0) [0|1] "" Vector__XXX
 SG_ VCRIGHT_a444_lowSide1OverCurent m444 : 46|1@1+ (1,0) [0|1] "" Vector__XXX
 SG_ VCRIGHT_a444_spiInit m444 : 47|1@1+ (1,0) [0|1] "" Vector__XXX
 SG_ VCRIGHT_a444_spiPeriodicCheck m444 : 48|1@1+ (1,0) [0|1] "" Vector__XXX
 SG_ VCRIGHT_a444_spiFault m444 : 49|1@1+ (1,0) [0|1] "" Vector__XXX
 SG_ VCRIGHT_a444_voltageMonitor m444 : 50|1@1+ (1,0) [0|1] "" Vector__XXX
 SG_ VCRIGHT_a444_enableLow m444 : 51|1@1+ (1,0) [0|1] "" Vector__XXX
 SG_ VCRIGHT_a444_highCurrentFeedEnab m444 : 52|1@1+ (1,0) [0|1] "" Vector__XXX
 SG_ VCRIGHT_a444_supplyVoltageEnable m444 : 53|1@1+ (1,0) [0|1] "" Vector__XXX
 SG_ VCRIGHT_a444_supplyVoltage m444 : 54|8@1+ (0.1,0) [0|25.5] "V" Vector__XXX
 SG_ VCRIGHT_a446_caseTempHVACUnavail m446 : 16|1@1+ (1,0) [0|1] "" Vector__XXX
 SG_ VCRIGHT_a446_evapHVACUnavailable m446 : 17|1@1+ (1,0) [0|1] "" Vector__XXX
 SG_ VCRIGHT_a446_evapTempInvalid m446 : 18|1@1+ (1,0) [0|1] "" Vector__XXX
 SG_ VCRIGHT_a446_hvacBlowerFaulted m446 : 19|1@1+ (1,0) [0|1] "" Vector__XXX
 SG_ VCRIGHT_a446_evapOperationNotAll m446 : 20|1@1+ (1,0) [0|1] "" Vector__XXX
 SG_ VCRIGHT_a446_allAirPathsBlocked m446 : 21|1@1+ (1,0) [0|1] "" Vector__XXX
 SG_ VCRIGHT_a446_rawDuctTempInvalidL m446 : 22|1@1+ (1,0) [0|1] "" Vector__XXX
 SG_ VCRIGHT_a446_rawDuctTempInvalidR m446 : 23|1@1+ (1,0) [0|1] "" Vector__XXX
 SG_ VCRIGHT_a448_manACOFFComfortCool m448 : 16|1@1+ (1,0) [0|1] "" Vector__XXX
 SG_ VCRIGHT_a448_manAirflowComfortHe m448 : 17|1@1+ (1,0) [0|1] "" Vector__XXX
 SG_ VCRIGHT_a448_manAirflowFwdL_0001 m448 : 18|1@1+ (1,0) [0|1] "" Vector__XXX
 SG_ VCRIGHT_a448_manAirflowFwdLkComf m448 : 19|1@1+ (1,0) [0|1] "" Vector__XXX
 SG_ VCRIGHT_a448_manACOffFwdLkComfor m448 : 20|1@1+ (1,0) [0|1] "" Vector__XXX
 SG_ VCRIGHT_a448_manFreshComfor_0002 m448 : 21|1@1+ (1,0) [0|1] "" Vector__XXX
 SG_ VCRIGHT_a448_manFreshComfor_0001 m448 : 22|1@1+ (1,0) [0|1] "" Vector__XXX
 SG_ VCRIGHT_a448_manFreshComfortCool m448 : 23|1@1+ (1,0) [0|1] "" Vector__XXX
 SG_ VCRIGHT_a448_manFreshComfortHeat m448 : 24|1@1+ (1,0) [0|1] "" Vector__XXX
 SG_ VCRIGHT_a448_manRecircRHAutoHVAC m448 : 25|1@1+ (1,0) [0|1] "" Vector__XXX
 SG_ VCRIGHT_a448_manRecircFlashFogGe m448 : 26|1@1+ (1,0) [0|1] "" Vector__XXX
 SG_ VCRIGHT_a448_manRecircFlashFogWe m448 : 27|1@1+ (1,0) [0|1] "" Vector__XXX
 SG_ VCRIGHT_a448_manRecircRHManualHV m448 : 28|1@1+ (1,0) [0|1] "" Vector__XXX
 SG_ VCRIGHT_a448_manACoffRHManualHVA m448 : 29|1@1+ (1,0) [0|1] "" Vector__XXX
 SG_ VCRIGHT_a448_manHvacOffAutoSteer m448 : 30|1@1+ (1,0) [0|1] "" Vector__XXX
 SG_ VCRIGHT_a448_manHvacOffAuto_0001 m448 : 31|1@1+ (1,0) [0|1] "" Vector__XXX
 SG_ VCRIGHT_a448_manHvacAutoSteerFog m448 : 32|1@1+ (1,0) [0|1] "" Vector__XXX
 SG_ VCRIGHT_a448_manHvacAutoSte_0001 m448 : 33|1@1+ (1,0) [0|1] "" Vector__XXX
 SG_ VCRIGHT_a448_manualHighBlowerSpe m448 : 34|1@1+ (1,0) [0|1] "" Vector__XXX
 SG_ VCRIGHT_a482_channel m482 : 16|6@1+ (1,0) [0|63] "" Vector__XXX
 SG_ VCRIGHT_a482_spiFault m482 : 22|1@1+ (1,0) [0|1] "" Vector__XXX
 SG_ VCRIGHT_a482_resetBar m482 : 23|1@1+ (1,0) [0|1] "" Vector__XXX
 SG_ VCRIGHT_a482_overTempShutdown m482 : 24|1@1+ (1,0) [0|1] "" Vector__XXX
 SG_ VCRIGHT_a482_thermalWarning m482 : 25|1@1+ (1,0) [0|1] "" Vector__XXX
 SG_ VCRIGHT_a482_underOrOverVoltageO m482 : 26|1@1+ (1,0) [0|1] "" Vector__XXX
 SG_ VCRIGHT_a482_underloadDetected m482 : 27|1@1+ (1,0) [0|1] "" Vector__XXX
 SG_ VCRIGHT_a489_vbatProtVoltage m489 : 16|9@1+ (0.0391389429569,0) [0|19.999999851] "V" Vector__XXX
 SG_ VCRIGHT_a489_3rUsbPortsStuckOn m489 : 25|1@1+ (1,0) [0|1] "" Vector__XXX
 SG_ VCRIGHT_a489_lumbarEcuStuckOn m489 : 26|1@1+ (1,0) [0|1] "" Vector__XXX
 SG_ VCRIGHT_a489_oilPumpStuckOn m489 : 27|1@1+ (1,0) [0|1] "" Vector__XXX
 SG_ VCRIGHT_a489_vbusProtFusedMiscSt m489 : 28|1@1+ (1,0) [0|1] "" Vector__XXX
 SG_ VCRIGHT_a489_vbusProtFusedSeatSt m489 : 29|1@1+ (1,0) [0|1] "" Vector__XXX
 SG_ VCRIGHT_a489_seatFrontVentFanCus m489 : 30|1@1+ (1,0) [0|1] "" Vector__XXX
 SG_ VCRIGHT_a489_seatFrontVentFanBac m489 : 31|1@1+ (1,0) [0|1] "" Vector__XXX
 SG_ VCRIGHT_a489_doorRearRgbStuckOn m489 : 32|1@1+ (1,0) [0|1] "" Vector__XXX
 SG_ VCRIGHT_a489_radioTunerStuckOn m489 : 33|1@1+ (1,0) [0|1] "" Vector__XXX
 SG_ VCRIGHT_a489_seat2rControllerStu m489 : 34|1@1+ (1,0) [0|1] "" Vector__XXX
 SG_ VCRIGHT_a489_premiumAmpStuckOn m489 : 35|1@1+ (1,0) [0|1] "" Vector__XXX
 SG_ VCRIGHT_a489_rearGlassHeaterStuc m489 : 36|1@1+ (1,0) [0|1] "" Vector__XXX
 SG_ VCRIGHT_a492_3rUsbPortsUnattempt m492 : 16|1@1+ (1,0) [0|1] "" Vector__XXX
 SG_ VCRIGHT_a492_lumbarEcuUnattempte m492 : 17|1@1+ (1,0) [0|1] "" Vector__XXX
 SG_ VCRIGHT_a492_oilPumpUnattemptedO m492 : 18|1@1+ (1,0) [0|1] "" Vector__XXX
 SG_ VCRIGHT_a492_vbusProtFusedMiscUn m492 : 19|1@1+ (1,0) [0|1] "" Vector__XXX
 SG_ VCRIGHT_a492_vbusProtFusedSeatUn m492 : 20|1@1+ (1,0) [0|1] "" Vector__XXX
 SG_ VCRIGHT_a492_seatFrontVentFanCus m492 : 21|1@1+ (1,0) [0|1] "" Vector__XXX
 SG_ VCRIGHT_a492_seatFrontVentFanBac m492 : 22|1@1+ (1,0) [0|1] "" Vector__XXX
 SG_ VCRIGHT_a492_doorRearRgbUnattemp m492 : 23|1@1+ (1,0) [0|1] "" Vector__XXX
 SG_ VCRIGHT_a492_radioTunerUnattempt m492 : 24|1@1+ (1,0) [0|1] "" Vector__XXX
 SG_ VCRIGHT_a492_seat2rControllerUna m492 : 25|1@1+ (1,0) [0|1] "" Vector__XXX
 SG_ VCRIGHT_a492_premiumAmpUnattempt m492 : 26|1@1+ (1,0) [0|1] "" Vector__XXX
 SG_ VCRIGHT_a492_rearGlassHeaterUnat m492 : 27|1@1+ (1,0) [0|1] "" Vector__XXX
 SG_ VCRIGHT_a496_cabinTempInterior m496 : 16|8@1+ (0.5,-40) [-40|87] "degC" Vector__XXX
 SG_ VCRIGHT_a497_ecuUnprovisioned m497 : 16|1@1+ (1,0) [0|1] "" Vector__XXX
 SG_ VCRIGHT_a510_isRearwardEndstopUn m510 : 16|1@1+ (1,0) [0|1] "" Vector__XXX
 SG_ VCRIGHT_a510_isAbsPosSensorUncal m510 : 17|1@1+ (1,0) [0|1] "" Vector__XXX
 SG_ VCRIGHT_a510_seatState m510 : 18|4@1+ (1,0) [0|14] "" Vector__XXX
 SG_ VCRIGHT_a510_motorType m510 : 22|1@1+ (1,0) [0|1] "" Vector__XXX
 SG_ VCRIGHT_a510_absPosSensState m510 : 24|2@1+ (1,0) [0|3] "" Vector__XXX
 SG_ VCRIGHT_a513_calibrated m513 : 16|1@1+ (1,0) [0|1] "" Vector__XXX
 SG_ VCRIGHT_a513_angle m513 : 17|8@1- (0.5,59) [-5|122.5] "deg" Vector__XXX
 SG_ VCRIGHT_a513_seatStatePrev m513 : 25|4@1+ (1,0) [0|14] "" Vector__XXX
 SG_ VCRIGHT_a513_obstacleDetectReaso m513 : 29|4@1+ (1,0) [0|15] "" Vector__XXX
 SG_ VCRIGHT_a513_accelLookbackTripDe m513 : 33|7@1+ (1,0) [0|127] "" Vector__XXX
 SG_ VCRIGHT_a513_duty m513 : 40|8@1- (1,0) [-128|127] "%" Vector__XXX
 SG_ VCRIGHT_a513_currentAbsFilt m513 : 48|8@1+ (0.25,0) [0|63.75] "A" Vector__XXX
 SG_ VCRIGHT_a513_motorType m513 : 56|1@1+ (1,0) [0|1] "" Vector__XXX
 SG_ VCRIGHT_a513_absolutePosSensorFo m513 : 57|1@1+ (1,0) [0|1] "" Vector__XXX
 SG_ VCRIGHT_a513_cabinTemp m513 : 58|6@1- (2,20) [-44|82] "degC" Vector__XXX
 SG_ VCRIGHT_a517_isRearwardEndstopUn m517 : 16|1@1+ (1,0) [0|1] "" Vector__XXX
 SG_ VCRIGHT_a517_isAbsPosSensorUncal m517 : 17|1@1+ (1,0) [0|1] "" Vector__XXX
 SG_ VCRIGHT_a518_seatState m518 : 16|4@1+ (1,0) [0|14] "" Vector__XXX
 SG_ VCRIGHT_a520_epbConfig m520 : 16|4@1+ (1,0) [0|15] "" Vector__XXX

CM_ SG_ 2011 VCRIGHT_a146_snsRateChangeUp "Right body controller: a146 sns rate change up";
CM_ SG_ 2011 VCRIGHT_a146_snsRateChangeDown "Right body controller: a146 sns rate change down";
CM_ SG_ 2011 VCRIGHT_a147_snsShortCircuit "Right body controller: a147 sns short circuit";
CM_ SG_ 2011 VCRIGHT_a147_snsDisconnect "Right body controller: a147 sns disconnect";
CM_ SG_ 2011 VCRIGHT_a147_snsRateChangeUp "Right body controller: a147 sns rate change up";
CM_ SG_ 2011 VCRIGHT_a147_snsRateChangeDown "Right body controller: a147 sns rate change down";
CM_ SG_ 2011 VCRIGHT_a148_snsShortCircuit "Right body controller: a148 sns short circuit";
CM_ SG_ 2011 VCRIGHT_a148_snsDisconnect "Right body controller: a148 sns disconnect";
CM_ SG_ 2011 VCRIGHT_a148_snsRateChangeUp "Right body controller: a148 sns rate change up";
CM_ SG_ 2011 VCRIGHT_a148_snsRateChangeDown "Right body controller: a148 sns rate change down";
CM_ SG_ 2011 VCRIGHT_a149_snsShortCircuit "Right body controller: a149 sns short circuit";
CM_ SG_ 2011 VCRIGHT_a149_snsDisconnect "Right body controller: a149 sns disconnect";
CM_ SG_ 2011 VCRIGHT_a149_snsRateChangeUp "Right body controller: a149 sns rate change up";
CM_ SG_ 2011 VCRIGHT_a149_snsRateChangeDown "Right body controller: a149 sns rate change down";
CM_ SG_ 2011 VCRIGHT_a150_windowPosition "Right body controller: a150 window position";
CM_ SG_ 2011 VCRIGHT_a150_movementTimeMs "Right body controller: a150 movement time ms";
CM_ SG_ 2011 VCRIGHT_a150_windowPinchReason "Right body controller: a150 window pinch reason";
CM_ SG_ 2011 VCRIGHT_a150_lookbackIndex "Right body controller: a150 lookback index";
CM_ SG_ 2011 VCRIGHT_a150_absAccelExceedance "Right body controller: a150 abs accel exceedance";
CM_ SG_ 2011 VCRIGHT_a150_relAccelExceedance "Right body controller: a150 rel accel exceedance";
CM_ SG_ 2011 VCRIGHT_a150_speedExpScore "Right body controller: a150 speed exp score";
CM_ SG_ 2011 VCRIGHT_a150_treatedInGear "Right body controller: a150 treated in gear";
CM_ SG_ 2011 VCRIGHT_a151_windowPosition "Right body controller: a151 window position";
CM_ SG_ 2011 VCRIGHT_a151_movementTimeMs "Right body controller: a151 movement time ms";
CM_ SG_ 2011 VCRIGHT_a151_windowPinchReason "Right body controller: a151 window pinch reason";
CM_ SG_ 2011 VCRIGHT_a151_lookbackIndex "Right body controller: a151 lookback index";
CM_ SG_ 2011 VCRIGHT_a151_absAccelExceedance "Right body controller: a151 abs accel exceedance";
CM_ SG_ 2011 VCRIGHT_a151_relAccelExceedance "Right body controller: a151 rel accel exceedance";
CM_ SG_ 2011 VCRIGHT_a151_speedExpScore "Right body controller: a151 speed exp score";
CM_ SG_ 2011 VCRIGHT_a151_treatedInGear "Right body controller: a151 treated in gear";
CM_ SG_ 2011 VCRIGHT_a152_zeroed "Right body controller: a152 zeroed";
CM_ SG_ 2011 VCRIGHT_a152_endStopTrusted "Right body controller: a152 end stop trusted";
CM_ SG_ 2011 VCRIGHT_a152_speedTableStatus "Right body controller: a152 speed table status; raw 0 = signal not available (SNA)";
CM_ SG_ 2011 VCRIGHT_a152_causedByBackoffs "Right body controller: a152 caused by backoffs";
CM_ SG_ 2011 VCRIGHT_a153_zeroed "Right body controller: a153 zeroed";
CM_ SG_ 2011 VCRIGHT_a153_endStopTrusted "Right body controller: a153 end stop trusted";
CM_ SG_ 2011 VCRIGHT_a153_speedTableStatus "Right body controller: a153 speed table status; raw 0 = signal not available (SNA)";
CM_ SG_ 2011 VCRIGHT_a153_causedByBackoffs "Right body controller: a153 caused by backoffs";
CM_ SG_ 2011 VCRIGHT_a154_windowThermalMode "Right body controller: a154 window thermal mode; raw 0 = signal not available (SNA)";
CM_ SG_ 2011 VCRIGHT_a154_lightShowActive "Right body controller: a154 light show active";
CM_ SG_ 2011 VCRIGHT_a155_windowThermalMode "Right body controller: a155 window thermal mode; raw 0 = signal not available (SNA)";
CM_ SG_ 2011 VCRIGHT_a155_lightShowActive "Right body controller: a155 light show active";
CM_ SG_ 2011 VCRIGHT_a177_hvacRearStall "Right body controller: a177 hvac rear stall";
CM_ SG_ 2011 VCRIGHT_a180_intButtonPressed "Right body controller: a180 int button pressed";
CM_ SG_ 2011 VCRIGHT_a180_extHandlePWM "Right body controller: a180 ext handle PWM";
CM_ SG_ 2011 VCRIGHT_a180_extHandlePulled "Right body controller: a180 ext handle pulled";
CM_ SG_ 2011 VCRIGHT_a180_releasePWM "Right body controller: a180 release PWM";
CM_ SG_ 2011 VCRIGHT_a180_latchStatus "Right body controller: a180 latch status; raw 0 = signal not available (SNA)";
CM_ SG_ 2011 VCRIGHT_a180_latchClawStatus "Right body controller: a180 latch claw status";
CM_ SG_ 2011 VCRIGHT_a181_intButtonPressed "Right body controller: a181 int button pressed";
CM_ SG_ 2011 VCRIGHT_a181_extHandlePWM "Right body controller: a181 ext handle PWM";
CM_ SG_ 2011 VCRIGHT_a181_extHandlePulled "Right body controller: a181 ext handle pulled";
CM_ SG_ 2011 VCRIGHT_a181_releasePWM "Right body controller: a181 release PWM";
CM_ SG_ 2011 VCRIGHT_a181_latchStatus "Right body controller: a181 latch status; raw 0 = signal not available (SNA)";
CM_ SG_ 2011 VCRIGHT_a181_latchClawStatus "Right body controller: a181 latch claw status";
CM_ SG_ 2011 VCRIGHT_a184_voltage "Right body controller: a184 voltage";
CM_ SG_ 2011 VCRIGHT_a184_temperature "Right body controller: a184 temperature";
CM_ SG_ 2011 VCRIGHT_a184_trunkCurrent "Right body controller: a184 trunk current";
CM_ SG_ 2011 VCRIGHT_a186_voltage "Right body controller: a186 voltage";
CM_ SG_ 2011 VCRIGHT_a186_temperature "Right body controller: a186 temperature";
CM_ SG_ 2011 VCRIGHT_a187_voltage "Right body controller: a187 voltage";
CM_ SG_ 2011 VCRIGHT_a187_temperature "Right body controller: a187 temperature";
CM_ SG_ 2011 VCRIGHT_a188_voltage "Right body controller: a188 voltage";
CM_ SG_ 2011 VCRIGHT_a188_temperature "Right body controller: a188 temperature";
CM_ SG_ 2011 VCRIGHT_a189_voltage "Right body controller: a189 voltage";
CM_ SG_ 2011 VCRIGHT_a189_temperature "Right body controller: a189 temperature";
CM_ SG_ 2011 VCRIGHT_a190_eFuseTripCount "Right body controller: a190 e fuse trip count";
CM_ SG_ 2011 VCRIGHT_a193_amplifierCurrent "Right body controller: a193 amplifier current";
CM_ SG_ 2011 VCRIGHT_a194_cntctrPwrCurrent "Right body controller: a194 cntctr pwr current";
CM_ SG_ 2011 VCRIGHT_a195_hvcCurrent "Right body controller: a195 hvc current";
CM_ SG_ 2011 VCRIGHT_a196_outputState "Right body controller: a196 output state";
CM_ SG_ 2011 VCRIGHT_a196_NVRAMState "Right body controller: a196 NVRAM state";
CM_ SG_ 2011 VCRIGHT_a196_lockoutState "Right body controller: a196 lockout state";
CM_ SG_ 2011 VCRIGHT_a197_outputState "Right body controller: a197 output state";
CM_ SG_ 2011 VCRIGHT_a197_NVRAMState "Right body controller: a197 NVRAM state";
CM_ SG_ 2011 VCRIGHT_a197_lockoutState "Right body controller: a197 lockout state";
CM_ SG_ 2011 VCRIGHT_a198_outputState "Right body controller: a198 output state";
CM_ SG_ 2011 VCRIGHT_a198_NVRAMState "Right body controller: a198 NVRAM state";
CM_ SG_ 2011 VCRIGHT_a198_lockoutState "Right body controller: a198 lockout state";
CM_ SG_ 2011 VCRIGHT_a199_outputState "Right body controller: a199 output state";
CM_ SG_ 2011 VCRIGHT_a199_NVRAMState "Right body controller: a199 NVRAM state";
CM_ SG_ 2011 VCRIGHT_a199_lockoutState "Right body controller: a199 lockout state";
CM_ SG_ 2011 VCRIGHT_a202_unknownAllowed "Right body controller: a202 unknown allowed";
CM_ SG_ 2011 VCRIGHT_a202_openAllowed "Right body controller: a202 open allowed";
CM_ SG_ 2011 VCRIGHT_a202_dynamicAllowed "Right body controller: a202 dynamic allowed";
CM_ SG_ 2011 VCRIGHT_a202_parkAllowed "Right body controller: a202 park allowed";
CM_ SG_ 2011 VCRIGHT_a202_startAllowed "Right body controller: a202 start allowed";
CM_ SG_ 2011 VCRIGHT_a202_serviceAllowed "Right body controller: a202 service allowed";
CM_ SG_ 2011 VCRIGHT_a202_winchAllowed "Right body controller: a202 winch allowed";
CM_ SG_ 2011 VCRIGHT_a202_winchReleaseAllowed "Right body controller: a202 winch release allowed";
CM_ SG_ 2011 VCRIGHT_a202_parkingAllowed "Right body controller: a202 parking allowed";
CM_ SG_ 2011 VCRIGHT_a202_dynApplyAllowed "Right body controller: a202 dyn apply allowed";
CM_ SG_ 2011 VCRIGHT_a202_releaseAllowed "Right body controller: a202 release allowed";
CM_ SG_ 2011 VCRIGHT_a202_parkPendingAllowed "Right body controller: a202 park pending allowed";
CM_ SG_ 2011 VCRIGHT_a202_wenchPendingAllowed "Right body controller: a202 wench pending allowed";
CM_ SG_ 2011 VCRIGHT_a202_desyncCount "Right body controller: a202 desync count";
CM_ SG_ 2011 VCRIGHT_a202_current "Right body controller: a202 current";
CM_ SG_ 2011 VCRIGHT_a202_epbConfig "Right body controller: a202 epb config";
CM_ SG_ 2011 VCRIGHT_a203_unknownAllowed "Right body controller: a203 unknown allowed";
CM_ SG_ 2011 VCRIGHT_a203_openAllowed "Right body controller: a203 open allowed";
CM_ SG_ 2011 VCRIGHT_a203_dynamicAllowed "Right body controller: a203 dynamic allowed";
CM_ SG_ 2011 VCRIGHT_a203_parkAllowed "Right body controller: a203 park allowed";
CM_ SG_ 2011 VCRIGHT_a203_startAllowed "Right body controller: a203 start allowed";
CM_ SG_ 2011 VCRIGHT_a203_serviceAllowed "Right body controller: a203 service allowed";
CM_ SG_ 2011 VCRIGHT_a203_winchAllowed "Right body controller: a203 winch allowed";
CM_ SG_ 2011 VCRIGHT_a203_winchReleaseAllowed "Right body controller: a203 winch release allowed";
CM_ SG_ 2011 VCRIGHT_a203_parkingAllowed "Right body controller: a203 parking allowed";
CM_ SG_ 2011 VCRIGHT_a203_dynApplyAllowed "Right body controller: a203 dyn apply allowed";
CM_ SG_ 2011 VCRIGHT_a203_releaseAllowed "Right body controller: a203 release allowed";
CM_ SG_ 2011 VCRIGHT_a203_parkPendingAllowed "Right body controller: a203 park pending allowed";
CM_ SG_ 2011 VCRIGHT_a203_wenchPendingAllowed "Right body controller: a203 wench pending allowed";
CM_ SG_ 2011 VCRIGHT_a203_desyncCount "Right body controller: a203 desync count";
CM_ SG_ 2011 VCRIGHT_a203_current "Right body controller: a203 current";
CM_ SG_ 2011 VCRIGHT_a203_epbConfig "Right body controller: a203 epb config";
CM_ SG_ 2011 VCRIGHT_a204_unknownAllowed "Right body controller: a204 unknown allowed";
CM_ SG_ 2011 VCRIGHT_a204_openAllowed "Right body controller: a204 open allowed";
CM_ SG_ 2011 VCRIGHT_a204_dynamicAllowed "Right body controller: a204 dynamic allowed";
CM_ SG_ 2011 VCRIGHT_a204_parkAllowed "Right body controller: a204 park allowed";
CM_ SG_ 2011 VCRIGHT_a204_startAllowed "Right body controller: a204 start allowed";
CM_ SG_ 2011 VCRIGHT_a204_serviceAllowed "Right body controller: a204 service allowed";
CM_ SG_ 2011 VCRIGHT_a204_winchAllowed "Right body controller: a204 winch allowed";
CM_ SG_ 2011 VCRIGHT_a204_winchReleaseAllowed "Right body controller: a204 winch release allowed";
CM_ SG_ 2011 VCRIGHT_a204_parkingAllowed "Right body controller: a204 parking allowed";
CM_ SG_ 2011 VCRIGHT_a204_dynApplyAllowed "Right body controller: a204 dyn apply allowed";
CM_ SG_ 2011 VCRIGHT_a204_releaseAllowed "Right body controller: a204 release allowed";
CM_ SG_ 2011 VCRIGHT_a204_parkPendingAllowed "Right body controller: a204 park pending allowed";
CM_ SG_ 2011 VCRIGHT_a204_wenchPendingAllowed "Right body controller: a204 wench pending allowed";
CM_ SG_ 2011 VCRIGHT_a204_desyncCount "Right body controller: a204 desync count";
CM_ SG_ 2011 VCRIGHT_a204_current "Right body controller: a204 current";
CM_ SG_ 2011 VCRIGHT_a204_epbConfig "Right body controller: a204 epb config";
CM_ SG_ 2011 VCRIGHT_a205_unknownAllowed "Right body controller: a205 unknown allowed";
CM_ SG_ 2011 VCRIGHT_a205_openAllowed "Right body controller: a205 open allowed";
CM_ SG_ 2011 VCRIGHT_a205_dynamicAllowed "Right body controller: a205 dynamic allowed";
CM_ SG_ 2011 VCRIGHT_a205_parkAllowed "Right body controller: a205 park allowed";
CM_ SG_ 2011 VCRIGHT_a205_startAllowed "Right body controller: a205 start allowed";
CM_ SG_ 2011 VCRIGHT_a205_serviceAllowed "Right body controller: a205 service allowed";
CM_ SG_ 2011 VCRIGHT_a205_winchAllowed "Right body controller: a205 winch allowed";
CM_ SG_ 2011 VCRIGHT_a205_winchReleaseAllowed "Right body controller: a205 winch release allowed";
CM_ SG_ 2011 VCRIGHT_a205_parkingAllowed "Right body controller: a205 parking allowed";
CM_ SG_ 2011 VCRIGHT_a205_dynApplyAllowed "Right body controller: a205 dyn apply allowed";
CM_ SG_ 2011 VCRIGHT_a205_releaseAllowed "Right body controller: a205 release allowed";
CM_ SG_ 2011 VCRIGHT_a205_parkPendingAllowed "Right body controller: a205 park pending allowed";
CM_ SG_ 2011 VCRIGHT_a205_wenchPendingAllowed "Right body controller: a205 wench pending allowed";
CM_ SG_ 2011 VCRIGHT_a205_desyncCount "Right body controller: a205 desync count";
CM_ SG_ 2011 VCRIGHT_a205_current "Right body controller: a205 current";
CM_ SG_ 2011 VCRIGHT_a205_epbConfig "Right body controller: a205 epb config";
CM_ SG_ 2011 VCRIGHT_a206_unknownAllowed "Right body controller: a206 unknown allowed";
CM_ SG_ 2011 VCRIGHT_a206_openAllowed "Right body controller: a206 open allowed";
CM_ SG_ 2011 VCRIGHT_a206_dynamicAllowed "Right body controller: a206 dynamic allowed";
CM_ SG_ 2011 VCRIGHT_a206_parkAllowed "Right body controller: a206 park allowed";
CM_ SG_ 2011 VCRIGHT_a206_startAllowed "Right body controller: a206 start allowed";
CM_ SG_ 2011 VCRIGHT_a206_serviceAllowed "Right body controller: a206 service allowed";
CM_ SG_ 2011 VCRIGHT_a206_winchAllowed "Right body controller: a206 winch allowed";
CM_ SG_ 2011 VCRIGHT_a206_winchReleaseAllowed "Right body controller: a206 winch release allowed";
CM_ SG_ 2011 VCRIGHT_a206_parkingAllowed "Right body controller: a206 parking allowed";
CM_ SG_ 2011 VCRIGHT_a206_dynApplyAllowed "Right body controller: a206 dyn apply allowed";
CM_ SG_ 2011 VCRIGHT_a206_releaseAllowed "Right body controller: a206 release allowed";
CM_ SG_ 2011 VCRIGHT_a206_parkPendingAllowed "Right body controller: a206 park pending allowed";
CM_ SG_ 2011 VCRIGHT_a206_wenchPendingAllowed "Right body controller: a206 wench pending allowed";
CM_ SG_ 2011 VCRIGHT_a206_unitStatusEPB "Right body controller: a206 unit status EPB";
CM_ SG_ 2011 VCRIGHT_a206_unitStatusEPBM "Right body controller: a206 unit status EPBM";
CM_ SG_ 2011 VCRIGHT_a207_unknownAllowed "Right body controller: a207 unknown allowed";
CM_ SG_ 2011 VCRIGHT_a207_openAllowed "Right body controller: a207 open allowed";
CM_ SG_ 2011 VCRIGHT_a207_dynamicAllowed "Right body controller: a207 dynamic allowed";
CM_ SG_ 2011 VCRIGHT_a207_parkAllowed "Right body controller: a207 park allowed";
CM_ SG_ 2011 VCRIGHT_a207_startAllowed "Right body controller: a207 start allowed";
CM_ SG_ 2011 VCRIGHT_a207_serviceAllowed "Right body controller: a207 service allowed";
CM_ SG_ 2011 VCRIGHT_a207_winchAllowed "Right body controller: a207 winch allowed";
CM_ SG_ 2011 VCRIGHT_a207_winchReleaseAllowed "Right body controller: a207 winch release allowed";
CM_ SG_ 2011 VCRIGHT_a207_parkingAllowed "Right body controller: a207 parking allowed";
CM_ SG_ 2011 VCRIGHT_a207_dynApplyAllowed "Right body controller: a207 dyn apply allowed";
CM_ SG_ 2011 VCRIGHT_a207_releaseAllowed "Right body controller: a207 release allowed";
CM_ SG_ 2011 VCRIGHT_a207_parkPendingAllowed "Right body controller: a207 park pending allowed";
CM_ SG_ 2011 VCRIGHT_a207_wenchPendingAllowed "Right body controller: a207 wench pending allowed";
CM_ SG_ 2011 VCRIGHT_a207_unitStatusEPB "Right body controller: a207 unit status EPB";
CM_ SG_ 2011 VCRIGHT_a207_unitStatusEPBM "Right body controller: a207 unit status EPBM";
CM_ SG_ 2011 VCRIGHT_a208_unknownAllowed "Right body controller: a208 unknown allowed";
CM_ SG_ 2011 VCRIGHT_a208_openAllowed "Right body controller: a208 open allowed";
CM_ SG_ 2011 VCRIGHT_a208_dynamicAllowed "Right body controller: a208 dynamic allowed";
CM_ SG_ 2011 VCRIGHT_a208_parkAllowed "Right body controller: a208 park allowed";
CM_ SG_ 2011 VCRIGHT_a208_startAllowed "Right body controller: a208 start allowed";
CM_ SG_ 2011 VCRIGHT_a208_serviceAllowed "Right body controller: a208 service allowed";
CM_ SG_ 2011 VCRIGHT_a208_winchAllowed "Right body controller: a208 winch allowed";
CM_ SG_ 2011 VCRIGHT_a208_winchReleaseAllowed "Right body controller: a208 winch release allowed";
CM_ SG_ 2011 VCRIGHT_a208_parkingAllowed "Right body controller: a208 parking allowed";
CM_ SG_ 2011 VCRIGHT_a208_dynApplyAllowed "Right body controller: a208 dyn apply allowed";
CM_ SG_ 2011 VCRIGHT_a208_releaseAllowed "Right body controller: a208 release allowed";
CM_ SG_ 2011 VCRIGHT_a208_parkPendingAllowed "Right body controller: a208 park pending allowed";
CM_ SG_ 2011 VCRIGHT_a208_wenchPendingAllowed "Right body controller: a208 wench pending allowed";
CM_ SG_ 2011 VCRIGHT_a208_unitStatusEPB "Right body controller: a208 unit status EPB";
CM_ SG_ 2011 VCRIGHT_a208_unitStatusEPBM "Right body controller: a208 unit status EPBM";
CM_ SG_ 2011 VCRIGHT_a209_unknownAllowed "Right body controller: a209 unknown allowed";
CM_ SG_ 2011 VCRIGHT_a209_openAllowed "Right body controller: a209 open allowed";
CM_ SG_ 2011 VCRIGHT_a209_dynamicAllowed "Right body controller: a209 dynamic allowed";
CM_ SG_ 2011 VCRIGHT_a209_parkAllowed "Right body controller: a209 park allowed";
CM_ SG_ 2011 VCRIGHT_a209_startAllowed "Right body controller: a209 start allowed";
CM_ SG_ 2011 VCRIGHT_a209_serviceAllowed "Right body controller: a209 service allowed";
CM_ SG_ 2011 VCRIGHT_a209_winchAllowed "Right body controller: a209 winch allowed";
CM_ SG_ 2011 VCRIGHT_a209_winchReleaseAllowed "Right body controller: a209 winch release allowed";
CM_ SG_ 2011 VCRIGHT_a209_parkingAllowed "Right body controller: a209 parking allowed";
CM_ SG_ 2011 VCRIGHT_a209_dynApplyAllowed "Right body controller: a209 dyn apply allowed";
CM_ SG_ 2011 VCRIGHT_a209_releaseAllowed "Right body controller: a209 release allowed";
CM_ SG_ 2011 VCRIGHT_a209_parkPendingAllowed "Right body controller: a209 park pending allowed";
CM_ SG_ 2011 VCRIGHT_a209_wenchPendingAllowed "Right body controller: a209 wench pending allowed";
CM_ SG_ 2011 VCRIGHT_a209_unitStatusEPB "Right body controller: a209 unit status EPB";
CM_ SG_ 2011 VCRIGHT_a209_unitStatusEPBM "Right body controller: a209 unit status EPBM";
CM_ SG_ 2011 VCRIGHT_a210_unknownAllowed "Right body controller: a210 unknown allowed";
CM_ SG_ 2011 VCRIGHT_a210_openAllowed "Right body controller: a210 open allowed";
CM_ SG_ 2011 VCRIGHT_a210_dynamicAllowed "Right body controller: a210 dynamic allowed";
CM_ SG_ 2011 VCRIGHT_a210_parkAllowed "Right body controller: a210 park allowed";
CM_ SG_ 2011 VCRIGHT_a210_startAllowed "Right body controller: a210 start allowed";
CM_ SG_ 2011 VCRIGHT_a210_serviceAllowed "Right body controller: a210 service allowed";
CM_ SG_ 2011 VCRIGHT_a210_winchAllowed "Right body controller: a210 winch allowed";
CM_ SG_ 2011 VCRIGHT_a210_winchReleaseAllowed "Right body controller: a210 winch release allowed";
CM_ SG_ 2011 VCRIGHT_a210_parkingAllowed "Right body controller: a210 parking allowed";
CM_ SG_ 2011 VCRIGHT_a210_dynApplyAllowed "Right body controller: a210 dyn apply allowed";
CM_ SG_ 2011 VCRIGHT_a210_releaseAllowed "Right body controller: a210 release allowed";
CM_ SG_ 2011 VCRIGHT_a210_parkPendingAllowed "Right body controller: a210 park pending allowed";
CM_ SG_ 2011 VCRIGHT_a210_wenchPendingAllowed "Right body controller: a210 wench pending allowed";
CM_ SG_ 2011 VCRIGHT_a210_unitStatusEPB "Right body controller: a210 unit status EPB";
CM_ SG_ 2011 VCRIGHT_a210_unitStatusEPBM "Right body controller: a210 unit status EPBM";
CM_ SG_ 2011 VCRIGHT_a221_vbatProtVoltage "Right body controller: a221 vbat prot voltage";
CM_ SG_ 2011 VCRIGHT_a221_vbatProtCurrent "Right body controller: a221 vbat prot current";
CM_ SG_ 2011 VCRIGHT_a221_uvLoadshedVoltage "Right body controller: a221 uv loadshed voltage";
CM_ SG_ 2011 VCRIGHT_a221_uvLoadshedFromFront "Right body controller: a221 uv loadshed from front monitor";
CM_ SG_ 2011 VCRIGHT_a221_faultInjectActive "Right body controller: a221 fault inject active";
CM_ SG_ 2011 VCRIGHT_a221_uvResetActive "Right body controller: a221 uv reset active";
CM_ SG_ 2011 VCRIGHT_a221_uvLoadshedArmPrimar "Right body controller: a221 uv loadshed arm primary";
CM_ SG_ 2011 VCRIGHT_a224_seatMotorCalibrated "Right body controller: a224 seat motor calibrated";
CM_ SG_ 2011 VCRIGHT_a224_seatMotorCurrent "Right body controller: a224 seat motor current";
CM_ SG_ 2011 VCRIGHT_a224_seatMotorState "Right body controller: a224 seat motor state";
CM_ SG_ 2011 VCRIGHT_a224_seatSwitchBack "Right body controller: a224 seat switch back; raw 0 = signal not available (SNA)";
CM_ SG_ 2011 VCRIGHT_a224_seatSwitchForward "Right body controller: a224 seat switch forward; raw 0 = signal not available (SNA)";
CM_ SG_ 2011 VCRIGHT_a225_seatMotorCalibrated "Right body controller: a225 seat motor calibrated";
CM_ SG_ 2011 VCRIGHT_a225_seatMotorCurrent "Right body controller: a225 seat motor current";
CM_ SG_ 2011 VCRIGHT_a225_seatMotorState "Right body controller: a225 seat motor state";
CM_ SG_ 2011 VCRIGHT_a225_seatSwitchBack "Right body controller: a225 seat switch back; raw 0 = signal not available (SNA)";
CM_ SG_ 2011 VCRIGHT_a225_seatSwitchForward "Right body controller: a225 seat switch forward; raw 0 = signal not available (SNA)";
CM_ SG_ 2011 VCRIGHT_a226_seatMotorCalibrated "Right body controller: a226 seat motor calibrated";
CM_ SG_ 2011 VCRIGHT_a226_seatMotorCurrent "Right body controller: a226 seat motor current";
CM_ SG_ 2011 VCRIGHT_a226_seatMotorState "Right body controller: a226 seat motor state";
CM_ SG_ 2011 VCRIGHT_a226_seatSwitchBack "Right body controller: a226 seat switch back; raw 0 = signal not available (SNA)";
CM_ SG_ 2011 VCRIGHT_a226_seatSwitchForward "Right body controller: a226 seat switch forward; raw 0 = signal not available (SNA)";
CM_ SG_ 2011 VCRIGHT_a227_seatMotorCalibrated "Right body controller: a227 seat motor calibrated";
CM_ SG_ 2011 VCRIGHT_a227_seatMotorCurrent "Right body controller: a227 seat motor current";
CM_ SG_ 2011 VCRIGHT_a227_seatMotorState "Right body controller: a227 seat motor state";
CM_ SG_ 2011 VCRIGHT_a227_seatSwitchBack "Right body controller: a227 seat switch back; raw 0 = signal not available (SNA)";
CM_ SG_ 2011 VCRIGHT_a227_seatSwitchForward "Right body controller: a227 seat switch forward; raw 0 = signal not available (SNA)";
CM_ SG_ 2011 VCRIGHT_a228_seatMotorCalibrated "Right body controller: a228 seat motor calibrated";
CM_ SG_ 2011 VCRIGHT_a228_seatMotorCurrent "Right body controller: a228 seat motor current";
CM_ SG_ 2011 VCRIGHT_a228_seatMotorPosReal "Right body controller: a228 seat motor pos real";
CM_ SG_ 2011 VCRIGHT_a228_seatMotorState "Right body controller: a228 seat motor state";
CM_ SG_ 2011 VCRIGHT_a228_seatSwitchBack "Right body controller: a228 seat switch back; raw 0 = signal not available (SNA)";
CM_ SG_ 2011 VCRIGHT_a228_seatSwitchForward "Right body controller: a228 seat switch forward; raw 0 = signal not available (SNA)";
CM_ SG_ 2011 VCRIGHT_a229_seatMotorCalibrated "Right body controller: a229 seat motor calibrated";
CM_ SG_ 2011 VCRIGHT_a229_seatMotorCurrent "Right body controller: a229 seat motor current";
CM_ SG_ 2011 VCRIGHT_a229_seatMotorPosReal "Right body controller: a229 seat motor pos real";
CM_ SG_ 2011 VCRIGHT_a229_seatMotorState "Right body controller: a229 seat motor state";
CM_ SG_ 2011 VCRIGHT_a229_seatSwitchBack "Right body controller: a229 seat switch back; raw 0 = signal not available (SNA)";
CM_ SG_ 2011 VCRIGHT_a229_seatSwitchForward "Right body controller: a229 seat switch forward; raw 0 = signal not available (SNA)";
CM_ SG_ 2011 VCRIGHT_a230_seatMotorCalibrated "Right body controller: a230 seat motor calibrated";
CM_ SG_ 2011 VCRIGHT_a230_seatMotorCurrent "Right body controller: a230 seat motor current";
CM_ SG_ 2011 VCRIGHT_a230_seatMotorPosReal "Right body controller: a230 seat motor pos real";
CM_ SG_ 2011 VCRIGHT_a230_seatMotorState "Right body controller: a230 seat motor state";
CM_ SG_ 2011 VCRIGHT_a230_seatSwitchBack "Right body controller: a230 seat switch back; raw 0 = signal not available (SNA)";
CM_ SG_ 2011 VCRIGHT_a230_seatSwitchForward "Right body controller: a230 seat switch forward; raw 0 = signal not available (SNA)";
CM_ SG_ 2011 VCRIGHT_a231_seatMotorCalibrated "Right body controller: a231 seat motor calibrated";
CM_ SG_ 2011 VCRIGHT_a231_seatMotorCurrent "Right body controller: a231 seat motor current";
CM_ SG_ 2011 VCRIGHT_a231_seatMotorPosReal "Right body controller: a231 seat motor pos real";
CM_ SG_ 2011 VCRIGHT_a231_seatMotorState "Right body controller: a231 seat motor state";
CM_ SG_ 2011 VCRIGHT_a231_seatSwitchBack "Right body controller: a231 seat switch back; raw 0 = signal not available (SNA)";
CM_ SG_ 2011 VCRIGHT_a231_seatSwitchForward "Right body controller: a231 seat switch forward; raw 0 = signal not available (SNA)";
CM_ SG_ 2011 VCRIGHT_a232_seatMotorCurrent "Right body controller: a232 seat motor current";
CM_ SG_ 2011 VCRIGHT_a232_seatMotorPosReal "Right body controller: a232 seat motor pos real";
CM_ SG_ 2011 VCRIGHT_a232_seatMotorState "Right body controller: a232 seat motor state";
CM_ SG_ 2011 VCRIGHT_a232_seatSwitchBack "Right body controller: a232 seat switch back; raw 0 = signal not available (SNA)";
CM_ SG_ 2011 VCRIGHT_a232_seatSwitchForward "Right body controller: a232 seat switch forward; raw 0 = signal not available (SNA)";
CM_ SG_ 2011 VCRIGHT_a233_seatMotorCurrent "Right body controller: a233 seat motor current";
CM_ SG_ 2011 VCRIGHT_a233_seatMotorPosReal "Right body controller: a233 seat motor pos real";
CM_ SG_ 2011 VCRIGHT_a233_seatMotorState "Right body controller: a233 seat motor state";
CM_ SG_ 2011 VCRIGHT_a233_seatSwitchBack "Right body controller: a233 seat switch back; raw 0 = signal not available (SNA)";
CM_ SG_ 2011 VCRIGHT_a233_seatSwitchForward "Right body controller: a233 seat switch forward; raw 0 = signal not available (SNA)";
CM_ SG_ 2011 VCRIGHT_a234_seatMotorCurrent "Right body controller: a234 seat motor current";
CM_ SG_ 2011 VCRIGHT_a234_seatMotorPosReal "Right body controller: a234 seat motor pos real";
CM_ SG_ 2011 VCRIGHT_a234_seatMotorState "Right body controller: a234 seat motor state";
CM_ SG_ 2011 VCRIGHT_a234_seatSwitchBack "Right body controller: a234 seat switch back; raw 0 = signal not available (SNA)";
CM_ SG_ 2011 VCRIGHT_a234_seatSwitchForward "Right body controller: a234 seat switch forward; raw 0 = signal not available (SNA)";
CM_ SG_ 2011 VCRIGHT_a235_seatMotorCurrent "Right body controller: a235 seat motor current";
CM_ SG_ 2011 VCRIGHT_a235_seatMotorPosReal "Right body controller: a235 seat motor pos real";
CM_ SG_ 2011 VCRIGHT_a235_seatMotorState "Right body controller: a235 seat motor state";
CM_ SG_ 2011 VCRIGHT_a235_seatSwitchBack "Right body controller: a235 seat switch back; raw 0 = signal not available (SNA)";
CM_ SG_ 2011 VCRIGHT_a235_seatSwitchForward "Right body controller: a235 seat switch forward; raw 0 = signal not available (SNA)";
CM_ SG_ 2011 VCRIGHT_a236_lumbarAPressureHpa "Right body controller: a236 lumbar a pressure hpa";
CM_ SG_ 2011 VCRIGHT_a236_lumbarBPressureHpa "Right body controller: a236 lumbar b pressure hpa";
CM_ SG_ 2011 VCRIGHT_a236_lumbarDiagStatus "Right body controller: a236 lumbar diag status";
CM_ SG_ 2011 VCRIGHT_a236_lumbarAState "Right body controller: a236 lumbar a state";
CM_ SG_ 2011 VCRIGHT_a236_lumbarBState "Right body controller: a236 lumbar b state";
CM_ SG_ 2011 VCRIGHT_a237_lumbarAPressureHpa "Right body controller: a237 lumbar a pressure hpa";
CM_ SG_ 2011 VCRIGHT_a237_lumbarBPressureHpa "Right body controller: a237 lumbar b pressure hpa";
CM_ SG_ 2011 VCRIGHT_a237_lumbarDiagStatus "Right body controller: a237 lumbar diag status";
CM_ SG_ 2011 VCRIGHT_a237_lumbarAState "Right body controller: a237 lumbar a state";
CM_ SG_ 2011 VCRIGHT_a237_lumbarBState "Right body controller: a237 lumbar b state";
CM_ SG_ 2011 VCRIGHT_a238_lumbarAPressureHpa "Right body controller: a238 lumbar a pressure hpa";
CM_ SG_ 2011 VCRIGHT_a238_lumbarBPressureHpa "Right body controller: a238 lumbar b pressure hpa";
CM_ SG_ 2011 VCRIGHT_a238_lumbarDiagStatus "Right body controller: a238 lumbar diag status";
CM_ SG_ 2011 VCRIGHT_a238_lumbarAState "Right body controller: a238 lumbar a state";
CM_ SG_ 2011 VCRIGHT_a238_lumbarBState "Right body controller: a238 lumbar b state";
CM_ SG_ 2011 VCRIGHT_a239_seatHeatCurrent "Right body controller: a239 seat heat current";
CM_ SG_ 2011 VCRIGHT_a239_seatHeatTmp "Right body controller: a239 seat heat tmp";
CM_ SG_ 2011 VCRIGHT_a239_seatHeatTmpTarget "Right body controller: a239 seat heat tmp target";
CM_ SG_ 2011 VCRIGHT_a240_seatHeatCurrent "Right body controller: a240 seat heat current";
CM_ SG_ 2011 VCRIGHT_a240_seatHeatTmp "Right body controller: a240 seat heat tmp";
CM_ SG_ 2011 VCRIGHT_a241_seatHeatCurrent "Right body controller: a241 seat heat current";
CM_ SG_ 2011 VCRIGHT_a241_seatHeatTmp "Right body controller: a241 seat heat tmp";
CM_ SG_ 2011 VCRIGHT_a241_cushion "Right body controller: a241 cushion";
CM_ SG_ 2011 VCRIGHT_a241_backrest "Right body controller: a241 backrest";
CM_ SG_ 2011 VCRIGHT_a242_seatHeatCurrent "Right body controller: a242 seat heat current";
CM_ SG_ 2011 VCRIGHT_a242_seatHeatTmp "Right body controller: a242 seat heat tmp";
CM_ SG_ 2011 VCRIGHT_a242_seatHeatTmpTarget "Right body controller: a242 seat heat tmp target";
CM_ SG_ 2011 VCRIGHT_a243_seatHeatCurrent "Right body controller: a243 seat heat current";
CM_ SG_ 2011 VCRIGHT_a243_seatHeatTmp "Right body controller: a243 seat heat tmp";
CM_ SG_ 2011 VCRIGHT_a244_seatHeatCurrent "Right body controller: a244 seat heat current";
CM_ SG_ 2011 VCRIGHT_a244_seatHeatTmp "Right body controller: a244 seat heat tmp";
CM_ SG_ 2011 VCRIGHT_a244_cushion "Right body controller: a244 cushion";
CM_ SG_ 2011 VCRIGHT_a244_backrest "Right body controller: a244 backrest";
CM_ SG_ 2011 VCRIGHT_a245_seatHeatCurrent "Right body controller: a245 seat heat current";
CM_ SG_ 2011 VCRIGHT_a245_seatHeatTmp "Right body controller: a245 seat heat tmp";
CM_ SG_ 2011 VCRIGHT_a245_seatHeatTmpTarget "Right body controller: a245 seat heat tmp target";
CM_ SG_ 2011 VCRIGHT_a246_seatHeatCurrent "Right body controller: a246 seat heat current";
CM_ SG_ 2011 VCRIGHT_a246_seatHeatTmp "Right body controller: a246 seat heat tmp";
CM_ SG_ 2011 VCRIGHT_a247_seatHeatCurrent "Right body controller: a247 seat heat current";
CM_ SG_ 2011 VCRIGHT_a247_seatHeatTmp "Right body controller: a247 seat heat tmp";
CM_ SG_ 2011 VCRIGHT_a247_cushion "Right body controller: a247 cushion";
CM_ SG_ 2011 VCRIGHT_a247_backrest "Right body controller: a247 backrest";
CM_ SG_ 2011 VCRIGHT_a248_seatHeatCurrent "Right body controller: a248 seat heat current";
CM_ SG_ 2011 VCRIGHT_a248_seatHeatTmp "Right body controller: a248 seat heat tmp";
CM_ SG_ 2011 VCRIGHT_a248_seatHeatTmpTarget "Right body controller: a248 seat heat tmp target";
CM_ SG_ 2011 VCRIGHT_a249_seatHeatCurrent "Right body controller: a249 seat heat current";
CM_ SG_ 2011 VCRIGHT_a249_seatHeatTmp "Right body controller: a249 seat heat tmp";
CM_ SG_ 2011 VCRIGHT_a250_seatHeatCurrent "Right body controller: a250 seat heat current";
CM_ SG_ 2011 VCRIGHT_a250_seatHeatTmp "Right body controller: a250 seat heat tmp";
CM_ SG_ 2011 VCRIGHT_a250_cushion "Right body controller: a250 cushion";
CM_ SG_ 2011 VCRIGHT_a250_backrest "Right body controller: a250 backrest";
CM_ SG_ 2011 VCRIGHT_a251_seatMotorCurrent "Right body controller: a251 seat motor current";
CM_ SG_ 2011 VCRIGHT_a251_seatMotorPosReal "Right body controller: a251 seat motor pos real";
CM_ SG_ 2011 VCRIGHT_a251_seatMotorState "Right body controller: a251 seat motor state";
CM_ SG_ 2011 VCRIGHT_a251_seatSwitchBack "Right body controller: a251 seat switch back; raw 0 = signal not available (SNA)";
CM_ SG_ 2011 VCRIGHT_a251_seatSwitchForward "Right body controller: a251 seat switch forward; raw 0 = signal not available (SNA)";
CM_ SG_ 2011 VCRIGHT_a252_seatMotorCurrent "Right body controller: a252 seat motor current";
CM_ SG_ 2011 VCRIGHT_a252_seatMotorPosReal "Right body controller: a252 seat motor pos real";
CM_ SG_ 2011 VCRIGHT_a252_seatMotorState "Right body controller: a252 seat motor state";
CM_ SG_ 2011 VCRIGHT_a252_seatSwitchBack "Right body controller: a252 seat switch back; raw 0 = signal not available (SNA)";
CM_ SG_ 2011 VCRIGHT_a252_seatSwitchForward "Right body controller: a252 seat switch forward; raw 0 = signal not available (SNA)";
CM_ SG_ 2011 VCRIGHT_a253_seatMotorCurrent "Right body controller: a253 seat motor current";
CM_ SG_ 2011 VCRIGHT_a253_seatMotorPosReal "Right body controller: a253 seat motor pos real";
CM_ SG_ 2011 VCRIGHT_a253_seatMotorState "Right body controller: a253 seat motor state";
CM_ SG_ 2011 VCRIGHT_a253_seatSwitchBack "Right body controller: a253 seat switch back; raw 0 = signal not available (SNA)";
CM_ SG_ 2011 VCRIGHT_a253_seatSwitchForward "Right body controller: a253 seat switch forward; raw 0 = signal not available (SNA)";
CM_ SG_ 2011 VCRIGHT_a254_seatMotorCurrent "Right body controller: a254 seat motor current";
CM_ SG_ 2011 VCRIGHT_a254_seatMotorPosReal "Right body controller: a254 seat motor pos real";
CM_ SG_ 2011 VCRIGHT_a254_seatMotorState "Right body controller: a254 seat motor state";
CM_ SG_ 2011 VCRIGHT_a254_seatSwitchBack "Right body controller: a254 seat switch back; raw 0 = signal not available (SNA)";
CM_ SG_ 2011 VCRIGHT_a254_seatSwitchForward "Right body controller: a254 seat switch forward; raw 0 = signal not available (SNA)";
CM_ SG_ 2011 VCRIGHT_a255_leftIGBTTemp "Right body controller: a255 left IGBT temp";
CM_ SG_ 2011 VCRIGHT_a255_rightIGBTTemp "Right body controller: a255 right IGBT temp";
CM_ SG_ 2011 VCRIGHT_a255_OCPTemp "Right body controller: a255 OCP temp";
CM_ SG_ 2011 VCRIGHT_a255_PCBTemp "Right body controller: a255 PCB temp";
CM_ SG_ 2011 VCRIGHT_a256_leftCurrent "Right body controller: a256 left current";
CM_ SG_ 2011 VCRIGHT_a256_rightCurrent "Right body controller: a256 right current";
CM_ SG_ 2011 VCRIGHT_a257_MIAStatus "Right body controller: a257 MIA status";
CM_ SG_ 2011 VCRIGHT_a258_bootIdFreq "Right body controller: a258 boot id freq";
CM_ SG_ 2011 VCRIGHT_a262_LVLow "Right body controller: a262 LV low";
CM_ SG_ 2011 VCRIGHT_a262_LVHigh "Right body controller: a262 LV high";
CM_ SG_ 2011 VCRIGHT_a262_HVLow "Right body controller: a262 HV low";
CM_ SG_ 2011 VCRIGHT_a262_HVHigh "Right body controller: a262 HV high";
CM_ SG_ 2011 VCRIGHT_a262_LeftOverCurrent "Right body controller: a262 left over current";
CM_ SG_ 2011 VCRIGHT_a262_RightOverCurrent "Right body controller: a262 right over current";
CM_ SG_ 2011 VCRIGHT_a262_LeftShutOutlet "Right body controller: a262 left shut outlet";
CM_ SG_ 2011 VCRIGHT_a262_RightShutOutlet "Right body controller: a262 right shut outlet";
CM_ SG_ 2011 VCRIGHT_a262_ThermalShutPCB "Right body controller: a262 thermal shut PCB";
CM_ SG_ 2011 VCRIGHT_a262_LeftThermalShutIGBT "Right body controller: a262 left thermal shut IGBT";
CM_ SG_ 2011 VCRIGHT_a262_RightThermalShutIGB "Right body controller: a262 right thermal shut IGBT";
CM_ SG_ 2011 VCRIGHT_a262_CANTimeout "Right body controller: a262 CAN timeout";
CM_ SG_ 2011 VCRIGHT_a262_LowVoltageSensor "Right body controller: a262 low voltage sensor";
CM_ SG_ 2011 VCRIGHT_a262_HighVoltageSensor "Right body controller: a262 high voltage sensor";
CM_ SG_ 2011 VCRIGHT_a262_LeftCurrentHVSensor "Right body controller: a262 left current HV sensor";
CM_ SG_ 2011 VCRIGHT_a262_RightCurrentHVSenso "Right body controller: a262 right current HV sensor";
CM_ SG_ 2011 VCRIGHT_a262_LeftTempIGBT "Right body controller: a262 left temp IGBT";
CM_ SG_ 2011 VCRIGHT_a262_TempOCP "Right body controller: a262 temp OCP";
CM_ SG_ 2011 VCRIGHT_a262_RightTempIGBT "Right body controller: a262 right temp IGBT";
CM_ SG_ 2011 VCRIGHT_a262_TempPCB "Right body controller: a262 temp PCB";
CM_ SG_ 2011 VCRIGHT_a262_LeftIGBTShort "Right body controller: a262 left IGBT short";
CM_ SG_ 2011 VCRIGHT_a262_RightIGBTShort "Right body controller: a262 right IGBT short";
CM_ SG_ 2011 VCRIGHT_a262_IGBTDriverTemporary "Right body controller: a262 IGBT driver temporary";
CM_ SG_ 2011 VCRIGHT_a262_IGBTDriverPermanent "Right body controller: a262 IGBT driver permanent";
CM_ SG_ 2011 VCRIGHT_a262_LeftIGBTOpen "Right body controller: a262 left IGBT open";
CM_ SG_ 2011 VCRIGHT_a262_RightIGBTOpen "Right body controller: a262 right IGBT open";
CM_ SG_ 2011 VCRIGHT_a263_seatMotorCurrent "Right body controller: a263 seat motor current";
CM_ SG_ 2011 VCRIGHT_a263_seatMotorDCurrent "Right body controller: a263 seat motor d current";
CM_ SG_ 2011 VCRIGHT_a263_seatMotorPosReal "Right body controller: a263 seat motor pos real";
CM_ SG_ 2011 VCRIGHT_a263_seatMotorState "Right body controller: a263 seat motor state";
CM_ SG_ 2011 VCRIGHT_a264_seatMotorCurrent "Right body controller: a264 seat motor current";
CM_ SG_ 2011 VCRIGHT_a264_seatMotorDCurrent "Right body controller: a264 seat motor d current";
CM_ SG_ 2011 VCRIGHT_a264_seatMotorPosReal "Right body controller: a264 seat motor pos real";
CM_ SG_ 2011 VCRIGHT_a264_seatMotorState "Right body controller: a264 seat motor state";
CM_ SG_ 2011 VCRIGHT_a265_seatMotorCurrent "Right body controller: a265 seat motor current";
CM_ SG_ 2011 VCRIGHT_a265_seatMotorDCurrent "Right body controller: a265 seat motor d current";
CM_ SG_ 2011 VCRIGHT_a265_seatMotorPosReal "Right body controller: a265 seat motor pos real";
CM_ SG_ 2011 VCRIGHT_a265_seatMotorState "Right body controller: a265 seat motor state";
CM_ SG_ 2011 VCRIGHT_a266_seatMotorCurrent "Right body controller: a266 seat motor current";
CM_ SG_ 2011 VCRIGHT_a266_seatMotorDCurrent "Right body controller: a266 seat motor d current";
CM_ SG_ 2011 VCRIGHT_a266_seatMotorPosReal "Right body controller: a266 seat motor pos real";
CM_ SG_ 2011 VCRIGHT_a266_seatMotorState "Right body controller: a266 seat motor state";
CM_ SG_ 2011 VCRIGHT_a267_seatMotorCurrent "Right body controller: a267 seat motor current";
CM_ SG_ 2011 VCRIGHT_a267_seatMotorDCurrent "Right body controller: a267 seat motor d current";
CM_ SG_ 2011 VCRIGHT_a267_seatMotorPosReal "Right body controller: a267 seat motor pos real";
CM_ SG_ 2011 VCRIGHT_a267_seatMotorState "Right body controller: a267 seat motor state";
CM_ SG_ 2011 VCRIGHT_a268_seatMotorCurrent "Right body controller: a268 seat motor current";
CM_ SG_ 2011 VCRIGHT_a268_seatMotorDCurrent "Right body controller: a268 seat motor d current";
CM_ SG_ 2011 VCRIGHT_a268_seatMotorPosReal "Right body controller: a268 seat motor pos real";
CM_ SG_ 2011 VCRIGHT_a268_seatMotorState "Right body controller: a268 seat motor state";
CM_ SG_ 2011 VCRIGHT_a269_seatMotorCurrent "Right body controller: a269 seat motor current";
CM_ SG_ 2011 VCRIGHT_a269_seatMotorDCurrent "Right body controller: a269 seat motor d current";
CM_ SG_ 2011 VCRIGHT_a269_seatMotorPosReal "Right body controller: a269 seat motor pos real";
CM_ SG_ 2011 VCRIGHT_a269_seatMotorState "Right body controller: a269 seat motor state";
CM_ SG_ 2011 VCRIGHT_a270_seatMotorCurrent "Right body controller: a270 seat motor current";
CM_ SG_ 2011 VCRIGHT_a270_seatMotorDCurrent "Right body controller: a270 seat motor d current";
CM_ SG_ 2011 VCRIGHT_a270_seatMotorPosReal "Right body controller: a270 seat motor pos real";
CM_ SG_ 2011 VCRIGHT_a270_seatMotorState "Right body controller: a270 seat motor state";
CM_ SG_ 2011 VCRIGHT_a271_humiditySensorSNA "Right body controller: a271 humidity sensor SNA";
CM_ SG_ 2011 VCRIGHT_a271_temperatureSensorSN "Right body controller: a271 temperature sensor SNA";
CM_ SG_ 2011 VCRIGHT_a271_solarVisSensorSNA "Right body controller: a271 solar vis sensor SNA";
CM_ SG_ 2011 VCRIGHT_a271_solarInfSensorSNA "Right body controller: a271 solar inf sensor SNA";
CM_ SG_ 2011 VCRIGHT_a273_handlePWM "Right body controller: a273 handle PWM";
CM_ SG_ 2011 VCRIGHT_a273_temperature "Right body controller: a273 temperature";
CM_ SG_ 2011 VCRIGHT_a274_handlePWM "Right body controller: a274 handle PWM";
CM_ SG_ 2011 VCRIGHT_a274_temperature "Right body controller: a274 temperature";
CM_ SG_ 2011 VCRIGHT_a275_outputFaulted "Right body controller: a275 output faulted";
CM_ SG_ 2011 VCRIGHT_a275_currentSenseFaulted "Right body controller: a275 current sense faulted";
CM_ SG_ 2011 VCRIGHT_a275_tempSenseFaulted "Right body controller: a275 temp sense faulted";
CM_ SG_ 2011 VCRIGHT_a275_underCurrent "Right body controller: a275 under current";
CM_ SG_ 2011 VCRIGHT_a275_overCurrent "Right body controller: a275 over current";
CM_ SG_ 2011 VCRIGHT_a275_overTemperature "Right body controller: a275 over temperature";
CM_ SG_ 2011 VCRIGHT_a278_HVLow "Right body controller: a278 HV low";
CM_ SG_ 2011 VCRIGHT_a278_PTCMIA "Right body controller: a278 PTCMIA";
CM_ SG_ 2011 VCRIGHT_a282_voltage "Right body controller: a282 voltage";
CM_ SG_ 2011 VCRIGHT_a282_temperature "Right body controller: a282 temperature";
CM_ SG_ 2011 VCRIGHT_a283_voltage "Right body controller: a283 voltage";
CM_ SG_ 2011 VCRIGHT_a283_temperature "Right body controller: a283 temperature";
CM_ SG_ 2011 VCRIGHT_a284_gloveboxMinCurrent "Right body controller: a284 glovebox min current";
CM_ SG_ 2011 VCRIGHT_a284_gloveboxMaxCurrent "Right body controller: a284 glovebox max current";
CM_ SG_ 2011 VCRIGHT_a284_cabinTempInterior "Right body controller: a284 cabin temp interior; raw 255 = signal not available (SNA)";
CM_ SG_ 2011 VCRIGHT_a285_gloveboxMinCurrent "Right body controller: a285 glovebox min current";
CM_ SG_ 2011 VCRIGHT_a285_gloveboxMaxCurrent "Right body controller: a285 glovebox max current";
CM_ SG_ 2011 VCRIGHT_a285_cabinTempInterior "Right body controller: a285 cabin temp interior; raw 255 = signal not available (SNA)";
CM_ SG_ 2011 VCRIGHT_a290_isNetworkSwitch "Right body controller: a290 is network switch";
CM_ SG_ 2011 VCRIGHT_a290_occupancySensorV "Right body controller: a290 occupancy sensor v";
CM_ SG_ 2011 VCRIGHT_a290_railVoltage "Right body controller: a290 rail voltage";
CM_ SG_ 2011 VCRIGHT_a291_buckleSensorVoltage "Right body controller: a291 buckle sensor voltage";
CM_ SG_ 2011 VCRIGHT_a291_railVoltage "Right body controller: a291 rail voltage";
CM_ SG_ 2011 VCRIGHT_a292_buckleSensorVoltage "Right body controller: a292 buckle sensor voltage";
CM_ SG_ 2011 VCRIGHT_a292_railV "Right body controller: a292 rail v";
CM_ SG_ 2011 VCRIGHT_a293_buckleSensorVoltage "Right body controller: a293 buckle sensor voltage";
CM_ SG_ 2011 VCRIGHT_a293_railV "Right body controller: a293 rail v";
CM_ SG_ 2011 VCRIGHT_a294_isNetworkSwitch "Right body controller: a294 is network switch";
CM_ SG_ 2011 VCRIGHT_a294_occupancySensorV "Right body controller: a294 occupancy sensor v";
CM_ SG_ 2011 VCRIGHT_a294_railV "Right body controller: a294 rail v";
CM_ SG_ 2011 VCRIGHT_a295_isNetworkSwitch "Right body controller: a295 is network switch";
CM_ SG_ 2011 VCRIGHT_a295_occupancySensorV "Right body controller: a295 occupancy sensor v";
CM_ SG_ 2011 VCRIGHT_a295_railV "Right body controller: a295 rail v";
CM_ SG_ 2011 VCRIGHT_a296_isNetworkSwitch "Right body controller: a296 is network switch";
CM_ SG_ 2011 VCRIGHT_a296_occupancySensorV "Right body controller: a296 occupancy sensor v";
CM_ SG_ 2011 VCRIGHT_a296_railV "Right body controller: a296 rail v";
CM_ SG_ 2011 VCRIGHT_a297_cabinTmp "Right body controller: a297 cabin tmp";
CM_ SG_ 2011 VCRIGHT_a298_buckleSensorVoltage "Right body controller: a298 buckle sensor voltage";
CM_ SG_ 2011 VCRIGHT_a298_railV "Right body controller: a298 rail v";
CM_ SG_ 2011 VCRIGHT_a299_buckleSensorVoltage "Right body controller: a299 buckle sensor voltage";
CM_ SG_ 2011 VCRIGHT_a299_railV "Right body controller: a299 rail v";
CM_ SG_ 2011 VCRIGHT_a302_calibrationPositive "Right body controller: a302 calibration positive direction";
CM_ SG_ 2011 VCRIGHT_a302_calibrationNegative "Right body controller: a302 calibration negative direction";
CM_ SG_ 2011 VCRIGHT_a302_uncalibrated "Right body controller: a302 uncalibrated";
CM_ SG_ 2011 VCRIGHT_a302_driverFault "Right body controller: a302 driver fault";
CM_ SG_ 2011 VCRIGHT_a302_connected "Right body controller: a302 connected";
CM_ SG_ 2011 VCRIGHT_a302_targetMissed "Right body controller: a302 target missed";
CM_ SG_ 2011 VCRIGHT_a302_positionTarget "Right body controller: a302 position target";
CM_ SG_ 2011 VCRIGHT_a302_positionActual "Right body controller: a302 position actual";
CM_ SG_ 2011 VCRIGHT_a303_eFuseTripCount "Right body controller: a303 e fuse trip count";
CM_ SG_ 2011 VCRIGHT_a306_disconnectedTime "Right body controller: a306 disconnected time";
CM_ SG_ 2011 VCRIGHT_a307_disconnectedTime "Right body controller: a307 disconnected time";
CM_ SG_ 2011 VCRIGHT_a308_calibrationPositive "Right body controller: a308 calibration positive direction";
CM_ SG_ 2011 VCRIGHT_a308_calibrationNegative "Right body controller: a308 calibration negative direction";
CM_ SG_ 2011 VCRIGHT_a308_uncalibrated "Right body controller: a308 uncalibrated";
CM_ SG_ 2011 VCRIGHT_a308_driverFault "Right body controller: a308 driver fault";
CM_ SG_ 2011 VCRIGHT_a308_connected "Right body controller: a308 connected";
CM_ SG_ 2011 VCRIGHT_a308_targetMissed "Right body controller: a308 target missed";
CM_ SG_ 2011 VCRIGHT_a308_positionTarget "Right body controller: a308 position target";
CM_ SG_ 2011 VCRIGHT_a308_positionActual "Right body controller: a308 position actual";
CM_ SG_ 2011 VCRIGHT_a310_mirrorFoldTime "Right body controller: a310 mirror fold time";
CM_ SG_ 2011 VCRIGHT_a310_foldingDirection "Right body controller: a310 folding direction";
CM_ SG_ 2011 VCRIGHT_a310_mirrorMaxFoldCurren "Right body controller: a310 mirror max fold current";
CM_ SG_ 2011 VCRIGHT_a310_ambientTemperature "Right body controller: a310 ambient temperature; raw 0 = signal not available (SNA)";
CM_ SG_ 2011 VCRIGHT_a311_outputFaulted "Right body controller: a311 output faulted";
CM_ SG_ 2011 VCRIGHT_a311_currentSenseFaulted "Right body controller: a311 current sense faulted";
CM_ SG_ 2011 VCRIGHT_a311_tempSenseFaulted "Right body controller: a311 temp sense faulted";
CM_ SG_ 2011 VCRIGHT_a311_underCurrent "Right body controller: a311 under current";
CM_ SG_ 2011 VCRIGHT_a311_overCurrent "Right body controller: a311 over current";
CM_ SG_ 2011 VCRIGHT_a311_overTemperature "Right body controller: a311 over temperature";
CM_ SG_ 2011 VCRIGHT_a312_outputFaulted "Right body controller: a312 output faulted";
CM_ SG_ 2011 VCRIGHT_a312_currentSenseFaulted "Right body controller: a312 current sense faulted";
CM_ SG_ 2011 VCRIGHT_a312_tempSenseFaulted "Right body controller: a312 temp sense faulted";
CM_ SG_ 2011 VCRIGHT_a312_underCurrent "Right body controller: a312 under current";
CM_ SG_ 2011 VCRIGHT_a312_overCurrent "Right body controller: a312 over current";
CM_ SG_ 2011 VCRIGHT_a312_overTemperature "Right body controller: a312 over temperature";
CM_ SG_ 2011 VCRIGHT_a313_outputFaulted "Right body controller: a313 output faulted";
CM_ SG_ 2011 VCRIGHT_a313_currentSenseFaulted "Right body controller: a313 current sense faulted";
CM_ SG_ 2011 VCRIGHT_a313_tempSenseFaulted "Right body controller: a313 temp sense faulted";
CM_ SG_ 2011 VCRIGHT_a313_underCurrent "Right body controller: a313 under current";
CM_ SG_ 2011 VCRIGHT_a313_overCurrent "Right body controller: a313 over current";
CM_ SG_ 2011 VCRIGHT_a313_overTemperature "Right body controller: a313 over temperature";
CM_ SG_ 2011 VCRIGHT_a314_outputFaulted "Right body controller: a314 output faulted";
CM_ SG_ 2011 VCRIGHT_a314_currentSenseFaulted "Right body controller: a314 current sense faulted";
CM_ SG_ 2011 VCRIGHT_a314_tempSenseFaulted "Right body controller: a314 temp sense faulted";
CM_ SG_ 2011 VCRIGHT_a314_underCurrent "Right body controller: a314 under current";
CM_ SG_ 2011 VCRIGHT_a314_overCurrent "Right body controller: a314 over current";
CM_ SG_ 2011 VCRIGHT_a314_overTemperature "Right body controller: a314 over temperature";
CM_ SG_ 2011 VCRIGHT_a315_outputFaulted "Right body controller: a315 output faulted";
CM_ SG_ 2011 VCRIGHT_a315_currentSenseFaulted "Right body controller: a315 current sense faulted";
CM_ SG_ 2011 VCRIGHT_a315_tempSenseFaulted "Right body controller: a315 temp sense faulted";
CM_ SG_ 2011 VCRIGHT_a315_underCurrent "Right body controller: a315 under current";
CM_ SG_ 2011 VCRIGHT_a315_overCurrent "Right body controller: a315 over current";
CM_ SG_ 2011 VCRIGHT_a315_overTemperature "Right body controller: a315 over temperature";
CM_ SG_ 2011 VCRIGHT_a316_foldState "Right body controller: a316 fold state";
CM_ SG_ 2011 VCRIGHT_a316_actuationDurationMs "Right body controller: a316 actuation duration ms";
CM_ SG_ 2011 VCRIGHT_a316_maxCurrentAmps "Right body controller: a316 max current amps";
CM_ SG_ 2011 VCRIGHT_a316_averageCurrentAmps "Right body controller: a316 average current amps";
CM_ SG_ 2011 VCRIGHT_a316_ambientTemperatureD "Right body controller: a316 ambient temperature deg c; raw 0 = signal not available (SNA)";
CM_ SG_ 2011 VCRIGHT_a318_outputFaulted "Right body controller: a318 output faulted";
CM_ SG_ 2011 VCRIGHT_a318_currentSenseFaulted "Right body controller: a318 current sense faulted";
CM_ SG_ 2011 VCRIGHT_a318_tempSenseFaulted "Right body controller: a318 temp sense faulted";
CM_ SG_ 2011 VCRIGHT_a318_underCurrent "Right body controller: a318 under current";
CM_ SG_ 2011 VCRIGHT_a318_overCurrent "Right body controller: a318 over current";
CM_ SG_ 2011 VCRIGHT_a318_overTemperature "Right body controller: a318 over temperature";
CM_ SG_ 2011 VCRIGHT_a319_outputFaulted "Right body controller: a319 output faulted";
CM_ SG_ 2011 VCRIGHT_a319_currentSenseFaulted "Right body controller: a319 current sense faulted";
CM_ SG_ 2011 VCRIGHT_a319_tempSenseFaulted "Right body controller: a319 temp sense faulted";
CM_ SG_ 2011 VCRIGHT_a319_underCurrent "Right body controller: a319 under current";
CM_ SG_ 2011 VCRIGHT_a319_overCurrent "Right body controller: a319 over current";
CM_ SG_ 2011 VCRIGHT_a319_overTemperature "Right body controller: a319 over temperature";
CM_ SG_ 2011 VCRIGHT_a324_mirrorHeatCurrent "Right body controller: a324 mirror heat current";
CM_ SG_ 2011 VCRIGHT_a325_calibrationPositive "Right body controller: a325 calibration positive direction";
CM_ SG_ 2011 VCRIGHT_a325_calibrationNegative "Right body controller: a325 calibration negative direction";
CM_ SG_ 2011 VCRIGHT_a325_uncalibrated "Right body controller: a325 uncalibrated";
CM_ SG_ 2011 VCRIGHT_a325_driverFault "Right body controller: a325 driver fault";
CM_ SG_ 2011 VCRIGHT_a325_connected "Right body controller: a325 connected";
CM_ SG_ 2011 VCRIGHT_a325_targetMissed "Right body controller: a325 target missed";
CM_ SG_ 2011 VCRIGHT_a325_positionTarget "Right body controller: a325 position target";
CM_ SG_ 2011 VCRIGHT_a325_positionActual "Right body controller: a325 position actual";
CM_ SG_ 2011 VCRIGHT_a326_calibrationPositive "Right body controller: a326 calibration positive direction";
CM_ SG_ 2011 VCRIGHT_a326_calibrationNegative "Right body controller: a326 calibration negative direction";
CM_ SG_ 2011 VCRIGHT_a326_uncalibrated "Right body controller: a326 uncalibrated";
CM_ SG_ 2011 VCRIGHT_a326_driverFault "Right body controller: a326 driver fault";
CM_ SG_ 2011 VCRIGHT_a326_connected "Right body controller: a326 connected";
CM_ SG_ 2011 VCRIGHT_a326_targetMissed "Right body controller: a326 target missed";
CM_ SG_ 2011 VCRIGHT_a326_positionTarget "Right body controller: a326 position target";
CM_ SG_ 2011 VCRIGHT_a326_positionActual "Right body controller: a326 position actual";
CM_ SG_ 2011 VCRIGHT_a330_voltage "Right body controller: a330 voltage";
CM_ SG_ 2011 VCRIGHT_a330_maxCurrent "Right body controller: a330 max current";
CM_ SG_ 2011 VCRIGHT_a330_temperature "Right body controller: a330 temperature";
CM_ SG_ 2011 VCRIGHT_a331_voltage "Right body controller: a331 voltage";
CM_ SG_ 2011 VCRIGHT_a331_maxCurrent "Right body controller: a331 max current";
CM_ SG_ 2011 VCRIGHT_a331_temperature "Right body controller: a331 temperature";
CM_ SG_ 2011 VCRIGHT_a343_rearDefrostCurrent "Right body controller: a343 rear defrost current";
CM_ SG_ 2011 VCRIGHT_a343_batteryVoltage "Right body controller: a343 battery voltage";
CM_ SG_ 2011 VCRIGHT_a343_ambientTemperature "Right body controller: a343 ambient temperature";
CM_ SG_ 2011 VCRIGHT_a344_rearDefrostCurrent "Right body controller: a344 rear defrost current";
CM_ SG_ 2011 VCRIGHT_a344_batteryVoltage "Right body controller: a344 battery voltage";
CM_ SG_ 2011 VCRIGHT_a344_ambientTemperature "Right body controller: a344 ambient temperature";
CM_ SG_ 2011 VCRIGHT_a345_PTCTHSGBPwrCurrent "Right body controller: a345 PTCTHSGB pwr current";
CM_ SG_ 2011 VCRIGHT_a368_snsShortCircuit "Right body controller: a368 sns short circuit";
CM_ SG_ 2011 VCRIGHT_a368_snsDisconnect "Right body controller: a368 sns disconnect";
CM_ SG_ 2011 VCRIGHT_a368_snsRateChangeUp "Right body controller: a368 sns rate change up";
CM_ SG_ 2011 VCRIGHT_a368_snsRateChangeDown "Right body controller: a368 sns rate change down";
CM_ SG_ 2011 VCRIGHT_a369_snsShortCircuit "Right body controller: a369 sns short circuit";
CM_ SG_ 2011 VCRIGHT_a369_snsDisconnect "Right body controller: a369 sns disconnect";
CM_ SG_ 2011 VCRIGHT_a369_snsRateChangeUp "Right body controller: a369 sns rate change up";
CM_ SG_ 2011 VCRIGHT_a369_snsRateChangeDown "Right body controller: a369 sns rate change down";
CM_ SG_ 2011 VCRIGHT_a373_windowChannel "Right body controller: a373 window channel";
CM_ SG_ 2011 VCRIGHT_a375_windowFront "Right body controller: a375 window front";
CM_ SG_ 2011 VCRIGHT_a376_2RowSeatTrackActuat "Right body controller: a376 2 row seat track actuator current";
CM_ SG_ 2011 VCRIGHT_a376_2RowSeatTrackA_0001 "Right body controller: a376 2 row seat track actuator duty";
CM_ SG_ 2011 VCRIGHT_a376_2RowSeatEasyEntrySt "Right body controller: a376 2 row seat easy entry state; raw 6 = signal not available (SNA)";
CM_ SG_ 2011 VCRIGHT_a376_2RowSeatTrackPositi "Right body controller: a376 2 row seat track position switch; raw 0 = signal not available (SNA)";
CM_ SG_ 2011 VCRIGHT_a377_snsShortCircuit "Right body controller: a377 sns short circuit";
CM_ SG_ 2011 VCRIGHT_a377_snsDisconnect "Right body controller: a377 sns disconnect";
CM_ SG_ 2011 VCRIGHT_a377_snsRateChangeUp "Right body controller: a377 sns rate change up";
CM_ SG_ 2011 VCRIGHT_a377_snsRateChangeDown "Right body controller: a377 sns rate change down";
CM_ SG_ 2011 VCRIGHT_a378_snsShortCircuit "Right body controller: a378 sns short circuit";
CM_ SG_ 2011 VCRIGHT_a378_snsDisconnect "Right body controller: a378 sns disconnect";
CM_ SG_ 2011 VCRIGHT_a378_snsRateChangeUp "Right body controller: a378 sns rate change up";
CM_ SG_ 2011 VCRIGHT_a378_snsRateChangeDown "Right body controller: a378 sns rate change down";
CM_ SG_ 2011 VCRIGHT_a379_snsShortCircuit "Right body controller: a379 sns short circuit";
CM_ SG_ 2011 VCRIGHT_a379_snsDisconnect "Right body controller: a379 sns disconnect";
CM_ SG_ 2011 VCRIGHT_a379_snsRateChangeUp "Right body controller: a379 sns rate change up";
CM_ SG_ 2011 VCRIGHT_a379_snsRateChangeDown "Right body controller: a379 sns rate change down";
CM_ SG_ 2011 VCRIGHT_a380_outputFaulted "Right body controller: a380 output faulted";
CM_ SG_ 2011 VCRIGHT_a380_currentSenseFaulted "Right body controller: a380 current sense faulted";
CM_ SG_ 2011 VCRIGHT_a380_tempSenseFaulted "Right body controller: a380 temp sense faulted";
CM_ SG_ 2011 VCRIGHT_a380_underCurrent "Right body controller: a380 under current";
CM_ SG_ 2011 VCRIGHT_a380_overCurrent "Right body controller: a380 over current";
CM_ SG_ 2011 VCRIGHT_a380_overTemperature "Right body controller: a380 over temperature";
CM_ SG_ 2011 VCRIGHT_a381_outputFaulted "Right body controller: a381 output faulted";
CM_ SG_ 2011 VCRIGHT_a381_currentSenseFaulted "Right body controller: a381 current sense faulted";
CM_ SG_ 2011 VCRIGHT_a381_tempSenseFaulted "Right body controller: a381 temp sense faulted";
CM_ SG_ 2011 VCRIGHT_a381_underCurrent "Right body controller: a381 under current";
CM_ SG_ 2011 VCRIGHT_a381_overCurrent "Right body controller: a381 over current";
CM_ SG_ 2011 VCRIGHT_a381_overTemperature "Right body controller: a381 over temperature";
CM_ SG_ 2011 VCRIGHT_a382_outputFaulted "Right body controller: a382 output faulted";
CM_ SG_ 2011 VCRIGHT_a382_currentSenseFaulted "Right body controller: a382 current sense faulted";
CM_ SG_ 2011 VCRIGHT_a382_tempSenseFaulted "Right body controller: a382 temp sense faulted";
CM_ SG_ 2011 VCRIGHT_a382_underCurrent "Right body controller: a382 under current";
CM_ SG_ 2011 VCRIGHT_a382_overCurrent "Right body controller: a382 over current";
CM_ SG_ 2011 VCRIGHT_a382_overTemperature "Right body controller: a382 over temperature";
CM_ SG_ 2011 VCRIGHT_a385_current "Right body controller: a385 current";
CM_ SG_ 2011 VCRIGHT_a385_voltage "Right body controller: a385 voltage";
CM_ SG_ 2011 VCRIGHT_a385_resistance "Right body controller: a385 resistance";
CM_ SG_ 2011 VCRIGHT_a385_reason "Right body controller: a385 reason";
CM_ SG_ 2011 VCRIGHT_a406_frame1MIA "Right body controller: a406 frame1 MIA";
CM_ SG_ 2011 VCRIGHT_a406_frame2MIA "Right body controller: a406 frame2 MIA";
CM_ SG_ 2011 VCRIGHT_a407_configMismatch "Right body controller: a407 config mismatch";
CM_ SG_ 2011 VCRIGHT_a407_counterError "Right body controller: a407 counter error";
CM_ SG_ 2011 VCRIGHT_a407_checksumError "Right body controller: a407 checksum error";
CM_ SG_ 2011 VCRIGHT_a407_linResponseError "Right body controller: a407 lin response error";
CM_ SG_ 2011 VCRIGHT_a408_generalError "Right body controller: a408 general error";
CM_ SG_ 2011 VCRIGHT_a408_seatbeltError "Right body controller: a408 seatbelt error";
CM_ SG_ 2011 VCRIGHT_a408_doorError "Right body controller: a408 door error";
CM_ SG_ 2011 VCRIGHT_a408_ALRError "Right body controller: a408 ALR error";
CM_ SG_ 2011 VCRIGHT_a408_pressureError "Right body controller: a408 pressure error";
CM_ SG_ 2011 VCRIGHT_a408_fluidLevelError "Right body controller: a408 fluid level error";
CM_ SG_ 2011 VCRIGHT_a408_temperatureError "Right body controller: a408 temperature error";
CM_ SG_ 2011 VCRIGHT_a408_hardwareInternalErr "Right body controller: a408 hardware internal error";
CM_ SG_ 2011 VCRIGHT_a408_overvoltageError "Right body controller: a408 overvoltage error";
CM_ SG_ 2011 VCRIGHT_a408_overcurrentError "Right body controller: a408 overcurrent error";
CM_ SG_ 2011 VCRIGHT_a408_ignitionError "Right body controller: a408 ignition error";
CM_ SG_ 2011 VCRIGHT_a408_calibrationError "Right body controller: a408 calibration error";
CM_ SG_ 2011 VCRIGHT_a408_trimError "Right body controller: a408 trim error";
CM_ SG_ 2011 VCRIGHT_a411_failureReason "Right body controller: a411 failure reason";
CM_ SG_ 2011 VCRIGHT_a411_loadUnattemptedOnFa "Right body controller: a411 load unattempted on failure";
CM_ SG_ 2011 VCRIGHT_a411_deviceStuckOnFailur "Right body controller: a411 device stuck on failure";
CM_ SG_ 2011 VCRIGHT_a411_uvLoadshedVsenseDig "Right body controller: a411 uv loadshed vsense dig in";
CM_ SG_ 2011 VCRIGHT_a411_uvLoadshedVoltage "Right body controller: a411 uv loadshed voltage";
CM_ SG_ 2011 VCRIGHT_a412_outputFaulted "Right body controller: a412 output faulted";
CM_ SG_ 2011 VCRIGHT_a412_currentSenseFaulted "Right body controller: a412 current sense faulted";
CM_ SG_ 2011 VCRIGHT_a412_tempSenseFaulted "Right body controller: a412 temp sense faulted";
CM_ SG_ 2011 VCRIGHT_a412_underCurrent "Right body controller: a412 under current";
CM_ SG_ 2011 VCRIGHT_a412_overCurrent "Right body controller: a412 over current";
CM_ SG_ 2011 VCRIGHT_a412_overTemperature "Right body controller: a412 over temperature";
CM_ SG_ 2011 VCRIGHT_a413_outputFaulted "Right body controller: a413 output faulted";
CM_ SG_ 2011 VCRIGHT_a413_currentSenseFaulted "Right body controller: a413 current sense faulted";
CM_ SG_ 2011 VCRIGHT_a413_tempSenseFaulted "Right body controller: a413 temp sense faulted";
CM_ SG_ 2011 VCRIGHT_a413_underCurrent "Right body controller: a413 under current";
CM_ SG_ 2011 VCRIGHT_a413_overCurrent "Right body controller: a413 over current";
CM_ SG_ 2011 VCRIGHT_a413_overTemperature "Right body controller: a413 over temperature";
CM_ SG_ 2011 VCRIGHT_a414_outputFaulted "Right body controller: a414 output faulted";
CM_ SG_ 2011 VCRIGHT_a414_currentSenseFaulted "Right body controller: a414 current sense faulted";
CM_ SG_ 2011 VCRIGHT_a414_tempSenseFaulted "Right body controller: a414 temp sense faulted";
CM_ SG_ 2011 VCRIGHT_a414_underCurrent "Right body controller: a414 under current";
CM_ SG_ 2011 VCRIGHT_a414_overCurrent "Right body controller: a414 over current";
CM_ SG_ 2011 VCRIGHT_a414_overTemperature "Right body controller: a414 over temperature";
CM_ SG_ 2011 VCRIGHT_a415_outputFaulted "Right body controller: a415 output faulted";
CM_ SG_ 2011 VCRIGHT_a415_currentSenseFaulted "Right body controller: a415 current sense faulted";
CM_ SG_ 2011 VCRIGHT_a415_tempSenseFaulted "Right body controller: a415 temp sense faulted";
CM_ SG_ 2011 VCRIGHT_a415_underCurrent "Right body controller: a415 under current";
CM_ SG_ 2011 VCRIGHT_a415_overCurrent "Right body controller: a415 over current";
CM_ SG_ 2011 VCRIGHT_a415_overTemperature "Right body controller: a415 over temperature";
CM_ SG_ 2011 VCRIGHT_a416_outputFaulted "Right body controller: a416 output faulted";
CM_ SG_ 2011 VCRIGHT_a416_currentSenseFaulted "Right body controller: a416 current sense faulted";
CM_ SG_ 2011 VCRIGHT_a416_tempSenseFaulted "Right body controller: a416 temp sense faulted";
CM_ SG_ 2011 VCRIGHT_a416_underCurrent "Right body controller: a416 under current";
CM_ SG_ 2011 VCRIGHT_a416_overCurrent "Right body controller: a416 over current";
CM_ SG_ 2011 VCRIGHT_a416_overTemperature "Right body controller: a416 over temperature";
CM_ SG_ 2011 VCRIGHT_a417_outputFaulted "Right body controller: a417 output faulted";
CM_ SG_ 2011 VCRIGHT_a417_currentSenseFaulted "Right body controller: a417 current sense faulted";
CM_ SG_ 2011 VCRIGHT_a417_tempSenseFaulted "Right body controller: a417 temp sense faulted";
CM_ SG_ 2011 VCRIGHT_a417_underCurrent "Right body controller: a417 under current";
CM_ SG_ 2011 VCRIGHT_a417_overCurrent "Right body controller: a417 over current";
CM_ SG_ 2011 VCRIGHT_a417_overTemperature "Right body controller: a417 over temperature";
CM_ SG_ 2011 VCRIGHT_a418_outputFaulted "Right body controller: a418 output faulted";
CM_ SG_ 2011 VCRIGHT_a418_currentSenseFaulted "Right body controller: a418 current sense faulted";
CM_ SG_ 2011 VCRIGHT_a418_tempSenseFaulted "Right body controller: a418 temp sense faulted";
CM_ SG_ 2011 VCRIGHT_a418_underCurrent "Right body controller: a418 under current";
CM_ SG_ 2011 VCRIGHT_a418_overCurrent "Right body controller: a418 over current";
CM_ SG_ 2011 VCRIGHT_a418_overTemperature "Right body controller: a418 over temperature";
CM_ SG_ 2011 VCRIGHT_a419_outputFaulted "Right body controller: a419 output faulted";
CM_ SG_ 2011 VCRIGHT_a419_currentSenseFaulted "Right body controller: a419 current sense faulted";
CM_ SG_ 2011 VCRIGHT_a419_tempSenseFaulted "Right body controller: a419 temp sense faulted";
CM_ SG_ 2011 VCRIGHT_a419_underCurrent "Right body controller: a419 under current";
CM_ SG_ 2011 VCRIGHT_a419_overCurrent "Right body controller: a419 over current";
CM_ SG_ 2011 VCRIGHT_a419_overTemperature "Right body controller: a419 over temperature";
CM_ SG_ 2011 VCRIGHT_a420_outputFaulted "Right body controller: a420 output faulted";
CM_ SG_ 2011 VCRIGHT_a420_currentSenseFaulted "Right body controller: a420 current sense faulted";
CM_ SG_ 2011 VCRIGHT_a420_tempSenseFaulted "Right body controller: a420 temp sense faulted";
CM_ SG_ 2011 VCRIGHT_a420_underCurrent "Right body controller: a420 under current";
CM_ SG_ 2011 VCRIGHT_a420_overCurrent "Right body controller: a420 over current";
CM_ SG_ 2011 VCRIGHT_a420_overTemperature "Right body controller: a420 over temperature";
CM_ SG_ 2011 VCRIGHT_a421_outputFaulted "Right body controller: a421 output faulted";
CM_ SG_ 2011 VCRIGHT_a421_currentSenseFaulted "Right body controller: a421 current sense faulted";
CM_ SG_ 2011 VCRIGHT_a421_tempSenseFaulted "Right body controller: a421 temp sense faulted";
CM_ SG_ 2011 VCRIGHT_a421_underCurrent "Right body controller: a421 under current";
CM_ SG_ 2011 VCRIGHT_a421_overCurrent "Right body controller: a421 over current";
CM_ SG_ 2011 VCRIGHT_a421_overTemperature "Right body controller: a421 over temperature";
CM_ SG_ 2011 VCRIGHT_a422_3rUsbPortsStuckOff "Right body controller: a422 3r usb ports stuck off";
CM_ SG_ 2011 VCRIGHT_a422_lumbarEcuStuckOff "Right body controller: a422 lumbar ecu stuck off";
CM_ SG_ 2011 VCRIGHT_a422_oilPumpStuckOff "Right body controller: a422 oil pump stuck off";
CM_ SG_ 2011 VCRIGHT_a422_vbusProtFusedMiscSt "Right body controller: a422 vbus prot fused misc stuck off";
CM_ SG_ 2011 VCRIGHT_a422_vbusProtFusedSeatSt "Right body controller: a422 vbus prot fused seat stuck off";
CM_ SG_ 2011 VCRIGHT_a422_seatFrontVentFanCus "Right body controller: a422 seat front vent fan cushion stuck off";
CM_ SG_ 2011 VCRIGHT_a422_seatFrontVentFanBac "Right body controller: a422 seat front vent fan backrest stuck off";
CM_ SG_ 2011 VCRIGHT_a422_doorRearRgbStuckOff "Right body controller: a422 door rear rgb stuck off";
CM_ SG_ 2011 VCRIGHT_a422_radioTunerStuckOff "Right body controller: a422 radio tuner stuck off";
CM_ SG_ 2011 VCRIGHT_a422_seat2rControllerStu "Right body controller: a422 seat2r controller stuck off";
CM_ SG_ 2011 VCRIGHT_a422_premiumAmpStuckOff "Right body controller: a422 premium amp stuck off";
CM_ SG_ 2011 VCRIGHT_a422_rearGlassHeaterStuc "Right body controller: a422 rear glass heater stuck off";
CM_ SG_ 2011 VCRIGHT_a426_seatMotorCalibrated "Right body controller: a426 seat motor calibrated";
CM_ SG_ 2011 VCRIGHT_a426_seatMotorCurrent "Right body controller: a426 seat motor current";
CM_ SG_ 2011 VCRIGHT_a426_seatMotorPosReal "Right body controller: a426 seat motor pos real";
CM_ SG_ 2011 VCRIGHT_a426_seatMotorState "Right body controller: a426 seat motor state";
CM_ SG_ 2011 VCRIGHT_a426_seatSwitchBack "Right body controller: a426 seat switch back; raw 0 = signal not available (SNA)";
CM_ SG_ 2011 VCRIGHT_a426_seatSwitchForward "Right body controller: a426 seat switch forward; raw 0 = signal not available (SNA)";
CM_ SG_ 2011 VCRIGHT_a426_cabinTmp "Right body controller: a426 cabin tmp";
CM_ SG_ 2011 VCRIGHT_a427_seatMotorCalibrated "Right body controller: a427 seat motor calibrated";
CM_ SG_ 2011 VCRIGHT_a427_seatMotorCurrent "Right body controller: a427 seat motor current";
CM_ SG_ 2011 VCRIGHT_a427_seatMotorPosReal "Right body controller: a427 seat motor pos real";
CM_ SG_ 2011 VCRIGHT_a427_seatMotorState "Right body controller: a427 seat motor state";
CM_ SG_ 2011 VCRIGHT_a427_seatSwitchBack "Right body controller: a427 seat switch back; raw 0 = signal not available (SNA)";
CM_ SG_ 2011 VCRIGHT_a427_seatSwitchForward "Right body controller: a427 seat switch forward; raw 0 = signal not available (SNA)";
CM_ SG_ 2011 VCRIGHT_a427_cabinTmp "Right body controller: a427 cabin tmp";
CM_ SG_ 2011 VCRIGHT_a428_seatMotorCalibrated "Right body controller: a428 seat motor calibrated";
CM_ SG_ 2011 VCRIGHT_a428_seatMotorCurrent "Right body controller: a428 seat motor current";
CM_ SG_ 2011 VCRIGHT_a428_seatMotorPosReal "Right body controller: a428 seat motor pos real";
CM_ SG_ 2011 VCRIGHT_a428_seatMotorState "Right body controller: a428 seat motor state";
CM_ SG_ 2011 VCRIGHT_a428_seatSwitchBack "Right body controller: a428 seat switch back; raw 0 = signal not available (SNA)";
CM_ SG_ 2011 VCRIGHT_a428_seatSwitchForward "Right body controller: a428 seat switch forward; raw 0 = signal not available (SNA)";
CM_ SG_ 2011 VCRIGHT_a428_cabinTmp "Right body controller: a428 cabin tmp";
CM_ SG_ 2011 VCRIGHT_a429_seatMotorCalibrated "Right body controller: a429 seat motor calibrated";
CM_ SG_ 2011 VCRIGHT_a429_seatMotorCurrent "Right body controller: a429 seat motor current";
CM_ SG_ 2011 VCRIGHT_a429_seatMotorPosReal "Right body controller: a429 seat motor pos real";
CM_ SG_ 2011 VCRIGHT_a429_seatMotorState "Right body controller: a429 seat motor state";
CM_ SG_ 2011 VCRIGHT_a429_seatSwitchBack "Right body controller: a429 seat switch back; raw 0 = signal not available (SNA)";
CM_ SG_ 2011 VCRIGHT_a429_seatSwitchForward "Right body controller: a429 seat switch forward; raw 0 = signal not available (SNA)";
CM_ SG_ 2011 VCRIGHT_a429_cabinTmp "Right body controller: a429 cabin tmp";
CM_ SG_ 2011 VCRIGHT_a444_retriesAvailable "Right body controller: a444 retries available";
CM_ SG_ 2011 VCRIGHT_a444_channel "Right body controller: a444 channel";
CM_ SG_ 2011 VCRIGHT_a444_watchdog "Right body controller: a444 watchdog";
CM_ SG_ 2011 VCRIGHT_a444_gateDriver "Right body controller: a444 gate driver";
CM_ SG_ 2011 VCRIGHT_a444_overcurrent "Right body controller: a444 overcurrent";
CM_ SG_ 2011 VCRIGHT_a444_supplyUndervoltage "Right body controller: a444 supply undervoltage";
CM_ SG_ 2011 VCRIGHT_a444_cpUndervoltage "Right body controller: a444 cp undervoltage";
CM_ SG_ 2011 VCRIGHT_a444_overTempShutdown "Right body controller: a444 over temp shutdown";
CM_ SG_ 2011 VCRIGHT_a444_overTempWarning "Right body controller: a444 over temp warning";
CM_ SG_ 2011 VCRIGHT_a444_highSide2GateDriver "Right body controller: a444 high side2 gate driver";
CM_ SG_ 2011 VCRIGHT_a444_lowSide2GateDriver "Right body controller: a444 low side2 gate driver";
CM_ SG_ 2011 VCRIGHT_a444_highSide1GateDriver "Right body controller: a444 high side1 gate driver";
CM_ SG_ 2011 VCRIGHT_a444_lowSide1GateDriver "Right body controller: a444 low side1 gate driver";
CM_ SG_ 2011 VCRIGHT_a444_highSide2OverCurent "Right body controller: a444 high side2 over curent";
CM_ SG_ 2011 VCRIGHT_a444_lowSide2OverCurent "Right body controller: a444 low side2 over curent";
CM_ SG_ 2011 VCRIGHT_a444_highSide1OverCurent "Right body controller: a444 high side1 over curent";
CM_ SG_ 2011 VCRIGHT_a444_lowSide1OverCurent "Right body controller: a444 low side1 over curent";
CM_ SG_ 2011 VCRIGHT_a444_spiInit "Right body controller: a444 spi init";
CM_ SG_ 2011 VCRIGHT_a444_spiPeriodicCheck "Right body controller: a444 spi periodic check";
CM_ SG_ 2011 VCRIGHT_a444_spiFault "Right body controller: a444 spi fault";
CM_ SG_ 2011 VCRIGHT_a444_voltageMonitor "Right body controller: a444 voltage monitor";
CM_ SG_ 2011 VCRIGHT_a444_enableLow "Right body controller: a444 enable low";
CM_ SG_ 2011 VCRIGHT_a444_highCurrentFeedEnab "Right body controller: a444 high current feed enabled";
CM_ SG_ 2011 VCRIGHT_a444_supplyVoltageEnable "Right body controller: a444 supply voltage enabled";
CM_ SG_ 2011 VCRIGHT_a444_supplyVoltage "Right body controller: a444 supply voltage";
CM_ SG_ 2011 VCRIGHT_a446_caseTempHVACUnavail "Right body controller: a446 case temp HVAC unavailable";
CM_ SG_ 2011 VCRIGHT_a446_evapHVACUnavailable "Right body controller: a446 evap HVAC unavailable";
CM_ SG_ 2011 VCRIGHT_a446_evapTempInvalid "Right body controller: a446 evap temp invalid";
CM_ SG_ 2011 VCRIGHT_a446_hvacBlowerFaulted "Right body controller: a446 hvac blower faulted";
CM_ SG_ 2011 VCRIGHT_a446_evapOperationNotAll "Right body controller: a446 evap operation not allowed";
CM_ SG_ 2011 VCRIGHT_a446_allAirPathsBlocked "Right body controller: a446 all air paths blocked";
CM_ SG_ 2011 VCRIGHT_a446_rawDuctTempInvalidL "Right body controller: a446 raw duct temp invalid left";
CM_ SG_ 2011 VCRIGHT_a446_rawDuctTempInvalidR "Right body controller: a446 raw duct temp invalid right";
CM_ SG_ 2011 VCRIGHT_a448_manACOFFComfortCool "Right body controller: a448 man ACOFF comfort cool nudge";
CM_ SG_ 2011 VCRIGHT_a448_manAirflowComfortHe "Right body controller: a448 man airflow comfort heat nudge";
CM_ SG_ 2011 VCRIGHT_a448_manAirflowFwdL_0001 "Right body controller: a448 man airflow fwd lk comfort heat nudge";
CM_ SG_ 2011 VCRIGHT_a448_manAirflowFwdLkComf "Right body controller: a448 man airflow fwd lk comfort cool nudge";
CM_ SG_ 2011 VCRIGHT_a448_manACOffFwdLkComfor "Right body controller: a448 man AC off fwd lk comfort cool nudge";
CM_ SG_ 2011 VCRIGHT_a448_manFreshComfor_0002 "Right body controller: a448 man fresh comfort heat manual HVAC intvn";
CM_ SG_ 2011 VCRIGHT_a448_manFreshComfor_0001 "Right body controller: a448 man fresh comfort cool manual HVAC intvn";
CM_ SG_ 2011 VCRIGHT_a448_manFreshComfortCool "Right body controller: a448 man fresh comfort cool auto HVAC intvn";
CM_ SG_ 2011 VCRIGHT_a448_manFreshComfortHeat "Right body controller: a448 man fresh comfort heat auto HVAC intvn";
CM_ SG_ 2011 VCRIGHT_a448_manRecircRHAutoHVAC "Right body controller: a448 man recirc RH auto HVAC intvn";
CM_ SG_ 2011 VCRIGHT_a448_manRecircFlashFogGe "Right body controller: a448 man recirc flash fog generic HVAC intvn";
CM_ SG_ 2011 VCRIGHT_a448_manRecircFlashFogWe "Right body controller: a448 man recirc flash fog wet air HVAC intvn";
CM_ SG_ 2011 VCRIGHT_a448_manRecircRHManualHV "Right body controller: a448 man recirc RH manual HVAC nudge";
CM_ SG_ 2011 VCRIGHT_a448_manACoffRHManualHVA "Right body controller: a448 man a coff RH manual HVAC nudge";
CM_ SG_ 2011 VCRIGHT_a448_manHvacOffAutoSteer "Right body controller: a448 man hvac off auto steer fog intvn";
CM_ SG_ 2011 VCRIGHT_a448_manHvacOffAuto_0001 "Right body controller: a448 man hvac off auto steer fog nudge";
CM_ SG_ 2011 VCRIGHT_a448_manHvacAutoSteerFog "Right body controller: a448 man hvac auto steer fog intvn";
CM_ SG_ 2011 VCRIGHT_a448_manHvacAutoSte_0001 "Right body controller: a448 man hvac auto steer fog nudge";
CM_ SG_ 2011 VCRIGHT_a448_manualHighBlowerSpe "Right body controller: a448 manual high blower speed auto HVAC intvn";
CM_ SG_ 2011 VCRIGHT_a482_channel "Right body controller: a482 channel";
CM_ SG_ 2011 VCRIGHT_a482_spiFault "Right body controller: a482 spi fault";
CM_ SG_ 2011 VCRIGHT_a482_resetBar "Right body controller: a482 reset bar";
CM_ SG_ 2011 VCRIGHT_a482_overTempShutdown "Right body controller: a482 over temp shutdown";
CM_ SG_ 2011 VCRIGHT_a482_thermalWarning "Right body controller: a482 thermal warning";
CM_ SG_ 2011 VCRIGHT_a482_underOrOverVoltageO "Right body controller: a482 under or over voltage or over current";
CM_ SG_ 2011 VCRIGHT_a482_underloadDetected "Right body controller: a482 underload detected";
CM_ SG_ 2011 VCRIGHT_a489_vbatProtVoltage "Right body controller: a489 vbat prot voltage";
CM_ SG_ 2011 VCRIGHT_a489_3rUsbPortsStuckOn "Right body controller: a489 3r usb ports stuck on";
CM_ SG_ 2011 VCRIGHT_a489_lumbarEcuStuckOn "Right body controller: a489 lumbar ecu stuck on";
CM_ SG_ 2011 VCRIGHT_a489_oilPumpStuckOn "Right body controller: a489 oil pump stuck on";
CM_ SG_ 2011 VCRIGHT_a489_vbusProtFusedMiscSt "Right body controller: a489 vbus prot fused misc stuck on";
CM_ SG_ 2011 VCRIGHT_a489_vbusProtFusedSeatSt "Right body controller: a489 vbus prot fused seat stuck on";
CM_ SG_ 2011 VCRIGHT_a489_seatFrontVentFanCus "Right body controller: a489 seat front vent fan cushion stuck on";
CM_ SG_ 2011 VCRIGHT_a489_seatFrontVentFanBac "Right body controller: a489 seat front vent fan backrest stuck on";
CM_ SG_ 2011 VCRIGHT_a489_doorRearRgbStuckOn "Right body controller: a489 door rear rgb stuck on";
CM_ SG_ 2011 VCRIGHT_a489_radioTunerStuckOn "Right body controller: a489 radio tuner stuck on";
CM_ SG_ 2011 VCRIGHT_a489_seat2rControllerStu "Right body controller: a489 seat2r controller stuck on";
CM_ SG_ 2011 VCRIGHT_a489_premiumAmpStuckOn "Right body controller: a489 premium amp stuck on";
CM_ SG_ 2011 VCRIGHT_a489_rearGlassHeaterStuc "Right body controller: a489 rear glass heater stuck on";
CM_ SG_ 2011 VCRIGHT_a492_3rUsbPortsUnattempt "Right body controller: a492 3r usb ports unattempted on";
CM_ SG_ 2011 VCRIGHT_a492_lumbarEcuUnattempte "Right body controller: a492 lumbar ecu unattempted on";
CM_ SG_ 2011 VCRIGHT_a492_oilPumpUnattemptedO "Right body controller: a492 oil pump unattempted on";
CM_ SG_ 2011 VCRIGHT_a492_vbusProtFusedMiscUn "Right body controller: a492 vbus prot fused misc unattempted on";
CM_ SG_ 2011 VCRIGHT_a492_vbusProtFusedSeatUn "Right body controller: a492 vbus prot fused seat unattempted on";
CM_ SG_ 2011 VCRIGHT_a492_seatFrontVentFanCus "Right body controller: a492 seat front vent fan cushion unattempted on";
CM_ SG_ 2011 VCRIGHT_a492_seatFrontVentFanBac "Right body controller: a492 seat front vent fan backrest unattempted on";
CM_ SG_ 2011 VCRIGHT_a492_doorRearRgbUnattemp "Right body controller: a492 door rear rgb unattempted on";
CM_ SG_ 2011 VCRIGHT_a492_radioTunerUnattempt "Right body controller: a492 radio tuner unattempted on";
CM_ SG_ 2011 VCRIGHT_a492_seat2rControllerUna "Right body controller: a492 seat2r controller unattempted on";
CM_ SG_ 2011 VCRIGHT_a492_premiumAmpUnattempt "Right body controller: a492 premium amp unattempted on";
CM_ SG_ 2011 VCRIGHT_a492_rearGlassHeaterUnat "Right body controller: a492 rear glass heater unattempted on";
CM_ SG_ 2011 VCRIGHT_a496_cabinTempInterior "Right body controller: a496 cabin temp interior; raw 255 = signal not available (SNA)";
CM_ SG_ 2011 VCRIGHT_a497_ecuUnprovisioned "Right body controller: a497 ecu unprovisioned";
CM_ SG_ 2011 VCRIGHT_a510_isRearwardEndstopUn "Right body controller: a510 is rearward endstop uncalibrated";
CM_ SG_ 2011 VCRIGHT_a510_isAbsPosSensorUncal "Right body controller: a510 is abs pos sensor uncalibrated";
CM_ SG_ 2011 VCRIGHT_a510_seatState "Right body controller: a510 seat state; raw 15 = signal not available (SNA)";
CM_ SG_ 2011 VCRIGHT_a510_motorType "Right body controller: a510 motor type";
CM_ SG_ 2011 VCRIGHT_a510_absPosSensState "Right body controller: a510 abs pos sens state";
CM_ SG_ 2011 VCRIGHT_a513_calibrated "Right body controller: a513 calibrated";
CM_ SG_ 2011 VCRIGHT_a513_angle "Right body controller: a513 angle";
CM_ SG_ 2011 VCRIGHT_a513_seatStatePrev "Right body controller: a513 seat state prev; raw 15 = signal not available (SNA)";
CM_ SG_ 2011 VCRIGHT_a513_obstacleDetectReaso "Right body controller: a513 obstacle detect reason";
CM_ SG_ 2011 VCRIGHT_a513_accelLookbackTripDe "Right body controller: a513 accel lookback trip depth";
CM_ SG_ 2011 VCRIGHT_a513_duty "Right body controller: a513 duty";
CM_ SG_ 2011 VCRIGHT_a513_currentAbsFilt "Right body controller: a513 current abs filt";
CM_ SG_ 2011 VCRIGHT_a513_motorType "Right body controller: a513 motor type";
CM_ SG_ 2011 VCRIGHT_a513_absolutePosSensorFo "Right body controller: a513 absolute pos sensor forward";
CM_ SG_ 2011 VCRIGHT_a513_cabinTemp "Right body controller: a513 cabin temp";
CM_ SG_ 2011 VCRIGHT_a517_isRearwardEndstopUn "Right body controller: a517 is rearward endstop uncalibrated";
CM_ SG_ 2011 VCRIGHT_a517_isAbsPosSensorUncal "Right body controller: a517 is abs pos sensor uncalibrated";
CM_ SG_ 2011 VCRIGHT_a518_seatState "Right body controller: a518 seat state; raw 15 = signal not available (SNA)";
CM_ SG_ 2011 VCRIGHT_a520_epbConfig "Right body controller: a520 epb config";
BA_DEF_ BO_ "GenMsgCycleTime" INT 0 3600000;
BA_DEF_ BO_ "GenMsgSendType" ENUM "Cyclic","NotUsed","NotUsed","NotUsed","NotUsed","NotUsed","NotUsed","IfActive","NoMsgSendType","NotUsed";
BA_DEF_ BO_ "VFrameFormat" ENUM "StandardCAN","ExtendedCAN","reserved","J1939PG","reserved","reserved","reserved","reserved","reserved","reserved","reserved","reserved","reserved","reserved","StandardCAN_FD","ExtendedCAN_FD";
BA_DEF_ BO_ "CANFD_BRS" ENUM "0","1";
BA_DEF_ SG_ "GenSigSNA" STRING;
BA_DEF_ SG_ "SystemSignalLongSymbol" STRING;
BA_DEF_ SG_ "Confidence" ENUM "validated","plausible","layout-only","contradicted";
BA_DEF_DEF_ "GenMsgCycleTime" 0;
BA_DEF_DEF_ "GenMsgSendType" "NoMsgSendType";
BA_DEF_DEF_ "VFrameFormat" "StandardCAN";
BA_DEF_DEF_ "CANFD_BRS" "1";
BA_DEF_DEF_ "GenSigSNA" "";
BA_DEF_DEF_ "SystemSignalLongSymbol" "";
BA_DEF_DEF_ "Confidence" "layout-only";
BA_ "Confidence" SG_ 2011 VCRIGHT_a150_windowPosition 1;
BA_ "Confidence" SG_ 2011 VCRIGHT_a150_movementTimeMs 1;
BA_ "Confidence" SG_ 2011 VCRIGHT_a150_windowPinchReason 1;
BA_ "Confidence" SG_ 2011 VCRIGHT_a150_absAccelExceedance 1;
BA_ "Confidence" SG_ 2011 VCRIGHT_a150_relAccelExceedance 1;
BA_ "Confidence" SG_ 2011 VCRIGHT_a150_speedExpScore 1;
BA_ "Confidence" SG_ 2011 VCRIGHT_a151_windowPosition 1;
BA_ "Confidence" SG_ 2011 VCRIGHT_a151_movementTimeMs 1;
BA_ "Confidence" SG_ 2011 VCRIGHT_a151_windowPinchReason 1;
BA_ "Confidence" SG_ 2011 VCRIGHT_a151_absAccelExceedance 1;
BA_ "Confidence" SG_ 2011 VCRIGHT_a151_relAccelExceedance 1;
BA_ "Confidence" SG_ 2011 VCRIGHT_a151_speedExpScore 1;
BA_ "Confidence" SG_ 2011 VCRIGHT_a152_speedTableStatus 1;
BA_ "GenSigSNA" SG_ 2011 VCRIGHT_a152_speedTableStatus "0";
BA_ "Confidence" SG_ 2011 VCRIGHT_a153_speedTableStatus 1;
BA_ "GenSigSNA" SG_ 2011 VCRIGHT_a153_speedTableStatus "0";
BA_ "Confidence" SG_ 2011 VCRIGHT_a154_windowThermalMode 1;
BA_ "GenSigSNA" SG_ 2011 VCRIGHT_a154_windowThermalMode "0";
BA_ "Confidence" SG_ 2011 VCRIGHT_a155_windowThermalMode 1;
BA_ "GenSigSNA" SG_ 2011 VCRIGHT_a155_windowThermalMode "0";
BA_ "Confidence" SG_ 2011 VCRIGHT_a180_extHandlePWM 1;
BA_ "Confidence" SG_ 2011 VCRIGHT_a180_releasePWM 1;
BA_ "Confidence" SG_ 2011 VCRIGHT_a180_latchStatus 1;
BA_ "GenSigSNA" SG_ 2011 VCRIGHT_a180_latchStatus "0";
BA_ "Confidence" SG_ 2011 VCRIGHT_a181_extHandlePWM 1;
BA_ "Confidence" SG_ 2011 VCRIGHT_a181_releasePWM 1;
BA_ "Confidence" SG_ 2011 VCRIGHT_a181_latchStatus 1;
BA_ "GenSigSNA" SG_ 2011 VCRIGHT_a181_latchStatus "0";
BA_ "Confidence" SG_ 2011 VCRIGHT_a184_voltage 1;
BA_ "Confidence" SG_ 2011 VCRIGHT_a184_temperature 1;
BA_ "Confidence" SG_ 2011 VCRIGHT_a184_trunkCurrent 1;
BA_ "Confidence" SG_ 2011 VCRIGHT_a186_voltage 1;
BA_ "Confidence" SG_ 2011 VCRIGHT_a186_temperature 1;
BA_ "Confidence" SG_ 2011 VCRIGHT_a187_voltage 1;
BA_ "Confidence" SG_ 2011 VCRIGHT_a187_temperature 1;
BA_ "Confidence" SG_ 2011 VCRIGHT_a188_voltage 1;
BA_ "Confidence" SG_ 2011 VCRIGHT_a188_temperature 1;
BA_ "Confidence" SG_ 2011 VCRIGHT_a189_voltage 1;
BA_ "Confidence" SG_ 2011 VCRIGHT_a189_temperature 1;
BA_ "Confidence" SG_ 2011 VCRIGHT_a193_amplifierCurrent 1;
BA_ "Confidence" SG_ 2011 VCRIGHT_a194_cntctrPwrCurrent 1;
BA_ "Confidence" SG_ 2011 VCRIGHT_a195_hvcCurrent 1;
BA_ "Confidence" SG_ 2011 VCRIGHT_a202_current 1;
BA_ "Confidence" SG_ 2011 VCRIGHT_a202_epbConfig 1;
BA_ "Confidence" SG_ 2011 VCRIGHT_a203_current 1;
BA_ "Confidence" SG_ 2011 VCRIGHT_a203_epbConfig 1;
BA_ "Confidence" SG_ 2011 VCRIGHT_a204_current 1;
BA_ "Confidence" SG_ 2011 VCRIGHT_a204_epbConfig 1;
BA_ "Confidence" SG_ 2011 VCRIGHT_a205_current 1;
BA_ "Confidence" SG_ 2011 VCRIGHT_a205_epbConfig 1;
BA_ "Confidence" SG_ 2011 VCRIGHT_a206_unitStatusEPB 1;
BA_ "Confidence" SG_ 2011 VCRIGHT_a206_unitStatusEPBM 1;
BA_ "Confidence" SG_ 2011 VCRIGHT_a207_unitStatusEPB 1;
BA_ "Confidence" SG_ 2011 VCRIGHT_a207_unitStatusEPBM 1;
BA_ "Confidence" SG_ 2011 VCRIGHT_a208_unitStatusEPB 1;
BA_ "Confidence" SG_ 2011 VCRIGHT_a208_unitStatusEPBM 1;
BA_ "Confidence" SG_ 2011 VCRIGHT_a209_unitStatusEPB 1;
BA_ "Confidence" SG_ 2011 VCRIGHT_a209_unitStatusEPBM 1;
BA_ "Confidence" SG_ 2011 VCRIGHT_a210_unitStatusEPB 1;
BA_ "Confidence" SG_ 2011 VCRIGHT_a210_unitStatusEPBM 1;
BA_ "Confidence" SG_ 2011 VCRIGHT_a221_vbatProtVoltage 1;
BA_ "Confidence" SG_ 2011 VCRIGHT_a221_vbatProtCurrent 1;
BA_ "Confidence" SG_ 2011 VCRIGHT_a221_uvLoadshedVoltage 1;
BA_ "Confidence" SG_ 2011 VCRIGHT_a221_uvLoadshedFromFront 1;
BA_ "SystemSignalLongSymbol" SG_ 2011 VCRIGHT_a221_uvLoadshedFromFront "VCRIGHT_a221_uvLoadshedFromFrontMonitor";
BA_ "SystemSignalLongSymbol" SG_ 2011 VCRIGHT_a221_uvLoadshedArmPrimar "VCRIGHT_a221_uvLoadshedArmPrimary";
BA_ "Confidence" SG_ 2011 VCRIGHT_a224_seatMotorCurrent 1;
BA_ "Confidence" SG_ 2011 VCRIGHT_a224_seatMotorState 1;
BA_ "Confidence" SG_ 2011 VCRIGHT_a224_seatSwitchBack 1;
BA_ "GenSigSNA" SG_ 2011 VCRIGHT_a224_seatSwitchBack "0";
BA_ "Confidence" SG_ 2011 VCRIGHT_a224_seatSwitchForward 1;
BA_ "GenSigSNA" SG_ 2011 VCRIGHT_a224_seatSwitchForward "0";
BA_ "Confidence" SG_ 2011 VCRIGHT_a225_seatMotorCurrent 1;
BA_ "Confidence" SG_ 2011 VCRIGHT_a225_seatMotorState 1;
BA_ "Confidence" SG_ 2011 VCRIGHT_a225_seatSwitchBack 1;
BA_ "GenSigSNA" SG_ 2011 VCRIGHT_a225_seatSwitchBack "0";
BA_ "Confidence" SG_ 2011 VCRIGHT_a225_seatSwitchForward 1;
BA_ "GenSigSNA" SG_ 2011 VCRIGHT_a225_seatSwitchForward "0";
BA_ "Confidence" SG_ 2011 VCRIGHT_a226_seatMotorCurrent 1;
BA_ "Confidence" SG_ 2011 VCRIGHT_a226_seatMotorState 1;
BA_ "Confidence" SG_ 2011 VCRIGHT_a226_seatSwitchBack 1;
BA_ "GenSigSNA" SG_ 2011 VCRIGHT_a226_seatSwitchBack "0";
BA_ "Confidence" SG_ 2011 VCRIGHT_a226_seatSwitchForward 1;
BA_ "GenSigSNA" SG_ 2011 VCRIGHT_a226_seatSwitchForward "0";
BA_ "Confidence" SG_ 2011 VCRIGHT_a227_seatMotorCurrent 1;
BA_ "Confidence" SG_ 2011 VCRIGHT_a227_seatMotorState 1;
BA_ "Confidence" SG_ 2011 VCRIGHT_a227_seatSwitchBack 1;
BA_ "GenSigSNA" SG_ 2011 VCRIGHT_a227_seatSwitchBack "0";
BA_ "Confidence" SG_ 2011 VCRIGHT_a227_seatSwitchForward 1;
BA_ "GenSigSNA" SG_ 2011 VCRIGHT_a227_seatSwitchForward "0";
BA_ "Confidence" SG_ 2011 VCRIGHT_a228_seatMotorCurrent 1;
BA_ "Confidence" SG_ 2011 VCRIGHT_a228_seatMotorPosReal 1;
BA_ "Confidence" SG_ 2011 VCRIGHT_a228_seatMotorState 1;
BA_ "Confidence" SG_ 2011 VCRIGHT_a228_seatSwitchBack 1;
BA_ "GenSigSNA" SG_ 2011 VCRIGHT_a228_seatSwitchBack "0";
BA_ "Confidence" SG_ 2011 VCRIGHT_a228_seatSwitchForward 1;
BA_ "GenSigSNA" SG_ 2011 VCRIGHT_a228_seatSwitchForward "0";
BA_ "Confidence" SG_ 2011 VCRIGHT_a229_seatMotorCurrent 1;
BA_ "Confidence" SG_ 2011 VCRIGHT_a229_seatMotorPosReal 1;
BA_ "Confidence" SG_ 2011 VCRIGHT_a229_seatMotorState 1;
BA_ "Confidence" SG_ 2011 VCRIGHT_a229_seatSwitchBack 1;
BA_ "GenSigSNA" SG_ 2011 VCRIGHT_a229_seatSwitchBack "0";
BA_ "Confidence" SG_ 2011 VCRIGHT_a229_seatSwitchForward 1;
BA_ "GenSigSNA" SG_ 2011 VCRIGHT_a229_seatSwitchForward "0";
BA_ "Confidence" SG_ 2011 VCRIGHT_a230_seatMotorCurrent 1;
BA_ "Confidence" SG_ 2011 VCRIGHT_a230_seatMotorPosReal 1;
BA_ "Confidence" SG_ 2011 VCRIGHT_a230_seatMotorState 1;
BA_ "Confidence" SG_ 2011 VCRIGHT_a230_seatSwitchBack 1;
BA_ "GenSigSNA" SG_ 2011 VCRIGHT_a230_seatSwitchBack "0";
BA_ "Confidence" SG_ 2011 VCRIGHT_a230_seatSwitchForward 1;
BA_ "GenSigSNA" SG_ 2011 VCRIGHT_a230_seatSwitchForward "0";
BA_ "Confidence" SG_ 2011 VCRIGHT_a231_seatMotorCurrent 1;
BA_ "Confidence" SG_ 2011 VCRIGHT_a231_seatMotorPosReal 1;
BA_ "Confidence" SG_ 2011 VCRIGHT_a231_seatMotorState 1;
BA_ "Confidence" SG_ 2011 VCRIGHT_a231_seatSwitchBack 1;
BA_ "GenSigSNA" SG_ 2011 VCRIGHT_a231_seatSwitchBack "0";
BA_ "Confidence" SG_ 2011 VCRIGHT_a231_seatSwitchForward 1;
BA_ "GenSigSNA" SG_ 2011 VCRIGHT_a231_seatSwitchForward "0";
BA_ "Confidence" SG_ 2011 VCRIGHT_a232_seatMotorCurrent 1;
BA_ "Confidence" SG_ 2011 VCRIGHT_a232_seatMotorPosReal 1;
BA_ "Confidence" SG_ 2011 VCRIGHT_a232_seatMotorState 1;
BA_ "Confidence" SG_ 2011 VCRIGHT_a232_seatSwitchBack 1;
BA_ "GenSigSNA" SG_ 2011 VCRIGHT_a232_seatSwitchBack "0";
BA_ "Confidence" SG_ 2011 VCRIGHT_a232_seatSwitchForward 1;
BA_ "GenSigSNA" SG_ 2011 VCRIGHT_a232_seatSwitchForward "0";
BA_ "Confidence" SG_ 2011 VCRIGHT_a233_seatMotorCurrent 1;
BA_ "Confidence" SG_ 2011 VCRIGHT_a233_seatMotorPosReal 1;
BA_ "Confidence" SG_ 2011 VCRIGHT_a233_seatMotorState 1;
BA_ "Confidence" SG_ 2011 VCRIGHT_a233_seatSwitchBack 1;
BA_ "GenSigSNA" SG_ 2011 VCRIGHT_a233_seatSwitchBack "0";
BA_ "Confidence" SG_ 2011 VCRIGHT_a233_seatSwitchForward 1;
BA_ "GenSigSNA" SG_ 2011 VCRIGHT_a233_seatSwitchForward "0";
BA_ "Confidence" SG_ 2011 VCRIGHT_a234_seatMotorCurrent 1;
BA_ "Confidence" SG_ 2011 VCRIGHT_a234_seatMotorPosReal 1;
BA_ "Confidence" SG_ 2011 VCRIGHT_a234_seatMotorState 1;
BA_ "Confidence" SG_ 2011 VCRIGHT_a234_seatSwitchBack 1;
BA_ "GenSigSNA" SG_ 2011 VCRIGHT_a234_seatSwitchBack "0";
BA_ "Confidence" SG_ 2011 VCRIGHT_a234_seatSwitchForward 1;
BA_ "GenSigSNA" SG_ 2011 VCRIGHT_a234_seatSwitchForward "0";
BA_ "Confidence" SG_ 2011 VCRIGHT_a235_seatMotorCurrent 1;
BA_ "Confidence" SG_ 2011 VCRIGHT_a235_seatMotorPosReal 1;
BA_ "Confidence" SG_ 2011 VCRIGHT_a235_seatMotorState 1;
BA_ "Confidence" SG_ 2011 VCRIGHT_a235_seatSwitchBack 1;
BA_ "GenSigSNA" SG_ 2011 VCRIGHT_a235_seatSwitchBack "0";
BA_ "Confidence" SG_ 2011 VCRIGHT_a235_seatSwitchForward 1;
BA_ "GenSigSNA" SG_ 2011 VCRIGHT_a235_seatSwitchForward "0";
BA_ "Confidence" SG_ 2011 VCRIGHT_a236_lumbarAState 1;
BA_ "Confidence" SG_ 2011 VCRIGHT_a236_lumbarBState 1;
BA_ "Confidence" SG_ 2011 VCRIGHT_a237_lumbarAState 1;
BA_ "Confidence" SG_ 2011 VCRIGHT_a237_lumbarBState 1;
BA_ "Confidence" SG_ 2011 VCRIGHT_a238_lumbarAState 1;
BA_ "Confidence" SG_ 2011 VCRIGHT_a238_lumbarBState 1;
BA_ "Confidence" SG_ 2011 VCRIGHT_a239_seatHeatCurrent 1;
BA_ "Confidence" SG_ 2011 VCRIGHT_a239_seatHeatTmp 1;
BA_ "Confidence" SG_ 2011 VCRIGHT_a239_seatHeatTmpTarget 1;
BA_ "Confidence" SG_ 2011 VCRIGHT_a240_seatHeatCurrent 1;
BA_ "Confidence" SG_ 2011 VCRIGHT_a240_seatHeatTmp 1;
BA_ "Confidence" SG_ 2011 VCRIGHT_a241_seatHeatCurrent 1;
BA_ "Confidence" SG_ 2011 VCRIGHT_a241_seatHeatTmp 1;
BA_ "Confidence" SG_ 2011 VCRIGHT_a242_seatHeatCurrent 1;
BA_ "Confidence" SG_ 2011 VCRIGHT_a242_seatHeatTmp 1;
BA_ "Confidence" SG_ 2011 VCRIGHT_a242_seatHeatTmpTarget 1;
BA_ "Confidence" SG_ 2011 VCRIGHT_a243_seatHeatCurrent 1;
BA_ "Confidence" SG_ 2011 VCRIGHT_a243_seatHeatTmp 1;
BA_ "Confidence" SG_ 2011 VCRIGHT_a244_seatHeatCurrent 1;
BA_ "Confidence" SG_ 2011 VCRIGHT_a244_seatHeatTmp 1;
BA_ "Confidence" SG_ 2011 VCRIGHT_a245_seatHeatCurrent 1;
BA_ "Confidence" SG_ 2011 VCRIGHT_a245_seatHeatTmp 1;
BA_ "Confidence" SG_ 2011 VCRIGHT_a245_seatHeatTmpTarget 1;
BA_ "Confidence" SG_ 2011 VCRIGHT_a246_seatHeatCurrent 1;
BA_ "Confidence" SG_ 2011 VCRIGHT_a246_seatHeatTmp 1;
BA_ "Confidence" SG_ 2011 VCRIGHT_a247_seatHeatCurrent 1;
BA_ "Confidence" SG_ 2011 VCRIGHT_a247_seatHeatTmp 1;
BA_ "Confidence" SG_ 2011 VCRIGHT_a248_seatHeatCurrent 1;
BA_ "Confidence" SG_ 2011 VCRIGHT_a248_seatHeatTmp 1;
BA_ "Confidence" SG_ 2011 VCRIGHT_a248_seatHeatTmpTarget 1;
BA_ "Confidence" SG_ 2011 VCRIGHT_a249_seatHeatCurrent 1;
BA_ "Confidence" SG_ 2011 VCRIGHT_a249_seatHeatTmp 1;
BA_ "Confidence" SG_ 2011 VCRIGHT_a250_seatHeatCurrent 1;
BA_ "Confidence" SG_ 2011 VCRIGHT_a250_seatHeatTmp 1;
BA_ "Confidence" SG_ 2011 VCRIGHT_a251_seatMotorCurrent 1;
BA_ "Confidence" SG_ 2011 VCRIGHT_a251_seatMotorPosReal 1;
BA_ "Confidence" SG_ 2011 VCRIGHT_a251_seatMotorState 1;
BA_ "Confidence" SG_ 2011 VCRIGHT_a251_seatSwitchBack 1;
BA_ "GenSigSNA" SG_ 2011 VCRIGHT_a251_seatSwitchBack "0";
BA_ "Confidence" SG_ 2011 VCRIGHT_a251_seatSwitchForward 1;
BA_ "GenSigSNA" SG_ 2011 VCRIGHT_a251_seatSwitchForward "0";
BA_ "Confidence" SG_ 2011 VCRIGHT_a252_seatMotorCurrent 1;
BA_ "Confidence" SG_ 2011 VCRIGHT_a252_seatMotorPosReal 1;
BA_ "Confidence" SG_ 2011 VCRIGHT_a252_seatMotorState 1;
BA_ "Confidence" SG_ 2011 VCRIGHT_a252_seatSwitchBack 1;
BA_ "GenSigSNA" SG_ 2011 VCRIGHT_a252_seatSwitchBack "0";
BA_ "Confidence" SG_ 2011 VCRIGHT_a252_seatSwitchForward 1;
BA_ "GenSigSNA" SG_ 2011 VCRIGHT_a252_seatSwitchForward "0";
BA_ "Confidence" SG_ 2011 VCRIGHT_a253_seatMotorCurrent 1;
BA_ "Confidence" SG_ 2011 VCRIGHT_a253_seatMotorPosReal 1;
BA_ "Confidence" SG_ 2011 VCRIGHT_a253_seatMotorState 1;
BA_ "Confidence" SG_ 2011 VCRIGHT_a253_seatSwitchBack 1;
BA_ "GenSigSNA" SG_ 2011 VCRIGHT_a253_seatSwitchBack "0";
BA_ "Confidence" SG_ 2011 VCRIGHT_a253_seatSwitchForward 1;
BA_ "GenSigSNA" SG_ 2011 VCRIGHT_a253_seatSwitchForward "0";
BA_ "Confidence" SG_ 2011 VCRIGHT_a254_seatMotorCurrent 1;
BA_ "Confidence" SG_ 2011 VCRIGHT_a254_seatMotorPosReal 1;
BA_ "Confidence" SG_ 2011 VCRIGHT_a254_seatMotorState 1;
BA_ "Confidence" SG_ 2011 VCRIGHT_a254_seatSwitchBack 1;
BA_ "GenSigSNA" SG_ 2011 VCRIGHT_a254_seatSwitchBack "0";
BA_ "Confidence" SG_ 2011 VCRIGHT_a254_seatSwitchForward 1;
BA_ "GenSigSNA" SG_ 2011 VCRIGHT_a254_seatSwitchForward "0";
BA_ "Confidence" SG_ 2011 VCRIGHT_a255_leftIGBTTemp 1;
BA_ "Confidence" SG_ 2011 VCRIGHT_a255_rightIGBTTemp 1;
BA_ "Confidence" SG_ 2011 VCRIGHT_a255_OCPTemp 1;
BA_ "Confidence" SG_ 2011 VCRIGHT_a255_PCBTemp 1;
BA_ "Confidence" SG_ 2011 VCRIGHT_a256_leftCurrent 1;
BA_ "Confidence" SG_ 2011 VCRIGHT_a256_rightCurrent 1;
BA_ "Confidence" SG_ 2011 VCRIGHT_a258_bootIdFreq 1;
BA_ "SystemSignalLongSymbol" SG_ 2011 VCRIGHT_a262_RightThermalShutIGB "VCRIGHT_a262_RightThermalShutIGBT";
BA_ "SystemSignalLongSymbol" SG_ 2011 VCRIGHT_a262_RightCurrentHVSenso "VCRIGHT_a262_RightCurrentHVSensor";
BA_ "Confidence" SG_ 2011 VCRIGHT_a263_seatMotorCurrent 1;
BA_ "Confidence" SG_ 2011 VCRIGHT_a263_seatMotorDCurrent 1;
BA_ "Confidence" SG_ 2011 VCRIGHT_a263_seatMotorPosReal 1;
BA_ "Confidence" SG_ 2011 VCRIGHT_a263_seatMotorState 1;
BA_ "Confidence" SG_ 2011 VCRIGHT_a264_seatMotorCurrent 1;
BA_ "Confidence" SG_ 2011 VCRIGHT_a264_seatMotorDCurrent 1;
BA_ "Confidence" SG_ 2011 VCRIGHT_a264_seatMotorPosReal 1;
BA_ "Confidence" SG_ 2011 VCRIGHT_a264_seatMotorState 1;
BA_ "Confidence" SG_ 2011 VCRIGHT_a265_seatMotorCurrent 1;
BA_ "Confidence" SG_ 2011 VCRIGHT_a265_seatMotorDCurrent 1;
BA_ "Confidence" SG_ 2011 VCRIGHT_a265_seatMotorPosReal 1;
BA_ "Confidence" SG_ 2011 VCRIGHT_a265_seatMotorState 1;
BA_ "Confidence" SG_ 2011 VCRIGHT_a266_seatMotorCurrent 1;
BA_ "Confidence" SG_ 2011 VCRIGHT_a266_seatMotorDCurrent 1;
BA_ "Confidence" SG_ 2011 VCRIGHT_a266_seatMotorPosReal 1;
BA_ "Confidence" SG_ 2011 VCRIGHT_a266_seatMotorState 1;
BA_ "Confidence" SG_ 2011 VCRIGHT_a267_seatMotorCurrent 1;
BA_ "Confidence" SG_ 2011 VCRIGHT_a267_seatMotorDCurrent 1;
BA_ "Confidence" SG_ 2011 VCRIGHT_a267_seatMotorPosReal 1;
BA_ "Confidence" SG_ 2011 VCRIGHT_a267_seatMotorState 1;
BA_ "Confidence" SG_ 2011 VCRIGHT_a268_seatMotorCurrent 1;
BA_ "Confidence" SG_ 2011 VCRIGHT_a268_seatMotorDCurrent 1;
BA_ "Confidence" SG_ 2011 VCRIGHT_a268_seatMotorPosReal 1;
BA_ "Confidence" SG_ 2011 VCRIGHT_a268_seatMotorState 1;
BA_ "Confidence" SG_ 2011 VCRIGHT_a269_seatMotorCurrent 1;
BA_ "Confidence" SG_ 2011 VCRIGHT_a269_seatMotorDCurrent 1;
BA_ "Confidence" SG_ 2011 VCRIGHT_a269_seatMotorPosReal 1;
BA_ "Confidence" SG_ 2011 VCRIGHT_a269_seatMotorState 1;
BA_ "Confidence" SG_ 2011 VCRIGHT_a270_seatMotorCurrent 1;
BA_ "Confidence" SG_ 2011 VCRIGHT_a270_seatMotorDCurrent 1;
BA_ "Confidence" SG_ 2011 VCRIGHT_a270_seatMotorPosReal 1;
BA_ "Confidence" SG_ 2011 VCRIGHT_a270_seatMotorState 1;
BA_ "SystemSignalLongSymbol" SG_ 2011 VCRIGHT_a271_temperatureSensorSN "VCRIGHT_a271_temperatureSensorSNA";
BA_ "Confidence" SG_ 2011 VCRIGHT_a273_handlePWM 1;
BA_ "Confidence" SG_ 2011 VCRIGHT_a273_temperature 1;
BA_ "Confidence" SG_ 2011 VCRIGHT_a274_handlePWM 1;
BA_ "Confidence" SG_ 2011 VCRIGHT_a274_temperature 1;
BA_ "Confidence" SG_ 2011 VCRIGHT_a282_voltage 1;
BA_ "Confidence" SG_ 2011 VCRIGHT_a282_temperature 1;
BA_ "Confidence" SG_ 2011 VCRIGHT_a283_voltage 1;
BA_ "Confidence" SG_ 2011 VCRIGHT_a283_temperature 1;
BA_ "Confidence" SG_ 2011 VCRIGHT_a284_gloveboxMinCurrent 1;
BA_ "Confidence" SG_ 2011 VCRIGHT_a284_gloveboxMaxCurrent 1;
BA_ "Confidence" SG_ 2011 VCRIGHT_a284_cabinTempInterior 1;
BA_ "GenSigSNA" SG_ 2011 VCRIGHT_a284_cabinTempInterior "255";
BA_ "Confidence" SG_ 2011 VCRIGHT_a285_gloveboxMinCurrent 1;
BA_ "Confidence" SG_ 2011 VCRIGHT_a285_gloveboxMaxCurrent 1;
BA_ "Confidence" SG_ 2011 VCRIGHT_a285_cabinTempInterior 1;
BA_ "GenSigSNA" SG_ 2011 VCRIGHT_a285_cabinTempInterior "255";
BA_ "Confidence" SG_ 2011 VCRIGHT_a290_occupancySensorV 1;
BA_ "Confidence" SG_ 2011 VCRIGHT_a290_railVoltage 1;
BA_ "Confidence" SG_ 2011 VCRIGHT_a291_buckleSensorVoltage 1;
BA_ "Confidence" SG_ 2011 VCRIGHT_a291_railVoltage 1;
BA_ "Confidence" SG_ 2011 VCRIGHT_a292_buckleSensorVoltage 1;
BA_ "Confidence" SG_ 2011 VCRIGHT_a292_railV 1;
BA_ "Confidence" SG_ 2011 VCRIGHT_a293_buckleSensorVoltage 1;
BA_ "Confidence" SG_ 2011 VCRIGHT_a293_railV 1;
BA_ "Confidence" SG_ 2011 VCRIGHT_a294_occupancySensorV 1;
BA_ "Confidence" SG_ 2011 VCRIGHT_a294_railV 1;
BA_ "Confidence" SG_ 2011 VCRIGHT_a295_occupancySensorV 1;
BA_ "Confidence" SG_ 2011 VCRIGHT_a295_railV 1;
BA_ "Confidence" SG_ 2011 VCRIGHT_a296_occupancySensorV 1;
BA_ "Confidence" SG_ 2011 VCRIGHT_a296_railV 1;
BA_ "Confidence" SG_ 2011 VCRIGHT_a297_cabinTmp 1;
BA_ "Confidence" SG_ 2011 VCRIGHT_a298_buckleSensorVoltage 1;
BA_ "Confidence" SG_ 2011 VCRIGHT_a298_railV 1;
BA_ "Confidence" SG_ 2011 VCRIGHT_a299_buckleSensorVoltage 1;
BA_ "Confidence" SG_ 2011 VCRIGHT_a299_railV 1;
BA_ "SystemSignalLongSymbol" SG_ 2011 VCRIGHT_a302_calibrationPositive "VCRIGHT_a302_calibrationPositiveDirection";
BA_ "SystemSignalLongSymbol" SG_ 2011 VCRIGHT_a302_calibrationNegative "VCRIGHT_a302_calibrationNegativeDirection";
BA_ "Confidence" SG_ 2011 VCRIGHT_a302_positionTarget 1;
BA_ "Confidence" SG_ 2011 VCRIGHT_a302_positionActual 1;
BA_ "Confidence" SG_ 2011 VCRIGHT_a306_disconnectedTime 1;
BA_ "Confidence" SG_ 2011 VCRIGHT_a307_disconnectedTime 1;
BA_ "SystemSignalLongSymbol" SG_ 2011 VCRIGHT_a308_calibrationPositive "VCRIGHT_a308_calibrationPositiveDirection";
BA_ "SystemSignalLongSymbol" SG_ 2011 VCRIGHT_a308_calibrationNegative "VCRIGHT_a308_calibrationNegativeDirection";
BA_ "Confidence" SG_ 2011 VCRIGHT_a308_positionTarget 1;
BA_ "Confidence" SG_ 2011 VCRIGHT_a308_positionActual 1;
BA_ "Confidence" SG_ 2011 VCRIGHT_a310_mirrorFoldTime 1;
BA_ "Confidence" SG_ 2011 VCRIGHT_a310_foldingDirection 1;
BA_ "Confidence" SG_ 2011 VCRIGHT_a310_mirrorMaxFoldCurren 1;
BA_ "SystemSignalLongSymbol" SG_ 2011 VCRIGHT_a310_mirrorMaxFoldCurren "VCRIGHT_a310_mirrorMaxFoldCurrent";
BA_ "Confidence" SG_ 2011 VCRIGHT_a310_ambientTemperature 1;
BA_ "GenSigSNA" SG_ 2011 VCRIGHT_a310_ambientTemperature "0";
BA_ "Confidence" SG_ 2011 VCRIGHT_a316_foldState 1;
BA_ "Confidence" SG_ 2011 VCRIGHT_a316_actuationDurationMs 1;
BA_ "Confidence" SG_ 2011 VCRIGHT_a316_maxCurrentAmps 1;
BA_ "Confidence" SG_ 2011 VCRIGHT_a316_averageCurrentAmps 1;
BA_ "Confidence" SG_ 2011 VCRIGHT_a316_ambientTemperatureD 1;
BA_ "GenSigSNA" SG_ 2011 VCRIGHT_a316_ambientTemperatureD "0";
BA_ "SystemSignalLongSymbol" SG_ 2011 VCRIGHT_a316_ambientTemperatureD "VCRIGHT_a316_ambientTemperatureDegC";
BA_ "Confidence" SG_ 2011 VCRIGHT_a324_mirrorHeatCurrent 1;
BA_ "SystemSignalLongSymbol" SG_ 2011 VCRIGHT_a325_calibrationPositive "VCRIGHT_a325_calibrationPositiveDirection";
BA_ "SystemSignalLongSymbol" SG_ 2011 VCRIGHT_a325_calibrationNegative "VCRIGHT_a325_calibrationNegativeDirection";
BA_ "Confidence" SG_ 2011 VCRIGHT_a325_positionTarget 1;
BA_ "Confidence" SG_ 2011 VCRIGHT_a325_positionActual 1;
BA_ "SystemSignalLongSymbol" SG_ 2011 VCRIGHT_a326_calibrationPositive "VCRIGHT_a326_calibrationPositiveDirection";
BA_ "SystemSignalLongSymbol" SG_ 2011 VCRIGHT_a326_calibrationNegative "VCRIGHT_a326_calibrationNegativeDirection";
BA_ "Confidence" SG_ 2011 VCRIGHT_a326_positionTarget 1;
BA_ "Confidence" SG_ 2011 VCRIGHT_a326_positionActual 1;
BA_ "Confidence" SG_ 2011 VCRIGHT_a330_voltage 1;
BA_ "Confidence" SG_ 2011 VCRIGHT_a330_maxCurrent 1;
BA_ "Confidence" SG_ 2011 VCRIGHT_a330_temperature 1;
BA_ "Confidence" SG_ 2011 VCRIGHT_a331_voltage 1;
BA_ "Confidence" SG_ 2011 VCRIGHT_a331_maxCurrent 1;
BA_ "Confidence" SG_ 2011 VCRIGHT_a331_temperature 1;
BA_ "Confidence" SG_ 2011 VCRIGHT_a343_rearDefrostCurrent 1;
BA_ "Confidence" SG_ 2011 VCRIGHT_a343_batteryVoltage 1;
BA_ "Confidence" SG_ 2011 VCRIGHT_a343_ambientTemperature 1;
BA_ "Confidence" SG_ 2011 VCRIGHT_a344_rearDefrostCurrent 1;
BA_ "Confidence" SG_ 2011 VCRIGHT_a344_batteryVoltage 1;
BA_ "Confidence" SG_ 2011 VCRIGHT_a344_ambientTemperature 1;
BA_ "Confidence" SG_ 2011 VCRIGHT_a345_PTCTHSGBPwrCurrent 1;
BA_ "Confidence" SG_ 2011 VCRIGHT_a373_windowChannel 1;
BA_ "Confidence" SG_ 2011 VCRIGHT_a376_2RowSeatTrackActuat 1;
BA_ "SystemSignalLongSymbol" SG_ 2011 VCRIGHT_a376_2RowSeatTrackActuat "VCRIGHT_a376_2RowSeatTrackActuatorCurrent";
BA_ "Confidence" SG_ 2011 VCRIGHT_a376_2RowSeatTrackA_0001 1;
BA_ "SystemSignalLongSymbol" SG_ 2011 VCRIGHT_a376_2RowSeatTrackA_0001 "VCRIGHT_a376_2RowSeatTrackActuatorDuty";
BA_ "Confidence" SG_ 2011 VCRIGHT_a376_2RowSeatEasyEntrySt 1;
BA_ "GenSigSNA" SG_ 2011 VCRIGHT_a376_2RowSeatEasyEntrySt "6";
BA_ "SystemSignalLongSymbol" SG_ 2011 VCRIGHT_a376_2RowSeatEasyEntrySt "VCRIGHT_a376_2RowSeatEasyEntryState";
BA_ "Confidence" SG_ 2011 VCRIGHT_a376_2RowSeatTrackPositi 1;
BA_ "GenSigSNA" SG_ 2011 VCRIGHT_a376_2RowSeatTrackPositi "0";
BA_ "SystemSignalLongSymbol" SG_ 2011 VCRIGHT_a376_2RowSeatTrackPositi "VCRIGHT_a376_2RowSeatTrackPositionSwitch";
BA_ "Confidence" SG_ 2011 VCRIGHT_a385_current 1;
BA_ "Confidence" SG_ 2011 VCRIGHT_a385_voltage 1;
BA_ "Confidence" SG_ 2011 VCRIGHT_a385_resistance 1;
BA_ "Confidence" SG_ 2011 VCRIGHT_a385_reason 1;
BA_ "SystemSignalLongSymbol" SG_ 2011 VCRIGHT_a408_hardwareInternalErr "VCRIGHT_a408_hardwareInternalError";
BA_ "Confidence" SG_ 2011 VCRIGHT_a411_failureReason 1;
BA_ "SystemSignalLongSymbol" SG_ 2011 VCRIGHT_a411_loadUnattemptedOnFa "VCRIGHT_a411_loadUnattemptedOnFailure";
BA_ "SystemSignalLongSymbol" SG_ 2011 VCRIGHT_a411_deviceStuckOnFailur "VCRIGHT_a411_deviceStuckOnFailure";
BA_ "SystemSignalLongSymbol" SG_ 2011 VCRIGHT_a411_uvLoadshedVsenseDig "VCRIGHT_a411_uvLoadshedVsenseDigIn";
BA_ "Confidence" SG_ 2011 VCRIGHT_a411_uvLoadshedVoltage 1;
BA_ "SystemSignalLongSymbol" SG_ 2011 VCRIGHT_a422_vbusProtFusedMiscSt "VCRIGHT_a422_vbusProtFusedMiscStuckOff";
BA_ "SystemSignalLongSymbol" SG_ 2011 VCRIGHT_a422_vbusProtFusedSeatSt "VCRIGHT_a422_vbusProtFusedSeatStuckOff";
BA_ "SystemSignalLongSymbol" SG_ 2011 VCRIGHT_a422_seatFrontVentFanCus "VCRIGHT_a422_seatFrontVentFanCushionStuckOff";
BA_ "SystemSignalLongSymbol" SG_ 2011 VCRIGHT_a422_seatFrontVentFanBac "VCRIGHT_a422_seatFrontVentFanBackrestStuckOff";
BA_ "SystemSignalLongSymbol" SG_ 2011 VCRIGHT_a422_seat2rControllerStu "VCRIGHT_a422_seat2rControllerStuckOff";
BA_ "SystemSignalLongSymbol" SG_ 2011 VCRIGHT_a422_rearGlassHeaterStuc "VCRIGHT_a422_rearGlassHeaterStuckOff";
BA_ "Confidence" SG_ 2011 VCRIGHT_a426_seatMotorCurrent 1;
BA_ "Confidence" SG_ 2011 VCRIGHT_a426_seatMotorPosReal 1;
BA_ "Confidence" SG_ 2011 VCRIGHT_a426_seatMotorState 1;
BA_ "Confidence" SG_ 2011 VCRIGHT_a426_seatSwitchBack 1;
BA_ "GenSigSNA" SG_ 2011 VCRIGHT_a426_seatSwitchBack "0";
BA_ "Confidence" SG_ 2011 VCRIGHT_a426_seatSwitchForward 1;
BA_ "GenSigSNA" SG_ 2011 VCRIGHT_a426_seatSwitchForward "0";
BA_ "Confidence" SG_ 2011 VCRIGHT_a426_cabinTmp 1;
BA_ "Confidence" SG_ 2011 VCRIGHT_a427_seatMotorCurrent 1;
BA_ "Confidence" SG_ 2011 VCRIGHT_a427_seatMotorPosReal 1;
BA_ "Confidence" SG_ 2011 VCRIGHT_a427_seatMotorState 1;
BA_ "Confidence" SG_ 2011 VCRIGHT_a427_seatSwitchBack 1;
BA_ "GenSigSNA" SG_ 2011 VCRIGHT_a427_seatSwitchBack "0";
BA_ "Confidence" SG_ 2011 VCRIGHT_a427_seatSwitchForward 1;
BA_ "GenSigSNA" SG_ 2011 VCRIGHT_a427_seatSwitchForward "0";
BA_ "Confidence" SG_ 2011 VCRIGHT_a427_cabinTmp 1;
BA_ "Confidence" SG_ 2011 VCRIGHT_a428_seatMotorCurrent 1;
BA_ "Confidence" SG_ 2011 VCRIGHT_a428_seatMotorPosReal 1;
BA_ "Confidence" SG_ 2011 VCRIGHT_a428_seatMotorState 1;
BA_ "Confidence" SG_ 2011 VCRIGHT_a428_seatSwitchBack 1;
BA_ "GenSigSNA" SG_ 2011 VCRIGHT_a428_seatSwitchBack "0";
BA_ "Confidence" SG_ 2011 VCRIGHT_a428_seatSwitchForward 1;
BA_ "GenSigSNA" SG_ 2011 VCRIGHT_a428_seatSwitchForward "0";
BA_ "Confidence" SG_ 2011 VCRIGHT_a428_cabinTmp 1;
BA_ "Confidence" SG_ 2011 VCRIGHT_a429_seatMotorCurrent 1;
BA_ "Confidence" SG_ 2011 VCRIGHT_a429_seatMotorPosReal 1;
BA_ "Confidence" SG_ 2011 VCRIGHT_a429_seatMotorState 1;
BA_ "Confidence" SG_ 2011 VCRIGHT_a429_seatSwitchBack 1;
BA_ "GenSigSNA" SG_ 2011 VCRIGHT_a429_seatSwitchBack "0";
BA_ "Confidence" SG_ 2011 VCRIGHT_a429_seatSwitchForward 1;
BA_ "GenSigSNA" SG_ 2011 VCRIGHT_a429_seatSwitchForward "0";
BA_ "Confidence" SG_ 2011 VCRIGHT_a429_cabinTmp 1;
BA_ "SystemSignalLongSymbol" SG_ 2011 VCRIGHT_a444_highCurrentFeedEnab "VCRIGHT_a444_highCurrentFeedEnabled";
BA_ "SystemSignalLongSymbol" SG_ 2011 VCRIGHT_a444_supplyVoltageEnable "VCRIGHT_a444_supplyVoltageEnabled";
BA_ "Confidence" SG_ 2011 VCRIGHT_a444_supplyVoltage 1;
BA_ "SystemSignalLongSymbol" SG_ 2011 VCRIGHT_a446_caseTempHVACUnavail "VCRIGHT_a446_caseTempHVACUnavailable";
BA_ "SystemSignalLongSymbol" SG_ 2011 VCRIGHT_a446_evapOperationNotAll "VCRIGHT_a446_evapOperationNotAllowed";
BA_ "SystemSignalLongSymbol" SG_ 2011 VCRIGHT_a446_rawDuctTempInvalidL "VCRIGHT_a446_rawDuctTempInvalidLeft";
BA_ "SystemSignalLongSymbol" SG_ 2011 VCRIGHT_a446_rawDuctTempInvalidR "VCRIGHT_a446_rawDuctTempInvalidRight";
BA_ "SystemSignalLongSymbol" SG_ 2011 VCRIGHT_a448_manACOFFComfortCool "VCRIGHT_a448_manACOFFComfortCoolNudge";
BA_ "SystemSignalLongSymbol" SG_ 2011 VCRIGHT_a448_manAirflowComfortHe "VCRIGHT_a448_manAirflowComfortHeatNudge";
BA_ "SystemSignalLongSymbol" SG_ 2011 VCRIGHT_a448_manAirflowFwdL_0001 "VCRIGHT_a448_manAirflowFwdLkComfortHeatNudge";
BA_ "SystemSignalLongSymbol" SG_ 2011 VCRIGHT_a448_manAirflowFwdLkComf "VCRIGHT_a448_manAirflowFwdLkComfortCoolNudge";
BA_ "SystemSignalLongSymbol" SG_ 2011 VCRIGHT_a448_manACOffFwdLkComfor "VCRIGHT_a448_manACOffFwdLkComfortCoolNudge";
BA_ "SystemSignalLongSymbol" SG_ 2011 VCRIGHT_a448_manFreshComfor_0002 "VCRIGHT_a448_manFreshComfortHeatManualHVACIntvn";
BA_ "SystemSignalLongSymbol" SG_ 2011 VCRIGHT_a448_manFreshComfor_0001 "VCRIGHT_a448_manFreshComfortCoolManualHVACIntvn";
BA_ "SystemSignalLongSymbol" SG_ 2011 VCRIGHT_a448_manFreshComfortCool "VCRIGHT_a448_manFreshComfortCoolAutoHVACIntvn";
BA_ "SystemSignalLongSymbol" SG_ 2011 VCRIGHT_a448_manFreshComfortHeat "VCRIGHT_a448_manFreshComfortHeatAutoHVACIntvn";
BA_ "SystemSignalLongSymbol" SG_ 2011 VCRIGHT_a448_manRecircRHAutoHVAC "VCRIGHT_a448_manRecircRHAutoHVACIntvn";
BA_ "SystemSignalLongSymbol" SG_ 2011 VCRIGHT_a448_manRecircFlashFogGe "VCRIGHT_a448_manRecircFlashFogGenericHVACIntvn";
BA_ "SystemSignalLongSymbol" SG_ 2011 VCRIGHT_a448_manRecircFlashFogWe "VCRIGHT_a448_manRecircFlashFogWetAirHVACIntvn";
BA_ "SystemSignalLongSymbol" SG_ 2011 VCRIGHT_a448_manRecircRHManualHV "VCRIGHT_a448_manRecircRHManualHVACNudge";
BA_ "SystemSignalLongSymbol" SG_ 2011 VCRIGHT_a448_manACoffRHManualHVA "VCRIGHT_a448_manACoffRHManualHVACNudge";
BA_ "SystemSignalLongSymbol" SG_ 2011 VCRIGHT_a448_manHvacOffAutoSteer "VCRIGHT_a448_manHvacOffAutoSteerFogIntvn";
BA_ "SystemSignalLongSymbol" SG_ 2011 VCRIGHT_a448_manHvacOffAuto_0001 "VCRIGHT_a448_manHvacOffAutoSteerFogNudge";
BA_ "SystemSignalLongSymbol" SG_ 2011 VCRIGHT_a448_manHvacAutoSteerFog "VCRIGHT_a448_manHvacAutoSteerFogIntvn";
BA_ "SystemSignalLongSymbol" SG_ 2011 VCRIGHT_a448_manHvacAutoSte_0001 "VCRIGHT_a448_manHvacAutoSteerFogNudge";
BA_ "SystemSignalLongSymbol" SG_ 2011 VCRIGHT_a448_manualHighBlowerSpe "VCRIGHT_a448_manualHighBlowerSpeedAutoHVACIntvn";
BA_ "SystemSignalLongSymbol" SG_ 2011 VCRIGHT_a482_underOrOverVoltageO "VCRIGHT_a482_underOrOverVoltageOrOverCurrent";
BA_ "Confidence" SG_ 2011 VCRIGHT_a489_vbatProtVoltage 1;
BA_ "Confidence" SG_ 2011 VCRIGHT_a489_3rUsbPortsStuckOn 1;
BA_ "Confidence" SG_ 2011 VCRIGHT_a489_lumbarEcuStuckOn 1;
BA_ "Confidence" SG_ 2011 VCRIGHT_a489_oilPumpStuckOn 1;
BA_ "Confidence" SG_ 2011 VCRIGHT_a489_vbusProtFusedMiscSt 1;
BA_ "SystemSignalLongSymbol" SG_ 2011 VCRIGHT_a489_vbusProtFusedMiscSt "VCRIGHT_a489_vbusProtFusedMiscStuckOn";
BA_ "Confidence" SG_ 2011 VCRIGHT_a489_vbusProtFusedSeatSt 1;
BA_ "SystemSignalLongSymbol" SG_ 2011 VCRIGHT_a489_vbusProtFusedSeatSt "VCRIGHT_a489_vbusProtFusedSeatStuckOn";
BA_ "Confidence" SG_ 2011 VCRIGHT_a489_seatFrontVentFanCus 1;
BA_ "SystemSignalLongSymbol" SG_ 2011 VCRIGHT_a489_seatFrontVentFanCus "VCRIGHT_a489_seatFrontVentFanCushionStuckOn";
BA_ "Confidence" SG_ 2011 VCRIGHT_a489_seatFrontVentFanBac 1;
BA_ "SystemSignalLongSymbol" SG_ 2011 VCRIGHT_a489_seatFrontVentFanBac "VCRIGHT_a489_seatFrontVentFanBackrestStuckOn";
BA_ "Confidence" SG_ 2011 VCRIGHT_a489_doorRearRgbStuckOn 1;
BA_ "Confidence" SG_ 2011 VCRIGHT_a489_radioTunerStuckOn 1;
BA_ "Confidence" SG_ 2011 VCRIGHT_a489_seat2rControllerStu 1;
BA_ "SystemSignalLongSymbol" SG_ 2011 VCRIGHT_a489_seat2rControllerStu "VCRIGHT_a489_seat2rControllerStuckOn";
BA_ "Confidence" SG_ 2011 VCRIGHT_a489_premiumAmpStuckOn 1;
BA_ "Confidence" SG_ 2011 VCRIGHT_a489_rearGlassHeaterStuc 1;
BA_ "SystemSignalLongSymbol" SG_ 2011 VCRIGHT_a489_rearGlassHeaterStuc "VCRIGHT_a489_rearGlassHeaterStuckOn";
BA_ "SystemSignalLongSymbol" SG_ 2011 VCRIGHT_a492_3rUsbPortsUnattempt "VCRIGHT_a492_3rUsbPortsUnattemptedOn";
BA_ "SystemSignalLongSymbol" SG_ 2011 VCRIGHT_a492_lumbarEcuUnattempte "VCRIGHT_a492_lumbarEcuUnattemptedOn";
BA_ "SystemSignalLongSymbol" SG_ 2011 VCRIGHT_a492_oilPumpUnattemptedO "VCRIGHT_a492_oilPumpUnattemptedOn";
BA_ "SystemSignalLongSymbol" SG_ 2011 VCRIGHT_a492_vbusProtFusedMiscUn "VCRIGHT_a492_vbusProtFusedMiscUnattemptedOn";
BA_ "SystemSignalLongSymbol" SG_ 2011 VCRIGHT_a492_vbusProtFusedSeatUn "VCRIGHT_a492_vbusProtFusedSeatUnattemptedOn";
BA_ "SystemSignalLongSymbol" SG_ 2011 VCRIGHT_a492_seatFrontVentFanCus "VCRIGHT_a492_seatFrontVentFanCushionUnattemptedOn";
BA_ "SystemSignalLongSymbol" SG_ 2011 VCRIGHT_a492_seatFrontVentFanBac "VCRIGHT_a492_seatFrontVentFanBackrestUnattemptedOn";
BA_ "SystemSignalLongSymbol" SG_ 2011 VCRIGHT_a492_doorRearRgbUnattemp "VCRIGHT_a492_doorRearRgbUnattemptedOn";
BA_ "SystemSignalLongSymbol" SG_ 2011 VCRIGHT_a492_radioTunerUnattempt "VCRIGHT_a492_radioTunerUnattemptedOn";
BA_ "SystemSignalLongSymbol" SG_ 2011 VCRIGHT_a492_seat2rControllerUna "VCRIGHT_a492_seat2rControllerUnattemptedOn";
BA_ "SystemSignalLongSymbol" SG_ 2011 VCRIGHT_a492_premiumAmpUnattempt "VCRIGHT_a492_premiumAmpUnattemptedOn";
BA_ "SystemSignalLongSymbol" SG_ 2011 VCRIGHT_a492_rearGlassHeaterUnat "VCRIGHT_a492_rearGlassHeaterUnattemptedOn";
BA_ "Confidence" SG_ 2011 VCRIGHT_a496_cabinTempInterior 1;
BA_ "GenSigSNA" SG_ 2011 VCRIGHT_a496_cabinTempInterior "255";
BA_ "SystemSignalLongSymbol" SG_ 2011 VCRIGHT_a510_isRearwardEndstopUn "VCRIGHT_a510_isRearwardEndstopUncalibrated";
BA_ "SystemSignalLongSymbol" SG_ 2011 VCRIGHT_a510_isAbsPosSensorUncal "VCRIGHT_a510_isAbsPosSensorUncalibrated";
BA_ "Confidence" SG_ 2011 VCRIGHT_a510_seatState 1;
BA_ "GenSigSNA" SG_ 2011 VCRIGHT_a510_seatState "15";
BA_ "Confidence" SG_ 2011 VCRIGHT_a510_motorType 1;
BA_ "Confidence" SG_ 2011 VCRIGHT_a510_absPosSensState 1;
BA_ "Confidence" SG_ 2011 VCRIGHT_a513_angle 1;
BA_ "Confidence" SG_ 2011 VCRIGHT_a513_seatStatePrev 1;
BA_ "GenSigSNA" SG_ 2011 VCRIGHT_a513_seatStatePrev "15";
BA_ "Confidence" SG_ 2011 VCRIGHT_a513_obstacleDetectReaso 1;
BA_ "SystemSignalLongSymbol" SG_ 2011 VCRIGHT_a513_obstacleDetectReaso "VCRIGHT_a513_obstacleDetectReason";
BA_ "SystemSignalLongSymbol" SG_ 2011 VCRIGHT_a513_accelLookbackTripDe "VCRIGHT_a513_accelLookbackTripDepth";
BA_ "Confidence" SG_ 2011 VCRIGHT_a513_duty 1;
BA_ "Confidence" SG_ 2011 VCRIGHT_a513_currentAbsFilt 1;
BA_ "Confidence" SG_ 2011 VCRIGHT_a513_motorType 1;
BA_ "SystemSignalLongSymbol" SG_ 2011 VCRIGHT_a513_absolutePosSensorFo "VCRIGHT_a513_absolutePosSensorForward";
BA_ "Confidence" SG_ 2011 VCRIGHT_a513_cabinTemp 1;
BA_ "SystemSignalLongSymbol" SG_ 2011 VCRIGHT_a517_isRearwardEndstopUn "VCRIGHT_a517_isRearwardEndstopUncalibrated";
BA_ "SystemSignalLongSymbol" SG_ 2011 VCRIGHT_a517_isAbsPosSensorUncal "VCRIGHT_a517_isAbsPosSensorUncalibrated";
BA_ "Confidence" SG_ 2011 VCRIGHT_a518_seatState 1;
BA_ "GenSigSNA" SG_ 2011 VCRIGHT_a518_seatState "15";
BA_ "Confidence" SG_ 2011 VCRIGHT_a520_epbConfig 1;
VAL_ 2011 VCRIGHT_a150_windowPinchReason 5 "UNUSED" 4 "ACCEL_LOOKBACK" 3 "POWER_CRUDE" 2 "POWER_DIV_SPEED" 1 "POWER" 0 "NONE" ;
VAL_ 2011 VCRIGHT_a151_windowPinchReason 5 "UNUSED" 4 "ACCEL_LOOKBACK" 3 "POWER_CRUDE" 2 "POWER_DIV_SPEED" 1 "POWER" 0 "NONE" ;
VAL_ 2011 VCRIGHT_a152_speedTableStatus 2 "FULLY_BUILT" 1 "SENSITIVE_BUILT" 0 "EMPTY_SNA" ;
VAL_ 2011 VCRIGHT_a153_speedTableStatus 2 "FULLY_BUILT" 1 "SENSITIVE_BUILT" 0 "EMPTY_SNA" ;
VAL_ 2011 VCRIGHT_a154_windowThermalMode 3 "CRITICAL" 2 "ALERT" 1 "NORMAL" 0 "SNA" ;
VAL_ 2011 VCRIGHT_a155_windowThermalMode 3 "CRITICAL" 2 "ALERT" 1 "NORMAL" 0 "SNA" ;
VAL_ 2011 VCRIGHT_a180_latchStatus 8 "FAULT" 7 "DEFAULT" 6 "TIMEOUT" 5 "AJAR" 4 "OPENING" 3 "CLOSING" 2 "CLOSED" 1 "OPENED" 0 "SNA" ;
VAL_ 2011 VCRIGHT_a181_latchStatus 8 "FAULT" 7 "DEFAULT" 6 "TIMEOUT" 5 "AJAR" 4 "OPENING" 3 "CLOSING" 2 "CLOSED" 1 "OPENED" 0 "SNA" ;
VAL_ 2011 VCRIGHT_a202_epbConfig 11 "CT_MANDO" 10 "MODEL3_ZF" 9 "MODELS_CERAMIC" 8 "MODELY_PERFORMANCE_V2" 7 "MODEL3_PERFORMANCE_V2" 6 "MODELX_BASE" 5 "MODELY_PERFORMANCE" 4 "MODELY_BASE" 3 "MODELS_BASE" 2 "MODEL3_PERFORMANCE" 1 "MODEL3_BASE" 0 "UNKNOWN" ;
VAL_ 2011 VCRIGHT_a203_epbConfig 11 "CT_MANDO" 10 "MODEL3_ZF" 9 "MODELS_CERAMIC" 8 "MODELY_PERFORMANCE_V2" 7 "MODEL3_PERFORMANCE_V2" 6 "MODELX_BASE" 5 "MODELY_PERFORMANCE" 4 "MODELY_BASE" 3 "MODELS_BASE" 2 "MODEL3_PERFORMANCE" 1 "MODEL3_BASE" 0 "UNKNOWN" ;
VAL_ 2011 VCRIGHT_a204_epbConfig 11 "CT_MANDO" 10 "MODEL3_ZF" 9 "MODELS_CERAMIC" 8 "MODELY_PERFORMANCE_V2" 7 "MODEL3_PERFORMANCE_V2" 6 "MODELX_BASE" 5 "MODELY_PERFORMANCE" 4 "MODELY_BASE" 3 "MODELS_BASE" 2 "MODEL3_PERFORMANCE" 1 "MODEL3_BASE" 0 "UNKNOWN" ;
VAL_ 2011 VCRIGHT_a205_epbConfig 11 "CT_MANDO" 10 "MODEL3_ZF" 9 "MODELS_CERAMIC" 8 "MODELY_PERFORMANCE_V2" 7 "MODEL3_PERFORMANCE_V2" 6 "MODELX_BASE" 5 "MODELY_PERFORMANCE" 4 "MODELY_BASE" 3 "MODELS_BASE" 2 "MODEL3_PERFORMANCE" 1 "MODEL3_BASE" 0 "UNKNOWN" ;
VAL_ 2011 VCRIGHT_a206_unitStatusEPB 23 "COUNT" 22 "AUTONOMY_OPEN" 21 "FREE_ROLL_MODE" 20 "DYNAMIC_PARKING" 19 "EXTERNAL_PARKING" 18 "RELEASING_FOR_EXTERNAL_PARK" 17 "EXTERNAL_DYNAMIC" 16 "SUMMON_PARKING" 15 "SUMMON_RELEASING" 14 "SUMMON" 13 "WINCHMODE_PENDING" 12 "PARK_PENDING" 11 "SERVICE_RELEASING" 10 "RELEASING" 9 "DYNAMIC_APPLYING" 8 "PARKING" 7 "WINCHMODE_RELEASING" 6 "WINCHMODE" 5 "SERVICE" 4 "START" 3 "PARK" 2 "DYNAMIC" 1 "OPEN" 0 "UNKNOWN" ;
VAL_ 2011 VCRIGHT_a206_unitStatusEPBM 23 "COUNT" 22 "AUTONOMY_OPEN" 21 "FREE_ROLL_MODE" 20 "DYNAMIC_PARKING" 19 "EXTERNAL_PARKING" 18 "RELEASING_FOR_EXTERNAL_PARK" 17 "EXTERNAL_DYNAMIC" 16 "SUMMON_PARKING" 15 "SUMMON_RELEASING" 14 "SUMMON" 13 "WINCHMODE_PENDING" 12 "PARK_PENDING" 11 "SERVICE_RELEASING" 10 "RELEASING" 9 "DYNAMIC_APPLYING" 8 "PARKING" 7 "WINCHMODE_RELEASING" 6 "WINCHMODE" 5 "SERVICE" 4 "START" 3 "PARK" 2 "DYNAMIC" 1 "OPEN" 0 "UNKNOWN" ;
VAL_ 2011 VCRIGHT_a207_unitStatusEPB 23 "COUNT" 22 "AUTONOMY_OPEN" 21 "FREE_ROLL_MODE" 20 "DYNAMIC_PARKING" 19 "EXTERNAL_PARKING" 18 "RELEASING_FOR_EXTERNAL_PARK" 17 "EXTERNAL_DYNAMIC" 16 "SUMMON_PARKING" 15 "SUMMON_RELEASING" 14 "SUMMON" 13 "WINCHMODE_PENDING" 12 "PARK_PENDING" 11 "SERVICE_RELEASING" 10 "RELEASING" 9 "DYNAMIC_APPLYING" 8 "PARKING" 7 "WINCHMODE_RELEASING" 6 "WINCHMODE" 5 "SERVICE" 4 "START" 3 "PARK" 2 "DYNAMIC" 1 "OPEN" 0 "UNKNOWN" ;
VAL_ 2011 VCRIGHT_a207_unitStatusEPBM 23 "COUNT" 22 "AUTONOMY_OPEN" 21 "FREE_ROLL_MODE" 20 "DYNAMIC_PARKING" 19 "EXTERNAL_PARKING" 18 "RELEASING_FOR_EXTERNAL_PARK" 17 "EXTERNAL_DYNAMIC" 16 "SUMMON_PARKING" 15 "SUMMON_RELEASING" 14 "SUMMON" 13 "WINCHMODE_PENDING" 12 "PARK_PENDING" 11 "SERVICE_RELEASING" 10 "RELEASING" 9 "DYNAMIC_APPLYING" 8 "PARKING" 7 "WINCHMODE_RELEASING" 6 "WINCHMODE" 5 "SERVICE" 4 "START" 3 "PARK" 2 "DYNAMIC" 1 "OPEN" 0 "UNKNOWN" ;
VAL_ 2011 VCRIGHT_a208_unitStatusEPB 23 "COUNT" 22 "AUTONOMY_OPEN" 21 "FREE_ROLL_MODE" 20 "DYNAMIC_PARKING" 19 "EXTERNAL_PARKING" 18 "RELEASING_FOR_EXTERNAL_PARK" 17 "EXTERNAL_DYNAMIC" 16 "SUMMON_PARKING" 15 "SUMMON_RELEASING" 14 "SUMMON" 13 "WINCHMODE_PENDING" 12 "PARK_PENDING" 11 "SERVICE_RELEASING" 10 "RELEASING" 9 "DYNAMIC_APPLYING" 8 "PARKING" 7 "WINCHMODE_RELEASING" 6 "WINCHMODE" 5 "SERVICE" 4 "START" 3 "PARK" 2 "DYNAMIC" 1 "OPEN" 0 "UNKNOWN" ;
VAL_ 2011 VCRIGHT_a208_unitStatusEPBM 23 "COUNT" 22 "AUTONOMY_OPEN" 21 "FREE_ROLL_MODE" 20 "DYNAMIC_PARKING" 19 "EXTERNAL_PARKING" 18 "RELEASING_FOR_EXTERNAL_PARK" 17 "EXTERNAL_DYNAMIC" 16 "SUMMON_PARKING" 15 "SUMMON_RELEASING" 14 "SUMMON" 13 "WINCHMODE_PENDING" 12 "PARK_PENDING" 11 "SERVICE_RELEASING" 10 "RELEASING" 9 "DYNAMIC_APPLYING" 8 "PARKING" 7 "WINCHMODE_RELEASING" 6 "WINCHMODE" 5 "SERVICE" 4 "START" 3 "PARK" 2 "DYNAMIC" 1 "OPEN" 0 "UNKNOWN" ;
VAL_ 2011 VCRIGHT_a209_unitStatusEPB 23 "COUNT" 22 "AUTONOMY_OPEN" 21 "FREE_ROLL_MODE" 20 "DYNAMIC_PARKING" 19 "EXTERNAL_PARKING" 18 "RELEASING_FOR_EXTERNAL_PARK" 17 "EXTERNAL_DYNAMIC" 16 "SUMMON_PARKING" 15 "SUMMON_RELEASING" 14 "SUMMON" 13 "WINCHMODE_PENDING" 12 "PARK_PENDING" 11 "SERVICE_RELEASING" 10 "RELEASING" 9 "DYNAMIC_APPLYING" 8 "PARKING" 7 "WINCHMODE_RELEASING" 6 "WINCHMODE" 5 "SERVICE" 4 "START" 3 "PARK" 2 "DYNAMIC" 1 "OPEN" 0 "UNKNOWN" ;
VAL_ 2011 VCRIGHT_a209_unitStatusEPBM 23 "COUNT" 22 "AUTONOMY_OPEN" 21 "FREE_ROLL_MODE" 20 "DYNAMIC_PARKING" 19 "EXTERNAL_PARKING" 18 "RELEASING_FOR_EXTERNAL_PARK" 17 "EXTERNAL_DYNAMIC" 16 "SUMMON_PARKING" 15 "SUMMON_RELEASING" 14 "SUMMON" 13 "WINCHMODE_PENDING" 12 "PARK_PENDING" 11 "SERVICE_RELEASING" 10 "RELEASING" 9 "DYNAMIC_APPLYING" 8 "PARKING" 7 "WINCHMODE_RELEASING" 6 "WINCHMODE" 5 "SERVICE" 4 "START" 3 "PARK" 2 "DYNAMIC" 1 "OPEN" 0 "UNKNOWN" ;
VAL_ 2011 VCRIGHT_a210_unitStatusEPB 23 "COUNT" 22 "AUTONOMY_OPEN" 21 "FREE_ROLL_MODE" 20 "DYNAMIC_PARKING" 19 "EXTERNAL_PARKING" 18 "RELEASING_FOR_EXTERNAL_PARK" 17 "EXTERNAL_DYNAMIC" 16 "SUMMON_PARKING" 15 "SUMMON_RELEASING" 14 "SUMMON" 13 "WINCHMODE_PENDING" 12 "PARK_PENDING" 11 "SERVICE_RELEASING" 10 "RELEASING" 9 "DYNAMIC_APPLYING" 8 "PARKING" 7 "WINCHMODE_RELEASING" 6 "WINCHMODE" 5 "SERVICE" 4 "START" 3 "PARK" 2 "DYNAMIC" 1 "OPEN" 0 "UNKNOWN" ;
VAL_ 2011 VCRIGHT_a210_unitStatusEPBM 23 "COUNT" 22 "AUTONOMY_OPEN" 21 "FREE_ROLL_MODE" 20 "DYNAMIC_PARKING" 19 "EXTERNAL_PARKING" 18 "RELEASING_FOR_EXTERNAL_PARK" 17 "EXTERNAL_DYNAMIC" 16 "SUMMON_PARKING" 15 "SUMMON_RELEASING" 14 "SUMMON" 13 "WINCHMODE_PENDING" 12 "PARK_PENDING" 11 "SERVICE_RELEASING" 10 "RELEASING" 9 "DYNAMIC_APPLYING" 8 "PARKING" 7 "WINCHMODE_RELEASING" 6 "WINCHMODE" 5 "SERVICE" 4 "START" 3 "PARK" 2 "DYNAMIC" 1 "OPEN" 0 "UNKNOWN" ;
VAL_ 2011 VCRIGHT_a224_seatMotorState 5 "UNDEFINED" 4 "CALIBRATING" 3 "RECALLING" 2 "MOVING_DOWN" 1 "MOVING_UP" 0 "STOPPED" ;
VAL_ 2011 VCRIGHT_a224_seatSwitchBack 3 "FAULT" 2 "ON" 1 "OFF" 0 "SNA" ;
VAL_ 2011 VCRIGHT_a224_seatSwitchForward 3 "FAULT" 2 "ON" 1 "OFF" 0 "SNA" ;
VAL_ 2011 VCRIGHT_a225_seatMotorState 5 "UNDEFINED" 4 "CALIBRATING" 3 "RECALLING" 2 "MOVING_DOWN" 1 "MOVING_UP" 0 "STOPPED" ;
VAL_ 2011 VCRIGHT_a225_seatSwitchBack 3 "FAULT" 2 "ON" 1 "OFF" 0 "SNA" ;
VAL_ 2011 VCRIGHT_a225_seatSwitchForward 3 "FAULT" 2 "ON" 1 "OFF" 0 "SNA" ;
VAL_ 2011 VCRIGHT_a226_seatMotorState 5 "UNDEFINED" 4 "CALIBRATING" 3 "RECALLING" 2 "MOVING_DOWN" 1 "MOVING_UP" 0 "STOPPED" ;
VAL_ 2011 VCRIGHT_a226_seatSwitchBack 3 "FAULT" 2 "ON" 1 "OFF" 0 "SNA" ;
VAL_ 2011 VCRIGHT_a226_seatSwitchForward 3 "FAULT" 2 "ON" 1 "OFF" 0 "SNA" ;
VAL_ 2011 VCRIGHT_a227_seatMotorState 5 "UNDEFINED" 4 "CALIBRATING" 3 "RECALLING" 2 "MOVING_DOWN" 1 "MOVING_UP" 0 "STOPPED" ;
VAL_ 2011 VCRIGHT_a227_seatSwitchBack 3 "FAULT" 2 "ON" 1 "OFF" 0 "SNA" ;
VAL_ 2011 VCRIGHT_a227_seatSwitchForward 3 "FAULT" 2 "ON" 1 "OFF" 0 "SNA" ;
VAL_ 2011 VCRIGHT_a228_seatMotorState 5 "UNDEFINED" 4 "CALIBRATING" 3 "RECALLING" 2 "MOVING_DOWN" 1 "MOVING_UP" 0 "STOPPED" ;
VAL_ 2011 VCRIGHT_a228_seatSwitchBack 3 "FAULT" 2 "ON" 1 "OFF" 0 "SNA" ;
VAL_ 2011 VCRIGHT_a228_seatSwitchForward 3 "FAULT" 2 "ON" 1 "OFF" 0 "SNA" ;
VAL_ 2011 VCRIGHT_a229_seatMotorState 5 "UNDEFINED" 4 "CALIBRATING" 3 "RECALLING" 2 "MOVING_DOWN" 1 "MOVING_UP" 0 "STOPPED" ;
VAL_ 2011 VCRIGHT_a229_seatSwitchBack 3 "FAULT" 2 "ON" 1 "OFF" 0 "SNA" ;
VAL_ 2011 VCRIGHT_a229_seatSwitchForward 3 "FAULT" 2 "ON" 1 "OFF" 0 "SNA" ;
VAL_ 2011 VCRIGHT_a230_seatMotorState 5 "UNDEFINED" 4 "CALIBRATING" 3 "RECALLING" 2 "MOVING_DOWN" 1 "MOVING_UP" 0 "STOPPED" ;
VAL_ 2011 VCRIGHT_a230_seatSwitchBack 3 "FAULT" 2 "ON" 1 "OFF" 0 "SNA" ;
VAL_ 2011 VCRIGHT_a230_seatSwitchForward 3 "FAULT" 2 "ON" 1 "OFF" 0 "SNA" ;
VAL_ 2011 VCRIGHT_a231_seatMotorState 5 "UNDEFINED" 4 "CALIBRATING" 3 "RECALLING" 2 "MOVING_DOWN" 1 "MOVING_UP" 0 "STOPPED" ;
VAL_ 2011 VCRIGHT_a231_seatSwitchBack 3 "FAULT" 2 "ON" 1 "OFF" 0 "SNA" ;
VAL_ 2011 VCRIGHT_a231_seatSwitchForward 3 "FAULT" 2 "ON" 1 "OFF" 0 "SNA" ;
VAL_ 2011 VCRIGHT_a232_seatMotorState 5 "UNDEFINED" 4 "CALIBRATING" 3 "RECALLING" 2 "MOVING_DOWN" 1 "MOVING_UP" 0 "STOPPED" ;
VAL_ 2011 VCRIGHT_a232_seatSwitchBack 3 "FAULT" 2 "ON" 1 "OFF" 0 "SNA" ;
VAL_ 2011 VCRIGHT_a232_seatSwitchForward 3 "FAULT" 2 "ON" 1 "OFF" 0 "SNA" ;
VAL_ 2011 VCRIGHT_a233_seatMotorState 5 "UNDEFINED" 4 "CALIBRATING" 3 "RECALLING" 2 "MOVING_DOWN" 1 "MOVING_UP" 0 "STOPPED" ;
VAL_ 2011 VCRIGHT_a233_seatSwitchBack 3 "FAULT" 2 "ON" 1 "OFF" 0 "SNA" ;
VAL_ 2011 VCRIGHT_a233_seatSwitchForward 3 "FAULT" 2 "ON" 1 "OFF" 0 "SNA" ;
VAL_ 2011 VCRIGHT_a234_seatMotorState 5 "UNDEFINED" 4 "CALIBRATING" 3 "RECALLING" 2 "MOVING_DOWN" 1 "MOVING_UP" 0 "STOPPED" ;
VAL_ 2011 VCRIGHT_a234_seatSwitchBack 3 "FAULT" 2 "ON" 1 "OFF" 0 "SNA" ;
VAL_ 2011 VCRIGHT_a234_seatSwitchForward 3 "FAULT" 2 "ON" 1 "OFF" 0 "SNA" ;
VAL_ 2011 VCRIGHT_a235_seatMotorState 5 "UNDEFINED" 4 "CALIBRATING" 3 "RECALLING" 2 "MOVING_DOWN" 1 "MOVING_UP" 0 "STOPPED" ;
VAL_ 2011 VCRIGHT_a235_seatSwitchBack 3 "FAULT" 2 "ON" 1 "OFF" 0 "SNA" ;
VAL_ 2011 VCRIGHT_a235_seatSwitchForward 3 "FAULT" 2 "ON" 1 "OFF" 0 "SNA" ;
VAL_ 2011 VCRIGHT_a236_lumbarAState 5 "UNDEFINED" 4 "CALIBRATING" 3 "RECALLING" 2 "MOVING_DOWN" 1 "MOVING_UP" 0 "STOPPED" ;
VAL_ 2011 VCRIGHT_a236_lumbarBState 5 "UNDEFINED" 4 "CALIBRATING" 3 "RECALLING" 2 "MOVING_DOWN" 1 "MOVING_UP" 0 "STOPPED" ;
VAL_ 2011 VCRIGHT_a237_lumbarAState 5 "UNDEFINED" 4 "CALIBRATING" 3 "RECALLING" 2 "MOVING_DOWN" 1 "MOVING_UP" 0 "STOPPED" ;
VAL_ 2011 VCRIGHT_a237_lumbarBState 5 "UNDEFINED" 4 "CALIBRATING" 3 "RECALLING" 2 "MOVING_DOWN" 1 "MOVING_UP" 0 "STOPPED" ;
VAL_ 2011 VCRIGHT_a238_lumbarAState 5 "UNDEFINED" 4 "CALIBRATING" 3 "RECALLING" 2 "MOVING_DOWN" 1 "MOVING_UP" 0 "STOPPED" ;
VAL_ 2011 VCRIGHT_a238_lumbarBState 5 "UNDEFINED" 4 "CALIBRATING" 3 "RECALLING" 2 "MOVING_DOWN" 1 "MOVING_UP" 0 "STOPPED" ;
VAL_ 2011 VCRIGHT_a251_seatMotorState 5 "UNDEFINED" 4 "CALIBRATING" 3 "RECALLING" 2 "MOVING_DOWN" 1 "MOVING_UP" 0 "STOPPED" ;
VAL_ 2011 VCRIGHT_a251_seatSwitchBack 3 "FAULT" 2 "ON" 1 "OFF" 0 "SNA" ;
VAL_ 2011 VCRIGHT_a251_seatSwitchForward 3 "FAULT" 2 "ON" 1 "OFF" 0 "SNA" ;
VAL_ 2011 VCRIGHT_a252_seatMotorState 5 "UNDEFINED" 4 "CALIBRATING" 3 "RECALLING" 2 "MOVING_DOWN" 1 "MOVING_UP" 0 "STOPPED" ;
VAL_ 2011 VCRIGHT_a252_seatSwitchBack 3 "FAULT" 2 "ON" 1 "OFF" 0 "SNA" ;
VAL_ 2011 VCRIGHT_a252_seatSwitchForward 3 "FAULT" 2 "ON" 1 "OFF" 0 "SNA" ;
VAL_ 2011 VCRIGHT_a253_seatMotorState 5 "UNDEFINED" 4 "CALIBRATING" 3 "RECALLING" 2 "MOVING_DOWN" 1 "MOVING_UP" 0 "STOPPED" ;
VAL_ 2011 VCRIGHT_a253_seatSwitchBack 3 "FAULT" 2 "ON" 1 "OFF" 0 "SNA" ;
VAL_ 2011 VCRIGHT_a253_seatSwitchForward 3 "FAULT" 2 "ON" 1 "OFF" 0 "SNA" ;
VAL_ 2011 VCRIGHT_a254_seatMotorState 5 "UNDEFINED" 4 "CALIBRATING" 3 "RECALLING" 2 "MOVING_DOWN" 1 "MOVING_UP" 0 "STOPPED" ;
VAL_ 2011 VCRIGHT_a254_seatSwitchBack 3 "FAULT" 2 "ON" 1 "OFF" 0 "SNA" ;
VAL_ 2011 VCRIGHT_a254_seatSwitchForward 3 "FAULT" 2 "ON" 1 "OFF" 0 "SNA" ;
VAL_ 2011 VCRIGHT_a263_seatMotorState 5 "UNDEFINED" 4 "CALIBRATING" 3 "RECALLING" 2 "MOVING_DOWN" 1 "MOVING_UP" 0 "STOPPED" ;
VAL_ 2011 VCRIGHT_a264_seatMotorState 5 "UNDEFINED" 4 "CALIBRATING" 3 "RECALLING" 2 "MOVING_DOWN" 1 "MOVING_UP" 0 "STOPPED" ;
VAL_ 2011 VCRIGHT_a265_seatMotorState 5 "UNDEFINED" 4 "CALIBRATING" 3 "RECALLING" 2 "MOVING_DOWN" 1 "MOVING_UP" 0 "STOPPED" ;
VAL_ 2011 VCRIGHT_a266_seatMotorState 5 "UNDEFINED" 4 "CALIBRATING" 3 "RECALLING" 2 "MOVING_DOWN" 1 "MOVING_UP" 0 "STOPPED" ;
VAL_ 2011 VCRIGHT_a267_seatMotorState 5 "UNDEFINED" 4 "CALIBRATING" 3 "RECALLING" 2 "MOVING_DOWN" 1 "MOVING_UP" 0 "STOPPED" ;
VAL_ 2011 VCRIGHT_a268_seatMotorState 5 "UNDEFINED" 4 "CALIBRATING" 3 "RECALLING" 2 "MOVING_DOWN" 1 "MOVING_UP" 0 "STOPPED" ;
VAL_ 2011 VCRIGHT_a269_seatMotorState 5 "UNDEFINED" 4 "CALIBRATING" 3 "RECALLING" 2 "MOVING_DOWN" 1 "MOVING_UP" 0 "STOPPED" ;
VAL_ 2011 VCRIGHT_a270_seatMotorState 5 "UNDEFINED" 4 "CALIBRATING" 3 "RECALLING" 2 "MOVING_DOWN" 1 "MOVING_UP" 0 "STOPPED" ;
VAL_ 2011 VCRIGHT_a284_cabinTempInterior 255 "SNA" ;
VAL_ 2011 VCRIGHT_a285_cabinTempInterior 255 "SNA" ;
VAL_ 2011 VCRIGHT_a310_foldingDirection 1 "UNFOLD" 0 "FOLD" ;
VAL_ 2011 VCRIGHT_a310_ambientTemperature 0 "SNA" ;
VAL_ 2011 VCRIGHT_a316_foldState 4 "UNFOLDING" 3 "FOLDING" 2 "UNFOLDED" 1 "FOLDED" 0 "UNKNOWN" ;
VAL_ 2011 VCRIGHT_a316_ambientTemperatureD 0 "SNA" ;
VAL_ 2011 VCRIGHT_a373_windowChannel 2 "FRONT" 1 "REAR" 0 "UNKNOWN" ;
VAL_ 2011 VCRIGHT_a376_2RowSeatEasyEntrySt 6 "SNA" 5 "TRACK_FORE_PITCH_UNLATCHED" 4 "TRACK_AFT_PITCH_UNLATCHED" 3 "PITCH_UNLATCHING" 2 "TRACK_FORE_PITCH_LATCHED" 1 "TRACK_UNLATCHING" 0 "TRACK_AFT_PITCH_LATCHED" ;
VAL_ 2011 VCRIGHT_a376_2RowSeatTrackPositi 3 "FAULT" 2 "ON" 1 "OFF" 0 "SNA" ;
VAL_ 2011 VCRIGHT_a385_reason 3 "RESISTANCE_HIGH" 2 "RESISTANCE_LOW" 1 "UNRESPONSIVE" 0 "NONE" ;
VAL_ 2011 VCRIGHT_a411_failureReason 32 "BRIDGE_SYNC" 16 "TIMEOUT" 8 "FOLLOWER" 4 "LOAD_UNATTEMPTED_ON" 3 "BRIDGE_AND_DEVICE_STUCK_ON" 2 "BRIDGE" 1 "DEVICE_STUCK_ON" 0 "NONE" ;
VAL_ 2011 VCRIGHT_a426_seatMotorState 5 "UNDEFINED" 4 "CALIBRATING" 3 "RECALLING" 2 "MOVING_DOWN" 1 "MOVING_UP" 0 "STOPPED" ;
VAL_ 2011 VCRIGHT_a426_seatSwitchBack 3 "FAULT" 2 "ON" 1 "OFF" 0 "SNA" ;
VAL_ 2011 VCRIGHT_a426_seatSwitchForward 3 "FAULT" 2 "ON" 1 "OFF" 0 "SNA" ;
VAL_ 2011 VCRIGHT_a427_seatMotorState 5 "UNDEFINED" 4 "CALIBRATING" 3 "RECALLING" 2 "MOVING_DOWN" 1 "MOVING_UP" 0 "STOPPED" ;
VAL_ 2011 VCRIGHT_a427_seatSwitchBack 3 "FAULT" 2 "ON" 1 "OFF" 0 "SNA" ;
VAL_ 2011 VCRIGHT_a427_seatSwitchForward 3 "FAULT" 2 "ON" 1 "OFF" 0 "SNA" ;
VAL_ 2011 VCRIGHT_a428_seatMotorState 5 "UNDEFINED" 4 "CALIBRATING" 3 "RECALLING" 2 "MOVING_DOWN" 1 "MOVING_UP" 0 "STOPPED" ;
VAL_ 2011 VCRIGHT_a428_seatSwitchBack 3 "FAULT" 2 "ON" 1 "OFF" 0 "SNA" ;
VAL_ 2011 VCRIGHT_a428_seatSwitchForward 3 "FAULT" 2 "ON" 1 "OFF" 0 "SNA" ;
VAL_ 2011 VCRIGHT_a429_seatMotorState 5 "UNDEFINED" 4 "CALIBRATING" 3 "RECALLING" 2 "MOVING_DOWN" 1 "MOVING_UP" 0 "STOPPED" ;
VAL_ 2011 VCRIGHT_a429_seatSwitchBack 3 "FAULT" 2 "ON" 1 "OFF" 0 "SNA" ;
VAL_ 2011 VCRIGHT_a429_seatSwitchForward 3 "FAULT" 2 "ON" 1 "OFF" 0 "SNA" ;
VAL_ 2011 VCRIGHT_a489_3rUsbPortsStuckOn 1 "STUCK_ON_SHARED_MONITOR" 0 "PASS_OR_NOT_APPLICABLE" ;
VAL_ 2011 VCRIGHT_a489_lumbarEcuStuckOn 1 "STUCK_ON_SHARED_MONITOR" 0 "PASS_OR_NOT_APPLICABLE" ;
VAL_ 2011 VCRIGHT_a489_oilPumpStuckOn 1 "STUCK_ON_SHARED_MONITOR" 0 "PASS_OR_NOT_APPLICABLE" ;
VAL_ 2011 VCRIGHT_a489_vbusProtFusedMiscSt 1 "STUCK_ON" 0 "PASS_OR_NOT_APPLICABLE" ;
VAL_ 2011 VCRIGHT_a489_vbusProtFusedSeatSt 1 "STUCK_ON" 0 "PASS_OR_NOT_APPLICABLE" ;
VAL_ 2011 VCRIGHT_a489_seatFrontVentFanCus 1 "STUCK_ON_SHARED_MONITOR" 0 "PASS_OR_NOT_APPLICABLE" ;
VAL_ 2011 VCRIGHT_a489_seatFrontVentFanBac 1 "STUCK_ON_SHARED_MONITOR" 0 "PASS_OR_NOT_APPLICABLE" ;
VAL_ 2011 VCRIGHT_a489_doorRearRgbStuckOn 1 "STUCK_ON_SHARED_MONITOR" 0 "PASS_OR_NOT_APPLICABLE" ;
VAL_ 2011 VCRIGHT_a489_radioTunerStuckOn 1 "STUCK_ON_SHARED_MONITOR" 0 "PASS_OR_NOT_APPLICABLE" ;
VAL_ 2011 VCRIGHT_a489_seat2rControllerStu 1 "STUCK_ON_SHARED_MONITOR" 0 "PASS_OR_NOT_APPLICABLE" ;
VAL_ 2011 VCRIGHT_a489_premiumAmpStuckOn 1 "STUCK_ON_SHARED_MONITOR" 0 "PASS_OR_NOT_APPLICABLE" ;
VAL_ 2011 VCRIGHT_a489_rearGlassHeaterStuc 1 "STUCK_ON_SHARED_MONITOR" 0 "PASS_OR_NOT_APPLICABLE" ;
VAL_ 2011 VCRIGHT_a496_cabinTempInterior 255 "SNA" ;
VAL_ 2011 VCRIGHT_a510_seatState 15 "SNA" 12 "CALIBRATING_ABSOLUTE_SENSOR" 11 "CALIBRATING_ZERO_POSITION" 10 "WAITING_TO_CLEAR_FOR_UNFOLD" 9 "WAITING_TO_CLEAR_FOR_FOLD" 8 "MOVING_REARWARD_TO_POSITION" 7 "MOVING_FORWARD_TO_POSITION" 6 "UNFOLDING" 5 "FOLDING" 4 "ADJUSTING_REARWARD_FAST" 3 "ADJUSTING_FORWARD_FAST" 2 "ADJUSTING_REARWARD_COMFORT" 1 "ADJUSTING_FORWARD_COMFORT" 0 "STOPPED" ;
VAL_ 2011 VCRIGHT_a510_motorType 1 "KEIPER" 0 "SHB_OR_UNKNOWN" ;
VAL_ 2011 VCRIGHT_a510_absPosSensState 3 "DISCONNECTED" 2 "FORWARD" 1 "REARWARD" 0 "FAULTED" ;
VAL_ 2011 VCRIGHT_a513_seatStatePrev 15 "SNA" 12 "CALIBRATING_ABSOLUTE_SENSOR" 11 "CALIBRATING_ZERO_POSITION" 10 "WAITING_TO_CLEAR_FOR_UNFOLD" 9 "WAITING_TO_CLEAR_FOR_FOLD" 8 "MOVING_REARWARD_TO_POSITION" 7 "MOVING_FORWARD_TO_POSITION" 6 "UNFOLDING" 5 "FOLDING" 4 "ADJUSTING_REARWARD_FAST" 3 "ADJUSTING_FORWARD_FAST" 2 "ADJUSTING_REARWARD_COMFORT" 1 "ADJUSTING_FORWARD_COMFORT" 0 "STOPPED" ;
VAL_ 2011 VCRIGHT_a513_obstacleDetectReaso 8 "MAX_SPEED_DIFF" 7 "SPEED_THRESHOLD" 6 "MEDIUM_CURRENT_THRESHOLD" 5 "ACCEL_LOOKBACK_COMP_ABS" 4 "ACCEL_LOOKBACK_UNCOMP_REL" 3 "ACCEL_LOOKBACK_UNCOMP_ABS" 2 "MOTOR_ENCODER_STALL" 1 "MOTOR_CURRENT_STALL" 0 "NONE" ;
VAL_ 2011 VCRIGHT_a513_motorType 1 "KEIPER" 0 "SHB_OR_UNKNOWN" ;
VAL_ 2011 VCRIGHT_a518_seatState 15 "SNA" 12 "CALIBRATING_ABSOLUTE_SENSOR" 11 "CALIBRATING_ZERO_POSITION" 10 "WAITING_TO_CLEAR_FOR_UNFOLD" 9 "WAITING_TO_CLEAR_FOR_FOLD" 8 "MOVING_REARWARD_TO_POSITION" 7 "MOVING_FORWARD_TO_POSITION" 6 "UNFOLDING" 5 "FOLDING" 4 "ADJUSTING_REARWARD_FAST" 3 "ADJUSTING_FORWARD_FAST" 2 "ADJUSTING_REARWARD_COMFORT" 1 "ADJUSTING_FORWARD_COMFORT" 0 "STOPPED" ;
VAL_ 2011 VCRIGHT_a520_epbConfig 11 "CT_MANDO" 10 "MODEL3_ZF" 9 "MODELS_CERAMIC" 8 "MODELY_PERFORMANCE_V2" 7 "MODEL3_PERFORMANCE_V2" 6 "MODELX_BASE" 5 "MODELY_PERFORMANCE" 4 "MODELY_BASE" 3 "MODELS_BASE" 2 "MODEL3_PERFORMANCE" 1 "MODEL3_BASE" 0 "UNKNOWN" ;
