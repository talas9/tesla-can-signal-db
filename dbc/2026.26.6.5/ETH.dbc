VERSION "dbc-export 1 2026.26.6.5"

NS_ :

BS_:

BU_: ADSP APB APP APS APSB BB BMS CC CMP CMPD CP DAS DI DIF DIR DPB EPAS3P EPAS3S EPASTP EPASTS EPBL EPBR ESP EVSE FC GTW HCML HCMR HVP IBST ICR IDB LS OCS1P ODIN PARK PCS PCS2 PLG PM PMF PMR PNCD PTC RADC RCM RCM2 RCM3 RCU SCCM SCM SCS SDCR TAS TCU TCU2 TPMS TRCM UDS UI UIS UMC USM V2G VC VCBATT VCBATT0 VCBATT1 VCBATT2 VCCC VCFRONT VCFRONT1 VCFRONT2 VCLEFT VCRIGHT VCSEAT2L VCSEAT2R VCSEC VEH

BO_ 920 EPASTS_alertMatrix: 8 EPASTS
 SG_ EPASTS_matrixIndex M : 0|4@1+ (1,0) [0|15] "" Vector__XXX
 SG_ EPASTS_a001_adcCalibrationOrInit m0 : 4|1@1+ (1,0) [0|1] "" Vector__XXX
 SG_ EPASTS_a002_adcMuxErr m0 : 5|1@1+ (1,0) [0|1] "" Vector__XXX
 SG_ EPASTS_a003_pspInvalidParamset m0 : 6|1@1+ (1,0) [0|1] "" Vector__XXX
 SG_ EPASTS_a004_scpInputMia m0 : 7|1@1+ (1,0) [0|1] "" Vector__XXX
 SG_ EPASTS_a005_scpUnknownResetSourc m0 : 8|1@1+ (1,0) [0|1] "" Vector__XXX
 SG_ EPASTS_a006_swrhResetByInvalidEr m0 : 9|1@1+ (1,0) [0|1] "" Vector__XXX
 SG_ EPASTS_a007_tsmcCoreTempDiff m0 : 10|1@1+ (1,0) [0|1] "" Vector__XXX
 SG_ EPASTS_a008_psdcPlatformShutdown m0 : 11|1@1+ (1,0) [0|1] "" Vector__XXX
 SG_ EPASTS_a009_mcusscLbistPermanent m0 : 12|1@1+ (1,0) [0|1] "" Vector__XXX
 SG_ EPASTS_a010_svcIncompatibleSwVer m0 : 13|1@1+ (1,0) [0|1] "" Vector__XXX
 SG_ EPASTS_a011_mcusscMonbistErr m0 : 14|1@1+ (1,0) [0|1] "" Vector__XXX
 SG_ EPASTS_a012_mcusscMbistEccErr m0 : 15|1@1+ (1,0) [0|1] "" Vector__XXX
 SG_ EPASTS_a013_mcusscSffMonitoringF m0 : 16|1@1+ (1,0) [0|1] "" Vector__XXX
 SG_ EPASTS_a014_mcusscSffMonitoringM m0 : 17|1@1+ (1,0) [0|1] "" Vector__XXX
 SG_ EPASTS_a015_mcusscCsErrorCheckFa m0 : 18|1@1+ (1,0) [0|1] "" Vector__XXX
 SG_ EPASTS_a016_mcufcCsErrorCheckFai m0 : 19|1@1+ (1,0) [0|1] "" Vector__XXX
 SG_ EPASTS_a017_stmdStmPlausibilityC m0 : 20|1@1+ (1,0) [0|1] "" Vector__XXX
 SG_ EPASTS_a018_exchCsErrorCheck m0 : 21|1@1+ (1,0) [0|1] "" Vector__XXX
 SG_ EPASTS_a019_rsthHwResetInfoCorru m0 : 22|1@1+ (1,0) [0|1] "" Vector__XXX
 SG_ EPASTS_a020_mcusscEolEcuIdIntegr m0 : 23|1@1+ (1,0) [0|1] "" Vector__XXX
 SG_ EPASTS_a021_osehCsErrorCheck m0 : 24|1@1+ (1,0) [0|1] "" Vector__XXX
 SG_ EPASTS_a022_swrhSwResetInfoCorru m0 : 25|1@1+ (1,0) [0|1] "" Vector__XXX
 SG_ EPASTS_a023_btarcCorruptionCheck m0 : 26|1@1+ (1,0) [0|1] "" Vector__XXX
 SG_ EPASTS_a024_srhCsErrorCheckFail m0 : 27|1@1+ (1,0) [0|1] "" Vector__XXX
 SG_ EPASTS_a025_btarcCorruptionCheck m0 : 28|1@1+ (1,0) [0|1] "" Vector__XXX
 SG_ EPASTS_a026_mrccCsErrorCheckFail m0 : 29|1@1+ (1,0) [0|1] "" Vector__XXX
 SG_ EPASTS_a027_mcusscDmuHfErr m0 : 30|1@1+ (1,0) [0|1] "" Vector__XXX
 SG_ EPASTS_a028_smuhNonInitDataCorru m0 : 31|1@1+ (1,0) [0|1] "" Vector__XXX
 SG_ EPASTS_a029_smuhSmuCoreCntErrorT m0 : 32|1@1+ (1,0) [0|1] "" Vector__XXX
 SG_ EPASTS_a030_rsthClockReset m0 : 33|1@1+ (1,0) [0|1] "" Vector__XXX
 SG_ EPASTS_a031_pmsProductionModeFai m0 : 34|1@1+ (1,0) [0|1] "" Vector__XXX
 SG_ EPASTS_a032_eolpEolCheckFailed m0 : 35|1@1+ (1,0) [0|1] "" Vector__XXX
 SG_ EPASTS_a033_icsvcPswVersionMisma m0 : 36|1@1+ (1,0) [0|1] "" Vector__XXX
 SG_ EPASTS_a034_sbchReadbackRegFail m0 : 37|1@1+ (1,0) [0|1] "" Vector__XXX
 SG_ EPASTS_a035_sbchChipIdFail m0 : 38|1@1+ (1,0) [0|1] "" Vector__XXX
 SG_ EPASTS_a036_sbcmSbcBistFailed m0 : 39|1@1+ (1,0) [0|1] "" Vector__XXX
 SG_ EPASTS_a037_epmV5P2Fail m0 : 40|1@1+ (1,0) [0|1] "" Vector__XXX
 SG_ EPASTS_a038_csohCh1CsErrorErrAtR m0 : 41|1@1+ (1,0) [0|1] "" Vector__XXX
 SG_ EPASTS_a039_csohCh2CsErrorErrAtR m0 : 42|1@1+ (1,0) [0|1] "" Vector__XXX
 SG_ EPASTS_a040_swrhLimitedResetRetr m0 : 43|1@1+ (1,0) [0|1] "" Vector__XXX
 SG_ EPASTS_a041_imcmCoreConfiguratio m0 : 44|1@1+ (1,0) [0|1] "" Vector__XXX
 SG_ EPASTS_a042_wdhWdTestFail m0 : 45|1@1+ (1,0) [0|1] "" Vector__XXX
 SG_ EPASTS_a043_sbcmWdStateDisabled m0 : 46|1@1+ (1,0) [0|1] "" Vector__XXX
 SG_ EPASTS_a044_sbcmSbcEepromFail m0 : 47|1@1+ (1,0) [0|1] "" Vector__XXX
 SG_ EPASTS_a045_psumSbcBandgapVoltEr m0 : 48|1@1+ (1,0) [0|1] "" Vector__XXX
 SG_ EPASTS_a046_mcusscOscillatorNotR m0 : 49|1@1+ (1,0) [0|1] "" Vector__XXX
 SG_ EPASTS_a047_epmVregVoltFail m0 : 50|1@1+ (1,0) [0|1] "" Vector__XXX
 SG_ EPASTS_a048_epmVcpVoltFail m0 : 51|1@1+ (1,0) [0|1] "" Vector__XXX
 SG_ EPASTS_a049_epmLgFail m0 : 52|1@1+ (1,0) [0|1] "" Vector__XXX
 SG_ EPASTS_a050_erlErr m0 : 53|1@1+ (1,0) [0|1] "" Vector__XXX
 SG_ EPASTS_a051_ermMessageErr m0 : 54|1@1+ (1,0) [0|1] "" Vector__XXX
 SG_ EPASTS_a052_ermSdcInputBufferOve m0 : 55|1@1+ (1,0) [0|1] "" Vector__XXX
 SG_ EPASTS_a053_adcUnexpectedNumOfDa m0 : 56|1@1+ (1,0) [0|1] "" Vector__XXX
 SG_ EPASTS_a054_adcUnexpectedData m0 : 57|1@1+ (1,0) [0|1] "" Vector__XXX
 SG_ EPASTS_a055_amExtendedGduTest m0 : 58|1@1+ (1,0) [0|1] "" Vector__XXX
 SG_ EPASTS_a056_amGduConfigCsErrorCh m0 : 59|1@1+ (1,0) [0|1] "" Vector__XXX
 SG_ EPASTS_a057_amGduVds m0 : 60|1@1+ (1,0) [0|1] "" Vector__XXX
 SG_ EPASTS_a058_amIntVgsUndervtgErr m0 : 61|1@1+ (1,0) [0|1] "" Vector__XXX
 SG_ EPASTS_a059_amStartupTestFailed m0 : 62|1@1+ (1,0) [0|1] "" Vector__XXX
 SG_ EPASTS_a060_amGduFail m0 : 63|1@1+ (1,0) [0|1] "" Vector__XXX
 SG_ EPASTS_a061_amIntSerialErr m1 : 4|1@1+ (1,0) [0|1] "" Vector__XXX
 SG_ EPASTS_a062_amPhaseBridgeCheck m1 : 5|1@1+ (1,0) [0|1] "" Vector__XXX
 SG_ EPASTS_a063_amIntRegulatorErr m1 : 6|1@1+ (1,0) [0|1] "" Vector__XXX
 SG_ EPASTS_a064_amBridgeShort m1 : 7|1@1+ (1,0) [0|1] "" Vector__XXX
 SG_ EPASTS_a065_amGduJuncTemp m1 : 8|1@1+ (1,0) [0|1] "" Vector__XXX
 SG_ EPASTS_a066_amVoltQfErr m1 : 9|1@1+ (1,0) [0|1] "" Vector__XXX
 SG_ EPASTS_a067_tspmPowermoduleTempI m1 : 10|1@1+ (1,0) [0|1] "" Vector__XXX
 SG_ EPASTS_a068_rsthCoreRedundancyEr m1 : 11|1@1+ (1,0) [0|1] "" Vector__XXX
 SG_ EPASTS_a069_rsthCoreTempOutOfRan m1 : 12|1@1+ (1,0) [0|1] "" Vector__XXX
 SG_ EPASTS_a070_rsthInternalLowVolt m1 : 13|1@1+ (1,0) [0|1] "" Vector__XXX
 SG_ EPASTS_a071_rsthInternalHighVolt m1 : 14|1@1+ (1,0) [0|1] "" Vector__XXX
 SG_ EPASTS_a072_rsthFlashUncorrEccOr m1 : 15|1@1+ (1,0) [0|1] "" Vector__XXX
 SG_ EPASTS_a073_rsthOtherEdcEcc m1 : 16|1@1+ (1,0) [0|1] "" Vector__XXX
 SG_ EPASTS_a074_rsthUnexpectedAlarm m1 : 17|1@1+ (1,0) [0|1] "" Vector__XXX
 SG_ EPASTS_a075_rsthUnusedOtherModul m1 : 18|1@1+ (1,0) [0|1] "" Vector__XXX
 SG_ EPASTS_a076_exchGeneralException m1 : 19|1@1+ (1,0) [0|1] "" Vector__XXX
 SG_ EPASTS_a077_dmDeadlineViolation m1 : 20|1@1+ (1,0) [0|1] "" Vector__XXX
 SG_ EPASTS_a078_dmDeadlineViolation m1 : 21|1@1+ (1,0) [0|1] "" Vector__XXX
 SG_ EPASTS_a079_gduhComErr m1 : 22|1@1+ (1,0) [0|1] "" Vector__XXX
 SG_ EPASTS_a080_pwmTimerSyncCheck m1 : 23|1@1+ (1,0) [0|1] "" Vector__XXX
 SG_ EPASTS_a081_exchFloatingPointExc m1 : 24|1@1+ (1,0) [0|1] "" Vector__XXX
 SG_ EPASTS_a082_adcTriggerTimeChk m1 : 25|1@1+ (1,0) [0|1] "" Vector__XXX
 SG_ EPASTS_a083_tdaDclinkcapacitorTe m1 : 26|1@1+ (1,0) [0|1] "" Vector__XXX
 SG_ EPASTS_a084_adcTriggerCheck m1 : 27|1@1+ (1,0) [0|1] "" Vector__XXX
 SG_ EPASTS_a085_amGduSwitchOffTestBy m1 : 28|1@1+ (1,0) [0|1] "" Vector__XXX
 SG_ EPASTS_a086_rsthRamUncorrEcc m1 : 29|1@1+ (1,0) [0|1] "" Vector__XXX
 SG_ EPASTS_a087_rsthFlashConfigErr m1 : 30|1@1+ (1,0) [0|1] "" Vector__XXX
 SG_ EPASTS_a088_tedMainboardTempChec m1 : 31|1@1+ (1,0) [0|1] "" Vector__XXX
 SG_ EPASTS_a089_tedRevercebattfetjun m1 : 32|1@1+ (1,0) [0|1] "" Vector__XXX
 SG_ EPASTS_a090_etsmWarning m1 : 33|1@1+ (1,0) [0|1] "" Vector__XXX
 SG_ EPASTS_a091_bvpBattVoltCrossChkF m1 : 34|1@1+ (1,0) [0|1] "" Vector__XXX
 SG_ EPASTS_a092_amGduSwitchOffTestBy m1 : 35|1@1+ (1,0) [0|1] "" Vector__XXX
 SG_ EPASTS_a093_sctpTsuSingleStaticF m1 : 36|1@1+ (1,0) [0|1] "" Vector__XXX
 SG_ EPASTS_a094_sctpTsuMultipleStati m1 : 37|1@1+ (1,0) [0|1] "" Vector__XXX
 SG_ EPASTS_a095_mdModelBasedMotorInt m1 : 38|1@1+ (1,0) [0|1] "" Vector__XXX
 SG_ EPASTS_a096_rppRpsSingleStaticFa m1 : 39|1@1+ (1,0) [0|1] "" Vector__XXX
 SG_ EPASTS_a097_rppRpsMultipleStatic m1 : 40|1@1+ (1,0) [0|1] "" Vector__XXX
 SG_ EPASTS_a098_invErr m1 : 41|1@1+ (1,0) [0|1] "" Vector__XXX
 SG_ EPASTS_a099_mcdTorqueMismatchFau m1 : 42|1@1+ (1,0) [0|1] "" Vector__XXX
 SG_ EPASTS_a100_amVbrgLssFault m1 : 43|1@1+ (1,0) [0|1] "" Vector__XXX
 SG_ EPASTS_a101_sdrvSpcIdMismatch m1 : 44|1@1+ (1,0) [0|1] "" Vector__XXX
 SG_ EPASTS_a102_amPhasecurrentQosErr m1 : 45|1@1+ (1,0) [0|1] "" Vector__XXX
 SG_ EPASTS_a103_exhaUnusedInterruptC m1 : 46|1@1+ (1,0) [0|1] "" Vector__XXX
 SG_ EPASTS_a104_exhaBusMpuException m1 : 47|1@1+ (1,0) [0|1] "" Vector__XXX
 SG_ EPASTS_a105_exhaSriBusErrExcepti m1 : 48|1@1+ (1,0) [0|1] "" Vector__XXX
 SG_ EPASTS_a106_exhaSpbBusErrExcepti m1 : 49|1@1+ (1,0) [0|1] "" Vector__XXX
 SG_ EPASTS_a107_exhaOtherNmiExceptio m1 : 50|1@1+ (1,0) [0|1] "" Vector__XXX
 SG_ EPASTS_a108_exhaInternalProtecti m1 : 51|1@1+ (1,0) [0|1] "" Vector__XXX
 SG_ EPASTS_a109_exhaSysBusOrPeriphEr m1 : 52|1@1+ (1,0) [0|1] "" Vector__XXX
 SG_ EPASTS_a110_amPhaseRelaySwitchOf m1 : 53|1@1+ (1,0) [0|1] "" Vector__XXX
 SG_ EPASTS_a111_amCurrentSensingDisc m1 : 54|1@1+ (1,0) [0|1] "" Vector__XXX
 SG_ EPASTS_a112_rsthSafetyFlipflopEr m1 : 55|1@1+ (1,0) [0|1] "" Vector__XXX
 SG_ EPASTS_a113_rsthUncorrectableEnd m1 : 56|1@1+ (1,0) [0|1] "" Vector__XXX
 SG_ EPASTS_a114_osehOsErr m1 : 57|1@1+ (1,0) [0|1] "" Vector__XXX
 SG_ EPASTS_a115_mcusscLbistSingleFai m1 : 58|1@1+ (1,0) [0|1] "" Vector__XXX
 SG_ EPASTS_a116_mrccStartupRegCsErro m1 : 59|1@1+ (1,0) [0|1] "" Vector__XXX
 SG_ EPASTS_a117_mrccStartupRegCsErro m1 : 60|1@1+ (1,0) [0|1] "" Vector__XXX
 SG_ EPASTS_a118_mcusscFlashCsErrorEr m1 : 61|1@1+ (1,0) [0|1] "" Vector__XXX
 SG_ EPASTS_a119_mcusscFlashEccCritic m1 : 62|1@1+ (1,0) [0|1] "" Vector__XXX
 SG_ EPASTS_a120_mcusscFlashEccLatent m1 : 63|1@1+ (1,0) [0|1] "" Vector__XXX
 SG_ EPASTS_a121_mcusscMbistEccErr m2 : 4|1@1+ (1,0) [0|1] "" Vector__XXX
 SG_ EPASTS_a122_pcpBridgeFetShort m2 : 5|1@1+ (1,0) [0|1] "" Vector__XXX
 SG_ EPASTS_a123_imcmCommErr m2 : 6|1@1+ (1,0) [0|1] "" Vector__XXX
 SG_ EPASTS_a124_mcusscMbistEccTransi m2 : 7|1@1+ (1,0) [0|1] "" Vector__XXX
 SG_ EPASTS_a125_mcusscMbistMiaErr m2 : 8|1@1+ (1,0) [0|1] "" Vector__XXX
 SG_ EPASTS_a126_mcusscMonbistMiaErr m2 : 9|1@1+ (1,0) [0|1] "" Vector__XXX
 SG_ EPASTS_a127_exchAdditionalExcept m2 : 10|1@1+ (1,0) [0|1] "" Vector__XXX
 SG_ EPASTS_a128_exchExceptionStopRes m2 : 11|1@1+ (1,0) [0|1] "" Vector__XXX
 SG_ EPASTS_a129_exchAdditionalExcept m2 : 12|1@1+ (1,0) [0|1] "" Vector__XXX
 SG_ EPASTS_a130_mrccConfigCsErrorErr m2 : 13|1@1+ (1,0) [0|1] "" Vector__XXX
 SG_ EPASTS_a131_exchGuardedResetAfte m2 : 14|1@1+ (1,0) [0|1] "" Vector__XXX
 SG_ EPASTS_a132_mcusscNotSupportedMc m2 : 15|1@1+ (1,0) [0|1] "" Vector__XXX
 SG_ EPASTS_a133_mcusscLbistEcuIdIsNo m2 : 16|1@1+ (1,0) [0|1] "" Vector__XXX
 SG_ EPASTS_a134_osehGuardedResetAfte m2 : 17|1@1+ (1,0) [0|1] "" Vector__XXX
 SG_ EPASTS_a135_tmpsfetjCalculationO m2 : 18|1@1+ (1,0) [0|1] "" Vector__XXX
 SG_ EPASTS_a136_ftElectricalAngleQf m2 : 19|1@1+ (1,0) [0|1] "" Vector__XXX
 SG_ EPASTS_a137_osehErrWithoutImmedi m2 : 20|1@1+ (1,0) [0|1] "" Vector__XXX
 SG_ EPASTS_a138_osehAdditionalErrWit m2 : 21|1@1+ (1,0) [0|1] "" Vector__XXX
 SG_ EPASTS_a139_osehAdditionalOsErr m2 : 22|1@1+ (1,0) [0|1] "" Vector__XXX
 SG_ EPASTS_a140_imcmConfigurationErr m2 : 23|1@1+ (1,0) [0|1] "" Vector__XXX
 SG_ EPASTS_a141_amFetShortTest m2 : 24|1@1+ (1,0) [0|1] "" Vector__XXX
 SG_ EPASTS_a142_tedEmifilterDmcTempC m2 : 25|1@1+ (1,0) [0|1] "" Vector__XXX
 SG_ EPASTS_a143_tedEmifilterCmcTempC m2 : 26|1@1+ (1,0) [0|1] "" Vector__XXX
 SG_ EPASTS_a144_mriCoreRaminitFailed m2 : 27|1@1+ (1,0) [0|1] "" Vector__XXX
 SG_ EPASTS_a145_mriPeripheralRaminit m2 : 28|1@1+ (1,0) [0|1] "" Vector__XXX
 SG_ EPASTS_a146_btarcRcCircuitCheck m2 : 29|1@1+ (1,0) [0|1] "" Vector__XXX
 SG_ EPASTS_a147_amDcLinkShortedFail m2 : 30|1@1+ (1,0) [0|1] "" Vector__XXX
 SG_ EPASTS_a148_mrccExitFromStandbyD m2 : 31|1@1+ (1,0) [0|1] "" Vector__XXX
 SG_ EPASTS_a149_amReversibleEmergenc m2 : 32|1@1+ (1,0) [0|1] "" Vector__XXX
 SG_ EPASTS_a150_amExternalEmergencyO m2 : 33|1@1+ (1,0) [0|1] "" Vector__XXX
 SG_ EPASTS_a151_amPermanentEmergency m2 : 34|1@1+ (1,0) [0|1] "" Vector__XXX
 SG_ EPASTS_a152_exchFlashEccExceptio m2 : 35|1@1+ (1,0) [0|1] "" Vector__XXX
 SG_ EPASTS_a153_sdsmBlockSelectorInv m2 : 36|1@1+ (1,0) [0|1] "" Vector__XXX
 SG_ EPASTS_a154_sdsmCsErrorInvalidPr m2 : 37|1@1+ (1,0) [0|1] "" Vector__XXX
 SG_ EPASTS_a155_sdsmDataInvalidAll m2 : 38|1@1+ (1,0) [0|1] "" Vector__XXX
 SG_ EPASTS_a156_amIntSerialErrSafety m2 : 39|1@1+ (1,0) [0|1] "" Vector__XXX
 SG_ EPASTS_a157_mcudcpInvalidEcuId m2 : 40|1@1+ (1,0) [0|1] "" Vector__XXX
 SG_ EPASTS_a158_amGduFailDuringRecov m2 : 41|1@1+ (1,0) [0|1] "" Vector__XXX
 SG_ EPASTS_a159_exchFlashWordlineTra m2 : 42|1@1+ (1,0) [0|1] "" Vector__XXX
 SG_ EPASTS_a160_rsthCpu1UnexpectedAl m2 : 43|1@1+ (1,0) [0|1] "" Vector__XXX
 SG_ EPASTS_a161_tdaRelayfetjunctionT m2 : 44|1@1+ (1,0) [0|1] "" Vector__XXX
 SG_ EPASTS_a162_tdaBridgefetjunction m2 : 45|1@1+ (1,0) [0|1] "" Vector__XXX
 SG_ EPASTS_a163_tdaPowermoduleTempCh m2 : 46|1@1+ (1,0) [0|1] "" Vector__XXX
 SG_ EPASTS_a164_tdaBattfetjunctionTe m2 : 47|1@1+ (1,0) [0|1] "" Vector__XXX
 SG_ EPASTS_a165_tdaDcbusshuntTempChe m2 : 48|1@1+ (1,0) [0|1] "" Vector__XXX
 SG_ EPASTS_a166_tdaPhasecurrentshunt m2 : 49|1@1+ (1,0) [0|1] "" Vector__XXX
 SG_ EPASTS_a167_iccd1ErrQueueOverflo m2 : 50|1@1+ (1,0) [0|1] "" Vector__XXX
 SG_ EPASTS_a168_c1csInvalidC1App m2 : 51|1@1+ (1,0) [0|1] "" Vector__XXX
 SG_ EPASTS_a169_scpSafetyReset m2 : 52|1@1+ (1,0) [0|1] "" Vector__XXX
 SG_ EPASTS_a170_pmpDcvoltAge m2 : 53|1@1+ (1,0) [0|1] "" Vector__XXX
 SG_ EPASTS_a171_pmpKgvalueAge m2 : 54|1@1+ (1,0) [0|1] "" Vector__XXX
 SG_ EPASTS_a172_pmpElangMotorcurrent m2 : 55|1@1+ (1,0) [0|1] "" Vector__XXX
 SG_ EPASTS_a173_pmpRotorspeedAge m2 : 56|1@1+ (1,0) [0|1] "" Vector__XXX
 SG_ EPASTS_a174_pmpPhasecurrentAge m2 : 57|1@1+ (1,0) [0|1] "" Vector__XXX
 SG_ EPASTS_a175_exchFlashStoredConfi m2 : 58|1@1+ (1,0) [0|1] "" Vector__XXX
 SG_ EPASTS_a176_exchCpu1ExceptionRes m2 : 59|1@1+ (1,0) [0|1] "" Vector__XXX
 SG_ EPASTS_a177_etsrInvalidated m2 : 60|1@1+ (1,0) [0|1] "" Vector__XXX
 SG_ EPASTS_a178_exchWdtException m2 : 61|1@1+ (1,0) [0|1] "" Vector__XXX
 SG_ EPASTS_a179_tedMotorcoilTempChec m2 : 62|1@1+ (1,0) [0|1] "" Vector__XXX
 SG_ EPASTS_a180_dmDeadlineViolationC m2 : 63|1@1+ (1,0) [0|1] "" Vector__XXX
 SG_ EPASTS_a181_dmDeadlineViolationC m3 : 4|1@1+ (1,0) [0|1] "" Vector__XXX
 SG_ EPASTS_a182_mcdInputMia m3 : 5|1@1+ (1,0) [0|1] "" Vector__XXX
 SG_ EPASTS_a183_sbchCommErrSbcToMcu m3 : 6|1@1+ (1,0) [0|1] "" Vector__XXX
 SG_ EPASTS_a184_sbcmCommBufferOverfl m3 : 7|1@1+ (1,0) [0|1] "" Vector__XXX
 SG_ EPASTS_a185_sbcscpQAWatchdogRese m3 : 8|1@1+ (1,0) [0|1] "" Vector__XXX
 SG_ EPASTS_a186_wdhCommBufferOverflo m3 : 9|1@1+ (1,0) [0|1] "" Vector__XXX
 SG_ EPASTS_a187_epmVoltFail m3 : 10|1@1+ (1,0) [0|1] "" Vector__XXX
 SG_ EPASTS_a188_epmCommBufferOverflo m3 : 11|1@1+ (1,0) [0|1] "" Vector__XXX
 SG_ EPASTS_a189_sbchCommErrMcuToSbc m3 : 12|1@1+ (1,0) [0|1] "" Vector__XXX
 SG_ EPASTS_a190_sbchCommBufferOverfl m3 : 13|1@1+ (1,0) [0|1] "" Vector__XXX
 SG_ EPASTS_a191_sbcscpVcp2VucVoltFai m3 : 14|1@1+ (1,0) [0|1] "" Vector__XXX
 SG_ EPASTS_a192_osumC0CsaNearFull m3 : 15|1@1+ (1,0) [0|1] "" Vector__XXX
 SG_ EPASTS_a193_osumC0StackNearFull m3 : 16|1@1+ (1,0) [0|1] "" Vector__XXX
 SG_ EPASTS_a194_amNvdataLoss m3 : 17|1@1+ (1,0) [0|1] "" Vector__XXX
 SG_ EPASTS_a195_imcmCommErrC1 m3 : 18|1@1+ (1,0) [0|1] "" Vector__XXX
 SG_ EPASTS_a196_topEolTasOffsetInval m3 : 19|1@1+ (1,0) [0|1] "" Vector__XXX
 SG_ EPASTS_a197_difpDifactorInvalid m3 : 20|1@1+ (1,0) [0|1] "" Vector__XXX
 SG_ EPASTS_a198_osumC1CsaNearFull m3 : 21|1@1+ (1,0) [0|1] "" Vector__XXX
 SG_ EPASTS_a199_osumC1StackNearFull m3 : 22|1@1+ (1,0) [0|1] "" Vector__XXX
 SG_ EPASTS_a200_ammInputBufferOverfl m3 : 23|1@1+ (1,0) [0|1] "" Vector__XXX
 SG_ EPASTS_a201_ammOutputBufferOverf m3 : 24|1@1+ (1,0) [0|1] "" Vector__XXX
 SG_ EPASTS_a202_ohnvmpStoredOffsetLo m3 : 25|1@1+ (1,0) [0|1] "" Vector__XXX
 SG_ EPASTS_a203_ctcInterfaceErr m3 : 26|1@1+ (1,0) [0|1] "" Vector__XXX
 SG_ EPASTS_a204_fdpPrevTrqErr m3 : 27|1@1+ (1,0) [0|1] "" Vector__XXX
 SG_ EPASTS_a205_fdrOclFail m3 : 28|1@1+ (1,0) [0|1] "" Vector__XXX
 SG_ EPASTS_a206_fdrOclPartialBlockin m3 : 29|1@1+ (1,0) [0|1] "" Vector__XXX
 SG_ EPASTS_a207_fdrOclFreezing m3 : 30|1@1+ (1,0) [0|1] "" Vector__XXX
 SG_ EPASTS_a208_fdrLowSeverityBlocki m3 : 31|1@1+ (1,0) [0|1] "" Vector__XXX
 SG_ EPASTS_a209_fdrLowSeverityFreezi m3 : 32|1@1+ (1,0) [0|1] "" Vector__XXX
 SG_ EPASTS_a210_fdrTotalBlocking m3 : 33|1@1+ (1,0) [0|1] "" Vector__XXX
 SG_ EPASTS_a211_frmInternalErr m3 : 34|1@1+ (1,0) [0|1] "" Vector__XXX
 SG_ EPASTS_a212_frmDataLost m3 : 35|1@1+ (1,0) [0|1] "" Vector__XXX
 SG_ EPASTS_a213_frmHighFrictionDetec m3 : 36|1@1+ (1,0) [0|1] "" Vector__XXX
 SG_ EPASTS_a214_velInterfaceErr m3 : 37|1@1+ (1,0) [0|1] "" Vector__XXX
 SG_ EPASTS_a215_vsgSafeViolErr m3 : 38|1@1+ (1,0) [0|1] "" Vector__XXX
 SG_ EPASTS_a216_isdgImproperShutdown m3 : 39|1@1+ (1,0) [0|1] "" Vector__XXX
 SG_ EPASTS_a217_msdMasterSilentErr m3 : 40|1@1+ (1,0) [0|1] "" Vector__XXX
 SG_ EPASTS_a218_aadApplicationStateE m3 : 41|1@1+ (1,0) [0|1] "" Vector__XXX
 SG_ EPASTS_a219_frhFastRestartFailed m3 : 42|1@1+ (1,0) [0|1] "" Vector__XXX
 SG_ EPASTS_a220_transceiverInputqueu m3 : 43|1@1+ (1,0) [0|1] "" Vector__XXX
 SG_ EPASTS_a221_apsCntError m3 : 44|1@1+ (1,0) [0|1] "" Vector__XXX
 SG_ EPASTS_a222_apsCsError m3 : 45|1@1+ (1,0) [0|1] "" Vector__XXX
 SG_ EPASTS_a223_apsMia m3 : 46|1@1+ (1,0) [0|1] "" Vector__XXX
 SG_ EPASTS_a224_dasCntError m3 : 47|1@1+ (1,0) [0|1] "" Vector__XXX
 SG_ EPASTS_a225_dasCsError m3 : 48|1@1+ (1,0) [0|1] "" Vector__XXX
 SG_ EPASTS_a226_dasMia m3 : 49|1@1+ (1,0) [0|1] "" Vector__XXX
 SG_ EPASTS_a227_dirTorqueCntError m3 : 50|1@1+ (1,0) [0|1] "" Vector__XXX
 SG_ EPASTS_a228_dirTorqueCsError m3 : 51|1@1+ (1,0) [0|1] "" Vector__XXX
 SG_ EPASTS_a229_dirTorqueMia m3 : 52|1@1+ (1,0) [0|1] "" Vector__XXX
 SG_ EPASTS_a230_diSpdCntError m3 : 53|1@1+ (1,0) [0|1] "" Vector__XXX
 SG_ EPASTS_a231_diSpdCsError m3 : 54|1@1+ (1,0) [0|1] "" Vector__XXX
 SG_ EPASTS_a232_diSpdMia m3 : 55|1@1+ (1,0) [0|1] "" Vector__XXX
 SG_ EPASTS_a233_ecu1StatCntError m3 : 56|1@1+ (1,0) [0|1] "" Vector__XXX
 SG_ EPASTS_a234_ecu1StatCsError m3 : 57|1@1+ (1,0) [0|1] "" Vector__XXX
 SG_ EPASTS_a235_ecu1StatMia m3 : 58|1@1+ (1,0) [0|1] "" Vector__XXX
 SG_ EPASTS_a236_espWrCntError m3 : 59|1@1+ (1,0) [0|1] "" Vector__XXX
 SG_ EPASTS_a237_espWrCsError m3 : 60|1@1+ (1,0) [0|1] "" Vector__XXX
 SG_ EPASTS_a238_espWrMia m3 : 61|1@1+ (1,0) [0|1] "" Vector__XXX
 SG_ EPASTS_a239_espWsCntError m3 : 62|1@1+ (1,0) [0|1] "" Vector__XXX
 SG_ EPASTS_a240_espWsCsError m3 : 63|1@1+ (1,0) [0|1] "" Vector__XXX
 SG_ EPASTS_a241_espWsMia m4 : 4|1@1+ (1,0) [0|1] "" Vector__XXX
 SG_ EPASTS_a242_gtwConfigMia m4 : 5|1@1+ (1,0) [0|1] "" Vector__XXX
 SG_ EPASTS_a243_rcmCntError m4 : 6|1@1+ (1,0) [0|1] "" Vector__XXX
 SG_ EPASTS_a244_rcmCsError m4 : 7|1@1+ (1,0) [0|1] "" Vector__XXX
 SG_ EPASTS_a245_rcmMia m4 : 8|1@1+ (1,0) [0|1] "" Vector__XXX
 SG_ EPASTS_a246_sccmCntError m4 : 9|1@1+ (1,0) [0|1] "" Vector__XXX
 SG_ EPASTS_a247_sccmCsError m4 : 10|1@1+ (1,0) [0|1] "" Vector__XXX
 SG_ EPASTS_a248_sccmMia m4 : 11|1@1+ (1,0) [0|1] "" Vector__XXX
 SG_ EPASTS_a249_uiTuneReqCntError m4 : 12|1@1+ (1,0) [0|1] "" Vector__XXX
 SG_ EPASTS_a250_uiTuneReqCsError m4 : 13|1@1+ (1,0) [0|1] "" Vector__XXX
 SG_ EPASTS_a251_uiTuneReqMia m4 : 14|1@1+ (1,0) [0|1] "" Vector__XXX
 SG_ EPASTS_a252_vcFrontCntError m4 : 15|1@1+ (1,0) [0|1] "" Vector__XXX
 SG_ EPASTS_a253_vcFrontCsError m4 : 16|1@1+ (1,0) [0|1] "" Vector__XXX
 SG_ EPASTS_a254_vcFrontMia m4 : 17|1@1+ (1,0) [0|1] "" Vector__XXX
 SG_ EPASTS_a255_pmState2Mia m4 : 18|1@1+ (1,0) [0|1] "" Vector__XXX
 SG_ EPASTS_a256_dcvmOverVolt m4 : 19|1@1+ (1,0) [0|1] "" Vector__XXX
 SG_ EPASTS_a257_dcvmUnderVolt m4 : 20|1@1+ (1,0) [0|1] "" Vector__XXX
 SG_ EPASTS_a258_pspInvalidProjectPar m4 : 21|1@1+ (1,0) [0|1] "" Vector__XXX
 SG_ EPASTS_a259_scoCanBusOff m4 : 22|1@1+ (1,0) [0|1] "" Vector__XXX
 SG_ EPASTS_a260_scoPrivateBusOff m4 : 23|1@1+ (1,0) [0|1] "" Vector__XXX
 SG_ EPASTS_a261_sccmStatusError m4 : 24|1@1+ (1,0) [0|1] "" Vector__XXX
 SG_ EPASTS_a262_yawRateStatus m4 : 25|1@1+ (1,0) [0|1] "" Vector__XXX
 SG_ EPASTS_a263_espWsStatus m4 : 26|1@1+ (1,0) [0|1] "" Vector__XXX
 SG_ EPASTS_a264_assistTorqueLimited m4 : 27|1@1+ (1,0) [0|1] "" Vector__XXX
 SG_ EPASTS_a265_overheatProtect m4 : 28|1@1+ (1,0) [0|1] "" Vector__XXX
 SG_ EPASTS_a266_overloadProtect m4 : 29|1@1+ (1,0) [0|1] "" Vector__XXX
 SG_ EPASTS_a267_safeSpeedAssist m4 : 30|1@1+ (1,0) [0|1] "" Vector__XXX
 SG_ EPASTS_a268_eacCancelled m4 : 31|1@1+ (1,0) [0|1] "" Vector__XXX
 SG_ EPASTS_a269_assistTorqueDisabled m4 : 32|1@1+ (1,0) [0|1] "" Vector__XXX
 SG_ EPASTS_a270_oscillationCompTrqLi m4 : 33|1@1+ (1,0) [0|1] "" Vector__XXX

BO_TX_BU_ 920 : EPASTS;
CM_ BO_ 920 "EPASTS ECU message: alert matrix";
CM_ SG_ 920 EPASTS_matrixIndex "EPASTS ECU: matrix index";
CM_ SG_ 920 EPASTS_a001_adcCalibrationOrInit "EPASTS ECU: a001 adc calibration or init fail";
CM_ SG_ 920 EPASTS_a002_adcMuxErr "EPASTS ECU: a002 adc mux err";
CM_ SG_ 920 EPASTS_a003_pspInvalidParamset "EPASTS ECU: a003 psp invalid paramset";
CM_ SG_ 920 EPASTS_a004_scpInputMia "EPASTS ECU: a004 scp input mia";
CM_ SG_ 920 EPASTS_a005_scpUnknownResetSourc "EPASTS ECU: a005 scp unknown reset source";
CM_ SG_ 920 EPASTS_a006_swrhResetByInvalidEr "EPASTS ECU: a006 swrh reset by invalid errid";
CM_ SG_ 920 EPASTS_a007_tsmcCoreTempDiff "EPASTS ECU: a007 tsmc core temp diff";
CM_ SG_ 920 EPASTS_a008_psdcPlatformShutdown "EPASTS ECU: a008 psdc platform shutdown";
CM_ SG_ 920 EPASTS_a009_mcusscLbistPermanent "EPASTS ECU: a009 mcussc lbist permanent fail";
CM_ SG_ 920 EPASTS_a010_svcIncompatibleSwVer "EPASTS ECU: a010 svc incompatible sw versions";
CM_ SG_ 920 EPASTS_a011_mcusscMonbistErr "EPASTS ECU: a011 mcussc monbist err";
CM_ SG_ 920 EPASTS_a012_mcusscMbistEccErr "EPASTS ECU: a012 mcussc mbist ecc err";
CM_ SG_ 920 EPASTS_a013_mcusscSffMonitoringF "EPASTS ECU: a013 mcussc sff monitoring failed";
CM_ SG_ 920 EPASTS_a014_mcusscSffMonitoringM "EPASTS ECU: a014 mcussc sff monitoring mia";
CM_ SG_ 920 EPASTS_a015_mcusscCsErrorCheckFa "EPASTS ECU: a015 mcussc cs error check fail";
CM_ SG_ 920 EPASTS_a016_mcufcCsErrorCheckFai "EPASTS ECU: a016 mcufc cs error check fail";
CM_ SG_ 920 EPASTS_a017_stmdStmPlausibilityC "EPASTS ECU: a017 stmd stm plausibility check err";
CM_ SG_ 920 EPASTS_a018_exchCsErrorCheck "EPASTS ECU: a018 exch cs error check";
CM_ SG_ 920 EPASTS_a019_rsthHwResetInfoCorru "EPASTS ECU: a019 rsth hw reset info corruption check";
CM_ SG_ 920 EPASTS_a020_mcusscEolEcuIdIntegr "EPASTS ECU: a020 mcussc eol ecu id integritiy fail";
CM_ SG_ 920 EPASTS_a021_osehCsErrorCheck "EPASTS ECU: a021 oseh cs error check";
CM_ SG_ 920 EPASTS_a022_swrhSwResetInfoCorru "EPASTS ECU: a022 swrh sw reset info corruption check";
CM_ SG_ 920 EPASTS_a023_btarcCorruptionCheck "EPASTS ECU: a023 btarc corruption check";
CM_ SG_ 920 EPASTS_a024_srhCsErrorCheckFail "EPASTS ECU: a024 srh cs error check fail";
CM_ SG_ 920 EPASTS_a025_btarcCorruptionCheck "EPASTS ECU: a025 btarc corruption check";
CM_ SG_ 920 EPASTS_a026_mrccCsErrorCheckFail "EPASTS ECU: a026 mrcc cs error check fail";
CM_ SG_ 920 EPASTS_a027_mcusscDmuHfErr "EPASTS ECU: a027 mcussc dmu hf err";
CM_ SG_ 920 EPASTS_a028_smuhNonInitDataCorru "EPASTS ECU: a028 smuh non init data corruption";
CM_ SG_ 920 EPASTS_a029_smuhSmuCoreCntErrorT "EPASTS ECU: a029 smuh smu core cnt error test fail";
CM_ SG_ 920 EPASTS_a030_rsthClockReset "EPASTS ECU: a030 rsth clock reset";
CM_ SG_ 920 EPASTS_a031_pmsProductionModeFai "EPASTS ECU: a031 pms production mode failed";
CM_ SG_ 920 EPASTS_a032_eolpEolCheckFailed "EPASTS ECU: a032 eolp eol check failed";
CM_ SG_ 920 EPASTS_a033_icsvcPswVersionMisma "EPASTS ECU: a033 icsvc psw version mismatch";
CM_ SG_ 920 EPASTS_a034_sbchReadbackRegFail "EPASTS ECU: a034 sbch readback reg fail";
CM_ SG_ 920 EPASTS_a035_sbchChipIdFail "EPASTS ECU: a035 sbch chip id fail";
CM_ SG_ 920 EPASTS_a036_sbcmSbcBistFailed "EPASTS ECU: a036 sbcm sbc bist failed";
CM_ SG_ 920 EPASTS_a037_epmV5P2Fail "EPASTS ECU: a037 epm V5 P2 fail";
CM_ SG_ 920 EPASTS_a038_csohCh1CsErrorErrAtR "EPASTS ECU: a038 csoh ch1 cs error err at reset";
CM_ SG_ 920 EPASTS_a039_csohCh2CsErrorErrAtR "EPASTS ECU: a039 csoh ch2 cs error err at reset";
CM_ SG_ 920 EPASTS_a040_swrhLimitedResetRetr "EPASTS ECU: a040 swrh limited reset retries expired";
CM_ SG_ 920 EPASTS_a041_imcmCoreConfiguratio "EPASTS ECU: a041 imcm core configuration mismatch";
CM_ SG_ 920 EPASTS_a042_wdhWdTestFail "EPASTS ECU: a042 wdh wd test fail";
CM_ SG_ 920 EPASTS_a043_sbcmWdStateDisabled "EPASTS ECU: a043 sbcm wd state disabled";
CM_ SG_ 920 EPASTS_a044_sbcmSbcEepromFail "EPASTS ECU: a044 sbcm sbc eeprom fail";
CM_ SG_ 920 EPASTS_a045_psumSbcBandgapVoltEr "EPASTS ECU: a045 psum sbc bandgap volt err";
CM_ SG_ 920 EPASTS_a046_mcusscOscillatorNotR "EPASTS ECU: a046 mcussc oscillator not reliable";
CM_ SG_ 920 EPASTS_a047_epmVregVoltFail "EPASTS ECU: a047 epm vreg volt fail";
CM_ SG_ 920 EPASTS_a048_epmVcpVoltFail "EPASTS ECU: a048 epm vcp volt fail";
CM_ SG_ 920 EPASTS_a049_epmLgFail "EPASTS ECU: a049 epm lg fail";
CM_ SG_ 920 EPASTS_a050_erlErr "EPASTS ECU: a050 erl err";
CM_ SG_ 920 EPASTS_a051_ermMessageErr "EPASTS ECU: a051 erm message err";
CM_ SG_ 920 EPASTS_a052_ermSdcInputBufferOve "EPASTS ECU: a052 erm sdc input buffer overflow";
CM_ SG_ 920 EPASTS_a053_adcUnexpectedNumOfDa "EPASTS ECU: a053 adc unexpected num of data";
CM_ SG_ 920 EPASTS_a054_adcUnexpectedData "EPASTS ECU: a054 adc unexpected data";
CM_ SG_ 920 EPASTS_a055_amExtendedGduTest "EPASTS ECU: a055 am extended gdu test";
CM_ SG_ 920 EPASTS_a056_amGduConfigCsErrorCh "EPASTS ECU: a056 am gdu config cs error check";
CM_ SG_ 920 EPASTS_a057_amGduVds "EPASTS ECU: a057 am gdu vds";
CM_ SG_ 920 EPASTS_a058_amIntVgsUndervtgErr "EPASTS ECU: a058 am int vgs undervtg err";
CM_ SG_ 920 EPASTS_a059_amStartupTestFailed "EPASTS ECU: a059 am startup test failed";
CM_ SG_ 920 EPASTS_a060_amGduFail "EPASTS ECU: a060 am gdu fail";
CM_ SG_ 920 EPASTS_a061_amIntSerialErr "EPASTS ECU: a061 am int serial err";
CM_ SG_ 920 EPASTS_a062_amPhaseBridgeCheck "EPASTS ECU: a062 am phase bridge check";
CM_ SG_ 920 EPASTS_a063_amIntRegulatorErr "EPASTS ECU: a063 am int regulator err";
CM_ SG_ 920 EPASTS_a064_amBridgeShort "EPASTS ECU: a064 am bridge short";
CM_ SG_ 920 EPASTS_a065_amGduJuncTemp "EPASTS ECU: a065 am gdu junc temp";
CM_ SG_ 920 EPASTS_a066_amVoltQfErr "EPASTS ECU: a066 am volt qf err";
CM_ SG_ 920 EPASTS_a067_tspmPowermoduleTempI "EPASTS ECU: a067 tspm powermodule temp implausible";
CM_ SG_ 920 EPASTS_a068_rsthCoreRedundancyEr "EPASTS ECU: a068 rsth core redundancy err";
CM_ SG_ 920 EPASTS_a069_rsthCoreTempOutOfRan "EPASTS ECU: a069 rsth core temp out of range hw check";
CM_ SG_ 920 EPASTS_a070_rsthInternalLowVolt "EPASTS ECU: a070 rsth internal low volt";
CM_ SG_ 920 EPASTS_a071_rsthInternalHighVolt "EPASTS ECU: a071 rsth internal high volt";
CM_ SG_ 920 EPASTS_a072_rsthFlashUncorrEccOr "EPASTS ECU: a072 rsth flash uncorr ecc or ovfl";
CM_ SG_ 920 EPASTS_a073_rsthOtherEdcEcc "EPASTS ECU: a073 rsth other edc ecc";
CM_ SG_ 920 EPASTS_a074_rsthUnexpectedAlarm "EPASTS ECU: a074 rsth unexpected alarm";
CM_ SG_ 920 EPASTS_a075_rsthUnusedOtherModul "EPASTS ECU: a075 rsth unused other module alarm";
CM_ SG_ 920 EPASTS_a076_exchGeneralException "EPASTS ECU: a076 exch general exception";
CM_ SG_ 920 EPASTS_a077_dmDeadlineViolation "EPASTS ECU: a077 dm deadline violation";
CM_ SG_ 920 EPASTS_a078_dmDeadlineViolation "EPASTS ECU: a078 dm deadline violation";
CM_ SG_ 920 EPASTS_a079_gduhComErr "EPASTS ECU: a079 gduh com err";
CM_ SG_ 920 EPASTS_a080_pwmTimerSyncCheck "EPASTS ECU: a080 pwm timer sync check";
CM_ SG_ 920 EPASTS_a081_exchFloatingPointExc "EPASTS ECU: a081 exch floating point exception";
CM_ SG_ 920 EPASTS_a082_adcTriggerTimeChk "EPASTS ECU: a082 adc trigger time chk";
CM_ SG_ 920 EPASTS_a083_tdaDclinkcapacitorTe "EPASTS ECU: a083 tda dclinkcapacitor temp checker";
CM_ SG_ 920 EPASTS_a084_adcTriggerCheck "EPASTS ECU: a084 adc trigger check";
CM_ SG_ 920 EPASTS_a085_amGduSwitchOffTestBy "EPASTS ECU: a085 am gdu switch off test by mcu";
CM_ SG_ 920 EPASTS_a086_rsthRamUncorrEcc "EPASTS ECU: a086 rsth ram uncorr ecc";
CM_ SG_ 920 EPASTS_a087_rsthFlashConfigErr "EPASTS ECU: a087 rsth flash config err";
CM_ SG_ 920 EPASTS_a088_tedMainboardTempChec "EPASTS ECU: a088 ted mainboard temp checker";
CM_ SG_ 920 EPASTS_a089_tedRevercebattfetjun "EPASTS ECU: a089 ted revercebattfetjunction temp checker";
CM_ SG_ 920 EPASTS_a090_etsmWarning "EPASTS ECU: a090 etsm warning";
CM_ SG_ 920 EPASTS_a091_bvpBattVoltCrossChkF "EPASTS ECU: a091 bvp batt volt cross chk failed";
CM_ SG_ 920 EPASTS_a092_amGduSwitchOffTestBy "EPASTS ECU: a092 am gdu switch off test by sbc";
CM_ SG_ 920 EPASTS_a093_sctpTsuSingleStaticF "EPASTS ECU: a093 sctp tsu single static fail";
CM_ SG_ 920 EPASTS_a094_sctpTsuMultipleStati "EPASTS ECU: a094 sctp tsu multiple static fail";
CM_ SG_ 920 EPASTS_a095_mdModelBasedMotorInt "EPASTS ECU: a095 md model based motor integrity check";
CM_ SG_ 920 EPASTS_a096_rppRpsSingleStaticFa "EPASTS ECU: a096 rpp rps single static fail";
CM_ SG_ 920 EPASTS_a097_rppRpsMultipleStatic "EPASTS ECU: a097 rpp rps multiple static fail";
CM_ SG_ 920 EPASTS_a098_invErr "EPASTS ECU: a098 inv err";
CM_ SG_ 920 EPASTS_a099_mcdTorqueMismatchFau "EPASTS ECU: a099 mcd torque mismatch fault";
CM_ SG_ 920 EPASTS_a100_amVbrgLssFault "EPASTS ECU: a100 am vbrg lss fault";
CM_ SG_ 920 EPASTS_a101_sdrvSpcIdMismatch "EPASTS ECU: a101 sdrv spc id mismatch";
CM_ SG_ 920 EPASTS_a102_amPhasecurrentQosErr "EPASTS ECU: a102 am phasecurrent qos err";
CM_ SG_ 920 EPASTS_a103_exhaUnusedInterruptC "EPASTS ECU: a103 exha unused interrupt call exception";
CM_ SG_ 920 EPASTS_a104_exhaBusMpuException "EPASTS ECU: a104 exha bus mpu exception";
CM_ SG_ 920 EPASTS_a105_exhaSriBusErrExcepti "EPASTS ECU: a105 exha sri bus err exception";
CM_ SG_ 920 EPASTS_a106_exhaSpbBusErrExcepti "EPASTS ECU: a106 exha spb bus err exception";
CM_ SG_ 920 EPASTS_a107_exhaOtherNmiExceptio "EPASTS ECU: a107 exha other nmi exception";
CM_ SG_ 920 EPASTS_a108_exhaInternalProtecti "EPASTS ECU: a108 exha internal protection exception";
CM_ SG_ 920 EPASTS_a109_exhaSysBusOrPeriphEr "EPASTS ECU: a109 exha sys bus or periph err exception";
CM_ SG_ 920 EPASTS_a110_amPhaseRelaySwitchOf "EPASTS ECU: a110 am phase relay switch off test";
CM_ SG_ 920 EPASTS_a111_amCurrentSensingDisc "EPASTS ECU: a111 am current sensing disconnection";
CM_ SG_ 920 EPASTS_a112_rsthSafetyFlipflopEr "EPASTS ECU: a112 rsth safety flipflop err";
CM_ SG_ 920 EPASTS_a113_rsthUncorrectableEnd "EPASTS ECU: a113 rsth uncorrectable end to end bus err";
CM_ SG_ 920 EPASTS_a114_osehOsErr "EPASTS ECU: a114 oseh os err";
CM_ SG_ 920 EPASTS_a115_mcusscLbistSingleFai "EPASTS ECU: a115 mcussc lbist single fail";
CM_ SG_ 920 EPASTS_a116_mrccStartupRegCsErro "EPASTS ECU: a116 mrcc startup reg cs error static err";
CM_ SG_ 920 EPASTS_a117_mrccStartupRegCsErro "EPASTS ECU: a117 mrcc startup reg cs error transient err";
CM_ SG_ 920 EPASTS_a118_mcusscFlashCsErrorEr "EPASTS ECU: a118 mcussc flash cs error err";
CM_ SG_ 920 EPASTS_a119_mcusscFlashEccCritic "EPASTS ECU: a119 mcussc flash ecc critical err";
CM_ SG_ 920 EPASTS_a120_mcusscFlashEccLatent "EPASTS ECU: a120 mcussc flash ecc latent err";
CM_ SG_ 920 EPASTS_a121_mcusscMbistEccErr "EPASTS ECU: a121 mcussc mbist ecc err";
CM_ SG_ 920 EPASTS_a122_pcpBridgeFetShort "EPASTS ECU: a122 pcp bridge fet short";
CM_ SG_ 920 EPASTS_a123_imcmCommErr "EPASTS ECU: a123 imcm comm err";
CM_ SG_ 920 EPASTS_a124_mcusscMbistEccTransi "EPASTS ECU: a124 mcussc mbist ecc transient err";
CM_ SG_ 920 EPASTS_a125_mcusscMbistMiaErr "EPASTS ECU: a125 mcussc mbist mia err";
CM_ SG_ 920 EPASTS_a126_mcusscMonbistMiaErr "EPASTS ECU: a126 mcussc monbist mia err";
CM_ SG_ 920 EPASTS_a127_exchAdditionalExcept "EPASTS ECU: a127 exch additional exception after rst";
CM_ SG_ 920 EPASTS_a128_exchExceptionStopRes "EPASTS ECU: a128 exch exception stop restart";
CM_ SG_ 920 EPASTS_a129_exchAdditionalExcept "EPASTS ECU: a129 exch additional exception stop restart";
CM_ SG_ 920 EPASTS_a130_mrccConfigCsErrorErr "EPASTS ECU: a130 mrcc config cs error err";
CM_ SG_ 920 EPASTS_a131_exchGuardedResetAfte "EPASTS ECU: a131 exch guarded reset after partition stop";
CM_ SG_ 920 EPASTS_a132_mcusscNotSupportedMc "EPASTS ECU: a132 mcussc not supported mcu";
CM_ SG_ 920 EPASTS_a133_mcusscLbistEcuIdIsNo "EPASTS ECU: a133 mcussc lbist ecu id is not supported";
CM_ SG_ 920 EPASTS_a134_osehGuardedResetAfte "EPASTS ECU: a134 oseh guarded reset after err without reset";
CM_ SG_ 920 EPASTS_a135_tmpsfetjCalculationO "EPASTS ECU: a135 tmpsfetj calculation overflow err";
CM_ SG_ 920 EPASTS_a136_ftElectricalAngleQf "EPASTS ECU: a136 ft electrical angle qf";
CM_ SG_ 920 EPASTS_a137_osehErrWithoutImmedi "EPASTS ECU: a137 oseh err without immediate reset";
CM_ SG_ 920 EPASTS_a138_osehAdditionalErrWit "EPASTS ECU: a138 oseh additional err without imm reset";
CM_ SG_ 920 EPASTS_a139_osehAdditionalOsErr "EPASTS ECU: a139 oseh additional os err";
CM_ SG_ 920 EPASTS_a140_imcmConfigurationErr "EPASTS ECU: a140 imcm configuration err";
CM_ SG_ 920 EPASTS_a141_amFetShortTest "EPASTS ECU: a141 am fet short test";
CM_ SG_ 920 EPASTS_a142_tedEmifilterDmcTempC "EPASTS ECU: a142 ted emifilter dmc temp checker";
CM_ SG_ 920 EPASTS_a143_tedEmifilterCmcTempC "EPASTS ECU: a143 ted emifilter cmc temp checker";
CM_ SG_ 920 EPASTS_a144_mriCoreRaminitFailed "EPASTS ECU: a144 mri core raminit failed";
CM_ SG_ 920 EPASTS_a145_mriPeripheralRaminit "EPASTS ECU: a145 mri peripheral raminit failed";
CM_ SG_ 920 EPASTS_a146_btarcRcCircuitCheck "EPASTS ECU: a146 btarc rc circuit check";
CM_ SG_ 920 EPASTS_a147_amDcLinkShortedFail "EPASTS ECU: a147 am dc link shorted fail";
CM_ SG_ 920 EPASTS_a148_mrccExitFromStandbyD "EPASTS ECU: a148 mrcc exit from standby detected";
CM_ SG_ 920 EPASTS_a149_amReversibleEmergenc "EPASTS ECU: a149 am reversible emergency off requested";
CM_ SG_ 920 EPASTS_a150_amExternalEmergencyO "EPASTS ECU: a150 am external emergency off requested";
CM_ SG_ 920 EPASTS_a151_amPermanentEmergency "EPASTS ECU: a151 am permanent emergency off requested";
CM_ SG_ 920 EPASTS_a152_exchFlashEccExceptio "EPASTS ECU: a152 exch flash ecc exception";
CM_ SG_ 920 EPASTS_a153_sdsmBlockSelectorInv "EPASTS ECU: a153 sdsm block selector invalid";
CM_ SG_ 920 EPASTS_a154_sdsmCsErrorInvalidPr "EPASTS ECU: a154 sdsm cs error invalid primary";
CM_ SG_ 920 EPASTS_a155_sdsmDataInvalidAll "EPASTS ECU: a155 sdsm data invalid all";
CM_ SG_ 920 EPASTS_a156_amIntSerialErrSafety "EPASTS ECU: a156 am int serial err safety reset";
CM_ SG_ 920 EPASTS_a157_mcudcpInvalidEcuId "EPASTS ECU: a157 mcudcp invalid ecu id";
CM_ SG_ 920 EPASTS_a158_amGduFailDuringRecov "EPASTS ECU: a158 am gdu fail during recovery";
CM_ SG_ 920 EPASTS_a159_exchFlashWordlineTra "EPASTS ECU: a159 exch flash wordline transient err";
CM_ SG_ 920 EPASTS_a160_rsthCpu1UnexpectedAl "EPASTS ECU: a160 rsth cpu1 unexpected alarm";
CM_ SG_ 920 EPASTS_a161_tdaRelayfetjunctionT "EPASTS ECU: a161 tda relayfetjunction temp checker";
CM_ SG_ 920 EPASTS_a162_tdaBridgefetjunction "EPASTS ECU: a162 tda bridgefetjunction temp checker";
CM_ SG_ 920 EPASTS_a163_tdaPowermoduleTempCh "EPASTS ECU: a163 tda powermodule temp checker";
CM_ SG_ 920 EPASTS_a164_tdaBattfetjunctionTe "EPASTS ECU: a164 tda battfetjunction temp checker";
CM_ SG_ 920 EPASTS_a165_tdaDcbusshuntTempChe "EPASTS ECU: a165 tda dcbusshunt temp checker";
CM_ SG_ 920 EPASTS_a166_tdaPhasecurrentshunt "EPASTS ECU: a166 tda phasecurrentshunt temp checker";
CM_ SG_ 920 EPASTS_a167_iccd1ErrQueueOverflo "EPASTS ECU: a167 iccd1 err queue overflow";
CM_ SG_ 920 EPASTS_a168_c1csInvalidC1App "EPASTS ECU: a168 c1cs invalid C1 app";
CM_ SG_ 920 EPASTS_a169_scpSafetyReset "EPASTS ECU: a169 scp safety reset";
CM_ SG_ 920 EPASTS_a170_pmpDcvoltAge "EPASTS ECU: a170 pmp dcvolt age";
CM_ SG_ 920 EPASTS_a171_pmpKgvalueAge "EPASTS ECU: a171 pmp kgvalue age";
CM_ SG_ 920 EPASTS_a172_pmpElangMotorcurrent "EPASTS ECU: a172 pmp elang motorcurrent age";
CM_ SG_ 920 EPASTS_a173_pmpRotorspeedAge "EPASTS ECU: a173 pmp rotorspeed age";
CM_ SG_ 920 EPASTS_a174_pmpPhasecurrentAge "EPASTS ECU: a174 pmp phasecurrent age";
CM_ SG_ 920 EPASTS_a175_exchFlashStoredConfi "EPASTS ECU: a175 exch flash stored config err";
CM_ SG_ 920 EPASTS_a176_exchCpu1ExceptionRes "EPASTS ECU: a176 exch cpu1 exception reset";
CM_ SG_ 920 EPASTS_a177_etsrInvalidated "EPASTS ECU: a177 etsr invalidated";
CM_ SG_ 920 EPASTS_a178_exchWdtException "EPASTS ECU: a178 exch wdt exception";
CM_ SG_ 920 EPASTS_a179_tedMotorcoilTempChec "EPASTS ECU: a179 ted motorcoil temp checker";
CM_ SG_ 920 EPASTS_a180_dmDeadlineViolationC "EPASTS ECU: a180 dm deadline violation C1";
CM_ SG_ 920 EPASTS_a181_dmDeadlineViolationC "EPASTS ECU: a181 dm deadline violation C1";
CM_ SG_ 920 EPASTS_a182_mcdInputMia "EPASTS ECU: a182 mcd input mia";
CM_ SG_ 920 EPASTS_a183_sbchCommErrSbcToMcu "EPASTS ECU: a183 sbch comm err sbc to mcu";
CM_ SG_ 920 EPASTS_a184_sbcmCommBufferOverfl "EPASTS ECU: a184 sbcm comm buffer overflow";
CM_ SG_ 920 EPASTS_a185_sbcscpQAWatchdogRese "EPASTS ECU: a185 sbcscp QA watchdog reset";
CM_ SG_ 920 EPASTS_a186_wdhCommBufferOverflo "EPASTS ECU: a186 wdh comm buffer overflow";
CM_ SG_ 920 EPASTS_a187_epmVoltFail "EPASTS ECU: a187 epm volt fail";
CM_ SG_ 920 EPASTS_a188_epmCommBufferOverflo "EPASTS ECU: a188 epm comm buffer overflow";
CM_ SG_ 920 EPASTS_a189_sbchCommErrMcuToSbc "EPASTS ECU: a189 sbch comm err mcu to sbc";
CM_ SG_ 920 EPASTS_a190_sbchCommBufferOverfl "EPASTS ECU: a190 sbch comm buffer overflow";
CM_ SG_ 920 EPASTS_a191_sbcscpVcp2VucVoltFai "EPASTS ECU: a191 sbcscp vcp2 vuc volt fail";
CM_ SG_ 920 EPASTS_a192_osumC0CsaNearFull "EPASTS ECU: a192 osum C0 csa near full";
CM_ SG_ 920 EPASTS_a193_osumC0StackNearFull "EPASTS ECU: a193 osum C0 stack near full";
CM_ SG_ 920 EPASTS_a194_amNvdataLoss "EPASTS ECU: a194 am nvdata loss";
CM_ SG_ 920 EPASTS_a195_imcmCommErrC1 "EPASTS ECU: a195 imcm comm err C1";
CM_ SG_ 920 EPASTS_a196_topEolTasOffsetInval "EPASTS ECU: a196 top eol tas offset invalid";
CM_ SG_ 920 EPASTS_a197_difpDifactorInvalid "EPASTS ECU: a197 difp difactor invalid";
CM_ SG_ 920 EPASTS_a198_osumC1CsaNearFull "EPASTS ECU: a198 osum C1 csa near full";
CM_ SG_ 920 EPASTS_a199_osumC1StackNearFull "EPASTS ECU: a199 osum C1 stack near full";
CM_ SG_ 920 EPASTS_a200_ammInputBufferOverfl "EPASTS ECU: a200 amm input buffer overflow";
CM_ SG_ 920 EPASTS_a201_ammOutputBufferOverf "EPASTS ECU: a201 amm output buffer overflow";
CM_ SG_ 920 EPASTS_a202_ohnvmpStoredOffsetLo "EPASTS ECU: a202 ohnvmp stored offset lost";
CM_ SG_ 920 EPASTS_a203_ctcInterfaceErr "EPASTS ECU: a203 ctc interface err";
CM_ SG_ 920 EPASTS_a204_fdpPrevTrqErr "EPASTS ECU: a204 fdp prev trq err";
CM_ SG_ 920 EPASTS_a205_fdrOclFail "EPASTS ECU: a205 fdr ocl fail";
CM_ SG_ 920 EPASTS_a206_fdrOclPartialBlockin "EPASTS ECU: a206 fdr ocl partial blocking";
CM_ SG_ 920 EPASTS_a207_fdrOclFreezing "EPASTS ECU: a207 fdr ocl freezing";
CM_ SG_ 920 EPASTS_a208_fdrLowSeverityBlocki "EPASTS ECU: a208 fdr low severity blocking";
CM_ SG_ 920 EPASTS_a209_fdrLowSeverityFreezi "EPASTS ECU: a209 fdr low severity freezing";
CM_ SG_ 920 EPASTS_a210_fdrTotalBlocking "EPASTS ECU: a210 fdr total blocking";
CM_ SG_ 920 EPASTS_a211_frmInternalErr "EPASTS ECU: a211 frm internal err";
CM_ SG_ 920 EPASTS_a212_frmDataLost "EPASTS ECU: a212 frm data lost";
CM_ SG_ 920 EPASTS_a213_frmHighFrictionDetec "EPASTS ECU: a213 frm high friction detected";
CM_ SG_ 920 EPASTS_a214_velInterfaceErr "EPASTS ECU: a214 vel interface err";
CM_ SG_ 920 EPASTS_a215_vsgSafeViolErr "EPASTS ECU: a215 vsg safe viol err";
CM_ SG_ 920 EPASTS_a216_isdgImproperShutdown "EPASTS ECU: a216 isdg improper shutdown";
CM_ SG_ 920 EPASTS_a217_msdMasterSilentErr "EPASTS ECU: a217 msd master silent err";
CM_ SG_ 920 EPASTS_a218_aadApplicationStateE "EPASTS ECU: a218 aad application state err";
CM_ SG_ 920 EPASTS_a219_frhFastRestartFailed "EPASTS ECU: a219 frh fast restart failed";
CM_ SG_ 920 EPASTS_a220_transceiverInputqueu "EPASTS ECU: a220 transceiver inputqueue overflow";
CM_ SG_ 920 EPASTS_a221_apsCntError "EPASTS ECU: a221 aps cnt error";
CM_ SG_ 920 EPASTS_a222_apsCsError "EPASTS ECU: a222 aps cs error";
CM_ SG_ 920 EPASTS_a223_apsMia "EPASTS ECU: a223 aps mia";
CM_ SG_ 920 EPASTS_a224_dasCntError "EPASTS ECU: a224 das cnt error";
CM_ SG_ 920 EPASTS_a225_dasCsError "EPASTS ECU: a225 das cs error";
CM_ SG_ 920 EPASTS_a226_dasMia "EPASTS ECU: a226 das mia";
CM_ SG_ 920 EPASTS_a227_dirTorqueCntError "EPASTS ECU: a227 dir torque cnt error";
CM_ SG_ 920 EPASTS_a228_dirTorqueCsError "EPASTS ECU: a228 dir torque cs error";
CM_ SG_ 920 EPASTS_a229_dirTorqueMia "EPASTS ECU: a229 dir torque mia";
CM_ SG_ 920 EPASTS_a230_diSpdCntError "EPASTS ECU: a230 di spd cnt error";
CM_ SG_ 920 EPASTS_a231_diSpdCsError "EPASTS ECU: a231 di spd cs error";
CM_ SG_ 920 EPASTS_a232_diSpdMia "EPASTS ECU: a232 di spd mia";
CM_ SG_ 920 EPASTS_a233_ecu1StatCntError "EPASTS ECU: a233 ecu1 stat cnt error";
CM_ SG_ 920 EPASTS_a234_ecu1StatCsError "EPASTS ECU: a234 ecu1 stat cs error";
CM_ SG_ 920 EPASTS_a235_ecu1StatMia "EPASTS ECU: a235 ecu1 stat mia";
CM_ SG_ 920 EPASTS_a236_espWrCntError "EPASTS ECU: a236 esp wr cnt error";
CM_ SG_ 920 EPASTS_a237_espWrCsError "EPASTS ECU: a237 esp wr cs error";
CM_ SG_ 920 EPASTS_a238_espWrMia "EPASTS ECU: a238 esp wr mia";
CM_ SG_ 920 EPASTS_a239_espWsCntError "EPASTS ECU: a239 esp ws cnt error";
CM_ SG_ 920 EPASTS_a240_espWsCsError "EPASTS ECU: a240 esp ws cs error";
CM_ SG_ 920 EPASTS_a241_espWsMia "EPASTS ECU: a241 esp ws mia";
CM_ SG_ 920 EPASTS_a242_gtwConfigMia "EPASTS ECU: a242 gtw config mia";
CM_ SG_ 920 EPASTS_a243_rcmCntError "EPASTS ECU: a243 rcm cnt error";
CM_ SG_ 920 EPASTS_a244_rcmCsError "EPASTS ECU: a244 rcm cs error";
CM_ SG_ 920 EPASTS_a245_rcmMia "EPASTS ECU: a245 rcm mia";
CM_ SG_ 920 EPASTS_a246_sccmCntError "EPASTS ECU: a246 sccm cnt error";
CM_ SG_ 920 EPASTS_a247_sccmCsError "EPASTS ECU: a247 sccm cs error";
CM_ SG_ 920 EPASTS_a248_sccmMia "EPASTS ECU: a248 sccm mia";
CM_ SG_ 920 EPASTS_a249_uiTuneReqCntError "EPASTS ECU: a249 ui tune req cnt error";
CM_ SG_ 920 EPASTS_a250_uiTuneReqCsError "EPASTS ECU: a250 ui tune req cs error";
CM_ SG_ 920 EPASTS_a251_uiTuneReqMia "EPASTS ECU: a251 ui tune req mia";
CM_ SG_ 920 EPASTS_a252_vcFrontCntError "EPASTS ECU: a252 vc front cnt error";
CM_ SG_ 920 EPASTS_a253_vcFrontCsError "EPASTS ECU: a253 vc front cs error";
CM_ SG_ 920 EPASTS_a254_vcFrontMia "EPASTS ECU: a254 vc front mia";
CM_ SG_ 920 EPASTS_a255_pmState2Mia "EPASTS ECU: a255 pm state2 mia";
CM_ SG_ 920 EPASTS_a256_dcvmOverVolt "EPASTS ECU: a256 dcvm over volt";
CM_ SG_ 920 EPASTS_a257_dcvmUnderVolt "EPASTS ECU: a257 dcvm under volt";
CM_ SG_ 920 EPASTS_a258_pspInvalidProjectPar "EPASTS ECU: a258 psp invalid project paramset";
CM_ SG_ 920 EPASTS_a259_scoCanBusOff "EPASTS ECU: a259 sco can bus off";
CM_ SG_ 920 EPASTS_a260_scoPrivateBusOff "EPASTS ECU: a260 sco private bus off";
CM_ SG_ 920 EPASTS_a261_sccmStatusError "EPASTS ECU: a261 sccm status error";
CM_ SG_ 920 EPASTS_a262_yawRateStatus "EPASTS ECU: a262 yaw rate status";
CM_ SG_ 920 EPASTS_a263_espWsStatus "EPASTS ECU: a263 esp ws status";
CM_ SG_ 920 EPASTS_a264_assistTorqueLimited "EPASTS ECU: a264 assist torque limited";
CM_ SG_ 920 EPASTS_a265_overheatProtect "EPASTS ECU: a265 overheat protect";
CM_ SG_ 920 EPASTS_a266_overloadProtect "EPASTS ECU: a266 overload protect";
CM_ SG_ 920 EPASTS_a267_safeSpeedAssist "EPASTS ECU: a267 safe speed assist";
CM_ SG_ 920 EPASTS_a268_eacCancelled "EPASTS ECU: a268 eac cancelled";
CM_ SG_ 920 EPASTS_a269_assistTorqueDisabled "EPASTS ECU: a269 assist torque disabled";
CM_ SG_ 920 EPASTS_a270_oscillationCompTrqLi "EPASTS ECU: a270 oscillation comp trq lim reached";
BA_DEF_ BO_ "GenMsgCycleTime" INT 0 3600000;
BA_DEF_ BO_ "GenMsgSendType" ENUM "Cyclic","NotUsed","NotUsed","NotUsed","NotUsed","NotUsed","NotUsed","IfActive","NoMsgSendType","NotUsed";
BA_DEF_ BO_ "VFrameFormat" ENUM "StandardCAN","ExtendedCAN","reserved","J1939PG","reserved","reserved","reserved","reserved","reserved","reserved","reserved","reserved","reserved","reserved","StandardCAN_FD","ExtendedCAN_FD";
BA_DEF_ BO_ "CANFD_BRS" ENUM "0","1";
BA_DEF_ SG_ "GenSigSNA" STRING;
BA_DEF_ SG_ "SystemSignalLongSymbol" STRING;
BA_DEF_ SG_ "Confidence" ENUM "validated","plausible","layout-only","contradicted";
BA_DEF_DEF_ "GenMsgCycleTime" 0;
BA_DEF_DEF_ "GenMsgSendType" "NoMsgSendType";
BA_DEF_DEF_ "VFrameFormat" "StandardCAN";
BA_DEF_DEF_ "CANFD_BRS" "1";
BA_DEF_DEF_ "GenSigSNA" "";
BA_DEF_DEF_ "SystemSignalLongSymbol" "";
BA_DEF_DEF_ "Confidence" "layout-only";
BA_ "GenMsgCycleTime" BO_ 920 1000;
BA_ "GenMsgSendType" BO_ 920 0;
BA_ "Confidence" SG_ 920 EPASTS_matrixIndex 1;
BA_ "SystemSignalLongSymbol" SG_ 920 EPASTS_a001_adcCalibrationOrInit "EPASTS_a001_adcCalibrationOrInitFail";
BA_ "SystemSignalLongSymbol" SG_ 920 EPASTS_a005_scpUnknownResetSourc "EPASTS_a005_scpUnknownResetSource";
BA_ "SystemSignalLongSymbol" SG_ 920 EPASTS_a006_swrhResetByInvalidEr "EPASTS_a006_swrhResetByInvalidErrid";
BA_ "SystemSignalLongSymbol" SG_ 920 EPASTS_a009_mcusscLbistPermanent "EPASTS_a009_mcusscLbistPermanentFail";
BA_ "SystemSignalLongSymbol" SG_ 920 EPASTS_a010_svcIncompatibleSwVer "EPASTS_a010_svcIncompatibleSwVersions";
BA_ "SystemSignalLongSymbol" SG_ 920 EPASTS_a013_mcusscSffMonitoringF "EPASTS_a013_mcusscSffMonitoringFailed";
BA_ "SystemSignalLongSymbol" SG_ 920 EPASTS_a014_mcusscSffMonitoringM "EPASTS_a014_mcusscSffMonitoringMia";
BA_ "SystemSignalLongSymbol" SG_ 920 EPASTS_a015_mcusscCsErrorCheckFa "EPASTS_a015_mcusscCsErrorCheckFail";
BA_ "SystemSignalLongSymbol" SG_ 920 EPASTS_a016_mcufcCsErrorCheckFai "EPASTS_a016_mcufcCsErrorCheckFail";
BA_ "SystemSignalLongSymbol" SG_ 920 EPASTS_a017_stmdStmPlausibilityC "EPASTS_a017_stmdStmPlausibilityCheckErr";
BA_ "SystemSignalLongSymbol" SG_ 920 EPASTS_a019_rsthHwResetInfoCorru "EPASTS_a019_rsthHwResetInfoCorruptionCheck";
BA_ "SystemSignalLongSymbol" SG_ 920 EPASTS_a020_mcusscEolEcuIdIntegr "EPASTS_a020_mcusscEolEcuIdIntegritiyFail";
BA_ "SystemSignalLongSymbol" SG_ 920 EPASTS_a022_swrhSwResetInfoCorru "EPASTS_a022_swrhSwResetInfoCorruptionCheck";
BA_ "SystemSignalLongSymbol" SG_ 920 EPASTS_a028_smuhNonInitDataCorru "EPASTS_a028_smuhNonInitDataCorruption";
BA_ "SystemSignalLongSymbol" SG_ 920 EPASTS_a029_smuhSmuCoreCntErrorT "EPASTS_a029_smuhSmuCoreCntErrorTestFail";
BA_ "SystemSignalLongSymbol" SG_ 920 EPASTS_a031_pmsProductionModeFai "EPASTS_a031_pmsProductionModeFailed";
BA_ "SystemSignalLongSymbol" SG_ 920 EPASTS_a033_icsvcPswVersionMisma "EPASTS_a033_icsvcPswVersionMismatch";
BA_ "SystemSignalLongSymbol" SG_ 920 EPASTS_a038_csohCh1CsErrorErrAtR "EPASTS_a038_csohCh1CsErrorErrAtReset";
BA_ "SystemSignalLongSymbol" SG_ 920 EPASTS_a039_csohCh2CsErrorErrAtR "EPASTS_a039_csohCh2CsErrorErrAtReset";
BA_ "SystemSignalLongSymbol" SG_ 920 EPASTS_a040_swrhLimitedResetRetr "EPASTS_a040_swrhLimitedResetRetriesExpired";
BA_ "SystemSignalLongSymbol" SG_ 920 EPASTS_a041_imcmCoreConfiguratio "EPASTS_a041_imcmCoreConfigurationMismatch";
BA_ "SystemSignalLongSymbol" SG_ 920 EPASTS_a045_psumSbcBandgapVoltEr "EPASTS_a045_psumSbcBandgapVoltErr";
BA_ "SystemSignalLongSymbol" SG_ 920 EPASTS_a046_mcusscOscillatorNotR "EPASTS_a046_mcusscOscillatorNotReliable";
BA_ "SystemSignalLongSymbol" SG_ 920 EPASTS_a052_ermSdcInputBufferOve "EPASTS_a052_ermSdcInputBufferOverflow";
BA_ "SystemSignalLongSymbol" SG_ 920 EPASTS_a053_adcUnexpectedNumOfDa "EPASTS_a053_adcUnexpectedNumOfData";
BA_ "SystemSignalLongSymbol" SG_ 920 EPASTS_a056_amGduConfigCsErrorCh "EPASTS_a056_amGduConfigCsErrorCheck";
BA_ "SystemSignalLongSymbol" SG_ 920 EPASTS_a067_tspmPowermoduleTempI "EPASTS_a067_tspmPowermoduleTempImplausible";
BA_ "SystemSignalLongSymbol" SG_ 920 EPASTS_a068_rsthCoreRedundancyEr "EPASTS_a068_rsthCoreRedundancyErr";
BA_ "SystemSignalLongSymbol" SG_ 920 EPASTS_a069_rsthCoreTempOutOfRan "EPASTS_a069_rsthCoreTempOutOfRangeHwCheck";
BA_ "SystemSignalLongSymbol" SG_ 920 EPASTS_a072_rsthFlashUncorrEccOr "EPASTS_a072_rsthFlashUncorrEccOrOvfl";
BA_ "SystemSignalLongSymbol" SG_ 920 EPASTS_a075_rsthUnusedOtherModul "EPASTS_a075_rsthUnusedOtherModuleAlarm";
BA_ "SystemSignalLongSymbol" SG_ 920 EPASTS_a081_exchFloatingPointExc "EPASTS_a081_exchFloatingPointException";
BA_ "SystemSignalLongSymbol" SG_ 920 EPASTS_a083_tdaDclinkcapacitorTe "EPASTS_a083_tdaDclinkcapacitorTempChecker";
BA_ "SystemSignalLongSymbol" SG_ 920 EPASTS_a085_amGduSwitchOffTestBy "EPASTS_a085_amGduSwitchOffTestByMcu";
BA_ "SystemSignalLongSymbol" SG_ 920 EPASTS_a088_tedMainboardTempChec "EPASTS_a088_tedMainboardTempChecker";
BA_ "SystemSignalLongSymbol" SG_ 920 EPASTS_a089_tedRevercebattfetjun "EPASTS_a089_tedRevercebattfetjunctionTempChecker";
BA_ "SystemSignalLongSymbol" SG_ 920 EPASTS_a091_bvpBattVoltCrossChkF "EPASTS_a091_bvpBattVoltCrossChkFailed";
BA_ "SystemSignalLongSymbol" SG_ 920 EPASTS_a092_amGduSwitchOffTestBy "EPASTS_a092_amGduSwitchOffTestBySbc";
BA_ "SystemSignalLongSymbol" SG_ 920 EPASTS_a093_sctpTsuSingleStaticF "EPASTS_a093_sctpTsuSingleStaticFail";
BA_ "SystemSignalLongSymbol" SG_ 920 EPASTS_a094_sctpTsuMultipleStati "EPASTS_a094_sctpTsuMultipleStaticFail";
BA_ "SystemSignalLongSymbol" SG_ 920 EPASTS_a095_mdModelBasedMotorInt "EPASTS_a095_mdModelBasedMotorIntegrityCheck";
BA_ "SystemSignalLongSymbol" SG_ 920 EPASTS_a096_rppRpsSingleStaticFa "EPASTS_a096_rppRpsSingleStaticFail";
BA_ "SystemSignalLongSymbol" SG_ 920 EPASTS_a097_rppRpsMultipleStatic "EPASTS_a097_rppRpsMultipleStaticFail";
BA_ "SystemSignalLongSymbol" SG_ 920 EPASTS_a099_mcdTorqueMismatchFau "EPASTS_a099_mcdTorqueMismatchFault";
BA_ "SystemSignalLongSymbol" SG_ 920 EPASTS_a103_exhaUnusedInterruptC "EPASTS_a103_exhaUnusedInterruptCallException";
BA_ "SystemSignalLongSymbol" SG_ 920 EPASTS_a105_exhaSriBusErrExcepti "EPASTS_a105_exhaSriBusErrException";
BA_ "SystemSignalLongSymbol" SG_ 920 EPASTS_a106_exhaSpbBusErrExcepti "EPASTS_a106_exhaSpbBusErrException";
BA_ "SystemSignalLongSymbol" SG_ 920 EPASTS_a107_exhaOtherNmiExceptio "EPASTS_a107_exhaOtherNmiException";
BA_ "SystemSignalLongSymbol" SG_ 920 EPASTS_a108_exhaInternalProtecti "EPASTS_a108_exhaInternalProtectionException";
BA_ "SystemSignalLongSymbol" SG_ 920 EPASTS_a109_exhaSysBusOrPeriphEr "EPASTS_a109_exhaSysBusOrPeriphErrException";
BA_ "SystemSignalLongSymbol" SG_ 920 EPASTS_a110_amPhaseRelaySwitchOf "EPASTS_a110_amPhaseRelaySwitchOffTest";
BA_ "SystemSignalLongSymbol" SG_ 920 EPASTS_a111_amCurrentSensingDisc "EPASTS_a111_amCurrentSensingDisconnection";
BA_ "SystemSignalLongSymbol" SG_ 920 EPASTS_a112_rsthSafetyFlipflopEr "EPASTS_a112_rsthSafetyFlipflopErr";
BA_ "SystemSignalLongSymbol" SG_ 920 EPASTS_a113_rsthUncorrectableEnd "EPASTS_a113_rsthUncorrectableEndToEndBusErr";
BA_ "SystemSignalLongSymbol" SG_ 920 EPASTS_a115_mcusscLbistSingleFai "EPASTS_a115_mcusscLbistSingleFail";
BA_ "SystemSignalLongSymbol" SG_ 920 EPASTS_a116_mrccStartupRegCsErro "EPASTS_a116_mrccStartupRegCsErrorStaticErr";
BA_ "SystemSignalLongSymbol" SG_ 920 EPASTS_a117_mrccStartupRegCsErro "EPASTS_a117_mrccStartupRegCsErrorTransientErr";
BA_ "SystemSignalLongSymbol" SG_ 920 EPASTS_a118_mcusscFlashCsErrorEr "EPASTS_a118_mcusscFlashCsErrorErr";
BA_ "SystemSignalLongSymbol" SG_ 920 EPASTS_a119_mcusscFlashEccCritic "EPASTS_a119_mcusscFlashEccCriticalErr";
BA_ "SystemSignalLongSymbol" SG_ 920 EPASTS_a120_mcusscFlashEccLatent "EPASTS_a120_mcusscFlashEccLatentErr";
BA_ "SystemSignalLongSymbol" SG_ 920 EPASTS_a124_mcusscMbistEccTransi "EPASTS_a124_mcusscMbistEccTransientErr";
BA_ "SystemSignalLongSymbol" SG_ 920 EPASTS_a127_exchAdditionalExcept "EPASTS_a127_exchAdditionalExceptionAfterRst";
BA_ "SystemSignalLongSymbol" SG_ 920 EPASTS_a128_exchExceptionStopRes "EPASTS_a128_exchExceptionStopRestart";
BA_ "SystemSignalLongSymbol" SG_ 920 EPASTS_a129_exchAdditionalExcept "EPASTS_a129_exchAdditionalExceptionStopRestart";
BA_ "SystemSignalLongSymbol" SG_ 920 EPASTS_a131_exchGuardedResetAfte "EPASTS_a131_exchGuardedResetAfterPartitionStop";
BA_ "SystemSignalLongSymbol" SG_ 920 EPASTS_a132_mcusscNotSupportedMc "EPASTS_a132_mcusscNotSupportedMcu";
BA_ "SystemSignalLongSymbol" SG_ 920 EPASTS_a133_mcusscLbistEcuIdIsNo "EPASTS_a133_mcusscLbistEcuIdIsNotSupported";
BA_ "SystemSignalLongSymbol" SG_ 920 EPASTS_a134_osehGuardedResetAfte "EPASTS_a134_osehGuardedResetAfterErrWithoutReset";
BA_ "SystemSignalLongSymbol" SG_ 920 EPASTS_a135_tmpsfetjCalculationO "EPASTS_a135_tmpsfetjCalculationOverflowErr";
BA_ "SystemSignalLongSymbol" SG_ 920 EPASTS_a137_osehErrWithoutImmedi "EPASTS_a137_osehErrWithoutImmediateReset";
BA_ "SystemSignalLongSymbol" SG_ 920 EPASTS_a138_osehAdditionalErrWit "EPASTS_a138_osehAdditionalErrWithoutImmReset";
BA_ "SystemSignalLongSymbol" SG_ 920 EPASTS_a142_tedEmifilterDmcTempC "EPASTS_a142_tedEmifilterDmcTempChecker";
BA_ "SystemSignalLongSymbol" SG_ 920 EPASTS_a143_tedEmifilterCmcTempC "EPASTS_a143_tedEmifilterCmcTempChecker";
BA_ "SystemSignalLongSymbol" SG_ 920 EPASTS_a145_mriPeripheralRaminit "EPASTS_a145_mriPeripheralRaminitFailed";
BA_ "SystemSignalLongSymbol" SG_ 920 EPASTS_a148_mrccExitFromStandbyD "EPASTS_a148_mrccExitFromStandbyDetected";
BA_ "SystemSignalLongSymbol" SG_ 920 EPASTS_a149_amReversibleEmergenc "EPASTS_a149_amReversibleEmergencyOffRequested";
BA_ "SystemSignalLongSymbol" SG_ 920 EPASTS_a150_amExternalEmergencyO "EPASTS_a150_amExternalEmergencyOffRequested";
BA_ "SystemSignalLongSymbol" SG_ 920 EPASTS_a151_amPermanentEmergency "EPASTS_a151_amPermanentEmergencyOffRequested";
BA_ "SystemSignalLongSymbol" SG_ 920 EPASTS_a152_exchFlashEccExceptio "EPASTS_a152_exchFlashEccException";
BA_ "SystemSignalLongSymbol" SG_ 920 EPASTS_a153_sdsmBlockSelectorInv "EPASTS_a153_sdsmBlockSelectorInvalid";
BA_ "SystemSignalLongSymbol" SG_ 920 EPASTS_a154_sdsmCsErrorInvalidPr "EPASTS_a154_sdsmCsErrorInvalidPrimary";
BA_ "SystemSignalLongSymbol" SG_ 920 EPASTS_a156_amIntSerialErrSafety "EPASTS_a156_amIntSerialErrSafetyReset";
BA_ "SystemSignalLongSymbol" SG_ 920 EPASTS_a158_amGduFailDuringRecov "EPASTS_a158_amGduFailDuringRecovery";
BA_ "SystemSignalLongSymbol" SG_ 920 EPASTS_a159_exchFlashWordlineTra "EPASTS_a159_exchFlashWordlineTransientErr";
BA_ "SystemSignalLongSymbol" SG_ 920 EPASTS_a160_rsthCpu1UnexpectedAl "EPASTS_a160_rsthCpu1UnexpectedAlarm";
BA_ "SystemSignalLongSymbol" SG_ 920 EPASTS_a161_tdaRelayfetjunctionT "EPASTS_a161_tdaRelayfetjunctionTempChecker";
BA_ "SystemSignalLongSymbol" SG_ 920 EPASTS_a162_tdaBridgefetjunction "EPASTS_a162_tdaBridgefetjunctionTempChecker";
BA_ "SystemSignalLongSymbol" SG_ 920 EPASTS_a163_tdaPowermoduleTempCh "EPASTS_a163_tdaPowermoduleTempChecker";
BA_ "SystemSignalLongSymbol" SG_ 920 EPASTS_a164_tdaBattfetjunctionTe "EPASTS_a164_tdaBattfetjunctionTempChecker";
BA_ "SystemSignalLongSymbol" SG_ 920 EPASTS_a165_tdaDcbusshuntTempChe "EPASTS_a165_tdaDcbusshuntTempChecker";
BA_ "SystemSignalLongSymbol" SG_ 920 EPASTS_a166_tdaPhasecurrentshunt "EPASTS_a166_tdaPhasecurrentshuntTempChecker";
BA_ "SystemSignalLongSymbol" SG_ 920 EPASTS_a167_iccd1ErrQueueOverflo "EPASTS_a167_iccd1ErrQueueOverflow";
BA_ "SystemSignalLongSymbol" SG_ 920 EPASTS_a172_pmpElangMotorcurrent "EPASTS_a172_pmpElangMotorcurrentAge";
BA_ "SystemSignalLongSymbol" SG_ 920 EPASTS_a175_exchFlashStoredConfi "EPASTS_a175_exchFlashStoredConfigErr";
BA_ "SystemSignalLongSymbol" SG_ 920 EPASTS_a176_exchCpu1ExceptionRes "EPASTS_a176_exchCpu1ExceptionReset";
BA_ "SystemSignalLongSymbol" SG_ 920 EPASTS_a179_tedMotorcoilTempChec "EPASTS_a179_tedMotorcoilTempChecker";
BA_ "SystemSignalLongSymbol" SG_ 920 EPASTS_a180_dmDeadlineViolationC "EPASTS_a180_dmDeadlineViolationC1";
BA_ "SystemSignalLongSymbol" SG_ 920 EPASTS_a181_dmDeadlineViolationC "EPASTS_a181_dmDeadlineViolationC1";
BA_ "SystemSignalLongSymbol" SG_ 920 EPASTS_a184_sbcmCommBufferOverfl "EPASTS_a184_sbcmCommBufferOverflow";
BA_ "SystemSignalLongSymbol" SG_ 920 EPASTS_a185_sbcscpQAWatchdogRese "EPASTS_a185_sbcscpQAWatchdogReset";
BA_ "SystemSignalLongSymbol" SG_ 920 EPASTS_a186_wdhCommBufferOverflo "EPASTS_a186_wdhCommBufferOverflow";
BA_ "SystemSignalLongSymbol" SG_ 920 EPASTS_a188_epmCommBufferOverflo "EPASTS_a188_epmCommBufferOverflow";
BA_ "SystemSignalLongSymbol" SG_ 920 EPASTS_a190_sbchCommBufferOverfl "EPASTS_a190_sbchCommBufferOverflow";
BA_ "SystemSignalLongSymbol" SG_ 920 EPASTS_a191_sbcscpVcp2VucVoltFai "EPASTS_a191_sbcscpVcp2VucVoltFail";
BA_ "SystemSignalLongSymbol" SG_ 920 EPASTS_a196_topEolTasOffsetInval "EPASTS_a196_topEolTasOffsetInvalid";
BA_ "SystemSignalLongSymbol" SG_ 920 EPASTS_a200_ammInputBufferOverfl "EPASTS_a200_ammInputBufferOverflow";
BA_ "SystemSignalLongSymbol" SG_ 920 EPASTS_a201_ammOutputBufferOverf "EPASTS_a201_ammOutputBufferOverflow";
BA_ "SystemSignalLongSymbol" SG_ 920 EPASTS_a202_ohnvmpStoredOffsetLo "EPASTS_a202_ohnvmpStoredOffsetLost";
BA_ "SystemSignalLongSymbol" SG_ 920 EPASTS_a206_fdrOclPartialBlockin "EPASTS_a206_fdrOclPartialBlocking";
BA_ "SystemSignalLongSymbol" SG_ 920 EPASTS_a208_fdrLowSeverityBlocki "EPASTS_a208_fdrLowSeverityBlocking";
BA_ "SystemSignalLongSymbol" SG_ 920 EPASTS_a209_fdrLowSeverityFreezi "EPASTS_a209_fdrLowSeverityFreezing";
BA_ "SystemSignalLongSymbol" SG_ 920 EPASTS_a213_frmHighFrictionDetec "EPASTS_a213_frmHighFrictionDetected";
BA_ "SystemSignalLongSymbol" SG_ 920 EPASTS_a218_aadApplicationStateE "EPASTS_a218_aadApplicationStateErr";
BA_ "SystemSignalLongSymbol" SG_ 920 EPASTS_a220_transceiverInputqueu "EPASTS_a220_transceiverInputqueueOverflow";
BA_ "SystemSignalLongSymbol" SG_ 920 EPASTS_a258_pspInvalidProjectPar "EPASTS_a258_pspInvalidProjectParamset";
BA_ "SystemSignalLongSymbol" SG_ 920 EPASTS_a270_oscillationCompTrqLi "EPASTS_a270_oscillationCompTrqLimReached";
VAL_ 920 EPASTS_matrixIndex 4 "AlertMatrix4" 3 "AlertMatrix3" 2 "AlertMatrix2" 1 "AlertMatrix1" 0 "AlertMatrix0" ;
