VERSION "dbc-export 1 2026.26.6.5"

NS_ :

BS_:

BU_: ADSP APB APP APS APSB BB BMS CC CMP CMPD CP DAS DI DIF DIR DPB EPAS3P EPAS3S EPASTP EPASTS EPBL EPBR ESP EVSE FC GTW HCML HCMR HVP IBST ICR IDB LS OCS1P ODIN PARK PCS PCS2 PLG PM PMF PMR PNCD PTC RADC RCM RCM2 RCM3 RCU SCCM SCM SCS SDCR TAS TCU TCU2 TPMS TRCM UDS UI UIS UMC USM V2G VC VCBATT VCBATT0 VCBATT1 VCBATT2 VCCC VCFRONT VCFRONT1 VCFRONT2 VCLEFT VCRIGHT VCSEAT2L VCSEAT2R VCSEC VEH

BO_ 1448 EPBR_alertLog: 8 EPBR
 SG_ EPBR_alertID M : 0|9@1+ (1,0) [0|511] "" Vector__XXX
 SG_ EPBR_alertState : 15|1@1+ (1,0) [0|1] "" Vector__XXX
 SG_ EPBR_a001_InternalWatchdog m1 : 16|1@1+ (1,0) [0|1] "" Vector__XXX
 SG_ EPBR_a015_NVMMMemOverflow m15 : 16|1@1+ (1,0) [0|1] "" Vector__XXX
 SG_ EPBR_a015_NVMMFilesystemError m15 : 17|1@1+ (1,0) [0|1] "" Vector__XXX
 SG_ EPBR_a015_NVMMRecordIDError m15 : 18|1@1+ (1,0) [0|1] "" Vector__XXX
 SG_ EPBR_a057_VEH_cpControl m57 : 16|1@1+ (1,0) [0|1] "" Vector__XXX
 SG_ EPBR_a059_voltageDrop m59 : 16|12@1+ (0.005443676,0) [0|22.29185322] "V" Vector__XXX
 SG_ EPBR_a059_resistanceEstimate m59 : 28|12@1+ (0.00244,0) [0|9.9918] "Ohms" Vector__XXX
 SG_ EPBR_a059_current m59 : 40|12@1+ (0.05,0) [0|204.75] "A" Vector__XXX
 SG_ EPBR_a063_switchChannel m63 : 16|8@1+ (1,0) [0|255] "" Vector__XXX
 SG_ EPBR_a063_switchType m63 : 24|8@1+ (1,0) [0|255] "" Vector__XXX
 SG_ EPBR_a063_ADCVoltage m63 : 32|8@1+ (0.025,0) [0|6.375] "V" Vector__XXX
 SG_ EPBR_a063_disconnected m63 : 40|1@1+ (1,0) [0|1] "" Vector__XXX
 SG_ EPBR_a063_indeterminate m63 : 41|1@1+ (1,0) [0|1] "" Vector__XXX
 SG_ EPBR_a063_stuckActive m63 : 42|1@1+ (1,0) [0|1] "" Vector__XXX
 SG_ EPBR_a063_faulted m63 : 43|1@1+ (1,0) [0|1] "" Vector__XXX
 SG_ EPBR_a082_RIPC_epbPrivateState m82 : 16|1@1+ (1,0) [0|1] "" Vector__XXX
 SG_ EPBR_a082_RIPC_remoteHSD m82 : 17|1@1+ (1,0) [0|1] "" Vector__XXX
 SG_ EPBR_a082_RIPC_railStatus m82 : 18|1@1+ (1,0) [0|1] "" Vector__XXX
 SG_ EPBR_a082_RIPC_remoteMux m82 : 19|1@1+ (1,0) [0|1] "" Vector__XXX
 SG_ EPBR_a082_RIPC_remoteCurrent m82 : 20|1@1+ (1,0) [0|1] "" Vector__XXX
 SG_ EPBR_a083_LIPC_epbPrivateState m83 : 16|1@1+ (1,0) [0|1] "" Vector__XXX
 SG_ EPBR_a083_LIPC_remoteHSD m83 : 17|1@1+ (1,0) [0|1] "" Vector__XXX
 SG_ EPBR_a083_LIPC_railStatus m83 : 18|1@1+ (1,0) [0|1] "" Vector__XXX
 SG_ EPBR_a083_LIPC_HSDFaults m83 : 19|1@1+ (1,0) [0|1] "" Vector__XXX
 SG_ EPBR_a083_LIPC_remoteCurrent m83 : 20|1@1+ (1,0) [0|1] "" Vector__XXX
 SG_ EPBR_a084_CH_StatusC m84 : 16|1@1+ (1,0) [0|1] "" Vector__XXX
 SG_ EPBR_a085_PARTY_buttonStatus m85 : 16|1@1+ (1,0) [0|1] "" Vector__XXX
 SG_ EPBR_a086_VEH_LVBMS_statusHigh m86 : 16|1@1+ (1,0) [0|1] "" Vector__XXX
 SG_ EPBR_a086_VEH_LVBMS_statusLow m86 : 17|1@1+ (1,0) [0|1] "" Vector__XXX
 SG_ EPBR_a086_VEH_status m86 : 18|1@1+ (1,0) [0|1] "" Vector__XXX
 SG_ EPBR_a086_VEH_12VBatteryStatus m86 : 19|1@1+ (1,0) [0|1] "" Vector__XXX
 SG_ EPBR_a086_VEH_LVPowerState m86 : 20|1@1+ (1,0) [0|1] "" Vector__XXX
 SG_ EPBR_a086_VEH_lightStatus m86 : 21|1@1+ (1,0) [0|1] "" Vector__XXX
 SG_ EPBR_a086_VEH_systemStatus m86 : 22|1@1+ (1,0) [0|1] "" Vector__XXX
 SG_ EPBR_a086_VEH_thermalStatus m86 : 23|1@1+ (1,0) [0|1] "" Vector__XXX
 SG_ EPBR_a086_VEH_vehNm m86 : 24|1@1+ (1,0) [0|1] "" Vector__XXX
 SG_ EPBR_a086_VEH_LVHealth m86 : 62|1@1+ (1,0) [0|1] "" Vector__XXX
 SG_ EPBR_a086_VEH_pcsInterface m86 : 63|1@1+ (1,0) [0|1] "" Vector__XXX
 SG_ EPBR_a087_VEH_temperature m87 : 16|1@1+ (1,0) [0|1] "" Vector__XXX
 SG_ EPBR_a087_VEH_thermalControl m87 : 17|1@1+ (1,0) [0|1] "" Vector__XXX
 SG_ EPBR_a087_VEH_torque m87 : 18|1@1+ (1,0) [0|1] "" Vector__XXX
 SG_ EPBR_a087_VEH_status m87 : 19|1@1+ (1,0) [0|1] "" Vector__XXX
 SG_ EPBR_a087_PARTY_torque m87 : 20|1@1+ (1,0) [0|1] "" Vector__XXX
 SG_ EPBR_a087_PARTY_status m87 : 21|1@1+ (1,0) [0|1] "" Vector__XXX
 SG_ EPBR_a087_PARTY_temperature m87 : 22|1@1+ (1,0) [0|1] "" Vector__XXX
 SG_ EPBR_a087_PARTY_thermalControl m87 : 23|1@1+ (1,0) [0|1] "" Vector__XXX
 SG_ EPBR_a087_VEH_motorStatus m87 : 24|1@1+ (1,0) [0|1] "" Vector__XXX
 SG_ EPBR_a088_VEH_temperature m88 : 16|1@1+ (1,0) [0|1] "" Vector__XXX
 SG_ EPBR_a088_VEH_thermalControl m88 : 17|1@1+ (1,0) [0|1] "" Vector__XXX
 SG_ EPBR_a088_VEH_torque m88 : 18|1@1+ (1,0) [0|1] "" Vector__XXX
 SG_ EPBR_a088_VEH_status m88 : 19|1@1+ (1,0) [0|1] "" Vector__XXX
 SG_ EPBR_a088_PARTY_torque m88 : 20|1@1+ (1,0) [0|1] "" Vector__XXX
 SG_ EPBR_a088_PARTY_status m88 : 21|1@1+ (1,0) [0|1] "" Vector__XXX
 SG_ EPBR_a088_PARTY_temperature m88 : 22|1@1+ (1,0) [0|1] "" Vector__XXX
 SG_ EPBR_a088_PARTY_thermalControl m88 : 23|1@1+ (1,0) [0|1] "" Vector__XXX
 SG_ EPBR_a088_VEH_motorStatus m88 : 24|1@1+ (1,0) [0|1] "" Vector__XXX
 SG_ EPBR_a089_PARTY_party1 m89 : 16|1@1+ (1,0) [0|1] "" Vector__XXX
 SG_ EPBR_a089_PARTY_status m89 : 17|1@1+ (1,0) [0|1] "" Vector__XXX
 SG_ EPBR_a089_VEH_status m89 : 18|1@1+ (1,0) [0|1] "" Vector__XXX
 SG_ EPBR_a089_BDY_party1 m89 : 19|1@1+ (1,0) [0|1] "" Vector__XXX
 SG_ EPBR_a089_BDY_status m89 : 20|1@1+ (1,0) [0|1] "" Vector__XXX
 SG_ EPBR_a089_CH_status m89 : 21|1@1+ (1,0) [0|1] "" Vector__XXX
 SG_ EPBR_a089_CH_party1 m89 : 22|1@1+ (1,0) [0|1] "" Vector__XXX
 SG_ EPBR_a089_CH_party3 m89 : 23|1@1+ (1,0) [0|1] "" Vector__XXX
 SG_ EPBR_a089_VEH_party1 m89 : 24|1@1+ (1,0) [0|1] "" Vector__XXX
 SG_ EPBR_a089_VEH_party3 m89 : 25|1@1+ (1,0) [0|1] "" Vector__XXX
 SG_ EPBR_a091_VEH_faultsAndExtras m91 : 16|1@1+ (1,0) [0|1] "" Vector__XXX
 SG_ EPBR_a091_VEH_info m91 : 17|1@1+ (1,0) [0|1] "" Vector__XXX
 SG_ EPBR_a091_VEH_state m91 : 18|1@1+ (1,0) [0|1] "" Vector__XXX
 SG_ EPBR_a092_VEH_restraintStatus m92 : 16|1@1+ (1,0) [0|1] "" Vector__XXX
 SG_ EPBR_a092_VEH_switchStatus m92 : 17|1@1+ (1,0) [0|1] "" Vector__XXX
 SG_ EPBR_a092_VEH_seatStatus2 m92 : 18|1@1+ (1,0) [0|1] "" Vector__XXX
 SG_ EPBR_a092_VEH_vehNm m92 : 19|1@1+ (1,0) [0|1] "" Vector__XXX
 SG_ EPBR_a093_VEH_restraintStatus m93 : 16|1@1+ (1,0) [0|1] "" Vector__XXX
 SG_ EPBR_a093_VEH_switchStatus m93 : 17|1@1+ (1,0) [0|1] "" Vector__XXX
 SG_ EPBR_a093_VEH_seatStatus2 m93 : 18|1@1+ (1,0) [0|1] "" Vector__XXX
 SG_ EPBR_a093_VEH_vehNm m93 : 19|1@1+ (1,0) [0|1] "" Vector__XXX
 SG_ EPBR_a094_VEH_sysStatus m94 : 16|1@1+ (1,0) [0|1] "" Vector__XXX
 SG_ EPBR_a094_PARTY_sysStatus m94 : 17|1@1+ (1,0) [0|1] "" Vector__XXX
 SG_ EPBR_a094_CH_sysStatus m94 : 18|1@1+ (1,0) [0|1] "" Vector__XXX
 SG_ EPBR_a095_PT_ptNm m95 : 16|1@1+ (1,0) [0|1] "" Vector__XXX
 SG_ EPBR_a095_PT_status m95 : 17|1@1+ (1,0) [0|1] "" Vector__XXX
 SG_ EPBR_a096_VEH_status m96 : 16|1@1+ (1,0) [0|1] "" Vector__XXX
 SG_ EPBR_a096_CH_status m96 : 17|1@1+ (1,0) [0|1] "" Vector__XXX
 SG_ EPBR_a097_VEH_HVStatus m97 : 16|1@1+ (1,0) [0|1] "" Vector__XXX
 SG_ EPBR_a097_VEH_state m97 : 17|1@1+ (1,0) [0|1] "" Vector__XXX
 SG_ EPBR_a098_CH_torque m98 : 16|1@1+ (1,0) [0|1] "" Vector__XXX
 SG_ EPBR_a098_VEH_hvStatus m98 : 17|1@1+ (1,0) [0|1] "" Vector__XXX
 SG_ EPBR_a098_VEH_status m98 : 18|1@1+ (1,0) [0|1] "" Vector__XXX
 SG_ EPBR_a098_VEH_thermalControl m98 : 19|1@1+ (1,0) [0|1] "" Vector__XXX
 SG_ EPBR_a098_VEH_temperature m98 : 20|1@1+ (1,0) [0|1] "" Vector__XXX
 SG_ EPBR_a098_VEH_torque m98 : 21|1@1+ (1,0) [0|1] "" Vector__XXX
 SG_ EPBR_a098_PARTY_status m98 : 22|1@1+ (1,0) [0|1] "" Vector__XXX
 SG_ EPBR_a098_PARTY_temperature m98 : 23|1@1+ (1,0) [0|1] "" Vector__XXX
 SG_ EPBR_a098_PARTY_thermalControl m98 : 24|1@1+ (1,0) [0|1] "" Vector__XXX
 SG_ EPBR_a098_PARTY_torque m98 : 25|1@1+ (1,0) [0|1] "" Vector__XXX
 SG_ EPBR_a098_PT_thermalControl m98 : 26|1@1+ (1,0) [0|1] "" Vector__XXX
 SG_ EPBR_a098_PT_temperature m98 : 27|1@1+ (1,0) [0|1] "" Vector__XXX
 SG_ EPBR_a098_PARTY_motorStatus m98 : 28|1@1+ (1,0) [0|1] "" Vector__XXX
 SG_ EPBR_a098_VEH_motorStatus m98 : 29|1@1+ (1,0) [0|1] "" Vector__XXX
 SG_ EPBR_a099_VEH_oocStatus m99 : 16|1@1+ (1,0) [0|1] "" Vector__XXX
 SG_ EPBR_a100_VEH m100 : 16|1@1+ (1,0) [0|1] "" Vector__XXX
 SG_ EPBR_a100_PARTY m100 : 17|1@1+ (1,0) [0|1] "" Vector__XXX
 SG_ EPBR_a100_PT m100 : 18|1@1+ (1,0) [0|1] "" Vector__XXX
 SG_ EPBR_a100_CH m100 : 19|1@1+ (1,0) [0|1] "" Vector__XXX
 SG_ EPBR_a100_OBD m100 : 20|1@1+ (1,0) [0|1] "" Vector__XXX
 SG_ EPBR_a101_VEH_state m101 : 16|1@1+ (1,0) [0|1] "" Vector__XXX
 SG_ EPBR_a101_PARTY_locState m101 : 17|1@1+ (1,0) [0|1] "" Vector__XXX
 SG_ EPBR_a101_LIPC_externalWatchdogH m101 : 18|1@1+ (1,0) [0|1] "" Vector__XXX
 SG_ EPBR_a101_VEH_locState m101 : 19|1@1+ (1,0) [0|1] "" Vector__XXX
 SG_ EPBR_a101_BDY_locState m101 : 20|1@1+ (1,0) [0|1] "" Vector__XXX
 SG_ EPBR_a102_VEH_faultsAndExtras m102 : 16|1@1+ (1,0) [0|1] "" Vector__XXX
 SG_ EPBR_a102_VEH_feedbackStatus m102 : 17|1@1+ (1,0) [0|1] "" Vector__XXX
 SG_ EPBR_a102_VEH_sensorStatus m102 : 18|1@1+ (1,0) [0|1] "" Vector__XXX
 SG_ EPBR_a102_VEH_rods m102 : 19|1@1+ (1,0) [0|1] "" Vector__XXX
 SG_ EPBR_a103_VEH_hvsNm m103 : 16|1@1+ (1,0) [0|1] "" Vector__XXX
 SG_ EPBR_a103_VEH_vehNm m103 : 17|1@1+ (1,0) [0|1] "" Vector__XXX
 SG_ EPBR_a103_VEH_status m103 : 18|1@1+ (1,0) [0|1] "" Vector__XXX
 SG_ EPBR_a103_PT_ptNm m103 : 19|1@1+ (1,0) [0|1] "" Vector__XXX
 SG_ EPBR_a103_PT_status m103 : 20|1@1+ (1,0) [0|1] "" Vector__XXX
 SG_ EPBR_a103_VEH_evseStatus m103 : 21|1@1+ (1,0) [0|1] "" Vector__XXX
 SG_ EPBR_a105_VEH_states m105 : 16|1@1+ (1,0) [0|1] "" Vector__XXX
 SG_ EPBR_a105_VEH_chNm m105 : 17|1@1+ (1,0) [0|1] "" Vector__XXX
 SG_ EPBR_a105_VEH_dampingStates m105 : 18|1@1+ (1,0) [0|1] "" Vector__XXX
 SG_ EPBR_a106_VEH_dcdcStatus m106 : 16|1@1+ (1,0) [0|1] "" Vector__XXX
 SG_ EPBR_a106_VEH_thermalControl m106 : 17|1@1+ (1,0) [0|1] "" Vector__XXX
 SG_ EPBR_a106_VEH_dcdcRailStatus m106 : 18|1@1+ (1,0) [0|1] "" Vector__XXX
 SG_ EPBR_a106_CH_dcdcRailStatus m106 : 19|1@1+ (1,0) [0|1] "" Vector__XXX
 SG_ EPBR_a106_CH_alertMatrix m106 : 20|1@1+ (1,0) [0|1] "" Vector__XXX
 SG_ EPBR_a107_VEH_hvsNm m107 : 16|1@1+ (1,0) [0|1] "" Vector__XXX
 SG_ EPBR_a107_VEH_vehNm m107 : 17|1@1+ (1,0) [0|1] "" Vector__XXX
 SG_ EPBR_a107_VEH_status m107 : 18|1@1+ (1,0) [0|1] "" Vector__XXX
 SG_ EPBR_a107_VEH_thermalStatus m107 : 19|1@1+ (1,0) [0|1] "" Vector__XXX
 SG_ EPBR_a107_VEH_bmbMinMax m107 : 20|1@1+ (1,0) [0|1] "" Vector__XXX
 SG_ EPBR_a107_VEH_powerAvailable m107 : 21|1@1+ (1,0) [0|1] "" Vector__XXX
 SG_ EPBR_a107_PT_ptNm m107 : 22|1@1+ (1,0) [0|1] "" Vector__XXX
 SG_ EPBR_a107_PT_status m107 : 23|1@1+ (1,0) [0|1] "" Vector__XXX
 SG_ EPBR_a107_PT_thermalStatus m107 : 24|1@1+ (1,0) [0|1] "" Vector__XXX
 SG_ EPBR_a107_PT_socStatus m107 : 25|1@1+ (1,0) [0|1] "" Vector__XXX
 SG_ EPBR_a107_VEH_socStatus m107 : 26|1@1+ (1,0) [0|1] "" Vector__XXX
 SG_ EPBR_a107_VEH_packConfig m107 : 27|1@1+ (1,0) [0|1] "" Vector__XXX
 SG_ EPBR_a107_VEH_energyStatus m107 : 28|1@1+ (1,0) [0|1] "" Vector__XXX
 SG_ EPBR_a107_VEH_chargeInfo m107 : 29|1@1+ (1,0) [0|1] "" Vector__XXX
 SG_ EPBR_a108_VEH_hvStatus m108 : 16|1@1+ (1,0) [0|1] "" Vector__XXX
 SG_ EPBR_a108_VEH_temperature m108 : 17|1@1+ (1,0) [0|1] "" Vector__XXX
 SG_ EPBR_a108_VEH_thermalControl m108 : 18|1@1+ (1,0) [0|1] "" Vector__XXX
 SG_ EPBR_a108_VEH_torque m108 : 19|1@1+ (1,0) [0|1] "" Vector__XXX
 SG_ EPBR_a108_VEH_status m108 : 20|1@1+ (1,0) [0|1] "" Vector__XXX
 SG_ EPBR_a108_PARTY_torque m108 : 21|1@1+ (1,0) [0|1] "" Vector__XXX
 SG_ EPBR_a108_PARTY_status m108 : 22|1@1+ (1,0) [0|1] "" Vector__XXX
 SG_ EPBR_a108_PARTY_temperature m108 : 23|1@1+ (1,0) [0|1] "" Vector__XXX
 SG_ EPBR_a108_PARTY_thermalControl m108 : 24|1@1+ (1,0) [0|1] "" Vector__XXX
 SG_ EPBR_a108_PT_temperature m108 : 25|1@1+ (1,0) [0|1] "" Vector__XXX
 SG_ EPBR_a108_PT_thermalControl m108 : 26|1@1+ (1,0) [0|1] "" Vector__XXX
 SG_ EPBR_a108_PARTY_motorStatus m108 : 27|1@1+ (1,0) [0|1] "" Vector__XXX
 SG_ EPBR_a108_VEH_motorStatus m108 : 28|1@1+ (1,0) [0|1] "" Vector__XXX
 SG_ EPBR_a108_CH_torque m108 : 29|1@1+ (1,0) [0|1] "" Vector__XXX
 SG_ EPBR_a110_VEH_powerRequests m110 : 16|1@1+ (1,0) [0|1] "" Vector__XXX
 SG_ EPBR_a110_VEH_carState m110 : 17|1@1+ (1,0) [0|1] "" Vector__XXX
 SG_ EPBR_a110_VEH_carConfig m110 : 18|1@1+ (1,0) [0|1] "" Vector__XXX
 SG_ EPBR_a110_VEH_time m110 : 19|1@1+ (1,0) [0|1] "" Vector__XXX
 SG_ EPBR_a110_VEH_updateStatus m110 : 20|1@1+ (1,0) [0|1] "" Vector__XXX
 SG_ EPBR_a110_VEH_vehNm m110 : 21|1@1+ (1,0) [0|1] "" Vector__XXX
 SG_ EPBR_a110_VEH_mismatchFault m110 : 22|1@1+ (1,0) [0|1] "" Vector__XXX
 SG_ EPBR_a110_VEH_vin m110 : 23|1@1+ (1,0) [0|1] "" Vector__XXX
 SG_ EPBR_a110_VEH_bmpDebug m110 : 24|1@1+ (1,0) [0|1] "" Vector__XXX
 SG_ EPBR_a110_VEH_gearControl m110 : 25|1@1+ (1,0) [0|1] "" Vector__XXX
 SG_ EPBR_a110_VEH_canLogAvailability m110 : 26|1@1+ (1,0) [0|1] "" Vector__XXX
 SG_ EPBR_a110_CH_airbagCutoffStatus m110 : 27|1@1+ (1,0) [0|1] "" Vector__XXX
 SG_ EPBR_a110_CH_carConfig m110 : 28|1@1+ (1,0) [0|1] "" Vector__XXX
 SG_ EPBR_a110_CH_carState m110 : 29|1@1+ (1,0) [0|1] "" Vector__XXX
 SG_ EPBR_a110_CH_vin m110 : 30|1@1+ (1,0) [0|1] "" Vector__XXX
 SG_ EPBR_a110_CH_chNm m110 : 31|1@1+ (1,0) [0|1] "" Vector__XXX
 SG_ EPBR_a110_CH_epochTimeGtw m110 : 32|1@1+ (1,0) [0|1] "" Vector__XXX
 SG_ EPBR_a110_PARTY_carConfig m110 : 33|1@1+ (1,0) [0|1] "" Vector__XXX
 SG_ EPBR_a111_VEH_internalStatus m111 : 16|1@1+ (1,0) [0|1] "" Vector__XXX
 SG_ EPBR_a111_VEH_status m111 : 17|1@1+ (1,0) [0|1] "" Vector__XXX
 SG_ EPBR_a111_VEH_vehNm m111 : 18|1@1+ (1,0) [0|1] "" Vector__XXX
 SG_ EPBR_a111_RIPC_LVPowerState m111 : 19|1@1+ (1,0) [0|1] "" Vector__XXX
 SG_ EPBR_a111_RIPC_epbPrivateState m111 : 20|1@1+ (1,0) [0|1] "" Vector__XXX
 SG_ EPBR_a111_RIPC_railStatus m111 : 21|1@1+ (1,0) [0|1] "" Vector__XXX
 SG_ EPBR_a111_RIPC_remoteADC m111 : 22|1@1+ (1,0) [0|1] "" Vector__XXX
 SG_ EPBR_a111_RIPC_switchStatus m111 : 23|1@1+ (1,0) [0|1] "" Vector__XXX
 SG_ EPBR_a111_VEH_LVPowerState m111 : 24|1@1+ (1,0) [0|1] "" Vector__XXX
 SG_ EPBR_a111_VEH_seatStatus m111 : 25|1@1+ (1,0) [0|1] "" Vector__XXX
 SG_ EPBR_a111_PARTY_status m111 : 26|1@1+ (1,0) [0|1] "" Vector__XXX
 SG_ EPBR_a111_CH_status m111 : 27|1@1+ (1,0) [0|1] "" Vector__XXX
 SG_ EPBR_a112_VEH_internalStatus m112 : 16|1@1+ (1,0) [0|1] "" Vector__XXX
 SG_ EPBR_a112_VEH_status m112 : 17|1@1+ (1,0) [0|1] "" Vector__XXX
 SG_ EPBR_a112_VEH_vehNm m112 : 18|1@1+ (1,0) [0|1] "" Vector__XXX
 SG_ EPBR_a112_LIPC_LVPowerState m112 : 19|1@1+ (1,0) [0|1] "" Vector__XXX
 SG_ EPBR_a112_LIPC_epbPrivateState m112 : 20|1@1+ (1,0) [0|1] "" Vector__XXX
 SG_ EPBR_a112_LIPC_railStatus m112 : 21|1@1+ (1,0) [0|1] "" Vector__XXX
 SG_ EPBR_a112_LIPC_remoteADC m112 : 22|1@1+ (1,0) [0|1] "" Vector__XXX
 SG_ EPBR_a112_LIPC_switchStatus m112 : 23|1@1+ (1,0) [0|1] "" Vector__XXX
 SG_ EPBR_a112_VEH_LVPowerState m112 : 24|1@1+ (1,0) [0|1] "" Vector__XXX
 SG_ EPBR_a112_PARTY_status m112 : 25|1@1+ (1,0) [0|1] "" Vector__XXX
 SG_ EPBR_a112_CH_status m112 : 26|1@1+ (1,0) [0|1] "" Vector__XXX
 SG_ EPBR_a112_VEH_seatStatus3 m112 : 28|1@1+ (1,0) [0|1] "" Vector__XXX
 SG_ EPBR_a114_PARTY_status m114 : 16|1@1+ (1,0) [0|1] "" Vector__XXX
 SG_ EPBR_a114_PARTY_wheelSpeeds m114 : 17|1@1+ (1,0) [0|1] "" Vector__XXX
 SG_ EPBR_a114_VEH_wheelSpeeds m114 : 18|1@1+ (1,0) [0|1] "" Vector__XXX
 SG_ EPBR_a114_CH_wheelSpeeds m114 : 19|1@1+ (1,0) [0|1] "" Vector__XXX
 SG_ EPBR_a114_PARTY_party3 m114 : 20|1@1+ (1,0) [0|1] "" Vector__XXX
 SG_ EPBR_a114_VEH_party3 m114 : 21|1@1+ (1,0) [0|1] "" Vector__XXX
 SG_ EPBR_a114_VEH_status m114 : 22|1@1+ (1,0) [0|1] "" Vector__XXX
 SG_ EPBR_a114_PARTY_wheelRotation m114 : 23|1@1+ (1,0) [0|1] "" Vector__XXX
 SG_ EPBR_a114_CH_wheelRotation m114 : 24|1@1+ (1,0) [0|1] "" Vector__XXX
 SG_ EPBR_a114_VEH_wheelRotation m114 : 25|1@1+ (1,0) [0|1] "" Vector__XXX
 SG_ EPBR_a114_PARTY_brakeTorque m114 : 26|1@1+ (1,0) [0|1] "" Vector__XXX
 SG_ EPBR_a114_PARTY_offsets m114 : 27|1@1+ (1,0) [0|1] "" Vector__XXX
 SG_ EPBR_a114_BDY_offsets m114 : 28|1@1+ (1,0) [0|1] "" Vector__XXX
 SG_ EPBR_a114_BDY_party3 m114 : 29|1@1+ (1,0) [0|1] "" Vector__XXX
 SG_ EPBR_a114_BDY_status m114 : 30|1@1+ (1,0) [0|1] "" Vector__XXX
 SG_ EPBR_a114_BDY_wheelRotation m114 : 31|1@1+ (1,0) [0|1] "" Vector__XXX
 SG_ EPBR_a114_BDY_wheelSpeeds m114 : 32|1@1+ (1,0) [0|1] "" Vector__XXX
 SG_ EPBR_a114_CH_party1 m114 : 33|1@1+ (1,0) [0|1] "" Vector__XXX
 SG_ EPBR_a114_CH_party3 m114 : 34|1@1+ (1,0) [0|1] "" Vector__XXX
 SG_ EPBR_a114_CH_status m114 : 35|1@1+ (1,0) [0|1] "" Vector__XXX
 SG_ EPBR_a115_VEH_vehNm m115 : 16|1@1+ (1,0) [0|1] "" Vector__XXX
 SG_ EPBR_a115_VEH_authentication m115 : 17|1@1+ (1,0) [0|1] "" Vector__XXX
 SG_ EPBR_a115_VEH_BLEResetRequest m115 : 18|1@1+ (1,0) [0|1] "" Vector__XXX
 SG_ EPBR_a115_VEH_requests m115 : 19|1@1+ (1,0) [0|1] "" Vector__XXX
 SG_ EPBR_a115_VEH_requests2 m115 : 20|1@1+ (1,0) [0|1] "" Vector__XXX
 SG_ EPBR_a115_REM_authentication m115 : 21|1@1+ (1,0) [0|1] "" Vector__XXX
 SG_ EPBR_a115_UI_corianderVehicleCon m115 : 22|1@1+ (1,0) [0|1] "" Vector__XXX
 SG_ EPBR_a115_CH_TPMSDisplay m115 : 23|1@1+ (1,0) [0|1] "" Vector__XXX
 SG_ EPBR_a116_LIPC_doorStatus m116 : 16|1@1+ (1,0) [0|1] "" Vector__XXX
 SG_ EPBR_a116_RIPC_doorStatus m116 : 17|1@1+ (1,0) [0|1] "" Vector__XXX
 SG_ EPBR_a116_RIPC_epbManagement m116 : 18|1@1+ (1,0) [0|1] "" Vector__XXX
 SG_ EPBR_a116_PARTY_epbmStatus m116 : 19|1@1+ (1,0) [0|1] "" Vector__XXX
 SG_ EPBR_a116_VEH_vehNm m116 : 20|1@1+ (1,0) [0|1] "" Vector__XXX
 SG_ EPBR_a116_VEH_hvacRequest m116 : 21|1@1+ (1,0) [0|1] "" Vector__XXX
 SG_ EPBR_a116_VEH_hvacStatus m116 : 22|1@1+ (1,0) [0|1] "" Vector__XXX
 SG_ EPBR_a116_VEH_LVPowerState m116 : 23|1@1+ (1,0) [0|1] "" Vector__XXX
 SG_ EPBR_a116_VEH_lightStatus m116 : 24|1@1+ (1,0) [0|1] "" Vector__XXX
 SG_ EPBR_a116_VEH_seatStatus m116 : 25|1@1+ (1,0) [0|1] "" Vector__XXX
 SG_ EPBR_a116_VEH_thsStatus m116 : 26|1@1+ (1,0) [0|1] "" Vector__XXX
 SG_ EPBR_a116_VEH_doorStatus m116 : 27|1@1+ (1,0) [0|1] "" Vector__XXX
 SG_ EPBR_a116_VEH_seatHeatStatus m116 : 28|1@1+ (1,0) [0|1] "" Vector__XXX
 SG_ EPBR_a116_VEH_restraintStatus m116 : 29|1@1+ (1,0) [0|1] "" Vector__XXX
 SG_ EPBR_a116_VEH_switchStatus m116 : 30|1@1+ (1,0) [0|1] "" Vector__XXX
 SG_ EPBR_a116_VEH_logging1Hz m116 : 31|1@1+ (1,0) [0|1] "" Vector__XXX
 SG_ EPBR_a116_VEH_seatStatus2 m116 : 32|1@1+ (1,0) [0|1] "" Vector__XXX
 SG_ EPBR_a116_VEH_status m116 : 33|1@1+ (1,0) [0|1] "" Vector__XXX
 SG_ EPBR_a116_VEH_thermalCommand m116 : 34|1@1+ (1,0) [0|1] "" Vector__XXX
 SG_ EPBR_a116_VEH_windowStatus m116 : 35|1@1+ (1,0) [0|1] "" Vector__XXX
 SG_ EPBR_a116_PARTY_restraintStatus m116 : 36|1@1+ (1,0) [0|1] "" Vector__XXX
 SG_ EPBR_a116_PARTY_doorStatus m116 : 37|1@1+ (1,0) [0|1] "" Vector__XXX
 SG_ EPBR_a116_BDY_epbmStatus m116 : 38|1@1+ (1,0) [0|1] "" Vector__XXX
 SG_ EPBR_a116_BDY_restraintStatus m116 : 39|1@1+ (1,0) [0|1] "" Vector__XXX
 SG_ EPBR_a116_BDY_switchStatus m116 : 40|1@1+ (1,0) [0|1] "" Vector__XXX
 SG_ EPBR_a116_VEH_hvacStatus2 m116 : 63|1@1+ (1,0) [0|1] "" Vector__XXX
 SG_ EPBR_a117_LIPC_doorStatus m117 : 16|1@1+ (1,0) [0|1] "" Vector__XXX
 SG_ EPBR_a117_RIPC_doorStatus m117 : 17|1@1+ (1,0) [0|1] "" Vector__XXX
 SG_ EPBR_a117_BDY_epbmStatus m117 : 18|1@1+ (1,0) [0|1] "" Vector__XXX
 SG_ EPBR_a117_BDY_restraintStatus m117 : 19|1@1+ (1,0) [0|1] "" Vector__XXX
 SG_ EPBR_a117_VEH_prndStatus m117 : 20|1@1+ (1,0) [0|1] "" Vector__XXX
 SG_ EPBR_a117_PARTY_epbmStatus m117 : 21|1@1+ (1,0) [0|1] "" Vector__XXX
 SG_ EPBR_a117_VEH_vehNm m117 : 22|1@1+ (1,0) [0|1] "" Vector__XXX
 SG_ EPBR_a117_VEH_hvacBlowerFdb m117 : 23|1@1+ (1,0) [0|1] "" Vector__XXX
 SG_ EPBR_a117_VEH_LVPowerState m117 : 24|1@1+ (1,0) [0|1] "" Vector__XXX
 SG_ EPBR_a117_VEH_restraintStatus m117 : 25|1@1+ (1,0) [0|1] "" Vector__XXX
 SG_ EPBR_a117_VEH_lightStatus m117 : 26|1@1+ (1,0) [0|1] "" Vector__XXX
 SG_ EPBR_a117_VEH_seatStatus m117 : 27|1@1+ (1,0) [0|1] "" Vector__XXX
 SG_ EPBR_a117_BDY_falconSwitchStatus m117 : 28|1@1+ (1,0) [0|1] "" Vector__XXX
 SG_ EPBR_a117_VEH_doorStatus m117 : 29|1@1+ (1,0) [0|1] "" Vector__XXX
 SG_ EPBR_a117_VEH_doorStatus2 m117 : 30|1@1+ (1,0) [0|1] "" Vector__XXX
 SG_ EPBR_a117_VEH_windowStatus m117 : 31|1@1+ (1,0) [0|1] "" Vector__XXX
 SG_ EPBR_a117_VEH_switchStatus m117 : 32|1@1+ (1,0) [0|1] "" Vector__XXX
 SG_ EPBR_a117_VEH_intrusionSensorSta m117 : 33|1@1+ (1,0) [0|1] "" Vector__XXX
 SG_ EPBR_a117_VEH_liftgateStatus m117 : 34|1@1+ (1,0) [0|1] "" Vector__XXX
 SG_ EPBR_a117_VEH_seatStatus2 m117 : 35|1@1+ (1,0) [0|1] "" Vector__XXX
 SG_ EPBR_a117_PARTY_restraintStatus m117 : 36|1@1+ (1,0) [0|1] "" Vector__XXX
 SG_ EPBR_a117_VEH_thermalStatus m117 : 37|1@1+ (1,0) [0|1] "" Vector__XXX
 SG_ EPBR_a117_PARTY_doorStatus m117 : 38|1@1+ (1,0) [0|1] "" Vector__XXX
 SG_ EPBR_a117_VEH_status m117 : 39|1@1+ (1,0) [0|1] "" Vector__XXX
 SG_ EPBR_a117_PARTY_prndStatus m117 : 40|1@1+ (1,0) [0|1] "" Vector__XXX
 SG_ EPBR_a117_PARTY_lightingSecondar m117 : 41|1@1+ (1,0) [0|1] "" Vector__XXX
 SG_ EPBR_a118_VEH_vehNm m118 : 16|1@1+ (1,0) [0|1] "" Vector__XXX
 SG_ EPBR_a118_VEH_lighting m118 : 17|1@1+ (1,0) [0|1] "" Vector__XXX
 SG_ EPBR_a118_VEH_sensors m118 : 18|1@1+ (1,0) [0|1] "" Vector__XXX
 SG_ EPBR_a118_VEH_status m118 : 19|1@1+ (1,0) [0|1] "" Vector__XXX
 SG_ EPBR_a118_VEH_okToUseHighPwr m118 : 20|1@1+ (1,0) [0|1] "" Vector__XXX
 SG_ EPBR_a118_VEH_LVPowerState m118 : 21|1@1+ (1,0) [0|1] "" Vector__XXX
 SG_ EPBR_a118_VEH_coolant m118 : 22|1@1+ (1,0) [0|1] "" Vector__XXX
 SG_ EPBR_a118_VEH_vehicleStatus m118 : 23|1@1+ (1,0) [0|1] "" Vector__XXX
 SG_ EPBR_a118_VEH_12VBatteryStatus m118 : 24|1@1+ (1,0) [0|1] "" Vector__XXX
 SG_ EPBR_a118_VEH_systemStatus m118 : 25|1@1+ (1,0) [0|1] "" Vector__XXX
 SG_ EPBR_a118_PARTY_LVPowerState m118 : 26|1@1+ (1,0) [0|1] "" Vector__XXX
 SG_ EPBR_a118_PARTY_outputPowerStatu m118 : 27|1@1+ (1,0) [0|1] "" Vector__XXX
 SG_ EPBR_a118_PARTY_vehicleTime m118 : 28|1@1+ (1,0) [0|1] "" Vector__XXX
 SG_ EPBR_a118_VEH_thermalCommand m118 : 29|1@1+ (1,0) [0|1] "" Vector__XXX
 SG_ EPBR_a118_CH_LVPowerState m118 : 30|1@1+ (1,0) [0|1] "" Vector__XXX
 SG_ EPBR_a118_PARTY_sensors m118 : 31|1@1+ (1,0) [0|1] "" Vector__XXX
 SG_ EPBR_a118_CH_sensors m118 : 32|1@1+ (1,0) [0|1] "" Vector__XXX
 SG_ EPBR_a118_VEH_interNodeResistanc m118 : 33|1@1+ (1,0) [0|1] "" Vector__XXX
 SG_ EPBR_a118_CH_lighting m118 : 34|1@1+ (1,0) [0|1] "" Vector__XXX
 SG_ EPBR_a118_VEH_lightStatus m118 : 35|1@1+ (1,0) [0|1] "" Vector__XXX
 SG_ EPBR_a118_PARTY_vehNm m118 : 36|1@1+ (1,0) [0|1] "" Vector__XXX
 SG_ EPBR_a118_CH_12VBatteryStatus m118 : 37|1@1+ (1,0) [0|1] "" Vector__XXX
 SG_ EPBR_a118_CH_LVBMS_statusHigh m118 : 38|1@1+ (1,0) [0|1] "" Vector__XXX
 SG_ EPBR_a118_CH_alertMatrix m118 : 39|1@1+ (1,0) [0|1] "" Vector__XXX
 SG_ EPBR_a118_BDY_outputPowerStatus m118 : 40|1@1+ (1,0) [0|1] "" Vector__XXX
 SG_ EPBR_a118_BDY_vehicleTime m118 : 41|1@1+ (1,0) [0|1] "" Vector__XXX
 SG_ EPBR_a118_PARTY_AP_vehicleState1 m118 : 42|1@1+ (1,0) [0|1] "" Vector__XXX
 SG_ EPBR_a118_BDY_AP_vehicleState1Hz m118 : 43|1@1+ (1,0) [0|1] "" Vector__XXX
 SG_ EPBR_a118_PARTY_VCFRONT_cameraCl m118 : 44|1@1+ (1,0) [0|1] "" Vector__XXX
 SG_ EPBR_a119_VEH_steerAngle m119 : 16|1@1+ (1,0) [0|1] "" Vector__XXX
 SG_ EPBR_a119_VEH_leftStalk m119 : 17|1@1+ (1,0) [0|1] "" Vector__XXX
 SG_ EPBR_a119_VEH_rightStalk m119 : 18|1@1+ (1,0) [0|1] "" Vector__XXX
 SG_ EPBR_a119_PARTY_rightStalk m119 : 19|1@1+ (1,0) [0|1] "" Vector__XXX
 SG_ EPBR_a119_CH_steerAngle m119 : 20|1@1+ (1,0) [0|1] "" Vector__XXX
 SG_ EPBR_a119_PARTY_steerAngle m119 : 21|1@1+ (1,0) [0|1] "" Vector__XXX
 SG_ EPBR_a120_PARTY_chassisCntl m120 : 16|1@1+ (1,0) [0|1] "" Vector__XXX
 SG_ EPBR_a120_VEH_systemStatus m120 : 17|1@1+ (1,0) [0|1] "" Vector__XXX
 SG_ EPBR_a120_CH_chassisCntl m120 : 18|1@1+ (1,0) [0|1] "" Vector__XXX
 SG_ EPBR_a120_PARTY_systemStatus m120 : 19|1@1+ (1,0) [0|1] "" Vector__XXX
 SG_ EPBR_a120_PARTY_torque m120 : 20|1@1+ (1,0) [0|1] "" Vector__XXX
 SG_ EPBR_a120_VEH_torque m120 : 21|1@1+ (1,0) [0|1] "" Vector__XXX
 SG_ EPBR_a120_PARTY_locStatus m120 : 22|1@1+ (1,0) [0|1] "" Vector__XXX
 SG_ EPBR_a120_PARTY_speed m120 : 23|1@1+ (1,0) [0|1] "" Vector__XXX
 SG_ EPBR_a120_VEH_speed m120 : 24|1@1+ (1,0) [0|1] "" Vector__XXX
 SG_ EPBR_a120_PARTY_status m120 : 25|1@1+ (1,0) [0|1] "" Vector__XXX
 SG_ EPBR_a120_PT_speed m120 : 26|1@1+ (1,0) [0|1] "" Vector__XXX
 SG_ EPBR_a120_PT_systemStatus m120 : 27|1@1+ (1,0) [0|1] "" Vector__XXX
 SG_ EPBR_a120_PARTY_vehicleEstimates m120 : 28|1@1+ (1,0) [0|1] "" Vector__XXX
 SG_ EPBR_a120_VEH_aggregatedAxleSpee m120 : 29|1@1+ (1,0) [0|1] "" Vector__XXX
 SG_ EPBR_a120_PARTY_aggregatedAxleSp m120 : 30|1@1+ (1,0) [0|1] "" Vector__XXX
 SG_ EPBR_a120_VEH_systemPower m120 : 31|1@1+ (1,0) [0|1] "" Vector__XXX
 SG_ EPBR_a120_PARTY_autonomyHealth m120 : 32|1@1+ (1,0) [0|1] "" Vector__XXX
 SG_ EPBR_a120_VEH_autonomyHealth m120 : 33|1@1+ (1,0) [0|1] "" Vector__XXX
 SG_ EPBR_a120_PT_systemPower m120 : 34|1@1+ (1,0) [0|1] "" Vector__XXX
 SG_ EPBR_a120_PARTY_stalklessInterfa m120 : 35|1@1+ (1,0) [0|1] "" Vector__XXX
 SG_ EPBR_a120_CH_speed m120 : 36|1@1+ (1,0) [0|1] "" Vector__XXX
 SG_ EPBR_a120_VEH_estimatedBrakeTemp m120 : 37|1@1+ (1,0) [0|1] "" Vector__XXX
 SG_ EPBR_a120_PARTY_prndControl m120 : 38|1@1+ (1,0) [0|1] "" Vector__XXX
 SG_ EPBR_a120_PARTY_locStatus2 m120 : 39|1@1+ (1,0) [0|1] "" Vector__XXX
 SG_ EPBR_a120_VEH_chassisCntl m120 : 40|1@1+ (1,0) [0|1] "" Vector__XXX
 SG_ EPBR_a120_CH_locStatus2 m120 : 41|1@1+ (1,0) [0|1] "" Vector__XXX
 SG_ EPBR_a120_VEH_locStatus m120 : 42|1@1+ (1,0) [0|1] "" Vector__XXX
 SG_ EPBR_a120_VEH_locStatus2 m120 : 43|1@1+ (1,0) [0|1] "" Vector__XXX
 SG_ EPBR_a120_VEH_prndControl m120 : 44|1@1+ (1,0) [0|1] "" Vector__XXX
 SG_ EPBR_a120_VEH_vehicleEstimates m120 : 45|1@1+ (1,0) [0|1] "" Vector__XXX
 SG_ EPBR_a120_PARTY_motorStatus m120 : 46|1@1+ (1,0) [0|1] "" Vector__XXX
 SG_ EPBR_a120_VEH_motorStatus m120 : 47|1@1+ (1,0) [0|1] "" Vector__XXX
 SG_ EPBR_a120_BDY_speed m120 : 48|1@1+ (1,0) [0|1] "" Vector__XXX
 SG_ EPBR_a122_filteredCurrentCal m122 : 16|12@1+ (0.01,0) [0|40.95] "A" Vector__XXX
 SG_ EPBR_a123_filteredCurrentCal m123 : 16|12@1+ (0.01,0) [0|40.95] "A" Vector__XXX
 SG_ EPBR_a124_calOutOfBoundsData m124 : 16|1@1+ (1,0) [0|1] "" Vector__XXX
 SG_ EPBR_a125_pvFilt m125 : 16|12@1+ (0.005443676,0) [0|22.29185322] "V" Vector__XXX
 SG_ EPBR_a125_nvFilt m125 : 28|12@1+ (0.005443676,0) [0|22.29185322] "V" Vector__XXX
 SG_ EPBR_a125_12vFilt m125 : 40|12@1+ (0.005443676,0) [0|22.29185322] "V" Vector__XXX
 SG_ EPBR_a126_pvFilt m126 : 16|12@1+ (0.005443676,0) [0|22.29185322] "V" Vector__XXX
 SG_ EPBR_a126_nvFilt m126 : 28|12@1+ (0.005443676,0) [0|22.29185322] "V" Vector__XXX
 SG_ EPBR_a126_12vFilt m126 : 40|12@1+ (0.005443676,0) [0|22.29185322] "V" Vector__XXX
 SG_ EPBR_a127_pvFilt m127 : 16|12@1+ (0.005443676,0) [0|22.29185322] "V" Vector__XXX
 SG_ EPBR_a127_nvFilt m127 : 28|12@1+ (0.005443676,0) [0|22.29185322] "V" Vector__XXX
 SG_ EPBR_a127_12vFilt m127 : 40|12@1+ (0.005443676,0) [0|22.29185322] "V" Vector__XXX
 SG_ EPBR_a128_pvFilt m128 : 16|12@1+ (0.005443676,0) [0|22.29185322] "V" Vector__XXX
 SG_ EPBR_a128_nvFilt m128 : 28|12@1+ (0.005443676,0) [0|22.29185322] "V" Vector__XXX
 SG_ EPBR_a128_12vFilt m128 : 40|12@1+ (0.005443676,0) [0|22.29185322] "V" Vector__XXX
 SG_ EPBR_a129_VEH_occupancy m129 : 16|1@1+ (1,0) [0|1] "" Vector__XXX
 SG_ EPBR_a130_PARTY_status m130 : 16|1@1+ (1,0) [0|1] "" Vector__XXX
 SG_ EPBR_a130_VEH_status m130 : 17|1@1+ (1,0) [0|1] "" Vector__XXX
 SG_ EPBR_a130_CH_status m130 : 18|1@1+ (1,0) [0|1] "" Vector__XXX
 SG_ EPBR_a131_PARTY_actuation m131 : 16|1@1+ (1,0) [0|1] "" Vector__XXX
 SG_ EPBR_a134_pvFilt m134 : 16|12@1+ (0.005443676,0) [0|22.29185322] "V" Vector__XXX
 SG_ EPBR_a134_nvFilt m134 : 28|12@1+ (0.005443676,0) [0|22.29185322] "V" Vector__XXX
 SG_ EPBR_a134_12vFilt m134 : 40|12@1+ (0.005443676,0) [0|22.29185322] "V" Vector__XXX
 SG_ EPBR_a135_pvFilt m135 : 16|12@1+ (0.005443676,0) [0|22.29185322] "V" Vector__XXX
 SG_ EPBR_a135_nvFilt m135 : 28|12@1+ (0.005443676,0) [0|22.29185322] "V" Vector__XXX
 SG_ EPBR_a135_12vFilt m135 : 40|12@1+ (0.005443676,0) [0|22.29185322] "V" Vector__XXX
 SG_ EPBR_a136_pvFilt m136 : 16|12@1+ (0.005443676,0) [0|22.29185322] "V" Vector__XXX
 SG_ EPBR_a136_nvFilt m136 : 28|12@1+ (0.005443676,0) [0|22.29185322] "V" Vector__XXX
 SG_ EPBR_a136_12vFilt m136 : 40|12@1+ (0.005443676,0) [0|22.29185322] "V" Vector__XXX
 SG_ EPBR_a137_pvFilt m137 : 16|12@1+ (0.005443676,0) [0|22.29185322] "V" Vector__XXX
 SG_ EPBR_a137_nvFilt m137 : 28|12@1+ (0.005443676,0) [0|22.29185322] "V" Vector__XXX
 SG_ EPBR_a137_12vFilt m137 : 40|12@1+ (0.005443676,0) [0|22.29185322] "V" Vector__XXX
 SG_ EPBR_a138_localState m138 : 16|3@1+ (1,0) [0|7] "" Vector__XXX
 SG_ EPBR_a138_monitorState m138 : 19|3@1+ (1,0) [0|7] "" Vector__XXX
 SG_ EPBR_a139_localState m139 : 16|3@1+ (1,0) [0|7] "" Vector__XXX
 SG_ EPBR_a139_monitorState m139 : 19|3@1+ (1,0) [0|7] "" Vector__XXX
 SG_ EPBR_a141_fromState m141 : 16|5@1+ (1,0) [0|31] "" Vector__XXX
 SG_ EPBR_a141_toState m141 : 24|5@1+ (1,0) [0|31] "" Vector__XXX
 SG_ EPBR_a170_pvFilt m170 : 16|12@1+ (0.005443676,0) [0|22.29185322] "V" Vector__XXX
 SG_ EPBR_a170_nvFilt m170 : 28|12@1+ (0.005443676,0) [0|22.29185322] "V" Vector__XXX
 SG_ EPBR_a170_12vFilt m170 : 40|12@1+ (0.005443676,0) [0|22.29185322] "V" Vector__XXX
 SG_ EPBR_a171_pvFilt m171 : 16|12@1+ (0.005443676,0) [0|22.29185322] "V" Vector__XXX
 SG_ EPBR_a171_nvFilt m171 : 28|12@1+ (0.005443676,0) [0|22.29185322] "V" Vector__XXX
 SG_ EPBR_a171_12vFilt m171 : 40|12@1+ (0.005443676,0) [0|22.29185322] "V" Vector__XXX
 SG_ EPBR_a174_esmState m174 : 16|5@1+ (1,0) [0|31] "" Vector__XXX
 SG_ EPBR_a174_esmStateRequest m174 : 24|5@1+ (1,0) [0|31] "" Vector__XXX
 SG_ EPBR_a174_faultStatus m174 : 29|2@1+ (1,0) [0|3] "" Vector__XXX
 SG_ EPBR_a174_monitorUnitStatus m174 : 32|5@1+ (1,0) [0|31] "" Vector__XXX
 SG_ EPBR_a174_monitorFaultStatus m174 : 37|2@1+ (1,0) [0|3] "" Vector__XXX
 SG_ EPBR_a174_csmFaultReason m174 : 40|5@1+ (1,0) [0|31] "" Vector__XXX
 SG_ EPBR_a174_esmOpTrigger m174 : 48|6@1+ (1,0) [0|63] "" Vector__XXX
 SG_ EPBR_a174_nonterminalReason m174 : 56|5@1+ (1,0) [0|31] "" Vector__XXX
 SG_ EPBR_a175_esmState m175 : 16|5@1+ (1,0) [0|31] "" Vector__XXX
 SG_ EPBR_a175_esmStateRequest m175 : 24|5@1+ (1,0) [0|31] "" Vector__XXX
 SG_ EPBR_a175_faultStatus m175 : 29|2@1+ (1,0) [0|3] "" Vector__XXX
 SG_ EPBR_a175_monitorUnitStatus m175 : 32|5@1+ (1,0) [0|31] "" Vector__XXX
 SG_ EPBR_a175_monitorFaultStatus m175 : 37|2@1+ (1,0) [0|3] "" Vector__XXX
 SG_ EPBR_a175_csmFaultReason m175 : 40|5@1+ (1,0) [0|31] "" Vector__XXX
 SG_ EPBR_a175_esmOpTrigger m175 : 48|6@1+ (1,0) [0|63] "" Vector__XXX
 SG_ EPBR_a175_nonterminalReason m175 : 56|5@1+ (1,0) [0|31] "" Vector__XXX
 SG_ EPBR_a176_esmState m176 : 16|5@1+ (1,0) [0|31] "" Vector__XXX
 SG_ EPBR_a176_esmStateRequest m176 : 24|5@1+ (1,0) [0|31] "" Vector__XXX
 SG_ EPBR_a176_faultStatus m176 : 29|2@1+ (1,0) [0|3] "" Vector__XXX
 SG_ EPBR_a176_monitorUnitStatus m176 : 32|5@1+ (1,0) [0|31] "" Vector__XXX
 SG_ EPBR_a176_monitorFaultStatus m176 : 37|2@1+ (1,0) [0|3] "" Vector__XXX
 SG_ EPBR_a176_csmFaultReason m176 : 40|5@1+ (1,0) [0|31] "" Vector__XXX
 SG_ EPBR_a176_esmOpTrigger m176 : 48|6@1+ (1,0) [0|63] "" Vector__XXX
 SG_ EPBR_a176_nonterminalReason m176 : 56|5@1+ (1,0) [0|31] "" Vector__XXX
 SG_ EPBR_a177_esmState m177 : 16|5@1+ (1,0) [0|31] "" Vector__XXX
 SG_ EPBR_a177_esmStateRequest m177 : 24|5@1+ (1,0) [0|31] "" Vector__XXX
 SG_ EPBR_a177_faultStatus m177 : 29|2@1+ (1,0) [0|3] "" Vector__XXX
 SG_ EPBR_a177_monitorUnitStatus m177 : 32|5@1+ (1,0) [0|31] "" Vector__XXX
 SG_ EPBR_a177_monitorFaultStatus m177 : 37|2@1+ (1,0) [0|3] "" Vector__XXX
 SG_ EPBR_a177_csmFaultReason m177 : 40|5@1+ (1,0) [0|31] "" Vector__XXX
 SG_ EPBR_a177_esmOpTrigger m177 : 48|6@1+ (1,0) [0|63] "" Vector__XXX
 SG_ EPBR_a177_nonterminalReason m177 : 56|5@1+ (1,0) [0|31] "" Vector__XXX
 SG_ EPBR_a178_localCaliperState m178 : 16|3@1+ (1,0) [0|7] "" Vector__XXX
 SG_ EPBR_a178_monitorCaliperState m178 : 19|3@1+ (1,0) [0|7] "" Vector__XXX
 SG_ EPBR_a179_esmState m179 : 16|5@1+ (1,0) [0|31] "" Vector__XXX
 SG_ EPBR_a179_esmStateRequest m179 : 24|5@1+ (1,0) [0|31] "" Vector__XXX
 SG_ EPBR_a179_faultStatus m179 : 29|2@1+ (1,0) [0|3] "" Vector__XXX
 SG_ EPBR_a179_monitorUnitStatus m179 : 32|5@1+ (1,0) [0|31] "" Vector__XXX
 SG_ EPBR_a179_monitorFaultStatus m179 : 37|2@1+ (1,0) [0|3] "" Vector__XXX
 SG_ EPBR_a179_csmFaultReason m179 : 40|5@1+ (1,0) [0|31] "" Vector__XXX
 SG_ EPBR_a179_esmOpTrigger m179 : 48|6@1+ (1,0) [0|63] "" Vector__XXX
 SG_ EPBR_a179_nonterminalReason m179 : 56|5@1+ (1,0) [0|31] "" Vector__XXX
 SG_ EPBR_a180_esmOpTrigger m180 : 16|6@1+ (1,0) [0|63] "" Vector__XXX
 SG_ EPBR_a180_previousState m180 : 24|5@1+ (1,0) [0|31] "" Vector__XXX
 SG_ EPBR_a180_nextState m180 : 32|5@1+ (1,0) [0|31] "" Vector__XXX
 SG_ EPBR_a180_panicModeLatched m180 : 37|1@1+ (1,0) [0|1] "" Vector__XXX
 SG_ EPBR_a180_activeDecelRequest m180 : 38|1@1+ (1,0) [0|1] "" Vector__XXX
 SG_ EPBR_a181_grade m181 : 16|7@1- (1,0) [-64|63] "%" Vector__XXX
 SG_ EPBR_a181_vcTrailerDetected m181 : 23|1@1+ (1,0) [0|1] "" Vector__XXX
 SG_ EPBR_a181_uiTrailerDetected m181 : 24|1@1+ (1,0) [0|1] "" Vector__XXX
 SG_ EPBR_a181_trailerDetected m181 : 25|1@1+ (1,0) [0|1] "" Vector__XXX
 SG_ EPBR_a182_epbSystemStatus m182 : 16|4@1+ (1,0) [0|15] "" Vector__XXX
 SG_ EPBR_a182_grade m182 : 24|7@1- (1,0) [-64|63] "%" Vector__XXX
 SG_ EPBR_a182_temperature m182 : 32|8@1+ (0.5,-40) [-40|87.5] "deg C" Vector__XXX
 SG_ EPBR_a182_vcTrailerDetected m182 : 40|1@1+ (1,0) [0|1] "" Vector__XXX
 SG_ EPBR_a182_uiTrailerDetected m182 : 41|1@1+ (1,0) [0|1] "" Vector__XXX
 SG_ EPBR_a182_trailerDetected m182 : 42|1@1+ (1,0) [0|1] "" Vector__XXX
 SG_ EPBR_a183_isRetransmit m183 : 16|1@1+ (1,0) [0|1] "" Vector__XXX
 SG_ EPBR_a183_localCdpState m183 : 17|2@1+ (1,0) [0|3] "" Vector__XXX
 SG_ EPBR_a183_remoteCdpState m183 : 19|2@1+ (1,0) [0|3] "" Vector__XXX
 SG_ EPBR_a183_espCdpStatus m183 : 21|2@1+ (1,0) [0|3] "" Vector__XXX
 SG_ EPBR_a183_esmState m183 : 24|5@1+ (1,0) [0|31] "" Vector__XXX
 SG_ EPBR_a183_esmStateRequest m183 : 32|5@1+ (1,0) [0|31] "" Vector__XXX
 SG_ EPBR_a183_esmOperationTrigger m183 : 40|6@1+ (1,0) [0|63] "" Vector__XXX
 SG_ EPBR_a183_cdpNotStopping m183 : 46|1@1+ (1,0) [0|1] "" Vector__XXX
 SG_ EPBR_a183_cdpNotStarting m183 : 47|1@1+ (1,0) [0|1] "" Vector__XXX
 SG_ EPBR_a183_remoteEpbDynamic m183 : 48|1@1+ (1,0) [0|1] "" Vector__XXX
 SG_ EPBR_a183_localEpbDynamic m183 : 49|1@1+ (1,0) [0|1] "" Vector__XXX
 SG_ EPBR_a183_epbmInvalidated m183 : 50|1@1+ (1,0) [0|1] "" Vector__XXX
 SG_ EPBR_a183_espConfirmedInvalid m183 : 51|1@1+ (1,0) [0|1] "" Vector__XXX
 SG_ EPBR_a183_brakeFluidConfirmedLow m183 : 52|1@1+ (1,0) [0|1] "" Vector__XXX
 SG_ EPBR_a183_lastRemoteEpbDynamic m183 : 53|1@1+ (1,0) [0|1] "" Vector__XXX
 SG_ EPBR_a183_lastLocalEpbDynamic m183 : 54|1@1+ (1,0) [0|1] "" Vector__XXX
 SG_ EPBR_a183_cdpCannotBeCommanded m183 : 55|1@1+ (1,0) [0|1] "" Vector__XXX
 SG_ EPBR_a183_remoteEpbStatusUnsure m183 : 56|1@1+ (1,0) [0|1] "" Vector__XXX
 SG_ EPBR_a183_lastLowBrakeFluid m183 : 57|1@1+ (1,0) [0|1] "" Vector__XXX
 SG_ EPBR_a183_espInvalidOrUnsure m183 : 58|1@1+ (1,0) [0|1] "" Vector__XXX
 SG_ EPBR_a183_lastFactoryMode m183 : 59|1@1+ (1,0) [0|1] "" Vector__XXX
 SG_ EPBR_a183_redundantBrakingEnable m183 : 60|1@1+ (1,0) [0|1] "" Vector__XXX
 SG_ EPBR_a184_esmOpTrigger m184 : 16|6@1+ (1,0) [0|63] "" Vector__XXX
 SG_ EPBR_a184_previousState m184 : 24|5@1+ (1,0) [0|31] "" Vector__XXX
 SG_ EPBR_a184_nextState m184 : 32|5@1+ (1,0) [0|31] "" Vector__XXX
 SG_ EPBR_a184_panicModeLatched m184 : 37|1@1+ (1,0) [0|1] "" Vector__XXX
 SG_ EPBR_a184_activeDecelRequest m184 : 38|1@1+ (1,0) [0|1] "" Vector__XXX
 SG_ EPBR_a187_esmOpTrigger m187 : 16|6@1+ (1,0) [0|63] "" Vector__XXX
 SG_ EPBR_a187_previousState m187 : 24|5@1+ (1,0) [0|31] "" Vector__XXX
 SG_ EPBR_a187_nextState m187 : 32|5@1+ (1,0) [0|31] "" Vector__XXX
 SG_ EPBR_a187_panicModeLatched m187 : 37|1@1+ (1,0) [0|1] "" Vector__XXX
 SG_ EPBR_a187_activeDecelRequest m187 : 38|1@1+ (1,0) [0|1] "" Vector__XXX
 SG_ EPBR_a188_esmOpTrigger m188 : 16|6@1+ (1,0) [0|63] "" Vector__XXX
 SG_ EPBR_a188_previousState m188 : 24|5@1+ (1,0) [0|31] "" Vector__XXX
 SG_ EPBR_a188_nextState m188 : 32|5@1+ (1,0) [0|31] "" Vector__XXX
 SG_ EPBR_a188_panicModeLatched m188 : 37|1@1+ (1,0) [0|1] "" Vector__XXX
 SG_ EPBR_a188_activeDecelRequest m188 : 38|1@1+ (1,0) [0|1] "" Vector__XXX
 SG_ EPBR_a189_esmOpTrigger m189 : 16|6@1+ (1,0) [0|63] "" Vector__XXX
 SG_ EPBR_a189_previousState m189 : 24|5@1+ (1,0) [0|31] "" Vector__XXX
 SG_ EPBR_a189_nextState m189 : 32|5@1+ (1,0) [0|31] "" Vector__XXX
 SG_ EPBR_a189_panicModeLatched m189 : 37|1@1+ (1,0) [0|1] "" Vector__XXX
 SG_ EPBR_a189_activeDecelRequest m189 : 38|1@1+ (1,0) [0|1] "" Vector__XXX
 SG_ EPBR_a190_esmState m190 : 16|5@1+ (1,0) [0|31] "" Vector__XXX
 SG_ EPBR_a190_esmStateRequest m190 : 24|5@1+ (1,0) [0|31] "" Vector__XXX
 SG_ EPBR_a190_faultStatus m190 : 29|2@1+ (1,0) [0|3] "" Vector__XXX
 SG_ EPBR_a190_monitorUnitStatus m190 : 32|5@1+ (1,0) [0|31] "" Vector__XXX
 SG_ EPBR_a190_monitorFaultStatus m190 : 37|2@1+ (1,0) [0|3] "" Vector__XXX
 SG_ EPBR_a190_csmFaultReason m190 : 40|5@1+ (1,0) [0|31] "" Vector__XXX
 SG_ EPBR_a190_esmOpTrigger m190 : 48|6@1+ (1,0) [0|63] "" Vector__XXX
 SG_ EPBR_a190_nonterminalReason m190 : 56|5@1+ (1,0) [0|31] "" Vector__XXX
 SG_ EPBR_a191_esmState m191 : 16|5@1+ (1,0) [0|31] "" Vector__XXX
 SG_ EPBR_a191_esmStateRequest m191 : 24|5@1+ (1,0) [0|31] "" Vector__XXX
 SG_ EPBR_a191_faultStatus m191 : 29|2@1+ (1,0) [0|3] "" Vector__XXX
 SG_ EPBR_a191_monitorUnitStatus m191 : 32|5@1+ (1,0) [0|31] "" Vector__XXX
 SG_ EPBR_a191_monitorFaultStatus m191 : 37|2@1+ (1,0) [0|3] "" Vector__XXX
 SG_ EPBR_a191_csmFaultReason m191 : 40|5@1+ (1,0) [0|31] "" Vector__XXX
 SG_ EPBR_a191_esmOpTrigger m191 : 48|6@1+ (1,0) [0|63] "" Vector__XXX
 SG_ EPBR_a191_nonterminalReason m191 : 56|5@1+ (1,0) [0|31] "" Vector__XXX
 SG_ EPBR_a202_localEpbConfig m202 : 16|4@1+ (1,0) [0|15] "" Vector__XXX
 SG_ EPBR_a202_remoteEpbConfig m202 : 20|4@1+ (1,0) [0|15] "" Vector__XXX
 SG_ EPBR_a203_gtwConfig m203 : 16|4@1+ (1,0) [0|15] "" Vector__XXX
 SG_ EPBR_a203_epbConfig m203 : 20|4@1+ (1,0) [0|15] "" Vector__XXX
 SG_ EPBR_a225_esmOpTrigger m225 : 16|6@1+ (1,0) [0|63] "" Vector__XXX
 SG_ EPBR_a225_previousState m225 : 24|5@1+ (1,0) [0|31] "" Vector__XXX
 SG_ EPBR_a225_nextState m225 : 32|5@1+ (1,0) [0|31] "" Vector__XXX
 SG_ EPBR_a225_panicModeLatched m225 : 37|1@1+ (1,0) [0|1] "" Vector__XXX
 SG_ EPBR_a225_activeDecelRequest m225 : 38|1@1+ (1,0) [0|1] "" Vector__XXX
 SG_ EPBR_a241_desiredState m241 : 16|1@1+ (1,0) [0|1] "" Vector__XXX
 SG_ EPBR_a241_currentState m241 : 17|1@1+ (1,0) [0|1] "" Vector__XXX
 SG_ EPBR_a241_diKeepAlive m241 : 18|1@1+ (1,0) [0|1] "" Vector__XXX
 SG_ EPBR_a241_epbSysStatus m241 : 19|4@1+ (1,0) [0|15] "" Vector__XXX
 SG_ EPBR_a241_vehiclePowerState m241 : 24|2@1+ (1,0) [0|3] "" Vector__XXX
 SG_ EPBR_a241_highCurrent m241 : 26|1@1+ (1,0) [0|1] "" Vector__XXX
 SG_ EPBR_a241_monitorDataGood m241 : 27|1@1+ (1,0) [0|1] "" Vector__XXX
 SG_ EPBR_a241_hasLockoutRequest m241 : 28|1@1+ (1,0) [0|1] "" Vector__XXX
 SG_ EPBR_a242_hvcDesiredState m242 : 16|1@1+ (1,0) [0|1] "" Vector__XXX
 SG_ EPBR_a242_hvcCurrentState m242 : 17|1@1+ (1,0) [0|1] "" Vector__XXX
 SG_ EPBR_a242_contDesiredState m242 : 18|1@1+ (1,0) [0|1] "" Vector__XXX
 SG_ EPBR_a242_contCurrentState m242 : 19|1@1+ (1,0) [0|1] "" Vector__XXX
 SG_ EPBR_a242_hvState m242 : 20|3@1+ (1,0) [0|7] "" Vector__XXX
 SG_ EPBR_a242_vehiclePowerState m242 : 24|2@1+ (1,0) [0|3] "" Vector__XXX
 SG_ EPBR_a242_highCurrent m242 : 26|1@1+ (1,0) [0|1] "" Vector__XXX
 SG_ EPBR_a242_monitorDataGood m242 : 27|1@1+ (1,0) [0|1] "" Vector__XXX
 SG_ EPBR_a242_hasLockoutRequest m242 : 28|1@1+ (1,0) [0|1] "" Vector__XXX
 SG_ EPBR_a243_brakeMasterCylPress m243 : 16|1@1+ (1,0) [0|1] "" Vector__XXX
 SG_ EPBR_a243_brakeMasterCylPressQF m243 : 17|1@1+ (1,0) [0|1] "" Vector__XXX
 SG_ EPBR_a243_drivetrainType m243 : 18|1@1+ (1,0) [0|1] "" Vector__XXX
 SG_ EPBR_a243_DIR1torqueActual m243 : 19|1@1+ (1,0) [0|1] "" Vector__XXX
 SG_ EPBR_a243_DIR2torqueActual m243 : 20|1@1+ (1,0) [0|1] "" Vector__XXX
 SG_ EPBR_a243_DIFtorqueActual m243 : 21|1@1+ (1,0) [0|1] "" Vector__XXX
 SG_ EPBR_a243_vehicleSpeed m243 : 22|1@1+ (1,0) [0|1] "" Vector__XXX
 SG_ EPBR_a243_tempAmbient m243 : 23|1@1+ (1,0) [0|1] "" Vector__XXX
 SG_ EPBR_a243_thermistorTMin m243 : 24|1@1+ (1,0) [0|1] "" Vector__XXX
 SG_ EPBR_a243_wiperSpeed m243 : 25|1@1+ (1,0) [0|1] "" Vector__XXX
 SG_ EPBR_a243_vehiclePowerState m243 : 26|1@1+ (1,0) [0|1] "" Vector__XXX
 SG_ EPBR_a243_brakeDiscWipingActive m243 : 27|1@1+ (1,0) [0|1] "" Vector__XXX
 SG_ EPBR_a244_permissiveMode m244 : 16|1@1+ (1,0) [0|1] "" Vector__XXX
 SG_ EPBR_a246_previousState m246 : 16|5@1+ (1,0) [0|31] "" Vector__XXX
 SG_ EPBR_a246_nextState m246 : 24|5@1+ (1,0) [0|31] "" Vector__XXX
 SG_ EPBR_a246_esmStateRequest m246 : 32|5@1+ (1,0) [0|31] "" Vector__XXX
 SG_ EPBR_a246_faultStatus m246 : 37|2@1+ (1,0) [0|3] "" Vector__XXX
 SG_ EPBR_a246_esmOpTrigger m246 : 40|6@1+ (1,0) [0|63] "" Vector__XXX
 SG_ EPBR_a247_esmState m247 : 16|5@1+ (1,0) [0|31] "" Vector__XXX
 SG_ EPBR_a247_esmStateRequest m247 : 24|5@1+ (1,0) [0|31] "" Vector__XXX
 SG_ EPBR_a247_faultStatus m247 : 29|2@1+ (1,0) [0|3] "" Vector__XXX
 SG_ EPBR_a247_monitorUnitStatus m247 : 32|5@1+ (1,0) [0|31] "" Vector__XXX
 SG_ EPBR_a247_monitorFaultStatus m247 : 37|2@1+ (1,0) [0|3] "" Vector__XXX
 SG_ EPBR_a247_csmFaultReason m247 : 40|5@1+ (1,0) [0|31] "" Vector__XXX
 SG_ EPBR_a247_esmOpTrigger m247 : 48|6@1+ (1,0) [0|63] "" Vector__XXX
 SG_ EPBR_a247_nonterminalReason m247 : 56|5@1+ (1,0) [0|31] "" Vector__XXX
 SG_ EPBR_a248_esmState m248 : 16|5@1+ (1,0) [0|31] "" Vector__XXX
 SG_ EPBR_a248_esmStateRequest m248 : 24|5@1+ (1,0) [0|31] "" Vector__XXX
 SG_ EPBR_a248_faultStatus m248 : 29|2@1+ (1,0) [0|3] "" Vector__XXX
 SG_ EPBR_a248_monitorUnitStatus m248 : 32|5@1+ (1,0) [0|31] "" Vector__XXX
 SG_ EPBR_a248_monitorFaultStatus m248 : 37|2@1+ (1,0) [0|3] "" Vector__XXX
 SG_ EPBR_a248_csmFaultReason m248 : 40|5@1+ (1,0) [0|31] "" Vector__XXX
 SG_ EPBR_a248_esmOpTrigger m248 : 48|6@1+ (1,0) [0|63] "" Vector__XXX
 SG_ EPBR_a248_nonterminalReason m248 : 56|5@1+ (1,0) [0|31] "" Vector__XXX
 SG_ EPBR_a249_previousState m249 : 16|5@1+ (1,0) [0|31] "" Vector__XXX
 SG_ EPBR_a249_nextState m249 : 24|5@1+ (1,0) [0|31] "" Vector__XXX
 SG_ EPBR_a249_esmStateRequest m249 : 32|5@1+ (1,0) [0|31] "" Vector__XXX
 SG_ EPBR_a249_faultStatus m249 : 37|2@1+ (1,0) [0|3] "" Vector__XXX
 SG_ EPBR_a249_esmOpTrigger m249 : 40|6@1+ (1,0) [0|63] "" Vector__XXX
 SG_ EPBR_a250_esmSpeedClass m250 : 16|3@1+ (1,0) [0|7] "" Vector__XXX
 SG_ EPBR_a250_esmOperationTrigger m250 : 24|6@1+ (1,0) [0|63] "" Vector__XXX
 SG_ EPBR_a250_isJumpPostTripped m250 : 30|1@1+ (1,0) [0|1] "" Vector__XXX
 SG_ EPBR_a251_currentVariance m251 : 16|12@1+ (0.01,0) [0|40.95] "A" Vector__XXX
 SG_ EPBR_a251_pistonPosition m251 : 32|13@1- (9.76801,0) [-40009.76896|40000.00095] "vCounts" Vector__XXX
 SG_ EPBR_a251_temperature m251 : 45|9@1- (0.5,-40) [-168|87.5] "deg C" Vector__XXX
 SG_ EPBR_a272_expectedState m272 : 16|2@1+ (1,0) [0|3] "" Vector__XXX
 SG_ EPBR_a272_actualState m272 : 18|2@1+ (1,0) [0|3] "" Vector__XXX
 SG_ EPBR_a300_harnessId m300 : 16|8@1+ (1,0) [0|255] "" Vector__XXX
 SG_ EPBR_a300_subUsageId m300 : 24|8@1+ (1,0) [0|255] "" Vector__XXX
 SG_ EPBR_a301_setSpeed m301 : 16|16@1+ (0.05,0) [0|3276.75] "kph" Vector__XXX
 SG_ EPBR_a301_oocConfidence m301 : 32|12@1+ (1,0) [0|4095] "" Vector__XXX
 SG_ EPBR_a301_oocDistanceFiltered m301 : 48|16@1+ (0.01,0) [0|655.35] "cm" Vector__XXX
 SG_ EPBR_a302_pistonPosition m302 : 16|13@1- (9.76801,0) [-40009.76896|40000.00095] "vCounts" Vector__XXX
 SG_ EPBR_a302_deltaCurrent m302 : 32|15@1+ (0.01,0) [0|327.67] "A/s" Vector__XXX
 SG_ EPBR_a303_currentVariance m303 : 16|12@1+ (0.01,0) [0|40.95] "A" Vector__XXX
 SG_ EPBR_a303_pistonPosition m303 : 32|13@1- (9.76801,0) [-40009.76896|40000.00095] "vCounts" Vector__XXX
 SG_ EPBR_a303_temperature m303 : 45|9@1- (0.5,-40) [-168|87.5] "deg C" Vector__XXX
 SG_ EPBR_a350_ensPeriod m350 : 16|16@1+ (0.0001,0) [0|6.5535] "s" Vector__XXX
 SG_ EPBR_a350_ensDuty m350 : 32|10@1+ (0.00098,0) [0|1.00254] "%" Vector__XXX
 SG_ EPBR_a350_ensTimedOut m350 : 42|1@1+ (1,0) [0|1] "" Vector__XXX
 SG_ EPBR_a355_brakeHwConfig m355 : 16|4@1+ (1,0) [0|15] "" Vector__XXX
 SG_ EPBR_a355_epbHwConfig m355 : 20|4@1+ (1,0) [0|15] "" Vector__XXX
 SG_ EPBR_a357_epbSystemStatus m357 : 16|4@1+ (1,0) [0|15] "" Vector__XXX
 SG_ EPBR_a357_grade m357 : 24|7@1- (1,0) [-64|63] "%" Vector__XXX
 SG_ EPBR_a357_ambientTemp m357 : 32|8@1+ (0.5,-40) [-40|87.5] "deg C" Vector__XXX
 SG_ EPBR_a357_brakeTemp m357 : 40|11@1+ (1,-40) [-40|2007] "deg C" Vector__XXX
 SG_ EPBR_a357_vcTrailerDetected m357 : 51|1@1+ (1,0) [0|1] "" Vector__XXX
 SG_ EPBR_a357_uiTrailerDetected m357 : 52|1@1+ (1,0) [0|1] "" Vector__XXX
 SG_ EPBR_a357_trailerDetected m357 : 53|1@1+ (1,0) [0|1] "" Vector__XXX
 SG_ EPBR_a358_epbSystemStatus m358 : 16|4@1+ (1,0) [0|15] "" Vector__XXX
 SG_ EPBR_a358_grade m358 : 24|7@1- (1,0) [-64|63] "%" Vector__XXX
 SG_ EPBR_a358_ambientTemp m358 : 32|8@1+ (0.5,-40) [-40|87.5] "deg C" Vector__XXX
 SG_ EPBR_a358_brakeTemp m358 : 40|11@1+ (1,-40) [-40|2007] "deg C" Vector__XXX
 SG_ EPBR_a358_vcTrailerDetected m358 : 51|1@1+ (1,0) [0|1] "" Vector__XXX
 SG_ EPBR_a358_uiTrailerDetected m358 : 52|1@1+ (1,0) [0|1] "" Vector__XXX
 SG_ EPBR_a358_trailerDetected m358 : 53|1@1+ (1,0) [0|1] "" Vector__XXX
 SG_ EPBR_a359_outputCurrent m359 : 16|10@1+ (0.1,0) [0|102.3] "A" Vector__XXX
 SG_ EPBR_a365_epbSystemStatus m365 : 16|4@1+ (1,0) [0|15] "" Vector__XXX
 SG_ EPBR_a365_grade m365 : 24|7@1- (1,0) [-64|63] "%" Vector__XXX
 SG_ EPBR_a365_ambientTemp m365 : 32|8@1+ (0.5,-40) [-40|87.5] "deg C" Vector__XXX
 SG_ EPBR_a365_vcTrailerDetected m365 : 40|1@1+ (1,0) [0|1] "" Vector__XXX
 SG_ EPBR_a365_uiTrailerDetected m365 : 41|1@1+ (1,0) [0|1] "" Vector__XXX
 SG_ EPBR_a365_trailerDetected m365 : 42|1@1+ (1,0) [0|1] "" Vector__XXX
 SG_ EPBR_a366_epbSystemStatus m366 : 16|4@1+ (1,0) [0|15] "" Vector__XXX
 SG_ EPBR_a366_grade m366 : 24|7@1- (1,0) [-64|63] "%" Vector__XXX
 SG_ EPBR_a366_ambientTemp m366 : 32|8@1+ (0.5,-40) [-40|87.5] "deg C" Vector__XXX
 SG_ EPBR_a366_vcTrailerDetected m366 : 40|1@1+ (1,0) [0|1] "" Vector__XXX
 SG_ EPBR_a366_uiTrailerDetected m366 : 41|1@1+ (1,0) [0|1] "" Vector__XXX
 SG_ EPBR_a366_trailerDetected m366 : 42|1@1+ (1,0) [0|1] "" Vector__XXX

BO_TX_BU_ 1448 : EPBR;
CM_ BO_ 1448 "Right electric parking brake message: alert log";
CM_ SG_ 1448 EPBR_alertID "Right electric parking brake: alert ID";
CM_ SG_ 1448 EPBR_alertState "Right electric parking brake: alert state";
CM_ SG_ 1448 EPBR_a001_InternalWatchdog "Right electric parking brake: a001 internal watchdog";
CM_ SG_ 1448 EPBR_a015_NVMMMemOverflow "Right electric parking brake: a015 NVMM mem overflow";
CM_ SG_ 1448 EPBR_a015_NVMMFilesystemError "Right electric parking brake: a015 NVMM filesystem error";
CM_ SG_ 1448 EPBR_a015_NVMMRecordIDError "Right electric parking brake: a015 NVMM record ID error";
CM_ SG_ 1448 EPBR_a057_VEH_cpControl "Right electric parking brake: a057 VEH cp control";
CM_ SG_ 1448 EPBR_a059_voltageDrop "Right electric parking brake: a059 voltage drop";
CM_ SG_ 1448 EPBR_a059_resistanceEstimate "Right electric parking brake: a059 resistance estimate";
CM_ SG_ 1448 EPBR_a059_current "Right electric parking brake: a059 current";
CM_ SG_ 1448 EPBR_a063_switchChannel "Right electric parking brake: a063 switch channel";
CM_ SG_ 1448 EPBR_a063_switchType "Right electric parking brake: a063 switch type";
CM_ SG_ 1448 EPBR_a063_ADCVoltage "Right electric parking brake: a063 ADC voltage";
CM_ SG_ 1448 EPBR_a063_disconnected "Right electric parking brake: a063 disconnected";
CM_ SG_ 1448 EPBR_a063_indeterminate "Right electric parking brake: a063 indeterminate";
CM_ SG_ 1448 EPBR_a063_stuckActive "Right electric parking brake: a063 stuck active";
CM_ SG_ 1448 EPBR_a063_faulted "Right electric parking brake: a063 faulted";
CM_ SG_ 1448 EPBR_a082_RIPC_epbPrivateState "Right electric parking brake: a082 RIPC epb private state";
CM_ SG_ 1448 EPBR_a082_RIPC_remoteHSD "Right electric parking brake: a082 RIPC remote HSD";
CM_ SG_ 1448 EPBR_a082_RIPC_railStatus "Right electric parking brake: a082 RIPC rail status";
CM_ SG_ 1448 EPBR_a082_RIPC_remoteMux "Right electric parking brake: a082 RIPC remote mux";
CM_ SG_ 1448 EPBR_a082_RIPC_remoteCurrent "Right electric parking brake: a082 RIPC remote current";
CM_ SG_ 1448 EPBR_a083_LIPC_epbPrivateState "Right electric parking brake: a083 LIPC epb private state";
CM_ SG_ 1448 EPBR_a083_LIPC_remoteHSD "Right electric parking brake: a083 LIPC remote HSD";
CM_ SG_ 1448 EPBR_a083_LIPC_railStatus "Right electric parking brake: a083 LIPC rail status";
CM_ SG_ 1448 EPBR_a083_LIPC_HSDFaults "Right electric parking brake: a083 LIPC HSD faults";
CM_ SG_ 1448 EPBR_a083_LIPC_remoteCurrent "Right electric parking brake: a083 LIPC remote current";
CM_ SG_ 1448 EPBR_a084_CH_StatusC "Right electric parking brake: a084 CH status c";
CM_ SG_ 1448 EPBR_a085_PARTY_buttonStatus "Right electric parking brake: a085 PARTY button status";
CM_ SG_ 1448 EPBR_a086_VEH_LVBMS_statusHigh "Right electric parking brake: a086 VEH LVBMS status high";
CM_ SG_ 1448 EPBR_a086_VEH_LVBMS_statusLow "Right electric parking brake: a086 VEH LVBMS status low";
CM_ SG_ 1448 EPBR_a086_VEH_status "Right electric parking brake: a086 VEH status";
CM_ SG_ 1448 EPBR_a086_VEH_12VBatteryStatus "Right electric parking brake: a086 VEH 12 v battery status";
CM_ SG_ 1448 EPBR_a086_VEH_LVPowerState "Right electric parking brake: a086 VEH LV power state";
CM_ SG_ 1448 EPBR_a086_VEH_lightStatus "Right electric parking brake: a086 VEH light status";
CM_ SG_ 1448 EPBR_a086_VEH_systemStatus "Right electric parking brake: a086 VEH system status";
CM_ SG_ 1448 EPBR_a086_VEH_thermalStatus "Right electric parking brake: a086 VEH thermal status";
CM_ SG_ 1448 EPBR_a086_VEH_vehNm "Right electric parking brake: a086 VEH veh nm";
CM_ SG_ 1448 EPBR_a086_VEH_LVHealth "Right electric parking brake: a086 VEH LV health";
CM_ SG_ 1448 EPBR_a086_VEH_pcsInterface "Right electric parking brake: a086 VEH pcs interface";
CM_ SG_ 1448 EPBR_a087_VEH_temperature "Right electric parking brake: a087 VEH temperature";
CM_ SG_ 1448 EPBR_a087_VEH_thermalControl "Right electric parking brake: a087 VEH thermal control";
CM_ SG_ 1448 EPBR_a087_VEH_torque "Right electric parking brake: a087 VEH torque";
CM_ SG_ 1448 EPBR_a087_VEH_status "Right electric parking brake: a087 VEH status";
CM_ SG_ 1448 EPBR_a087_PARTY_torque "Right electric parking brake: a087 PARTY torque";
CM_ SG_ 1448 EPBR_a087_PARTY_status "Right electric parking brake: a087 PARTY status";
CM_ SG_ 1448 EPBR_a087_PARTY_temperature "Right electric parking brake: a087 PARTY temperature";
CM_ SG_ 1448 EPBR_a087_PARTY_thermalControl "Right electric parking brake: a087 PARTY thermal control";
CM_ SG_ 1448 EPBR_a087_VEH_motorStatus "Right electric parking brake: a087 VEH motor status";
CM_ SG_ 1448 EPBR_a088_VEH_temperature "Right electric parking brake: a088 VEH temperature";
CM_ SG_ 1448 EPBR_a088_VEH_thermalControl "Right electric parking brake: a088 VEH thermal control";
CM_ SG_ 1448 EPBR_a088_VEH_torque "Right electric parking brake: a088 VEH torque";
CM_ SG_ 1448 EPBR_a088_VEH_status "Right electric parking brake: a088 VEH status";
CM_ SG_ 1448 EPBR_a088_PARTY_torque "Right electric parking brake: a088 PARTY torque";
CM_ SG_ 1448 EPBR_a088_PARTY_status "Right electric parking brake: a088 PARTY status";
CM_ SG_ 1448 EPBR_a088_PARTY_temperature "Right electric parking brake: a088 PARTY temperature";
CM_ SG_ 1448 EPBR_a088_PARTY_thermalControl "Right electric parking brake: a088 PARTY thermal control";
CM_ SG_ 1448 EPBR_a088_VEH_motorStatus "Right electric parking brake: a088 VEH motor status";
CM_ SG_ 1448 EPBR_a089_PARTY_party1 "Right electric parking brake: a089 PARTY party1";
CM_ SG_ 1448 EPBR_a089_PARTY_status "Right electric parking brake: a089 PARTY status";
CM_ SG_ 1448 EPBR_a089_VEH_status "Right electric parking brake: a089 VEH status";
CM_ SG_ 1448 EPBR_a089_BDY_party1 "Right electric parking brake: a089 BDY party1";
CM_ SG_ 1448 EPBR_a089_BDY_status "Right electric parking brake: a089 BDY status";
CM_ SG_ 1448 EPBR_a089_CH_status "Right electric parking brake: a089 CH status";
CM_ SG_ 1448 EPBR_a089_CH_party1 "Right electric parking brake: a089 CH party1";
CM_ SG_ 1448 EPBR_a089_CH_party3 "Right electric parking brake: a089 CH party3";
CM_ SG_ 1448 EPBR_a089_VEH_party1 "Right electric parking brake: a089 VEH party1";
CM_ SG_ 1448 EPBR_a089_VEH_party3 "Right electric parking brake: a089 VEH party3";
CM_ SG_ 1448 EPBR_a091_VEH_faultsAndExtras "Right electric parking brake: a091 VEH faults and extras";
CM_ SG_ 1448 EPBR_a091_VEH_info "Right electric parking brake: a091 VEH info";
CM_ SG_ 1448 EPBR_a091_VEH_state "Right electric parking brake: a091 VEH state";
CM_ SG_ 1448 EPBR_a092_VEH_restraintStatus "Right electric parking brake: a092 VEH restraint status";
CM_ SG_ 1448 EPBR_a092_VEH_switchStatus "Right electric parking brake: a092 VEH switch status";
CM_ SG_ 1448 EPBR_a092_VEH_seatStatus2 "Right electric parking brake: a092 VEH seat status2";
CM_ SG_ 1448 EPBR_a092_VEH_vehNm "Right electric parking brake: a092 VEH veh nm";
CM_ SG_ 1448 EPBR_a093_VEH_restraintStatus "Right electric parking brake: a093 VEH restraint status";
CM_ SG_ 1448 EPBR_a093_VEH_switchStatus "Right electric parking brake: a093 VEH switch status";
CM_ SG_ 1448 EPBR_a093_VEH_seatStatus2 "Right electric parking brake: a093 VEH seat status2";
CM_ SG_ 1448 EPBR_a093_VEH_vehNm "Right electric parking brake: a093 VEH veh nm";
CM_ SG_ 1448 EPBR_a094_VEH_sysStatus "Right electric parking brake: a094 VEH sys status";
CM_ SG_ 1448 EPBR_a094_PARTY_sysStatus "Right electric parking brake: a094 PARTY sys status";
CM_ SG_ 1448 EPBR_a094_CH_sysStatus "Right electric parking brake: a094 CH sys status";
CM_ SG_ 1448 EPBR_a095_PT_ptNm "Right electric parking brake: a095 PT pt nm";
CM_ SG_ 1448 EPBR_a095_PT_status "Right electric parking brake: a095 PT status";
CM_ SG_ 1448 EPBR_a096_VEH_status "Right electric parking brake: a096 VEH status";
CM_ SG_ 1448 EPBR_a096_CH_status "Right electric parking brake: a096 CH status";
CM_ SG_ 1448 EPBR_a097_VEH_HVStatus "Right electric parking brake: a097 VEH HV status";
CM_ SG_ 1448 EPBR_a097_VEH_state "Right electric parking brake: a097 VEH state";
CM_ SG_ 1448 EPBR_a098_CH_torque "Right electric parking brake: a098 CH torque";
CM_ SG_ 1448 EPBR_a098_VEH_hvStatus "Right electric parking brake: a098 VEH hv status";
CM_ SG_ 1448 EPBR_a098_VEH_status "Right electric parking brake: a098 VEH status";
CM_ SG_ 1448 EPBR_a098_VEH_thermalControl "Right electric parking brake: a098 VEH thermal control";
CM_ SG_ 1448 EPBR_a098_VEH_temperature "Right electric parking brake: a098 VEH temperature";
CM_ SG_ 1448 EPBR_a098_VEH_torque "Right electric parking brake: a098 VEH torque";
CM_ SG_ 1448 EPBR_a098_PARTY_status "Right electric parking brake: a098 PARTY status";
CM_ SG_ 1448 EPBR_a098_PARTY_temperature "Right electric parking brake: a098 PARTY temperature";
CM_ SG_ 1448 EPBR_a098_PARTY_thermalControl "Right electric parking brake: a098 PARTY thermal control";
CM_ SG_ 1448 EPBR_a098_PARTY_torque "Right electric parking brake: a098 PARTY torque";
CM_ SG_ 1448 EPBR_a098_PT_thermalControl "Right electric parking brake: a098 PT thermal control";
CM_ SG_ 1448 EPBR_a098_PT_temperature "Right electric parking brake: a098 PT temperature";
CM_ SG_ 1448 EPBR_a098_PARTY_motorStatus "Right electric parking brake: a098 PARTY motor status";
CM_ SG_ 1448 EPBR_a098_VEH_motorStatus "Right electric parking brake: a098 VEH motor status";
CM_ SG_ 1448 EPBR_a099_VEH_oocStatus "Right electric parking brake: a099 VEH ooc status";
CM_ SG_ 1448 EPBR_a100_VEH "Right electric parking brake: a100 VEH";
CM_ SG_ 1448 EPBR_a100_PARTY "Right electric parking brake: a100 PARTY";
CM_ SG_ 1448 EPBR_a100_PT "Right electric parking brake: a100 PT";
CM_ SG_ 1448 EPBR_a100_CH "Right electric parking brake: a100 CH";
CM_ SG_ 1448 EPBR_a100_OBD "Right electric parking brake: a100 OBD";
CM_ SG_ 1448 EPBR_a101_VEH_state "Right electric parking brake: a101 VEH state";
CM_ SG_ 1448 EPBR_a101_PARTY_locState "Right electric parking brake: a101 PARTY loc state";
CM_ SG_ 1448 EPBR_a101_LIPC_externalWatchdogH "Right electric parking brake: a101 LIPC external watchdog heart beat";
CM_ SG_ 1448 EPBR_a101_VEH_locState "Right electric parking brake: a101 VEH loc state";
CM_ SG_ 1448 EPBR_a101_BDY_locState "Right electric parking brake: a101 BDY loc state";
CM_ SG_ 1448 EPBR_a102_VEH_faultsAndExtras "Right electric parking brake: a102 VEH faults and extras";
CM_ SG_ 1448 EPBR_a102_VEH_feedbackStatus "Right electric parking brake: a102 VEH feedback status";
CM_ SG_ 1448 EPBR_a102_VEH_sensorStatus "Right electric parking brake: a102 VEH sensor status";
CM_ SG_ 1448 EPBR_a102_VEH_rods "Right electric parking brake: a102 VEH rods";
CM_ SG_ 1448 EPBR_a103_VEH_hvsNm "Right electric parking brake: a103 VEH hvs nm";
CM_ SG_ 1448 EPBR_a103_VEH_vehNm "Right electric parking brake: a103 VEH veh nm";
CM_ SG_ 1448 EPBR_a103_VEH_status "Right electric parking brake: a103 VEH status";
CM_ SG_ 1448 EPBR_a103_PT_ptNm "Right electric parking brake: a103 PT pt nm";
CM_ SG_ 1448 EPBR_a103_PT_status "Right electric parking brake: a103 PT status";
CM_ SG_ 1448 EPBR_a103_VEH_evseStatus "Right electric parking brake: a103 VEH evse status";
CM_ SG_ 1448 EPBR_a105_VEH_states "Right electric parking brake: a105 VEH states";
CM_ SG_ 1448 EPBR_a105_VEH_chNm "Right electric parking brake: a105 VEH ch nm";
CM_ SG_ 1448 EPBR_a105_VEH_dampingStates "Right electric parking brake: a105 VEH damping states";
CM_ SG_ 1448 EPBR_a106_VEH_dcdcStatus "Right electric parking brake: a106 VEH dcdc status";
CM_ SG_ 1448 EPBR_a106_VEH_thermalControl "Right electric parking brake: a106 VEH thermal control";
CM_ SG_ 1448 EPBR_a106_VEH_dcdcRailStatus "Right electric parking brake: a106 VEH dcdc rail status";
CM_ SG_ 1448 EPBR_a106_CH_dcdcRailStatus "Right electric parking brake: a106 CH dcdc rail status";
CM_ SG_ 1448 EPBR_a106_CH_alertMatrix "Right electric parking brake: a106 CH alert matrix";
CM_ SG_ 1448 EPBR_a107_VEH_hvsNm "Right electric parking brake: a107 VEH hvs nm";
CM_ SG_ 1448 EPBR_a107_VEH_vehNm "Right electric parking brake: a107 VEH veh nm";
CM_ SG_ 1448 EPBR_a107_VEH_status "Right electric parking brake: a107 VEH status";
CM_ SG_ 1448 EPBR_a107_VEH_thermalStatus "Right electric parking brake: a107 VEH thermal status";
CM_ SG_ 1448 EPBR_a107_VEH_bmbMinMax "Right electric parking brake: a107 VEH bmb min max";
CM_ SG_ 1448 EPBR_a107_VEH_powerAvailable "Right electric parking brake: a107 VEH power available";
CM_ SG_ 1448 EPBR_a107_PT_ptNm "Right electric parking brake: a107 PT pt nm";
CM_ SG_ 1448 EPBR_a107_PT_status "Right electric parking brake: a107 PT status";
CM_ SG_ 1448 EPBR_a107_PT_thermalStatus "Right electric parking brake: a107 PT thermal status";
CM_ SG_ 1448 EPBR_a107_PT_socStatus "Right electric parking brake: a107 PT soc status";
CM_ SG_ 1448 EPBR_a107_VEH_socStatus "Right electric parking brake: a107 VEH soc status";
CM_ SG_ 1448 EPBR_a107_VEH_packConfig "Right electric parking brake: a107 VEH pack config";
CM_ SG_ 1448 EPBR_a107_VEH_energyStatus "Right electric parking brake: a107 VEH energy status";
CM_ SG_ 1448 EPBR_a107_VEH_chargeInfo "Right electric parking brake: a107 VEH charge info";
CM_ SG_ 1448 EPBR_a108_VEH_hvStatus "Right electric parking brake: a108 VEH hv status";
CM_ SG_ 1448 EPBR_a108_VEH_temperature "Right electric parking brake: a108 VEH temperature";
CM_ SG_ 1448 EPBR_a108_VEH_thermalControl "Right electric parking brake: a108 VEH thermal control";
CM_ SG_ 1448 EPBR_a108_VEH_torque "Right electric parking brake: a108 VEH torque";
CM_ SG_ 1448 EPBR_a108_VEH_status "Right electric parking brake: a108 VEH status";
CM_ SG_ 1448 EPBR_a108_PARTY_torque "Right electric parking brake: a108 PARTY torque";
CM_ SG_ 1448 EPBR_a108_PARTY_status "Right electric parking brake: a108 PARTY status";
CM_ SG_ 1448 EPBR_a108_PARTY_temperature "Right electric parking brake: a108 PARTY temperature";
CM_ SG_ 1448 EPBR_a108_PARTY_thermalControl "Right electric parking brake: a108 PARTY thermal control";
CM_ SG_ 1448 EPBR_a108_PT_temperature "Right electric parking brake: a108 PT temperature";
CM_ SG_ 1448 EPBR_a108_PT_thermalControl "Right electric parking brake: a108 PT thermal control";
CM_ SG_ 1448 EPBR_a108_PARTY_motorStatus "Right electric parking brake: a108 PARTY motor status";
CM_ SG_ 1448 EPBR_a108_VEH_motorStatus "Right electric parking brake: a108 VEH motor status";
CM_ SG_ 1448 EPBR_a108_CH_torque "Right electric parking brake: a108 CH torque";
CM_ SG_ 1448 EPBR_a110_VEH_powerRequests "Right electric parking brake: a110 VEH power requests";
CM_ SG_ 1448 EPBR_a110_VEH_carState "Right electric parking brake: a110 VEH car state";
CM_ SG_ 1448 EPBR_a110_VEH_carConfig "Right electric parking brake: a110 VEH car config";
CM_ SG_ 1448 EPBR_a110_VEH_time "Right electric parking brake: a110 VEH time";
CM_ SG_ 1448 EPBR_a110_VEH_updateStatus "Right electric parking brake: a110 VEH update status";
CM_ SG_ 1448 EPBR_a110_VEH_vehNm "Right electric parking brake: a110 VEH veh nm";
CM_ SG_ 1448 EPBR_a110_VEH_mismatchFault "Right electric parking brake: a110 VEH mismatch fault";
CM_ SG_ 1448 EPBR_a110_VEH_vin "Right electric parking brake: a110 VEH vin";
CM_ SG_ 1448 EPBR_a110_VEH_bmpDebug "Right electric parking brake: a110 VEH bmp debug";
CM_ SG_ 1448 EPBR_a110_VEH_gearControl "Right electric parking brake: a110 VEH gear control";
CM_ SG_ 1448 EPBR_a110_VEH_canLogAvailability "Right electric parking brake: a110 VEH can log availability";
CM_ SG_ 1448 EPBR_a110_CH_airbagCutoffStatus "Right electric parking brake: a110 CH airbag cutoff status";
CM_ SG_ 1448 EPBR_a110_CH_carConfig "Right electric parking brake: a110 CH car config";
CM_ SG_ 1448 EPBR_a110_CH_carState "Right electric parking brake: a110 CH car state";
CM_ SG_ 1448 EPBR_a110_CH_vin "Right electric parking brake: a110 CH vin";
CM_ SG_ 1448 EPBR_a110_CH_chNm "Right electric parking brake: a110 CH ch nm";
CM_ SG_ 1448 EPBR_a110_CH_epochTimeGtw "Right electric parking brake: a110 CH epoch time gtw";
CM_ SG_ 1448 EPBR_a110_PARTY_carConfig "Right electric parking brake: a110 PARTY car config";
CM_ SG_ 1448 EPBR_a111_VEH_internalStatus "Right electric parking brake: a111 VEH internal status";
CM_ SG_ 1448 EPBR_a111_VEH_status "Right electric parking brake: a111 VEH status";
CM_ SG_ 1448 EPBR_a111_VEH_vehNm "Right electric parking brake: a111 VEH veh nm";
CM_ SG_ 1448 EPBR_a111_RIPC_LVPowerState "Right electric parking brake: a111 RIPC LV power state";
CM_ SG_ 1448 EPBR_a111_RIPC_epbPrivateState "Right electric parking brake: a111 RIPC epb private state";
CM_ SG_ 1448 EPBR_a111_RIPC_railStatus "Right electric parking brake: a111 RIPC rail status";
CM_ SG_ 1448 EPBR_a111_RIPC_remoteADC "Right electric parking brake: a111 RIPC remote ADC";
CM_ SG_ 1448 EPBR_a111_RIPC_switchStatus "Right electric parking brake: a111 RIPC switch status";
CM_ SG_ 1448 EPBR_a111_VEH_LVPowerState "Right electric parking brake: a111 VEH LV power state";
CM_ SG_ 1448 EPBR_a111_VEH_seatStatus "Right electric parking brake: a111 VEH seat status";
CM_ SG_ 1448 EPBR_a111_PARTY_status "Right electric parking brake: a111 PARTY status";
CM_ SG_ 1448 EPBR_a111_CH_status "Right electric parking brake: a111 CH status";
CM_ SG_ 1448 EPBR_a112_VEH_internalStatus "Right electric parking brake: a112 VEH internal status";
CM_ SG_ 1448 EPBR_a112_VEH_status "Right electric parking brake: a112 VEH status";
CM_ SG_ 1448 EPBR_a112_VEH_vehNm "Right electric parking brake: a112 VEH veh nm";
CM_ SG_ 1448 EPBR_a112_LIPC_LVPowerState "Right electric parking brake: a112 LIPC LV power state";
CM_ SG_ 1448 EPBR_a112_LIPC_epbPrivateState "Right electric parking brake: a112 LIPC epb private state";
CM_ SG_ 1448 EPBR_a112_LIPC_railStatus "Right electric parking brake: a112 LIPC rail status";
CM_ SG_ 1448 EPBR_a112_LIPC_remoteADC "Right electric parking brake: a112 LIPC remote ADC";
CM_ SG_ 1448 EPBR_a112_LIPC_switchStatus "Right electric parking brake: a112 LIPC switch status";
CM_ SG_ 1448 EPBR_a112_VEH_LVPowerState "Right electric parking brake: a112 VEH LV power state";
CM_ SG_ 1448 EPBR_a112_PARTY_status "Right electric parking brake: a112 PARTY status";
CM_ SG_ 1448 EPBR_a112_CH_status "Right electric parking brake: a112 CH status";
CM_ SG_ 1448 EPBR_a112_VEH_seatStatus3 "Right electric parking brake: a112 VEH seat status3";
CM_ SG_ 1448 EPBR_a114_PARTY_status "Right electric parking brake: a114 PARTY status";
CM_ SG_ 1448 EPBR_a114_PARTY_wheelSpeeds "Right electric parking brake: a114 PARTY wheel speeds";
CM_ SG_ 1448 EPBR_a114_VEH_wheelSpeeds "Right electric parking brake: a114 VEH wheel speeds";
CM_ SG_ 1448 EPBR_a114_CH_wheelSpeeds "Right electric parking brake: a114 CH wheel speeds";
CM_ SG_ 1448 EPBR_a114_PARTY_party3 "Right electric parking brake: a114 PARTY party3";
CM_ SG_ 1448 EPBR_a114_VEH_party3 "Right electric parking brake: a114 VEH party3";
CM_ SG_ 1448 EPBR_a114_VEH_status "Right electric parking brake: a114 VEH status";
CM_ SG_ 1448 EPBR_a114_PARTY_wheelRotation "Right electric parking brake: a114 PARTY wheel rotation";
CM_ SG_ 1448 EPBR_a114_CH_wheelRotation "Right electric parking brake: a114 CH wheel rotation";
CM_ SG_ 1448 EPBR_a114_VEH_wheelRotation "Right electric parking brake: a114 VEH wheel rotation";
CM_ SG_ 1448 EPBR_a114_PARTY_brakeTorque "Right electric parking brake: a114 PARTY brake torque";
CM_ SG_ 1448 EPBR_a114_PARTY_offsets "Right electric parking brake: a114 PARTY offsets";
CM_ SG_ 1448 EPBR_a114_BDY_offsets "Right electric parking brake: a114 BDY offsets";
CM_ SG_ 1448 EPBR_a114_BDY_party3 "Right electric parking brake: a114 BDY party3";
CM_ SG_ 1448 EPBR_a114_BDY_status "Right electric parking brake: a114 BDY status";
CM_ SG_ 1448 EPBR_a114_BDY_wheelRotation "Right electric parking brake: a114 BDY wheel rotation";
CM_ SG_ 1448 EPBR_a114_BDY_wheelSpeeds "Right electric parking brake: a114 BDY wheel speeds";
CM_ SG_ 1448 EPBR_a114_CH_party1 "Right electric parking brake: a114 CH party1";
CM_ SG_ 1448 EPBR_a114_CH_party3 "Right electric parking brake: a114 CH party3";
CM_ SG_ 1448 EPBR_a114_CH_status "Right electric parking brake: a114 CH status";
CM_ SG_ 1448 EPBR_a115_VEH_vehNm "Right electric parking brake: a115 VEH veh nm";
CM_ SG_ 1448 EPBR_a115_VEH_authentication "Right electric parking brake: a115 VEH authentication";
CM_ SG_ 1448 EPBR_a115_VEH_BLEResetRequest "Right electric parking brake: a115 VEH BLE reset request";
CM_ SG_ 1448 EPBR_a115_VEH_requests "Right electric parking brake: a115 VEH requests";
CM_ SG_ 1448 EPBR_a115_VEH_requests2 "Right electric parking brake: a115 VEH requests2";
CM_ SG_ 1448 EPBR_a115_REM_authentication "Right electric parking brake: a115 REM authentication";
CM_ SG_ 1448 EPBR_a115_UI_corianderVehicleCon "Right electric parking brake: a115 UI coriander vehicle control";
CM_ SG_ 1448 EPBR_a115_CH_TPMSDisplay "Right electric parking brake: a115 CH TPMS display";
CM_ SG_ 1448 EPBR_a116_LIPC_doorStatus "Right electric parking brake: a116 LIPC door status";
CM_ SG_ 1448 EPBR_a116_RIPC_doorStatus "Right electric parking brake: a116 RIPC door status";
CM_ SG_ 1448 EPBR_a116_RIPC_epbManagement "Right electric parking brake: a116 RIPC epb management";
CM_ SG_ 1448 EPBR_a116_PARTY_epbmStatus "Right electric parking brake: a116 PARTY epbm status";
CM_ SG_ 1448 EPBR_a116_VEH_vehNm "Right electric parking brake: a116 VEH veh nm";
CM_ SG_ 1448 EPBR_a116_VEH_hvacRequest "Right electric parking brake: a116 VEH hvac request";
CM_ SG_ 1448 EPBR_a116_VEH_hvacStatus "Right electric parking brake: a116 VEH hvac status";
CM_ SG_ 1448 EPBR_a116_VEH_LVPowerState "Right electric parking brake: a116 VEH LV power state";
CM_ SG_ 1448 EPBR_a116_VEH_lightStatus "Right electric parking brake: a116 VEH light status";
CM_ SG_ 1448 EPBR_a116_VEH_seatStatus "Right electric parking brake: a116 VEH seat status";
CM_ SG_ 1448 EPBR_a116_VEH_thsStatus "Right electric parking brake: a116 VEH ths status";
CM_ SG_ 1448 EPBR_a116_VEH_doorStatus "Right electric parking brake: a116 VEH door status";
CM_ SG_ 1448 EPBR_a116_VEH_seatHeatStatus "Right electric parking brake: a116 VEH seat heat status";
CM_ SG_ 1448 EPBR_a116_VEH_restraintStatus "Right electric parking brake: a116 VEH restraint status";
CM_ SG_ 1448 EPBR_a116_VEH_switchStatus "Right electric parking brake: a116 VEH switch status";
CM_ SG_ 1448 EPBR_a116_VEH_logging1Hz "Right electric parking brake: a116 VEH logging1 hz";
CM_ SG_ 1448 EPBR_a116_VEH_seatStatus2 "Right electric parking brake: a116 VEH seat status2";
CM_ SG_ 1448 EPBR_a116_VEH_status "Right electric parking brake: a116 VEH status";
CM_ SG_ 1448 EPBR_a116_VEH_thermalCommand "Right electric parking brake: a116 VEH thermal command";
CM_ SG_ 1448 EPBR_a116_VEH_windowStatus "Right electric parking brake: a116 VEH window status";
CM_ SG_ 1448 EPBR_a116_PARTY_restraintStatus "Right electric parking brake: a116 PARTY restraint status";
CM_ SG_ 1448 EPBR_a116_PARTY_doorStatus "Right electric parking brake: a116 PARTY door status";
CM_ SG_ 1448 EPBR_a116_BDY_epbmStatus "Right electric parking brake: a116 BDY epbm status";
CM_ SG_ 1448 EPBR_a116_BDY_restraintStatus "Right electric parking brake: a116 BDY restraint status";
CM_ SG_ 1448 EPBR_a116_BDY_switchStatus "Right electric parking brake: a116 BDY switch status";
CM_ SG_ 1448 EPBR_a116_VEH_hvacStatus2 "Right electric parking brake: a116 VEH hvac status2";
CM_ SG_ 1448 EPBR_a117_LIPC_doorStatus "Right electric parking brake: a117 LIPC door status";
CM_ SG_ 1448 EPBR_a117_RIPC_doorStatus "Right electric parking brake: a117 RIPC door status";
CM_ SG_ 1448 EPBR_a117_BDY_epbmStatus "Right electric parking brake: a117 BDY epbm status";
CM_ SG_ 1448 EPBR_a117_BDY_restraintStatus "Right electric parking brake: a117 BDY restraint status";
CM_ SG_ 1448 EPBR_a117_VEH_prndStatus "Right electric parking brake: a117 VEH prnd status";
CM_ SG_ 1448 EPBR_a117_PARTY_epbmStatus "Right electric parking brake: a117 PARTY epbm status";
CM_ SG_ 1448 EPBR_a117_VEH_vehNm "Right electric parking brake: a117 VEH veh nm";
CM_ SG_ 1448 EPBR_a117_VEH_hvacBlowerFdb "Right electric parking brake: a117 VEH hvac blower fdb";
CM_ SG_ 1448 EPBR_a117_VEH_LVPowerState "Right electric parking brake: a117 VEH LV power state";
CM_ SG_ 1448 EPBR_a117_VEH_restraintStatus "Right electric parking brake: a117 VEH restraint status";
CM_ SG_ 1448 EPBR_a117_VEH_lightStatus "Right electric parking brake: a117 VEH light status";
CM_ SG_ 1448 EPBR_a117_VEH_seatStatus "Right electric parking brake: a117 VEH seat status";
CM_ SG_ 1448 EPBR_a117_BDY_falconSwitchStatus "Right electric parking brake: a117 BDY falcon switch status";
CM_ SG_ 1448 EPBR_a117_VEH_doorStatus "Right electric parking brake: a117 VEH door status";
CM_ SG_ 1448 EPBR_a117_VEH_doorStatus2 "Right electric parking brake: a117 VEH door status2";
CM_ SG_ 1448 EPBR_a117_VEH_windowStatus "Right electric parking brake: a117 VEH window status";
CM_ SG_ 1448 EPBR_a117_VEH_switchStatus "Right electric parking brake: a117 VEH switch status";
CM_ SG_ 1448 EPBR_a117_VEH_intrusionSensorSta "Right electric parking brake: a117 VEH intrusion sensor status";
CM_ SG_ 1448 EPBR_a117_VEH_liftgateStatus "Right electric parking brake: a117 VEH liftgate status";
CM_ SG_ 1448 EPBR_a117_VEH_seatStatus2 "Right electric parking brake: a117 VEH seat status2";
CM_ SG_ 1448 EPBR_a117_PARTY_restraintStatus "Right electric parking brake: a117 PARTY restraint status";
CM_ SG_ 1448 EPBR_a117_VEH_thermalStatus "Right electric parking brake: a117 VEH thermal status";
CM_ SG_ 1448 EPBR_a117_PARTY_doorStatus "Right electric parking brake: a117 PARTY door status";
CM_ SG_ 1448 EPBR_a117_VEH_status "Right electric parking brake: a117 VEH status";
CM_ SG_ 1448 EPBR_a117_PARTY_prndStatus "Right electric parking brake: a117 PARTY prnd status";
CM_ SG_ 1448 EPBR_a117_PARTY_lightingSecondar "Right electric parking brake: a117 PARTY lighting secondary";
CM_ SG_ 1448 EPBR_a118_VEH_vehNm "Right electric parking brake: a118 VEH veh nm";
CM_ SG_ 1448 EPBR_a118_VEH_lighting "Right electric parking brake: a118 VEH lighting";
CM_ SG_ 1448 EPBR_a118_VEH_sensors "Right electric parking brake: a118 VEH sensors";
CM_ SG_ 1448 EPBR_a118_VEH_status "Right electric parking brake: a118 VEH status";
CM_ SG_ 1448 EPBR_a118_VEH_okToUseHighPwr "Right electric parking brake: a118 VEH ok to use high pwr";
CM_ SG_ 1448 EPBR_a118_VEH_LVPowerState "Right electric parking brake: a118 VEH LV power state";
CM_ SG_ 1448 EPBR_a118_VEH_coolant "Right electric parking brake: a118 VEH coolant";
CM_ SG_ 1448 EPBR_a118_VEH_vehicleStatus "Right electric parking brake: a118 VEH vehicle status";
CM_ SG_ 1448 EPBR_a118_VEH_12VBatteryStatus "Right electric parking brake: a118 VEH 12 v battery status";
CM_ SG_ 1448 EPBR_a118_VEH_systemStatus "Right electric parking brake: a118 VEH system status";
CM_ SG_ 1448 EPBR_a118_PARTY_LVPowerState "Right electric parking brake: a118 PARTY LV power state";
CM_ SG_ 1448 EPBR_a118_PARTY_outputPowerStatu "Right electric parking brake: a118 PARTY output power status";
CM_ SG_ 1448 EPBR_a118_PARTY_vehicleTime "Right electric parking brake: a118 PARTY vehicle time";
CM_ SG_ 1448 EPBR_a118_VEH_thermalCommand "Right electric parking brake: a118 VEH thermal command";
CM_ SG_ 1448 EPBR_a118_CH_LVPowerState "Right electric parking brake: a118 CH LV power state";
CM_ SG_ 1448 EPBR_a118_PARTY_sensors "Right electric parking brake: a118 PARTY sensors";
CM_ SG_ 1448 EPBR_a118_CH_sensors "Right electric parking brake: a118 CH sensors";
CM_ SG_ 1448 EPBR_a118_VEH_interNodeResistanc "Right electric parking brake: a118 VEH inter node resistance";
CM_ SG_ 1448 EPBR_a118_CH_lighting "Right electric parking brake: a118 CH lighting";
CM_ SG_ 1448 EPBR_a118_VEH_lightStatus "Right electric parking brake: a118 VEH light status";
CM_ SG_ 1448 EPBR_a118_PARTY_vehNm "Right electric parking brake: a118 PARTY veh nm";
CM_ SG_ 1448 EPBR_a118_CH_12VBatteryStatus "Right electric parking brake: a118 CH 12 v battery status";
CM_ SG_ 1448 EPBR_a118_CH_LVBMS_statusHigh "Right electric parking brake: a118 CH LVBMS status high";
CM_ SG_ 1448 EPBR_a118_CH_alertMatrix "Right electric parking brake: a118 CH alert matrix";
CM_ SG_ 1448 EPBR_a118_BDY_outputPowerStatus "Right electric parking brake: a118 BDY output power status";
CM_ SG_ 1448 EPBR_a118_BDY_vehicleTime "Right electric parking brake: a118 BDY vehicle time";
CM_ SG_ 1448 EPBR_a118_PARTY_AP_vehicleState1 "Right electric parking brake: a118 PARTY AP vehicle state1 hz muxed";
CM_ SG_ 1448 EPBR_a118_BDY_AP_vehicleState1Hz "Right electric parking brake: a118 BDY AP vehicle state1 hz muxed";
CM_ SG_ 1448 EPBR_a118_PARTY_VCFRONT_cameraCl "Right electric parking brake: a118 PARTY VCFRONT camera cleaning status";
CM_ SG_ 1448 EPBR_a119_VEH_steerAngle "Right electric parking brake: a119 VEH steer angle";
CM_ SG_ 1448 EPBR_a119_VEH_leftStalk "Right electric parking brake: a119 VEH left stalk";
CM_ SG_ 1448 EPBR_a119_VEH_rightStalk "Right electric parking brake: a119 VEH right stalk";
CM_ SG_ 1448 EPBR_a119_PARTY_rightStalk "Right electric parking brake: a119 PARTY right stalk";
CM_ SG_ 1448 EPBR_a119_CH_steerAngle "Right electric parking brake: a119 CH steer angle";
CM_ SG_ 1448 EPBR_a119_PARTY_steerAngle "Right electric parking brake: a119 PARTY steer angle";
CM_ SG_ 1448 EPBR_a120_PARTY_chassisCntl "Right electric parking brake: a120 PARTY chassis cntl";
CM_ SG_ 1448 EPBR_a120_VEH_systemStatus "Right electric parking brake: a120 VEH system status";
CM_ SG_ 1448 EPBR_a120_CH_chassisCntl "Right electric parking brake: a120 CH chassis cntl";
CM_ SG_ 1448 EPBR_a120_PARTY_systemStatus "Right electric parking brake: a120 PARTY system status";
CM_ SG_ 1448 EPBR_a120_PARTY_torque "Right electric parking brake: a120 PARTY torque";
CM_ SG_ 1448 EPBR_a120_VEH_torque "Right electric parking brake: a120 VEH torque";
CM_ SG_ 1448 EPBR_a120_PARTY_locStatus "Right electric parking brake: a120 PARTY loc status";
CM_ SG_ 1448 EPBR_a120_PARTY_speed "Right electric parking brake: a120 PARTY speed";
CM_ SG_ 1448 EPBR_a120_VEH_speed "Right electric parking brake: a120 VEH speed";
CM_ SG_ 1448 EPBR_a120_PARTY_status "Right electric parking brake: a120 PARTY status";
CM_ SG_ 1448 EPBR_a120_PT_speed "Right electric parking brake: a120 PT speed";
CM_ SG_ 1448 EPBR_a120_PT_systemStatus "Right electric parking brake: a120 PT system status";
CM_ SG_ 1448 EPBR_a120_PARTY_vehicleEstimates "Right electric parking brake: a120 PARTY vehicle estimates";
CM_ SG_ 1448 EPBR_a120_VEH_aggregatedAxleSpee "Right electric parking brake: a120 VEH aggregated axle speed";
CM_ SG_ 1448 EPBR_a120_PARTY_aggregatedAxleSp "Right electric parking brake: a120 PARTY aggregated axle speed";
CM_ SG_ 1448 EPBR_a120_VEH_systemPower "Right electric parking brake: a120 VEH system power";
CM_ SG_ 1448 EPBR_a120_PARTY_autonomyHealth "Right electric parking brake: a120 PARTY autonomy health";
CM_ SG_ 1448 EPBR_a120_VEH_autonomyHealth "Right electric parking brake: a120 VEH autonomy health";
CM_ SG_ 1448 EPBR_a120_PT_systemPower "Right electric parking brake: a120 PT system power";
CM_ SG_ 1448 EPBR_a120_PARTY_stalklessInterfa "Right electric parking brake: a120 PARTY stalkless interfaces";
CM_ SG_ 1448 EPBR_a120_CH_speed "Right electric parking brake: a120 CH speed";
CM_ SG_ 1448 EPBR_a120_VEH_estimatedBrakeTemp "Right electric parking brake: a120 VEH estimated brake temp";
CM_ SG_ 1448 EPBR_a120_PARTY_prndControl "Right electric parking brake: a120 PARTY prnd control";
CM_ SG_ 1448 EPBR_a120_PARTY_locStatus2 "Right electric parking brake: a120 PARTY loc status2";
CM_ SG_ 1448 EPBR_a120_VEH_chassisCntl "Right electric parking brake: a120 VEH chassis cntl";
CM_ SG_ 1448 EPBR_a120_CH_locStatus2 "Right electric parking brake: a120 CH loc status2";
CM_ SG_ 1448 EPBR_a120_VEH_locStatus "Right electric parking brake: a120 VEH loc status";
CM_ SG_ 1448 EPBR_a120_VEH_locStatus2 "Right electric parking brake: a120 VEH loc status2";
CM_ SG_ 1448 EPBR_a120_VEH_prndControl "Right electric parking brake: a120 VEH prnd control";
CM_ SG_ 1448 EPBR_a120_VEH_vehicleEstimates "Right electric parking brake: a120 VEH vehicle estimates";
CM_ SG_ 1448 EPBR_a120_PARTY_motorStatus "Right electric parking brake: a120 PARTY motor status";
CM_ SG_ 1448 EPBR_a120_VEH_motorStatus "Right electric parking brake: a120 VEH motor status";
CM_ SG_ 1448 EPBR_a120_BDY_speed "Right electric parking brake: a120 BDY speed";
CM_ SG_ 1448 EPBR_a122_filteredCurrentCal "Right electric parking brake: a122 filtered current cal";
CM_ SG_ 1448 EPBR_a123_filteredCurrentCal "Right electric parking brake: a123 filtered current cal";
CM_ SG_ 1448 EPBR_a124_calOutOfBoundsData "Right electric parking brake: a124 cal out of bounds data";
CM_ SG_ 1448 EPBR_a125_pvFilt "Right electric parking brake: a125 pv filt";
CM_ SG_ 1448 EPBR_a125_nvFilt "Right electric parking brake: a125 nv filt";
CM_ SG_ 1448 EPBR_a125_12vFilt "Right electric parking brake: a125 12v filt";
CM_ SG_ 1448 EPBR_a126_pvFilt "Right electric parking brake: a126 pv filt";
CM_ SG_ 1448 EPBR_a126_nvFilt "Right electric parking brake: a126 nv filt";
CM_ SG_ 1448 EPBR_a126_12vFilt "Right electric parking brake: a126 12v filt";
CM_ SG_ 1448 EPBR_a127_pvFilt "Right electric parking brake: a127 pv filt";
CM_ SG_ 1448 EPBR_a127_nvFilt "Right electric parking brake: a127 nv filt";
CM_ SG_ 1448 EPBR_a127_12vFilt "Right electric parking brake: a127 12v filt";
CM_ SG_ 1448 EPBR_a128_pvFilt "Right electric parking brake: a128 pv filt";
CM_ SG_ 1448 EPBR_a128_nvFilt "Right electric parking brake: a128 nv filt";
CM_ SG_ 1448 EPBR_a128_12vFilt "Right electric parking brake: a128 12v filt";
CM_ SG_ 1448 EPBR_a129_VEH_occupancy "Right electric parking brake: a129 VEH occupancy";
CM_ SG_ 1448 EPBR_a130_PARTY_status "Right electric parking brake: a130 PARTY status";
CM_ SG_ 1448 EPBR_a130_VEH_status "Right electric parking brake: a130 VEH status";
CM_ SG_ 1448 EPBR_a130_CH_status "Right electric parking brake: a130 CH status";
CM_ SG_ 1448 EPBR_a131_PARTY_actuation "Right electric parking brake: a131 PARTY actuation";
CM_ SG_ 1448 EPBR_a134_pvFilt "Right electric parking brake: a134 pv filt";
CM_ SG_ 1448 EPBR_a134_nvFilt "Right electric parking brake: a134 nv filt";
CM_ SG_ 1448 EPBR_a134_12vFilt "Right electric parking brake: a134 12v filt";
CM_ SG_ 1448 EPBR_a135_pvFilt "Right electric parking brake: a135 pv filt";
CM_ SG_ 1448 EPBR_a135_nvFilt "Right electric parking brake: a135 nv filt";
CM_ SG_ 1448 EPBR_a135_12vFilt "Right electric parking brake: a135 12v filt";
CM_ SG_ 1448 EPBR_a136_pvFilt "Right electric parking brake: a136 pv filt";
CM_ SG_ 1448 EPBR_a136_nvFilt "Right electric parking brake: a136 nv filt";
CM_ SG_ 1448 EPBR_a136_12vFilt "Right electric parking brake: a136 12v filt";
CM_ SG_ 1448 EPBR_a137_pvFilt "Right electric parking brake: a137 pv filt";
CM_ SG_ 1448 EPBR_a137_nvFilt "Right electric parking brake: a137 nv filt";
CM_ SG_ 1448 EPBR_a137_12vFilt "Right electric parking brake: a137 12v filt";
CM_ SG_ 1448 EPBR_a138_localState "Right electric parking brake: a138 local state";
CM_ SG_ 1448 EPBR_a138_monitorState "Right electric parking brake: a138 monitor state";
CM_ SG_ 1448 EPBR_a139_localState "Right electric parking brake: a139 local state";
CM_ SG_ 1448 EPBR_a139_monitorState "Right electric parking brake: a139 monitor state";
CM_ SG_ 1448 EPBR_a141_fromState "Right electric parking brake: a141 from state";
CM_ SG_ 1448 EPBR_a141_toState "Right electric parking brake: a141 to state";
CM_ SG_ 1448 EPBR_a170_pvFilt "Right electric parking brake: a170 pv filt";
CM_ SG_ 1448 EPBR_a170_nvFilt "Right electric parking brake: a170 nv filt";
CM_ SG_ 1448 EPBR_a170_12vFilt "Right electric parking brake: a170 12v filt";
CM_ SG_ 1448 EPBR_a171_pvFilt "Right electric parking brake: a171 pv filt";
CM_ SG_ 1448 EPBR_a171_nvFilt "Right electric parking brake: a171 nv filt";
CM_ SG_ 1448 EPBR_a171_12vFilt "Right electric parking brake: a171 12v filt";
CM_ SG_ 1448 EPBR_a174_esmState "Right electric parking brake: a174 esm state";
CM_ SG_ 1448 EPBR_a174_esmStateRequest "Right electric parking brake: a174 esm state request";
CM_ SG_ 1448 EPBR_a174_faultStatus "Right electric parking brake: a174 fault status";
CM_ SG_ 1448 EPBR_a174_monitorUnitStatus "Right electric parking brake: a174 monitor unit status";
CM_ SG_ 1448 EPBR_a174_monitorFaultStatus "Right electric parking brake: a174 monitor fault status";
CM_ SG_ 1448 EPBR_a174_csmFaultReason "Right electric parking brake: a174 csm fault reason";
CM_ SG_ 1448 EPBR_a174_esmOpTrigger "Right electric parking brake: a174 esm op trigger";
CM_ SG_ 1448 EPBR_a174_nonterminalReason "Right electric parking brake: a174 nonterminal reason";
CM_ SG_ 1448 EPBR_a175_esmState "Right electric parking brake: a175 esm state";
CM_ SG_ 1448 EPBR_a175_esmStateRequest "Right electric parking brake: a175 esm state request";
CM_ SG_ 1448 EPBR_a175_faultStatus "Right electric parking brake: a175 fault status";
CM_ SG_ 1448 EPBR_a175_monitorUnitStatus "Right electric parking brake: a175 monitor unit status";
CM_ SG_ 1448 EPBR_a175_monitorFaultStatus "Right electric parking brake: a175 monitor fault status";
CM_ SG_ 1448 EPBR_a175_csmFaultReason "Right electric parking brake: a175 csm fault reason";
CM_ SG_ 1448 EPBR_a175_esmOpTrigger "Right electric parking brake: a175 esm op trigger";
CM_ SG_ 1448 EPBR_a175_nonterminalReason "Right electric parking brake: a175 nonterminal reason";
CM_ SG_ 1448 EPBR_a176_esmState "Right electric parking brake: a176 esm state";
CM_ SG_ 1448 EPBR_a176_esmStateRequest "Right electric parking brake: a176 esm state request";
CM_ SG_ 1448 EPBR_a176_faultStatus "Right electric parking brake: a176 fault status";
CM_ SG_ 1448 EPBR_a176_monitorUnitStatus "Right electric parking brake: a176 monitor unit status";
CM_ SG_ 1448 EPBR_a176_monitorFaultStatus "Right electric parking brake: a176 monitor fault status";
CM_ SG_ 1448 EPBR_a176_csmFaultReason "Right electric parking brake: a176 csm fault reason";
CM_ SG_ 1448 EPBR_a176_esmOpTrigger "Right electric parking brake: a176 esm op trigger";
CM_ SG_ 1448 EPBR_a176_nonterminalReason "Right electric parking brake: a176 nonterminal reason";
CM_ SG_ 1448 EPBR_a177_esmState "Right electric parking brake: a177 esm state";
CM_ SG_ 1448 EPBR_a177_esmStateRequest "Right electric parking brake: a177 esm state request";
CM_ SG_ 1448 EPBR_a177_faultStatus "Right electric parking brake: a177 fault status";
CM_ SG_ 1448 EPBR_a177_monitorUnitStatus "Right electric parking brake: a177 monitor unit status";
CM_ SG_ 1448 EPBR_a177_monitorFaultStatus "Right electric parking brake: a177 monitor fault status";
CM_ SG_ 1448 EPBR_a177_csmFaultReason "Right electric parking brake: a177 csm fault reason";
CM_ SG_ 1448 EPBR_a177_esmOpTrigger "Right electric parking brake: a177 esm op trigger";
CM_ SG_ 1448 EPBR_a177_nonterminalReason "Right electric parking brake: a177 nonterminal reason";
CM_ SG_ 1448 EPBR_a178_localCaliperState "Right electric parking brake: a178 local caliper state";
CM_ SG_ 1448 EPBR_a178_monitorCaliperState "Right electric parking brake: a178 monitor caliper state";
CM_ SG_ 1448 EPBR_a179_esmState "Right electric parking brake: a179 esm state";
CM_ SG_ 1448 EPBR_a179_esmStateRequest "Right electric parking brake: a179 esm state request";
CM_ SG_ 1448 EPBR_a179_faultStatus "Right electric parking brake: a179 fault status";
CM_ SG_ 1448 EPBR_a179_monitorUnitStatus "Right electric parking brake: a179 monitor unit status";
CM_ SG_ 1448 EPBR_a179_monitorFaultStatus "Right electric parking brake: a179 monitor fault status";
CM_ SG_ 1448 EPBR_a179_csmFaultReason "Right electric parking brake: a179 csm fault reason";
CM_ SG_ 1448 EPBR_a179_esmOpTrigger "Right electric parking brake: a179 esm op trigger";
CM_ SG_ 1448 EPBR_a179_nonterminalReason "Right electric parking brake: a179 nonterminal reason";
CM_ SG_ 1448 EPBR_a180_esmOpTrigger "Right electric parking brake: a180 esm op trigger";
CM_ SG_ 1448 EPBR_a180_previousState "Right electric parking brake: a180 previous state";
CM_ SG_ 1448 EPBR_a180_nextState "Right electric parking brake: a180 next state";
CM_ SG_ 1448 EPBR_a180_panicModeLatched "Right electric parking brake: a180 panic mode latched";
CM_ SG_ 1448 EPBR_a180_activeDecelRequest "Right electric parking brake: a180 active decel request";
CM_ SG_ 1448 EPBR_a181_grade "Right electric parking brake: a181 grade";
CM_ SG_ 1448 EPBR_a181_vcTrailerDetected "Right electric parking brake: a181 vc trailer detected";
CM_ SG_ 1448 EPBR_a181_uiTrailerDetected "Right electric parking brake: a181 ui trailer detected";
CM_ SG_ 1448 EPBR_a181_trailerDetected "Right electric parking brake: a181 trailer detected";
CM_ SG_ 1448 EPBR_a182_epbSystemStatus "Right electric parking brake: a182 epb system status";
CM_ SG_ 1448 EPBR_a182_grade "Right electric parking brake: a182 grade";
CM_ SG_ 1448 EPBR_a182_temperature "Right electric parking brake: a182 temperature";
CM_ SG_ 1448 EPBR_a182_vcTrailerDetected "Right electric parking brake: a182 vc trailer detected";
CM_ SG_ 1448 EPBR_a182_uiTrailerDetected "Right electric parking brake: a182 ui trailer detected";
CM_ SG_ 1448 EPBR_a182_trailerDetected "Right electric parking brake: a182 trailer detected";
CM_ SG_ 1448 EPBR_a183_isRetransmit "Right electric parking brake: a183 is retransmit";
CM_ SG_ 1448 EPBR_a183_localCdpState "Right electric parking brake: a183 local cdp state";
CM_ SG_ 1448 EPBR_a183_remoteCdpState "Right electric parking brake: a183 remote cdp state";
CM_ SG_ 1448 EPBR_a183_espCdpStatus "Right electric parking brake: a183 esp cdp status";
CM_ SG_ 1448 EPBR_a183_esmState "Right electric parking brake: a183 esm state";
CM_ SG_ 1448 EPBR_a183_esmStateRequest "Right electric parking brake: a183 esm state request";
CM_ SG_ 1448 EPBR_a183_esmOperationTrigger "Right electric parking brake: a183 esm operation trigger";
CM_ SG_ 1448 EPBR_a183_cdpNotStopping "Right electric parking brake: a183 cdp not stopping";
CM_ SG_ 1448 EPBR_a183_cdpNotStarting "Right electric parking brake: a183 cdp not starting";
CM_ SG_ 1448 EPBR_a183_remoteEpbDynamic "Right electric parking brake: a183 remote epb dynamic";
CM_ SG_ 1448 EPBR_a183_localEpbDynamic "Right electric parking brake: a183 local epb dynamic";
CM_ SG_ 1448 EPBR_a183_epbmInvalidated "Right electric parking brake: a183 epbm invalidated";
CM_ SG_ 1448 EPBR_a183_espConfirmedInvalid "Right electric parking brake: a183 esp confirmed invalid";
CM_ SG_ 1448 EPBR_a183_brakeFluidConfirmedLow "Right electric parking brake: a183 brake fluid confirmed low";
CM_ SG_ 1448 EPBR_a183_lastRemoteEpbDynamic "Right electric parking brake: a183 last remote epb dynamic";
CM_ SG_ 1448 EPBR_a183_lastLocalEpbDynamic "Right electric parking brake: a183 last local epb dynamic";
CM_ SG_ 1448 EPBR_a183_cdpCannotBeCommanded "Right electric parking brake: a183 cdp cannot be commanded";
CM_ SG_ 1448 EPBR_a183_remoteEpbStatusUnsure "Right electric parking brake: a183 remote epb status unsure";
CM_ SG_ 1448 EPBR_a183_lastLowBrakeFluid "Right electric parking brake: a183 last low brake fluid";
CM_ SG_ 1448 EPBR_a183_espInvalidOrUnsure "Right electric parking brake: a183 esp invalid or unsure";
CM_ SG_ 1448 EPBR_a183_lastFactoryMode "Right electric parking brake: a183 last factory mode";
CM_ SG_ 1448 EPBR_a183_redundantBrakingEnable "Right electric parking brake: a183 redundant braking enabled";
CM_ SG_ 1448 EPBR_a184_esmOpTrigger "Right electric parking brake: a184 esm op trigger";
CM_ SG_ 1448 EPBR_a184_previousState "Right electric parking brake: a184 previous state";
CM_ SG_ 1448 EPBR_a184_nextState "Right electric parking brake: a184 next state";
CM_ SG_ 1448 EPBR_a184_panicModeLatched "Right electric parking brake: a184 panic mode latched";
CM_ SG_ 1448 EPBR_a184_activeDecelRequest "Right electric parking brake: a184 active decel request";
CM_ SG_ 1448 EPBR_a187_esmOpTrigger "Right electric parking brake: a187 esm op trigger";
CM_ SG_ 1448 EPBR_a187_previousState "Right electric parking brake: a187 previous state";
CM_ SG_ 1448 EPBR_a187_nextState "Right electric parking brake: a187 next state";
CM_ SG_ 1448 EPBR_a187_panicModeLatched "Right electric parking brake: a187 panic mode latched";
CM_ SG_ 1448 EPBR_a187_activeDecelRequest "Right electric parking brake: a187 active decel request";
CM_ SG_ 1448 EPBR_a188_esmOpTrigger "Right electric parking brake: a188 esm op trigger";
CM_ SG_ 1448 EPBR_a188_previousState "Right electric parking brake: a188 previous state";
CM_ SG_ 1448 EPBR_a188_nextState "Right electric parking brake: a188 next state";
CM_ SG_ 1448 EPBR_a188_panicModeLatched "Right electric parking brake: a188 panic mode latched";
CM_ SG_ 1448 EPBR_a188_activeDecelRequest "Right electric parking brake: a188 active decel request";
CM_ SG_ 1448 EPBR_a189_esmOpTrigger "Right electric parking brake: a189 esm op trigger";
CM_ SG_ 1448 EPBR_a189_previousState "Right electric parking brake: a189 previous state";
CM_ SG_ 1448 EPBR_a189_nextState "Right electric parking brake: a189 next state";
CM_ SG_ 1448 EPBR_a189_panicModeLatched "Right electric parking brake: a189 panic mode latched";
CM_ SG_ 1448 EPBR_a189_activeDecelRequest "Right electric parking brake: a189 active decel request";
CM_ SG_ 1448 EPBR_a190_esmState "Right electric parking brake: a190 esm state";
CM_ SG_ 1448 EPBR_a190_esmStateRequest "Right electric parking brake: a190 esm state request";
CM_ SG_ 1448 EPBR_a190_faultStatus "Right electric parking brake: a190 fault status";
CM_ SG_ 1448 EPBR_a190_monitorUnitStatus "Right electric parking brake: a190 monitor unit status";
CM_ SG_ 1448 EPBR_a190_monitorFaultStatus "Right electric parking brake: a190 monitor fault status";
CM_ SG_ 1448 EPBR_a190_csmFaultReason "Right electric parking brake: a190 csm fault reason";
CM_ SG_ 1448 EPBR_a190_esmOpTrigger "Right electric parking brake: a190 esm op trigger";
CM_ SG_ 1448 EPBR_a190_nonterminalReason "Right electric parking brake: a190 nonterminal reason";
CM_ SG_ 1448 EPBR_a191_esmState "Right electric parking brake: a191 esm state";
CM_ SG_ 1448 EPBR_a191_esmStateRequest "Right electric parking brake: a191 esm state request";
CM_ SG_ 1448 EPBR_a191_faultStatus "Right electric parking brake: a191 fault status";
CM_ SG_ 1448 EPBR_a191_monitorUnitStatus "Right electric parking brake: a191 monitor unit status";
CM_ SG_ 1448 EPBR_a191_monitorFaultStatus "Right electric parking brake: a191 monitor fault status";
CM_ SG_ 1448 EPBR_a191_csmFaultReason "Right electric parking brake: a191 csm fault reason";
CM_ SG_ 1448 EPBR_a191_esmOpTrigger "Right electric parking brake: a191 esm op trigger";
CM_ SG_ 1448 EPBR_a191_nonterminalReason "Right electric parking brake: a191 nonterminal reason";
CM_ SG_ 1448 EPBR_a202_localEpbConfig "Right electric parking brake: a202 local epb config";
CM_ SG_ 1448 EPBR_a202_remoteEpbConfig "Right electric parking brake: a202 remote epb config";
CM_ SG_ 1448 EPBR_a203_gtwConfig "Right electric parking brake: a203 gtw config";
CM_ SG_ 1448 EPBR_a203_epbConfig "Right electric parking brake: a203 epb config";
CM_ SG_ 1448 EPBR_a225_esmOpTrigger "Right electric parking brake: a225 esm op trigger";
CM_ SG_ 1448 EPBR_a225_previousState "Right electric parking brake: a225 previous state";
CM_ SG_ 1448 EPBR_a225_nextState "Right electric parking brake: a225 next state";
CM_ SG_ 1448 EPBR_a225_panicModeLatched "Right electric parking brake: a225 panic mode latched";
CM_ SG_ 1448 EPBR_a225_activeDecelRequest "Right electric parking brake: a225 active decel request";
CM_ SG_ 1448 EPBR_a241_desiredState "Right electric parking brake: a241 desired state";
CM_ SG_ 1448 EPBR_a241_currentState "Right electric parking brake: a241 current state";
CM_ SG_ 1448 EPBR_a241_diKeepAlive "Right electric parking brake: a241 di keep alive";
CM_ SG_ 1448 EPBR_a241_epbSysStatus "Right electric parking brake: a241 epb sys status";
CM_ SG_ 1448 EPBR_a241_vehiclePowerState "Right electric parking brake: a241 vehicle power state";
CM_ SG_ 1448 EPBR_a241_highCurrent "Right electric parking brake: a241 high current";
CM_ SG_ 1448 EPBR_a241_monitorDataGood "Right electric parking brake: a241 monitor data good";
CM_ SG_ 1448 EPBR_a241_hasLockoutRequest "Right electric parking brake: a241 has lockout request";
CM_ SG_ 1448 EPBR_a242_hvcDesiredState "Right electric parking brake: a242 hvc desired state";
CM_ SG_ 1448 EPBR_a242_hvcCurrentState "Right electric parking brake: a242 hvc current state";
CM_ SG_ 1448 EPBR_a242_contDesiredState "Right electric parking brake: a242 cont desired state";
CM_ SG_ 1448 EPBR_a242_contCurrentState "Right electric parking brake: a242 cont current state";
CM_ SG_ 1448 EPBR_a242_hvState "Right electric parking brake: a242 hv state";
CM_ SG_ 1448 EPBR_a242_vehiclePowerState "Right electric parking brake: a242 vehicle power state";
CM_ SG_ 1448 EPBR_a242_highCurrent "Right electric parking brake: a242 high current";
CM_ SG_ 1448 EPBR_a242_monitorDataGood "Right electric parking brake: a242 monitor data good";
CM_ SG_ 1448 EPBR_a242_hasLockoutRequest "Right electric parking brake: a242 has lockout request";
CM_ SG_ 1448 EPBR_a243_brakeMasterCylPress "Right electric parking brake: a243 brake master cyl press";
CM_ SG_ 1448 EPBR_a243_brakeMasterCylPressQF "Right electric parking brake: a243 brake master cyl press QF";
CM_ SG_ 1448 EPBR_a243_drivetrainType "Right electric parking brake: a243 drivetrain type";
CM_ SG_ 1448 EPBR_a243_DIR1torqueActual "Right electric parking brake: a243 dir1torque actual";
CM_ SG_ 1448 EPBR_a243_DIR2torqueActual "Right electric parking brake: a243 dir2torque actual";
CM_ SG_ 1448 EPBR_a243_DIFtorqueActual "Right electric parking brake: a243 DI ftorque actual";
CM_ SG_ 1448 EPBR_a243_vehicleSpeed "Right electric parking brake: a243 vehicle speed";
CM_ SG_ 1448 EPBR_a243_tempAmbient "Right electric parking brake: a243 temp ambient";
CM_ SG_ 1448 EPBR_a243_thermistorTMin "Right electric parking brake: a243 thermistor t min";
CM_ SG_ 1448 EPBR_a243_wiperSpeed "Right electric parking brake: a243 wiper speed";
CM_ SG_ 1448 EPBR_a243_vehiclePowerState "Right electric parking brake: a243 vehicle power state";
CM_ SG_ 1448 EPBR_a243_brakeDiscWipingActive "Right electric parking brake: a243 brake disc wiping active";
CM_ SG_ 1448 EPBR_a244_permissiveMode "Right electric parking brake: a244 permissive mode";
CM_ SG_ 1448 EPBR_a246_previousState "Right electric parking brake: a246 previous state";
CM_ SG_ 1448 EPBR_a246_nextState "Right electric parking brake: a246 next state";
CM_ SG_ 1448 EPBR_a246_esmStateRequest "Right electric parking brake: a246 esm state request";
CM_ SG_ 1448 EPBR_a246_faultStatus "Right electric parking brake: a246 fault status";
CM_ SG_ 1448 EPBR_a246_esmOpTrigger "Right electric parking brake: a246 esm op trigger";
CM_ SG_ 1448 EPBR_a247_esmState "Right electric parking brake: a247 esm state";
CM_ SG_ 1448 EPBR_a247_esmStateRequest "Right electric parking brake: a247 esm state request";
CM_ SG_ 1448 EPBR_a247_faultStatus "Right electric parking brake: a247 fault status";
CM_ SG_ 1448 EPBR_a247_monitorUnitStatus "Right electric parking brake: a247 monitor unit status";
CM_ SG_ 1448 EPBR_a247_monitorFaultStatus "Right electric parking brake: a247 monitor fault status";
CM_ SG_ 1448 EPBR_a247_csmFaultReason "Right electric parking brake: a247 csm fault reason";
CM_ SG_ 1448 EPBR_a247_esmOpTrigger "Right electric parking brake: a247 esm op trigger";
CM_ SG_ 1448 EPBR_a247_nonterminalReason "Right electric parking brake: a247 nonterminal reason";
CM_ SG_ 1448 EPBR_a248_esmState "Right electric parking brake: a248 esm state";
CM_ SG_ 1448 EPBR_a248_esmStateRequest "Right electric parking brake: a248 esm state request";
CM_ SG_ 1448 EPBR_a248_faultStatus "Right electric parking brake: a248 fault status";
CM_ SG_ 1448 EPBR_a248_monitorUnitStatus "Right electric parking brake: a248 monitor unit status";
CM_ SG_ 1448 EPBR_a248_monitorFaultStatus "Right electric parking brake: a248 monitor fault status";
CM_ SG_ 1448 EPBR_a248_csmFaultReason "Right electric parking brake: a248 csm fault reason";
CM_ SG_ 1448 EPBR_a248_esmOpTrigger "Right electric parking brake: a248 esm op trigger";
CM_ SG_ 1448 EPBR_a248_nonterminalReason "Right electric parking brake: a248 nonterminal reason";
CM_ SG_ 1448 EPBR_a249_previousState "Right electric parking brake: a249 previous state";
CM_ SG_ 1448 EPBR_a249_nextState "Right electric parking brake: a249 next state";
CM_ SG_ 1448 EPBR_a249_esmStateRequest "Right electric parking brake: a249 esm state request";
CM_ SG_ 1448 EPBR_a249_faultStatus "Right electric parking brake: a249 fault status";
CM_ SG_ 1448 EPBR_a249_esmOpTrigger "Right electric parking brake: a249 esm op trigger";
CM_ SG_ 1448 EPBR_a250_esmSpeedClass "Right electric parking brake: a250 esm speed class";
CM_ SG_ 1448 EPBR_a250_esmOperationTrigger "Right electric parking brake: a250 esm operation trigger";
CM_ SG_ 1448 EPBR_a250_isJumpPostTripped "Right electric parking brake: a250 is jump post tripped";
CM_ SG_ 1448 EPBR_a251_currentVariance "Right electric parking brake: a251 current variance";
CM_ SG_ 1448 EPBR_a251_pistonPosition "Right electric parking brake: a251 piston position";
CM_ SG_ 1448 EPBR_a251_temperature "Right electric parking brake: a251 temperature";
CM_ SG_ 1448 EPBR_a272_expectedState "Right electric parking brake: a272 expected state";
CM_ SG_ 1448 EPBR_a272_actualState "Right electric parking brake: a272 actual state";
CM_ SG_ 1448 EPBR_a300_harnessId "Right electric parking brake: a300 harness id";
CM_ SG_ 1448 EPBR_a300_subUsageId "Right electric parking brake: a300 sub usage id";
CM_ SG_ 1448 EPBR_a301_setSpeed "Right electric parking brake: a301 set speed";
CM_ SG_ 1448 EPBR_a301_oocConfidence "Right electric parking brake: a301 ooc confidence";
CM_ SG_ 1448 EPBR_a301_oocDistanceFiltered "Right electric parking brake: a301 ooc distance filtered";
CM_ SG_ 1448 EPBR_a302_pistonPosition "Right electric parking brake: a302 piston position";
CM_ SG_ 1448 EPBR_a302_deltaCurrent "Right electric parking brake: a302 delta current";
CM_ SG_ 1448 EPBR_a303_currentVariance "Right electric parking brake: a303 current variance";
CM_ SG_ 1448 EPBR_a303_pistonPosition "Right electric parking brake: a303 piston position";
CM_ SG_ 1448 EPBR_a303_temperature "Right electric parking brake: a303 temperature";
CM_ SG_ 1448 EPBR_a350_ensPeriod "Right electric parking brake: a350 ens period";
CM_ SG_ 1448 EPBR_a350_ensDuty "Right electric parking brake: a350 ens duty";
CM_ SG_ 1448 EPBR_a350_ensTimedOut "Right electric parking brake: a350 ens timed out";
CM_ SG_ 1448 EPBR_a355_brakeHwConfig "Right electric parking brake: a355 brake hw config";
CM_ SG_ 1448 EPBR_a355_epbHwConfig "Right electric parking brake: a355 epb hw config";
CM_ SG_ 1448 EPBR_a357_epbSystemStatus "Right electric parking brake: a357 epb system status";
CM_ SG_ 1448 EPBR_a357_grade "Right electric parking brake: a357 grade";
CM_ SG_ 1448 EPBR_a357_ambientTemp "Right electric parking brake: a357 ambient temp";
CM_ SG_ 1448 EPBR_a357_brakeTemp "Right electric parking brake: a357 brake temp";
CM_ SG_ 1448 EPBR_a357_vcTrailerDetected "Right electric parking brake: a357 vc trailer detected";
CM_ SG_ 1448 EPBR_a357_uiTrailerDetected "Right electric parking brake: a357 ui trailer detected";
CM_ SG_ 1448 EPBR_a357_trailerDetected "Right electric parking brake: a357 trailer detected";
CM_ SG_ 1448 EPBR_a358_epbSystemStatus "Right electric parking brake: a358 epb system status";
CM_ SG_ 1448 EPBR_a358_grade "Right electric parking brake: a358 grade";
CM_ SG_ 1448 EPBR_a358_ambientTemp "Right electric parking brake: a358 ambient temp";
CM_ SG_ 1448 EPBR_a358_brakeTemp "Right electric parking brake: a358 brake temp";
CM_ SG_ 1448 EPBR_a358_vcTrailerDetected "Right electric parking brake: a358 vc trailer detected";
CM_ SG_ 1448 EPBR_a358_uiTrailerDetected "Right electric parking brake: a358 ui trailer detected";
CM_ SG_ 1448 EPBR_a358_trailerDetected "Right electric parking brake: a358 trailer detected";
CM_ SG_ 1448 EPBR_a359_outputCurrent "Right electric parking brake: a359 output current";
CM_ SG_ 1448 EPBR_a365_epbSystemStatus "Right electric parking brake: a365 epb system status";
CM_ SG_ 1448 EPBR_a365_grade "Right electric parking brake: a365 grade";
CM_ SG_ 1448 EPBR_a365_ambientTemp "Right electric parking brake: a365 ambient temp";
CM_ SG_ 1448 EPBR_a365_vcTrailerDetected "Right electric parking brake: a365 vc trailer detected";
CM_ SG_ 1448 EPBR_a365_uiTrailerDetected "Right electric parking brake: a365 ui trailer detected";
CM_ SG_ 1448 EPBR_a365_trailerDetected "Right electric parking brake: a365 trailer detected";
CM_ SG_ 1448 EPBR_a366_epbSystemStatus "Right electric parking brake: a366 epb system status";
CM_ SG_ 1448 EPBR_a366_grade "Right electric parking brake: a366 grade";
CM_ SG_ 1448 EPBR_a366_ambientTemp "Right electric parking brake: a366 ambient temp";
CM_ SG_ 1448 EPBR_a366_vcTrailerDetected "Right electric parking brake: a366 vc trailer detected";
CM_ SG_ 1448 EPBR_a366_uiTrailerDetected "Right electric parking brake: a366 ui trailer detected";
CM_ SG_ 1448 EPBR_a366_trailerDetected "Right electric parking brake: a366 trailer detected";
BA_DEF_ BO_ "GenMsgCycleTime" INT 0 3600000;
BA_DEF_ BO_ "GenMsgSendType" ENUM "Cyclic","NotUsed","NotUsed","NotUsed","NotUsed","NotUsed","NotUsed","IfActive","NoMsgSendType","NotUsed";
BA_DEF_ BO_ "VFrameFormat" ENUM "StandardCAN","ExtendedCAN","reserved","J1939PG","reserved","reserved","reserved","reserved","reserved","reserved","reserved","reserved","reserved","reserved","StandardCAN_FD","ExtendedCAN_FD";
BA_DEF_ BO_ "CANFD_BRS" ENUM "0","1";
BA_DEF_ SG_ "GenSigSNA" STRING;
BA_DEF_ SG_ "SystemSignalLongSymbol" STRING;
BA_DEF_ SG_ "Confidence" ENUM "validated","plausible","layout-only","contradicted";
BA_DEF_DEF_ "GenMsgCycleTime" 0;
BA_DEF_DEF_ "GenMsgSendType" "NoMsgSendType";
BA_DEF_DEF_ "VFrameFormat" "StandardCAN";
BA_DEF_DEF_ "CANFD_BRS" "1";
BA_DEF_DEF_ "GenSigSNA" "";
BA_DEF_DEF_ "SystemSignalLongSymbol" "";
BA_DEF_DEF_ "Confidence" "layout-only";
BA_ "Confidence" SG_ 1448 EPBR_alertID 1;
BA_ "Confidence" SG_ 1448 EPBR_alertState 1;
BA_ "Confidence" SG_ 1448 EPBR_a059_voltageDrop 1;
BA_ "Confidence" SG_ 1448 EPBR_a059_resistanceEstimate 1;
BA_ "Confidence" SG_ 1448 EPBR_a059_current 1;
BA_ "Confidence" SG_ 1448 EPBR_a063_ADCVoltage 1;
BA_ "SystemSignalLongSymbol" SG_ 1448 EPBR_a101_LIPC_externalWatchdogH "EPBR_a101_LIPC_externalWatchdogHeartBeat";
BA_ "SystemSignalLongSymbol" SG_ 1448 EPBR_a115_UI_corianderVehicleCon "EPBR_a115_UI_corianderVehicleControl";
BA_ "SystemSignalLongSymbol" SG_ 1448 EPBR_a117_VEH_intrusionSensorSta "EPBR_a117_VEH_intrusionSensorStatus";
BA_ "SystemSignalLongSymbol" SG_ 1448 EPBR_a117_PARTY_lightingSecondar "EPBR_a117_PARTY_lightingSecondary";
BA_ "SystemSignalLongSymbol" SG_ 1448 EPBR_a118_PARTY_outputPowerStatu "EPBR_a118_PARTY_outputPowerStatus";
BA_ "SystemSignalLongSymbol" SG_ 1448 EPBR_a118_VEH_interNodeResistanc "EPBR_a118_VEH_interNodeResistance";
BA_ "SystemSignalLongSymbol" SG_ 1448 EPBR_a118_PARTY_AP_vehicleState1 "EPBR_a118_PARTY_AP_vehicleState1HzMuxed";
BA_ "SystemSignalLongSymbol" SG_ 1448 EPBR_a118_BDY_AP_vehicleState1Hz "EPBR_a118_BDY_AP_vehicleState1HzMuxed";
BA_ "SystemSignalLongSymbol" SG_ 1448 EPBR_a118_PARTY_VCFRONT_cameraCl "EPBR_a118_PARTY_VCFRONT_cameraCleaningStatus";
BA_ "SystemSignalLongSymbol" SG_ 1448 EPBR_a120_VEH_aggregatedAxleSpee "EPBR_a120_VEH_aggregatedAxleSpeed";
BA_ "SystemSignalLongSymbol" SG_ 1448 EPBR_a120_PARTY_aggregatedAxleSp "EPBR_a120_PARTY_aggregatedAxleSpeed";
BA_ "SystemSignalLongSymbol" SG_ 1448 EPBR_a120_PARTY_stalklessInterfa "EPBR_a120_PARTY_stalklessInterfaces";
BA_ "Confidence" SG_ 1448 EPBR_a122_filteredCurrentCal 1;
BA_ "Confidence" SG_ 1448 EPBR_a123_filteredCurrentCal 1;
BA_ "Confidence" SG_ 1448 EPBR_a125_pvFilt 1;
BA_ "Confidence" SG_ 1448 EPBR_a125_nvFilt 1;
BA_ "Confidence" SG_ 1448 EPBR_a125_12vFilt 1;
BA_ "Confidence" SG_ 1448 EPBR_a126_pvFilt 1;
BA_ "Confidence" SG_ 1448 EPBR_a126_nvFilt 1;
BA_ "Confidence" SG_ 1448 EPBR_a126_12vFilt 1;
BA_ "Confidence" SG_ 1448 EPBR_a127_pvFilt 1;
BA_ "Confidence" SG_ 1448 EPBR_a127_nvFilt 1;
BA_ "Confidence" SG_ 1448 EPBR_a127_12vFilt 1;
BA_ "Confidence" SG_ 1448 EPBR_a128_pvFilt 1;
BA_ "Confidence" SG_ 1448 EPBR_a128_nvFilt 1;
BA_ "Confidence" SG_ 1448 EPBR_a128_12vFilt 1;
BA_ "Confidence" SG_ 1448 EPBR_a134_pvFilt 1;
BA_ "Confidence" SG_ 1448 EPBR_a134_nvFilt 1;
BA_ "Confidence" SG_ 1448 EPBR_a134_12vFilt 1;
BA_ "Confidence" SG_ 1448 EPBR_a135_pvFilt 1;
BA_ "Confidence" SG_ 1448 EPBR_a135_nvFilt 1;
BA_ "Confidence" SG_ 1448 EPBR_a135_12vFilt 1;
BA_ "Confidence" SG_ 1448 EPBR_a136_pvFilt 1;
BA_ "Confidence" SG_ 1448 EPBR_a136_nvFilt 1;
BA_ "Confidence" SG_ 1448 EPBR_a136_12vFilt 1;
BA_ "Confidence" SG_ 1448 EPBR_a137_pvFilt 1;
BA_ "Confidence" SG_ 1448 EPBR_a137_nvFilt 1;
BA_ "Confidence" SG_ 1448 EPBR_a137_12vFilt 1;
BA_ "Confidence" SG_ 1448 EPBR_a138_localState 1;
BA_ "Confidence" SG_ 1448 EPBR_a138_monitorState 1;
BA_ "Confidence" SG_ 1448 EPBR_a139_localState 1;
BA_ "Confidence" SG_ 1448 EPBR_a139_monitorState 1;
BA_ "Confidence" SG_ 1448 EPBR_a141_fromState 1;
BA_ "Confidence" SG_ 1448 EPBR_a141_toState 1;
BA_ "Confidence" SG_ 1448 EPBR_a170_pvFilt 1;
BA_ "Confidence" SG_ 1448 EPBR_a170_nvFilt 1;
BA_ "Confidence" SG_ 1448 EPBR_a170_12vFilt 1;
BA_ "Confidence" SG_ 1448 EPBR_a171_pvFilt 1;
BA_ "Confidence" SG_ 1448 EPBR_a171_nvFilt 1;
BA_ "Confidence" SG_ 1448 EPBR_a171_12vFilt 1;
BA_ "Confidence" SG_ 1448 EPBR_a174_esmState 1;
BA_ "Confidence" SG_ 1448 EPBR_a174_esmStateRequest 1;
BA_ "Confidence" SG_ 1448 EPBR_a174_faultStatus 1;
BA_ "Confidence" SG_ 1448 EPBR_a174_monitorUnitStatus 1;
BA_ "Confidence" SG_ 1448 EPBR_a174_monitorFaultStatus 1;
BA_ "Confidence" SG_ 1448 EPBR_a174_csmFaultReason 1;
BA_ "Confidence" SG_ 1448 EPBR_a174_esmOpTrigger 1;
BA_ "Confidence" SG_ 1448 EPBR_a174_nonterminalReason 1;
BA_ "Confidence" SG_ 1448 EPBR_a175_esmState 1;
BA_ "Confidence" SG_ 1448 EPBR_a175_esmStateRequest 1;
BA_ "Confidence" SG_ 1448 EPBR_a175_faultStatus 1;
BA_ "Confidence" SG_ 1448 EPBR_a175_monitorUnitStatus 1;
BA_ "Confidence" SG_ 1448 EPBR_a175_monitorFaultStatus 1;
BA_ "Confidence" SG_ 1448 EPBR_a175_csmFaultReason 1;
BA_ "Confidence" SG_ 1448 EPBR_a175_esmOpTrigger 1;
BA_ "Confidence" SG_ 1448 EPBR_a175_nonterminalReason 1;
BA_ "Confidence" SG_ 1448 EPBR_a176_esmState 1;
BA_ "Confidence" SG_ 1448 EPBR_a176_esmStateRequest 1;
BA_ "Confidence" SG_ 1448 EPBR_a176_faultStatus 1;
BA_ "Confidence" SG_ 1448 EPBR_a176_monitorUnitStatus 1;
BA_ "Confidence" SG_ 1448 EPBR_a176_monitorFaultStatus 1;
BA_ "Confidence" SG_ 1448 EPBR_a176_csmFaultReason 1;
BA_ "Confidence" SG_ 1448 EPBR_a176_esmOpTrigger 1;
BA_ "Confidence" SG_ 1448 EPBR_a176_nonterminalReason 1;
BA_ "Confidence" SG_ 1448 EPBR_a177_esmState 1;
BA_ "Confidence" SG_ 1448 EPBR_a177_esmStateRequest 1;
BA_ "Confidence" SG_ 1448 EPBR_a177_faultStatus 1;
BA_ "Confidence" SG_ 1448 EPBR_a177_monitorUnitStatus 1;
BA_ "Confidence" SG_ 1448 EPBR_a177_monitorFaultStatus 1;
BA_ "Confidence" SG_ 1448 EPBR_a177_csmFaultReason 1;
BA_ "Confidence" SG_ 1448 EPBR_a177_esmOpTrigger 1;
BA_ "Confidence" SG_ 1448 EPBR_a177_nonterminalReason 1;
BA_ "Confidence" SG_ 1448 EPBR_a178_localCaliperState 1;
BA_ "Confidence" SG_ 1448 EPBR_a178_monitorCaliperState 1;
BA_ "Confidence" SG_ 1448 EPBR_a179_esmState 1;
BA_ "Confidence" SG_ 1448 EPBR_a179_esmStateRequest 1;
BA_ "Confidence" SG_ 1448 EPBR_a179_faultStatus 1;
BA_ "Confidence" SG_ 1448 EPBR_a179_monitorUnitStatus 1;
BA_ "Confidence" SG_ 1448 EPBR_a179_monitorFaultStatus 1;
BA_ "Confidence" SG_ 1448 EPBR_a179_csmFaultReason 1;
BA_ "Confidence" SG_ 1448 EPBR_a179_esmOpTrigger 1;
BA_ "Confidence" SG_ 1448 EPBR_a179_nonterminalReason 1;
BA_ "Confidence" SG_ 1448 EPBR_a180_esmOpTrigger 1;
BA_ "Confidence" SG_ 1448 EPBR_a180_previousState 1;
BA_ "Confidence" SG_ 1448 EPBR_a180_nextState 1;
BA_ "Confidence" SG_ 1448 EPBR_a181_grade 1;
BA_ "Confidence" SG_ 1448 EPBR_a182_epbSystemStatus 1;
BA_ "Confidence" SG_ 1448 EPBR_a182_grade 1;
BA_ "Confidence" SG_ 1448 EPBR_a182_temperature 1;
BA_ "Confidence" SG_ 1448 EPBR_a183_localCdpState 1;
BA_ "Confidence" SG_ 1448 EPBR_a183_remoteCdpState 1;
BA_ "Confidence" SG_ 1448 EPBR_a183_espCdpStatus 1;
BA_ "Confidence" SG_ 1448 EPBR_a183_esmState 1;
BA_ "Confidence" SG_ 1448 EPBR_a183_esmStateRequest 1;
BA_ "Confidence" SG_ 1448 EPBR_a183_esmOperationTrigger 1;
BA_ "SystemSignalLongSymbol" SG_ 1448 EPBR_a183_redundantBrakingEnable "EPBR_a183_redundantBrakingEnabled";
BA_ "Confidence" SG_ 1448 EPBR_a184_esmOpTrigger 1;
BA_ "Confidence" SG_ 1448 EPBR_a184_previousState 1;
BA_ "Confidence" SG_ 1448 EPBR_a184_nextState 1;
BA_ "Confidence" SG_ 1448 EPBR_a187_esmOpTrigger 1;
BA_ "Confidence" SG_ 1448 EPBR_a187_previousState 1;
BA_ "Confidence" SG_ 1448 EPBR_a187_nextState 1;
BA_ "Confidence" SG_ 1448 EPBR_a188_esmOpTrigger 1;
BA_ "Confidence" SG_ 1448 EPBR_a188_previousState 1;
BA_ "Confidence" SG_ 1448 EPBR_a188_nextState 1;
BA_ "Confidence" SG_ 1448 EPBR_a189_esmOpTrigger 1;
BA_ "Confidence" SG_ 1448 EPBR_a189_previousState 1;
BA_ "Confidence" SG_ 1448 EPBR_a189_nextState 1;
BA_ "Confidence" SG_ 1448 EPBR_a190_esmState 1;
BA_ "Confidence" SG_ 1448 EPBR_a190_esmStateRequest 1;
BA_ "Confidence" SG_ 1448 EPBR_a190_faultStatus 1;
BA_ "Confidence" SG_ 1448 EPBR_a190_monitorUnitStatus 1;
BA_ "Confidence" SG_ 1448 EPBR_a190_monitorFaultStatus 1;
BA_ "Confidence" SG_ 1448 EPBR_a190_csmFaultReason 1;
BA_ "Confidence" SG_ 1448 EPBR_a190_esmOpTrigger 1;
BA_ "Confidence" SG_ 1448 EPBR_a190_nonterminalReason 1;
BA_ "Confidence" SG_ 1448 EPBR_a191_esmState 1;
BA_ "Confidence" SG_ 1448 EPBR_a191_esmStateRequest 1;
BA_ "Confidence" SG_ 1448 EPBR_a191_faultStatus 1;
BA_ "Confidence" SG_ 1448 EPBR_a191_monitorUnitStatus 1;
BA_ "Confidence" SG_ 1448 EPBR_a191_monitorFaultStatus 1;
BA_ "Confidence" SG_ 1448 EPBR_a191_csmFaultReason 1;
BA_ "Confidence" SG_ 1448 EPBR_a191_esmOpTrigger 1;
BA_ "Confidence" SG_ 1448 EPBR_a191_nonterminalReason 1;
BA_ "Confidence" SG_ 1448 EPBR_a202_localEpbConfig 1;
BA_ "Confidence" SG_ 1448 EPBR_a202_remoteEpbConfig 1;
BA_ "Confidence" SG_ 1448 EPBR_a203_gtwConfig 1;
BA_ "Confidence" SG_ 1448 EPBR_a203_epbConfig 1;
BA_ "Confidence" SG_ 1448 EPBR_a225_esmOpTrigger 1;
BA_ "Confidence" SG_ 1448 EPBR_a225_previousState 1;
BA_ "Confidence" SG_ 1448 EPBR_a225_nextState 1;
BA_ "Confidence" SG_ 1448 EPBR_a241_epbSysStatus 1;
BA_ "Confidence" SG_ 1448 EPBR_a241_vehiclePowerState 1;
BA_ "Confidence" SG_ 1448 EPBR_a242_hvState 1;
BA_ "Confidence" SG_ 1448 EPBR_a242_vehiclePowerState 1;
BA_ "Confidence" SG_ 1448 EPBR_a246_previousState 1;
BA_ "Confidence" SG_ 1448 EPBR_a246_nextState 1;
BA_ "Confidence" SG_ 1448 EPBR_a246_esmStateRequest 1;
BA_ "Confidence" SG_ 1448 EPBR_a246_faultStatus 1;
BA_ "Confidence" SG_ 1448 EPBR_a246_esmOpTrigger 1;
BA_ "Confidence" SG_ 1448 EPBR_a247_esmState 1;
BA_ "Confidence" SG_ 1448 EPBR_a247_esmStateRequest 1;
BA_ "Confidence" SG_ 1448 EPBR_a247_faultStatus 1;
BA_ "Confidence" SG_ 1448 EPBR_a247_monitorUnitStatus 1;
BA_ "Confidence" SG_ 1448 EPBR_a247_monitorFaultStatus 1;
BA_ "Confidence" SG_ 1448 EPBR_a247_csmFaultReason 1;
BA_ "Confidence" SG_ 1448 EPBR_a247_esmOpTrigger 1;
BA_ "Confidence" SG_ 1448 EPBR_a247_nonterminalReason 1;
BA_ "Confidence" SG_ 1448 EPBR_a248_esmState 1;
BA_ "Confidence" SG_ 1448 EPBR_a248_esmStateRequest 1;
BA_ "Confidence" SG_ 1448 EPBR_a248_faultStatus 1;
BA_ "Confidence" SG_ 1448 EPBR_a248_monitorUnitStatus 1;
BA_ "Confidence" SG_ 1448 EPBR_a248_monitorFaultStatus 1;
BA_ "Confidence" SG_ 1448 EPBR_a248_csmFaultReason 1;
BA_ "Confidence" SG_ 1448 EPBR_a248_esmOpTrigger 1;
BA_ "Confidence" SG_ 1448 EPBR_a248_nonterminalReason 1;
BA_ "Confidence" SG_ 1448 EPBR_a249_previousState 1;
BA_ "Confidence" SG_ 1448 EPBR_a249_nextState 1;
BA_ "Confidence" SG_ 1448 EPBR_a249_esmStateRequest 1;
BA_ "Confidence" SG_ 1448 EPBR_a249_faultStatus 1;
BA_ "Confidence" SG_ 1448 EPBR_a249_esmOpTrigger 1;
BA_ "Confidence" SG_ 1448 EPBR_a250_esmSpeedClass 1;
BA_ "Confidence" SG_ 1448 EPBR_a250_esmOperationTrigger 1;
BA_ "Confidence" SG_ 1448 EPBR_a251_currentVariance 1;
BA_ "Confidence" SG_ 1448 EPBR_a251_pistonPosition 1;
BA_ "Confidence" SG_ 1448 EPBR_a251_temperature 1;
BA_ "Confidence" SG_ 1448 EPBR_a272_expectedState 1;
BA_ "Confidence" SG_ 1448 EPBR_a272_actualState 1;
BA_ "Confidence" SG_ 1448 EPBR_a301_setSpeed 1;
BA_ "Confidence" SG_ 1448 EPBR_a301_oocDistanceFiltered 1;
BA_ "Confidence" SG_ 1448 EPBR_a302_pistonPosition 1;
BA_ "Confidence" SG_ 1448 EPBR_a302_deltaCurrent 1;
BA_ "Confidence" SG_ 1448 EPBR_a303_currentVariance 1;
BA_ "Confidence" SG_ 1448 EPBR_a303_pistonPosition 1;
BA_ "Confidence" SG_ 1448 EPBR_a303_temperature 1;
BA_ "Confidence" SG_ 1448 EPBR_a350_ensPeriod 1;
BA_ "Confidence" SG_ 1448 EPBR_a350_ensDuty 1;
BA_ "Confidence" SG_ 1448 EPBR_a355_brakeHwConfig 1;
BA_ "Confidence" SG_ 1448 EPBR_a355_epbHwConfig 1;
BA_ "Confidence" SG_ 1448 EPBR_a357_epbSystemStatus 1;
BA_ "Confidence" SG_ 1448 EPBR_a357_grade 1;
BA_ "Confidence" SG_ 1448 EPBR_a357_ambientTemp 1;
BA_ "Confidence" SG_ 1448 EPBR_a357_brakeTemp 1;
BA_ "Confidence" SG_ 1448 EPBR_a358_epbSystemStatus 1;
BA_ "Confidence" SG_ 1448 EPBR_a358_grade 1;
BA_ "Confidence" SG_ 1448 EPBR_a358_ambientTemp 1;
BA_ "Confidence" SG_ 1448 EPBR_a358_brakeTemp 1;
BA_ "Confidence" SG_ 1448 EPBR_a359_outputCurrent 1;
BA_ "Confidence" SG_ 1448 EPBR_a365_epbSystemStatus 1;
BA_ "Confidence" SG_ 1448 EPBR_a365_grade 1;
BA_ "Confidence" SG_ 1448 EPBR_a365_ambientTemp 1;
BA_ "Confidence" SG_ 1448 EPBR_a366_epbSystemStatus 1;
BA_ "Confidence" SG_ 1448 EPBR_a366_grade 1;
BA_ "Confidence" SG_ 1448 EPBR_a366_ambientTemp 1;
VAL_ 1448 EPBR_alertID 370 "a370_imposterDetected" 366 "a366_TooSteepToParkWithTrailerUnSecEnv" 365 "a365_TooSteepToParkWithTrailerWarning" 364 "a364_espMasterCylCompOverThreshold" 363 "a363_ibstNotPressedEspPressedMismatch" 362 "a362_ibstPressedEspNotPressedMismatch" 361 "a361_espBrakeSwitchInvalid" 360 "a360_ibstBrakeSwitchInvalid" 359 "a359_seat2RControllerTrip" 358 "a358_brakesTooHotForSlopeWithOnlyOneEpb" 357 "a357_brakesTooHotForSlope" 356 "a356_parkingForStationaryDetect" 355 "a355_brakeHwAndEpbHwMismatch" 354 "a354_parkedForLowBrakeFluidMode" 353 "a353_missingSpeedUnableToPark" 352 "a352_audioCurrentSpikeData" 350 "a350_ensOutOfRange" 330 "a330_parkForApIsLeaving" 305 "a305_premiumAmpEFuseTrip" 304 "a304_rearSeatControllerEFuseTrip" 303 "a303_clampingOccuredEarly" 302 "a302_csmLongRelease" 301 "a301_oocSpeedViolation" 300 "a300_leftRightConfusion" 272 "a272_vhclPwrStateMsmtch" 264 "a264_winchModeDeactivated" 263 "a263_epbRecoveryPark" 262 "a262_cannotPrepareWinchMode" 261 "a261_winchModeWithoutSteering" 256 "a256_epbSystemApply" 254 "a254_showStalkParkButtonFaultOnUi" 253 "a253_esmReleaseBlocked" 252 "a252_winchModePending" 251 "a251_currentVarianceHigh" 250 "a250_WinchModeCanceled" 249 "a249_idleFaultRelease" 248 "a248_csmDynamicApplyFailed" 247 "a247_csmDynamicApplyRetry" 246 "a246_idleFaultApply" 245 "a245_serviceModeActive" 244 "a244_WinchModeActive" 243 "a243_bdwUnavailable" 242 "a242_hvOutputLocked" 241 "a241_diOutputLocked" 225 "a225_epbActiveDecel" 217 "a217_SPI_MIA_debugData2" 216 "a216_SPI_MIA_debugData1" 210 "a210_parkForDriverIsLeavingDebug" 203 "a203_hwBrakeTypeMismatch" 202 "a202_remoteEpbConfigIncompatible" 200 "a200_PmUnparkNotAllowed" 198 "a198_holdClampComplete" 197 "a197_freeRollModeAtSpeed" 196 "a196_freeRollModeActive" 195 "a195_parkForDriverIsLeaving" 191 "a191_csmReleaseDegraded" 190 "a190_csmApplyDegraded" 189 "a189_epbDynamicParkCanceled" 188 "a188_epbDynamic" 187 "a187_cdpDynamic" 186 "a186_externalParkAbort" 185 "a185_summonAborted" 184 "a184_dynamicParkAbort" 183 "a183_cdpNotAvailable" 182 "a182_OneEPBAppliedUnsecEnv" 181 "a181_TooSteepGradeToPark" 180 "a180_dynamicActive" 179 "a179_epbProblem" 178 "a178_caliperStateUnknown" 177 "a177_csmApplyRetry" 176 "a176_csmApplyFailed" 175 "a175_csmReleaseRetry" 174 "a174_csmReleaseFailed" 173 "a173_hiCurrentMissing" 172 "a172_SPI_MIA" 171 "a171_12vUv" 170 "a170_12vOv" 141 "a141_invalidState" 140 "a140_NvmSlowWrite" 139 "a139_NvmRedundancyLoss" 138 "a138_NvmDualFailure" 137 "a137_PvUv" 136 "a136_PvOv" 135 "a135_NvUv" 134 "a134_NvOv" 133 "a133_VCBATT2_MIA" 132 "a132_VCBATT1_MIA" 131 "a131_RCU_MIA" 130 "a130_BB_MIA" 129 "a129_ICR_MIA" 128 "a128_MotorPVoltHigh" 127 "a127_MotorNVoltHigh" 126 "a126_MotorNVoltLow" 125 "a125_IdleVMismatch" 124 "a124_calOutOfBounds" 123 "a123_Uc" 122 "a122_Oc" 121 "a121_nDriveFault" 120 "a120_DI_DRIVE_MIA" 119 "a119_SCCM_MIA" 118 "a118_VCFRONT_MIA" 117 "a117_VCLEFT_MIA" 116 "a116_VCRIGHT_MIA" 115 "a115_VCSEC_MIA" 114 "a114_ESP_MIA" 113 "a113_UI_MIA" 112 "a112_EPBL_MIA" 111 "a111_EPBR_MIA" 110 "a110_GTW_MIA" 109 "a109_RCM_MIA" 108 "a108_DIF_MIA" 107 "a107_BMS_MIA" 106 "a106_PCS_MIA" 105 "a105_TAS_MIA" 104 "a104_DAS_MIA" 103 "a103_CP_MIA" 102 "a102_PTC_MIA" 101 "a101_PM_MIA" 100 "a100_CANbus_MIA" 99 "a099_PARK_MIA" 98 "a098_DIR_MIA" 97 "a097_CMP_MIA" 96 "a096_OCS1P_MIA" 95 "a095_CHG_MIA" 94 "a094_EPAS3P_MIA" 93 "a093_VCSEATP_MIA" 92 "a092_VCSEATD_MIA" 91 "a091_CMPD_MIA" 90 "a090_APS_MIA" 89 "a089_IBST_MIA" 88 "a088_DIRER_MIA" 87 "a087_DIREL_MIA" 86 "a086_VCBATT_MIA" 85 "a085_CCCM_MIA" 84 "a084_TPMS_MIA" 83 "a083_VCLEFT_IPC_MIA" 82 "a082_VCRIGHT_IPC_MIA" 81 "a081_APP_MIA" 64 "a064_busSleepReqTimeout" 63 "a063_SwitchFault" 62 "a062_XCPWasConnected" 61 "a061_XCPConnected" 60 "a060_engineeringBuild" 59 "a059_inputResistanceHigh" 58 "a058_inputRHighSyncDebug" 57 "a057_HVP_MIA" 46 "a046_Task1000msError" 45 "a045_Task100msError" 44 "a044_Task10msError" 43 "a043_Task1msError" 42 "a042_HighStackUsage" 41 "a041_HighCPULoad" 31 "a031_UDSActive" 30 "a030_ECULogUploadRequest" 29 "a029_CoreDump" 22 "a022_TaskInitError" 21 "a021_TaskSchedulerError" 16 "a016_NVMMRecordError" 15 "a015_NVMMError" 13 "a013_AlertManagerFault" 12 "a012_CPUReset" 6 "a006_CANTX_cyclicError" 5 "a005_CANTXError" 3 "a003_SWAssertion" 2 "a002_PowerLossReset" 1 "a001_WatchdogReset" 0 "ALERT_DO_NOT_USE_ZERO" ;
VAL_ 1448 EPBR_alertState 1 "SET" 0 "CLEARED" ;
VAL_ 1448 EPBR_a138_localState 6 "WINCHMODE" 5 "SERVICE" 4 "OPEN" 3 "PARK" 2 "REAPPLY" 1 "UNKNOWN" 0 "UNSAVED" ;
VAL_ 1448 EPBR_a138_monitorState 6 "WINCHMODE" 5 "SERVICE" 4 "OPEN" 3 "PARK" 2 "REAPPLY" 1 "UNKNOWN" 0 "UNSAVED" ;
VAL_ 1448 EPBR_a139_localState 6 "WINCHMODE" 5 "SERVICE" 4 "OPEN" 3 "PARK" 2 "REAPPLY" 1 "UNKNOWN" 0 "UNSAVED" ;
VAL_ 1448 EPBR_a139_monitorState 6 "WINCHMODE" 5 "SERVICE" 4 "OPEN" 3 "PARK" 2 "REAPPLY" 1 "UNKNOWN" 0 "UNSAVED" ;
VAL_ 1448 EPBR_a141_fromState 23 "UNKNOWN" 22 "AUTONOMY_DYNAMIC" 21 "AUTONOMY_OPEN" 20 "SYSTEM_DYNAMIC_EXTERNAL" 19 "FREE_ROLL_MODE" 18 "DYNAMIC_EXTERNAL_EXIT" 17 "SERVICE_PENDING" 16 "LATCHED_DYNAMIC_EXTERNAL" 15 "DYNAMIC_PENDING" 14 "DYNAMIC_EXTERNAL" 13 "SUMMON_PARK" 12 "WINCHMODE_PENDING" 11 "PARK_PENDING" 10 "DYNAMIC_PARK" 9 "DIAGNOSTIC_OPEN" 8 "DIAGNOSTIC_PARK" 7 "SERVICE" 6 "WINCHMODE" 5 "SUMMON" 4 "DYNAMIC" 3 "OPEN" 2 "REAPPLY" 1 "PARK" 0 "INIT" ;
VAL_ 1448 EPBR_a141_toState 23 "UNKNOWN" 22 "AUTONOMY_DYNAMIC" 21 "AUTONOMY_OPEN" 20 "SYSTEM_DYNAMIC_EXTERNAL" 19 "FREE_ROLL_MODE" 18 "DYNAMIC_EXTERNAL_EXIT" 17 "SERVICE_PENDING" 16 "LATCHED_DYNAMIC_EXTERNAL" 15 "DYNAMIC_PENDING" 14 "DYNAMIC_EXTERNAL" 13 "SUMMON_PARK" 12 "WINCHMODE_PENDING" 11 "PARK_PENDING" 10 "DYNAMIC_PARK" 9 "DIAGNOSTIC_OPEN" 8 "DIAGNOSTIC_PARK" 7 "SERVICE" 6 "WINCHMODE" 5 "SUMMON" 4 "DYNAMIC" 3 "OPEN" 2 "REAPPLY" 1 "PARK" 0 "INIT" ;
VAL_ 1448 EPBR_a174_esmState 23 "UNKNOWN" 22 "AUTONOMY_DYNAMIC" 21 "AUTONOMY_OPEN" 20 "SYSTEM_DYNAMIC_EXTERNAL" 19 "FREE_ROLL_MODE" 18 "DYNAMIC_EXTERNAL_EXIT" 17 "SERVICE_PENDING" 16 "LATCHED_DYNAMIC_EXTERNAL" 15 "DYNAMIC_PENDING" 14 "DYNAMIC_EXTERNAL" 13 "SUMMON_PARK" 12 "WINCHMODE_PENDING" 11 "PARK_PENDING" 10 "DYNAMIC_PARK" 9 "DIAGNOSTIC_OPEN" 8 "DIAGNOSTIC_PARK" 7 "SERVICE" 6 "WINCHMODE" 5 "SUMMON" 4 "DYNAMIC" 3 "OPEN" 2 "REAPPLY" 1 "PARK" 0 "INIT" ;
VAL_ 1448 EPBR_a174_esmStateRequest 23 "UNKNOWN" 22 "AUTONOMY_DYNAMIC" 21 "AUTONOMY_OPEN" 20 "SYSTEM_DYNAMIC_EXTERNAL" 19 "FREE_ROLL_MODE" 18 "DYNAMIC_EXTERNAL_EXIT" 17 "SERVICE_PENDING" 16 "LATCHED_DYNAMIC_EXTERNAL" 15 "DYNAMIC_PENDING" 14 "DYNAMIC_EXTERNAL" 13 "SUMMON_PARK" 12 "WINCHMODE_PENDING" 11 "PARK_PENDING" 10 "DYNAMIC_PARK" 9 "DIAGNOSTIC_OPEN" 8 "DIAGNOSTIC_PARK" 7 "SERVICE" 6 "WINCHMODE" 5 "SUMMON" 4 "DYNAMIC" 3 "OPEN" 2 "REAPPLY" 1 "PARK" 0 "INIT" ;
VAL_ 1448 EPBR_a174_faultStatus 3 "FAULT_IDLE" 2 "FAULT" 1 "RETRY" 0 "NOMINAL" ;
VAL_ 1448 EPBR_a174_monitorUnitStatus 23 "COUNT" 22 "AUTONOMY_OPEN" 21 "FREE_ROLL_MODE" 20 "DYNAMIC_PARKING" 19 "EXTERNAL_PARKING" 18 "RELEASING_FOR_EXTERNAL_PARK" 17 "EXTERNAL_DYNAMIC" 16 "SUMMON_PARKING" 15 "SUMMON_RELEASING" 14 "SUMMON" 13 "WINCHMODE_PENDING" 12 "PARK_PENDING" 11 "SERVICE_RELEASING" 10 "RELEASING" 9 "DYNAMIC_APPLYING" 8 "PARKING" 7 "WINCHMODE_RELEASING" 6 "WINCHMODE" 5 "SERVICE" 4 "START" 3 "PARK" 2 "DYNAMIC" 1 "OPEN" 0 "UNKNOWN" ;
VAL_ 1448 EPBR_a174_monitorFaultStatus 3 "FAULT_IDLE" 2 "FAULT" 1 "RETRY" 0 "NOMINAL" ;
VAL_ 1448 EPBR_a174_csmFaultReason 23 "REMOTE_MIA" 22 "NVM_MISMATCH" 21 "EPBM_MIA" 20 "MOTOR_NOT_READY" 19 "MOTOR_ACTIVE_FAULT" 18 "MOTOR_IDLE_FAULT" 17 "TIMEOUT_EPBM_START" 16 "TIMEOUT_NO_RAMP" 15 "TIMEOUT_EPBM_CUTOFF" 14 "TIMEOUT_RELEASE_COMPLETE" 13 "TIMEOUT_RELEASE_NO_LOAD" 12 "TIMEOUT_RELEASE_WAIT_FOR_ENDSTOP" 11 "TIMEOUT_RELEASE_INRUSH" 10 "TIMEOUT_EPBM_WAIT_FOR_CLAMP" 9 "TIMEOUT_EPB_WAIT_FOR_CLAMP" 8 "TIMEOUT_APPLY_INRUSH" 7 "TIMEOUT_APPLY_COMPLETE" 6 "RELEASE_BLOCKED" 5 "APPLY_BLOCKED" 4 "TIMEOUT_CALIBRATE" 3 "STATE_MISMATCH" 2 "EPBM_FAULTED" 1 "EPBM_DISABLED" 0 "NONE" ;
VAL_ 1448 EPBR_a174_esmOpTrigger 50 "ACTIVE_DECEL_DAS_STATIC" 49 "ACTIVE_DECEL_CDP_DOWN" 48 "AP_IS_LEAVING" 47 "RECOVERY_PARK" 46 "SPEED_SOURCES_LOST" 45 "ACTIVE_DECEL_OKTOPARK" 44 "ACTIVE_DECEL_FAST" 43 "STEERING_ACTIVE_DECEL" 42 "LV_ACTIVE_DECEL" 41 "CDP_PANIC_MODE_READY" 40 "CDP_PANIC_MODE_TIMEOUT" 39 "DI_PARK" 38 "FREE_ROLL_PARK_FOR_HANDLE_PULLED" 37 "LOW_BRAKE_FLUID_MODE_DYNAMIC" 36 "LOW_BRAKE_FLUID_MODE_DYNAMIC_PARK" 35 "LOW_BRAKE_FLUID_MODE_PARK" 34 "STATIONARY_DETECT" 33 "TOUCHSCREEN_INVALID" 32 "UI_DOOR_OPEN_REQUEST" 31 "AUTOPARK_END" 30 "DRIVER_IS_LEAVING" 29 "SYSTEM_APPLY" 28 "ACCELERATION" 27 "EPBM_DISQUALIFIED" 26 "DISQUALIFIED" 25 "SUMMON_FAULT" 24 "FAULT" 23 "SUMMON_COMPLETE" 22 "REAPPLY" 21 "SAVESTATE_ON_BOOT" 20 "TIMEOUT" 19 "SPEED_FAST" 18 "SPEED_OKAYTOPARK" 17 "SPEED_STOPPED" 16 "USER_CANCEL" 15 "USER_CONFIRMED" 14 "DIAG_EXIT" 13 "DIAG_OPEN" 12 "DIAG_CLOSE" 11 "SERVICE" 10 "WINCHMODE_UNAVAILABLE" 9 "WINCHMODE_ENTER" 8 "WINCHMODE_EXIT" 7 "TOUCHSCREEN" 6 "DI_UNPARK" 5 "ACTIVE_PARK_REQUEST" 4 "PBUTTON_RELEASED" 3 "PBUTTON_PRESSED_UNKNOWN" 2 "PBUTTON_PRESSED_FAST" 1 "PBUTTON_PRESSED_OKTOPARK" 0 "PBUTTON_PRESSED_STOPPED" ;
VAL_ 1448 EPBR_a174_nonterminalReason 23 "REMOTE_MIA" 22 "NVM_MISMATCH" 21 "EPBM_MIA" 20 "MOTOR_NOT_READY" 19 "MOTOR_ACTIVE_FAULT" 18 "MOTOR_IDLE_FAULT" 17 "TIMEOUT_EPBM_START" 16 "TIMEOUT_NO_RAMP" 15 "TIMEOUT_EPBM_CUTOFF" 14 "TIMEOUT_RELEASE_COMPLETE" 13 "TIMEOUT_RELEASE_NO_LOAD" 12 "TIMEOUT_RELEASE_WAIT_FOR_ENDSTOP" 11 "TIMEOUT_RELEASE_INRUSH" 10 "TIMEOUT_EPBM_WAIT_FOR_CLAMP" 9 "TIMEOUT_EPB_WAIT_FOR_CLAMP" 8 "TIMEOUT_APPLY_INRUSH" 7 "TIMEOUT_APPLY_COMPLETE" 6 "RELEASE_BLOCKED" 5 "APPLY_BLOCKED" 4 "TIMEOUT_CALIBRATE" 3 "STATE_MISMATCH" 2 "EPBM_FAULTED" 1 "EPBM_DISABLED" 0 "NONE" ;
VAL_ 1448 EPBR_a175_esmState 23 "UNKNOWN" 22 "AUTONOMY_DYNAMIC" 21 "AUTONOMY_OPEN" 20 "SYSTEM_DYNAMIC_EXTERNAL" 19 "FREE_ROLL_MODE" 18 "DYNAMIC_EXTERNAL_EXIT" 17 "SERVICE_PENDING" 16 "LATCHED_DYNAMIC_EXTERNAL" 15 "DYNAMIC_PENDING" 14 "DYNAMIC_EXTERNAL" 13 "SUMMON_PARK" 12 "WINCHMODE_PENDING" 11 "PARK_PENDING" 10 "DYNAMIC_PARK" 9 "DIAGNOSTIC_OPEN" 8 "DIAGNOSTIC_PARK" 7 "SERVICE" 6 "WINCHMODE" 5 "SUMMON" 4 "DYNAMIC" 3 "OPEN" 2 "REAPPLY" 1 "PARK" 0 "INIT" ;
VAL_ 1448 EPBR_a175_esmStateRequest 23 "UNKNOWN" 22 "AUTONOMY_DYNAMIC" 21 "AUTONOMY_OPEN" 20 "SYSTEM_DYNAMIC_EXTERNAL" 19 "FREE_ROLL_MODE" 18 "DYNAMIC_EXTERNAL_EXIT" 17 "SERVICE_PENDING" 16 "LATCHED_DYNAMIC_EXTERNAL" 15 "DYNAMIC_PENDING" 14 "DYNAMIC_EXTERNAL" 13 "SUMMON_PARK" 12 "WINCHMODE_PENDING" 11 "PARK_PENDING" 10 "DYNAMIC_PARK" 9 "DIAGNOSTIC_OPEN" 8 "DIAGNOSTIC_PARK" 7 "SERVICE" 6 "WINCHMODE" 5 "SUMMON" 4 "DYNAMIC" 3 "OPEN" 2 "REAPPLY" 1 "PARK" 0 "INIT" ;
VAL_ 1448 EPBR_a175_faultStatus 3 "FAULT_IDLE" 2 "FAULT" 1 "RETRY" 0 "NOMINAL" ;
VAL_ 1448 EPBR_a175_monitorUnitStatus 23 "COUNT" 22 "AUTONOMY_OPEN" 21 "FREE_ROLL_MODE" 20 "DYNAMIC_PARKING" 19 "EXTERNAL_PARKING" 18 "RELEASING_FOR_EXTERNAL_PARK" 17 "EXTERNAL_DYNAMIC" 16 "SUMMON_PARKING" 15 "SUMMON_RELEASING" 14 "SUMMON" 13 "WINCHMODE_PENDING" 12 "PARK_PENDING" 11 "SERVICE_RELEASING" 10 "RELEASING" 9 "DYNAMIC_APPLYING" 8 "PARKING" 7 "WINCHMODE_RELEASING" 6 "WINCHMODE" 5 "SERVICE" 4 "START" 3 "PARK" 2 "DYNAMIC" 1 "OPEN" 0 "UNKNOWN" ;
VAL_ 1448 EPBR_a175_monitorFaultStatus 3 "FAULT_IDLE" 2 "FAULT" 1 "RETRY" 0 "NOMINAL" ;
VAL_ 1448 EPBR_a175_csmFaultReason 23 "REMOTE_MIA" 22 "NVM_MISMATCH" 21 "EPBM_MIA" 20 "MOTOR_NOT_READY" 19 "MOTOR_ACTIVE_FAULT" 18 "MOTOR_IDLE_FAULT" 17 "TIMEOUT_EPBM_START" 16 "TIMEOUT_NO_RAMP" 15 "TIMEOUT_EPBM_CUTOFF" 14 "TIMEOUT_RELEASE_COMPLETE" 13 "TIMEOUT_RELEASE_NO_LOAD" 12 "TIMEOUT_RELEASE_WAIT_FOR_ENDSTOP" 11 "TIMEOUT_RELEASE_INRUSH" 10 "TIMEOUT_EPBM_WAIT_FOR_CLAMP" 9 "TIMEOUT_EPB_WAIT_FOR_CLAMP" 8 "TIMEOUT_APPLY_INRUSH" 7 "TIMEOUT_APPLY_COMPLETE" 6 "RELEASE_BLOCKED" 5 "APPLY_BLOCKED" 4 "TIMEOUT_CALIBRATE" 3 "STATE_MISMATCH" 2 "EPBM_FAULTED" 1 "EPBM_DISABLED" 0 "NONE" ;
VAL_ 1448 EPBR_a175_esmOpTrigger 50 "ACTIVE_DECEL_DAS_STATIC" 49 "ACTIVE_DECEL_CDP_DOWN" 48 "AP_IS_LEAVING" 47 "RECOVERY_PARK" 46 "SPEED_SOURCES_LOST" 45 "ACTIVE_DECEL_OKTOPARK" 44 "ACTIVE_DECEL_FAST" 43 "STEERING_ACTIVE_DECEL" 42 "LV_ACTIVE_DECEL" 41 "CDP_PANIC_MODE_READY" 40 "CDP_PANIC_MODE_TIMEOUT" 39 "DI_PARK" 38 "FREE_ROLL_PARK_FOR_HANDLE_PULLED" 37 "LOW_BRAKE_FLUID_MODE_DYNAMIC" 36 "LOW_BRAKE_FLUID_MODE_DYNAMIC_PARK" 35 "LOW_BRAKE_FLUID_MODE_PARK" 34 "STATIONARY_DETECT" 33 "TOUCHSCREEN_INVALID" 32 "UI_DOOR_OPEN_REQUEST" 31 "AUTOPARK_END" 30 "DRIVER_IS_LEAVING" 29 "SYSTEM_APPLY" 28 "ACCELERATION" 27 "EPBM_DISQUALIFIED" 26 "DISQUALIFIED" 25 "SUMMON_FAULT" 24 "FAULT" 23 "SUMMON_COMPLETE" 22 "REAPPLY" 21 "SAVESTATE_ON_BOOT" 20 "TIMEOUT" 19 "SPEED_FAST" 18 "SPEED_OKAYTOPARK" 17 "SPEED_STOPPED" 16 "USER_CANCEL" 15 "USER_CONFIRMED" 14 "DIAG_EXIT" 13 "DIAG_OPEN" 12 "DIAG_CLOSE" 11 "SERVICE" 10 "WINCHMODE_UNAVAILABLE" 9 "WINCHMODE_ENTER" 8 "WINCHMODE_EXIT" 7 "TOUCHSCREEN" 6 "DI_UNPARK" 5 "ACTIVE_PARK_REQUEST" 4 "PBUTTON_RELEASED" 3 "PBUTTON_PRESSED_UNKNOWN" 2 "PBUTTON_PRESSED_FAST" 1 "PBUTTON_PRESSED_OKTOPARK" 0 "PBUTTON_PRESSED_STOPPED" ;
VAL_ 1448 EPBR_a175_nonterminalReason 23 "REMOTE_MIA" 22 "NVM_MISMATCH" 21 "EPBM_MIA" 20 "MOTOR_NOT_READY" 19 "MOTOR_ACTIVE_FAULT" 18 "MOTOR_IDLE_FAULT" 17 "TIMEOUT_EPBM_START" 16 "TIMEOUT_NO_RAMP" 15 "TIMEOUT_EPBM_CUTOFF" 14 "TIMEOUT_RELEASE_COMPLETE" 13 "TIMEOUT_RELEASE_NO_LOAD" 12 "TIMEOUT_RELEASE_WAIT_FOR_ENDSTOP" 11 "TIMEOUT_RELEASE_INRUSH" 10 "TIMEOUT_EPBM_WAIT_FOR_CLAMP" 9 "TIMEOUT_EPB_WAIT_FOR_CLAMP" 8 "TIMEOUT_APPLY_INRUSH" 7 "TIMEOUT_APPLY_COMPLETE" 6 "RELEASE_BLOCKED" 5 "APPLY_BLOCKED" 4 "TIMEOUT_CALIBRATE" 3 "STATE_MISMATCH" 2 "EPBM_FAULTED" 1 "EPBM_DISABLED" 0 "NONE" ;
VAL_ 1448 EPBR_a176_esmState 23 "UNKNOWN" 22 "AUTONOMY_DYNAMIC" 21 "AUTONOMY_OPEN" 20 "SYSTEM_DYNAMIC_EXTERNAL" 19 "FREE_ROLL_MODE" 18 "DYNAMIC_EXTERNAL_EXIT" 17 "SERVICE_PENDING" 16 "LATCHED_DYNAMIC_EXTERNAL" 15 "DYNAMIC_PENDING" 14 "DYNAMIC_EXTERNAL" 13 "SUMMON_PARK" 12 "WINCHMODE_PENDING" 11 "PARK_PENDING" 10 "DYNAMIC_PARK" 9 "DIAGNOSTIC_OPEN" 8 "DIAGNOSTIC_PARK" 7 "SERVICE" 6 "WINCHMODE" 5 "SUMMON" 4 "DYNAMIC" 3 "OPEN" 2 "REAPPLY" 1 "PARK" 0 "INIT" ;
VAL_ 1448 EPBR_a176_esmStateRequest 23 "UNKNOWN" 22 "AUTONOMY_DYNAMIC" 21 "AUTONOMY_OPEN" 20 "SYSTEM_DYNAMIC_EXTERNAL" 19 "FREE_ROLL_MODE" 18 "DYNAMIC_EXTERNAL_EXIT" 17 "SERVICE_PENDING" 16 "LATCHED_DYNAMIC_EXTERNAL" 15 "DYNAMIC_PENDING" 14 "DYNAMIC_EXTERNAL" 13 "SUMMON_PARK" 12 "WINCHMODE_PENDING" 11 "PARK_PENDING" 10 "DYNAMIC_PARK" 9 "DIAGNOSTIC_OPEN" 8 "DIAGNOSTIC_PARK" 7 "SERVICE" 6 "WINCHMODE" 5 "SUMMON" 4 "DYNAMIC" 3 "OPEN" 2 "REAPPLY" 1 "PARK" 0 "INIT" ;
VAL_ 1448 EPBR_a176_faultStatus 3 "FAULT_IDLE" 2 "FAULT" 1 "RETRY" 0 "NOMINAL" ;
VAL_ 1448 EPBR_a176_monitorUnitStatus 23 "COUNT" 22 "AUTONOMY_OPEN" 21 "FREE_ROLL_MODE" 20 "DYNAMIC_PARKING" 19 "EXTERNAL_PARKING" 18 "RELEASING_FOR_EXTERNAL_PARK" 17 "EXTERNAL_DYNAMIC" 16 "SUMMON_PARKING" 15 "SUMMON_RELEASING" 14 "SUMMON" 13 "WINCHMODE_PENDING" 12 "PARK_PENDING" 11 "SERVICE_RELEASING" 10 "RELEASING" 9 "DYNAMIC_APPLYING" 8 "PARKING" 7 "WINCHMODE_RELEASING" 6 "WINCHMODE" 5 "SERVICE" 4 "START" 3 "PARK" 2 "DYNAMIC" 1 "OPEN" 0 "UNKNOWN" ;
VAL_ 1448 EPBR_a176_monitorFaultStatus 3 "FAULT_IDLE" 2 "FAULT" 1 "RETRY" 0 "NOMINAL" ;
VAL_ 1448 EPBR_a176_csmFaultReason 23 "REMOTE_MIA" 22 "NVM_MISMATCH" 21 "EPBM_MIA" 20 "MOTOR_NOT_READY" 19 "MOTOR_ACTIVE_FAULT" 18 "MOTOR_IDLE_FAULT" 17 "TIMEOUT_EPBM_START" 16 "TIMEOUT_NO_RAMP" 15 "TIMEOUT_EPBM_CUTOFF" 14 "TIMEOUT_RELEASE_COMPLETE" 13 "TIMEOUT_RELEASE_NO_LOAD" 12 "TIMEOUT_RELEASE_WAIT_FOR_ENDSTOP" 11 "TIMEOUT_RELEASE_INRUSH" 10 "TIMEOUT_EPBM_WAIT_FOR_CLAMP" 9 "TIMEOUT_EPB_WAIT_FOR_CLAMP" 8 "TIMEOUT_APPLY_INRUSH" 7 "TIMEOUT_APPLY_COMPLETE" 6 "RELEASE_BLOCKED" 5 "APPLY_BLOCKED" 4 "TIMEOUT_CALIBRATE" 3 "STATE_MISMATCH" 2 "EPBM_FAULTED" 1 "EPBM_DISABLED" 0 "NONE" ;
VAL_ 1448 EPBR_a176_esmOpTrigger 50 "ACTIVE_DECEL_DAS_STATIC" 49 "ACTIVE_DECEL_CDP_DOWN" 48 "AP_IS_LEAVING" 47 "RECOVERY_PARK" 46 "SPEED_SOURCES_LOST" 45 "ACTIVE_DECEL_OKTOPARK" 44 "ACTIVE_DECEL_FAST" 43 "STEERING_ACTIVE_DECEL" 42 "LV_ACTIVE_DECEL" 41 "CDP_PANIC_MODE_READY" 40 "CDP_PANIC_MODE_TIMEOUT" 39 "DI_PARK" 38 "FREE_ROLL_PARK_FOR_HANDLE_PULLED" 37 "LOW_BRAKE_FLUID_MODE_DYNAMIC" 36 "LOW_BRAKE_FLUID_MODE_DYNAMIC_PARK" 35 "LOW_BRAKE_FLUID_MODE_PARK" 34 "STATIONARY_DETECT" 33 "TOUCHSCREEN_INVALID" 32 "UI_DOOR_OPEN_REQUEST" 31 "AUTOPARK_END" 30 "DRIVER_IS_LEAVING" 29 "SYSTEM_APPLY" 28 "ACCELERATION" 27 "EPBM_DISQUALIFIED" 26 "DISQUALIFIED" 25 "SUMMON_FAULT" 24 "FAULT" 23 "SUMMON_COMPLETE" 22 "REAPPLY" 21 "SAVESTATE_ON_BOOT" 20 "TIMEOUT" 19 "SPEED_FAST" 18 "SPEED_OKAYTOPARK" 17 "SPEED_STOPPED" 16 "USER_CANCEL" 15 "USER_CONFIRMED" 14 "DIAG_EXIT" 13 "DIAG_OPEN" 12 "DIAG_CLOSE" 11 "SERVICE" 10 "WINCHMODE_UNAVAILABLE" 9 "WINCHMODE_ENTER" 8 "WINCHMODE_EXIT" 7 "TOUCHSCREEN" 6 "DI_UNPARK" 5 "ACTIVE_PARK_REQUEST" 4 "PBUTTON_RELEASED" 3 "PBUTTON_PRESSED_UNKNOWN" 2 "PBUTTON_PRESSED_FAST" 1 "PBUTTON_PRESSED_OKTOPARK" 0 "PBUTTON_PRESSED_STOPPED" ;
VAL_ 1448 EPBR_a176_nonterminalReason 23 "REMOTE_MIA" 22 "NVM_MISMATCH" 21 "EPBM_MIA" 20 "MOTOR_NOT_READY" 19 "MOTOR_ACTIVE_FAULT" 18 "MOTOR_IDLE_FAULT" 17 "TIMEOUT_EPBM_START" 16 "TIMEOUT_NO_RAMP" 15 "TIMEOUT_EPBM_CUTOFF" 14 "TIMEOUT_RELEASE_COMPLETE" 13 "TIMEOUT_RELEASE_NO_LOAD" 12 "TIMEOUT_RELEASE_WAIT_FOR_ENDSTOP" 11 "TIMEOUT_RELEASE_INRUSH" 10 "TIMEOUT_EPBM_WAIT_FOR_CLAMP" 9 "TIMEOUT_EPB_WAIT_FOR_CLAMP" 8 "TIMEOUT_APPLY_INRUSH" 7 "TIMEOUT_APPLY_COMPLETE" 6 "RELEASE_BLOCKED" 5 "APPLY_BLOCKED" 4 "TIMEOUT_CALIBRATE" 3 "STATE_MISMATCH" 2 "EPBM_FAULTED" 1 "EPBM_DISABLED" 0 "NONE" ;
VAL_ 1448 EPBR_a177_esmState 23 "UNKNOWN" 22 "AUTONOMY_DYNAMIC" 21 "AUTONOMY_OPEN" 20 "SYSTEM_DYNAMIC_EXTERNAL" 19 "FREE_ROLL_MODE" 18 "DYNAMIC_EXTERNAL_EXIT" 17 "SERVICE_PENDING" 16 "LATCHED_DYNAMIC_EXTERNAL" 15 "DYNAMIC_PENDING" 14 "DYNAMIC_EXTERNAL" 13 "SUMMON_PARK" 12 "WINCHMODE_PENDING" 11 "PARK_PENDING" 10 "DYNAMIC_PARK" 9 "DIAGNOSTIC_OPEN" 8 "DIAGNOSTIC_PARK" 7 "SERVICE" 6 "WINCHMODE" 5 "SUMMON" 4 "DYNAMIC" 3 "OPEN" 2 "REAPPLY" 1 "PARK" 0 "INIT" ;
VAL_ 1448 EPBR_a177_esmStateRequest 23 "UNKNOWN" 22 "AUTONOMY_DYNAMIC" 21 "AUTONOMY_OPEN" 20 "SYSTEM_DYNAMIC_EXTERNAL" 19 "FREE_ROLL_MODE" 18 "DYNAMIC_EXTERNAL_EXIT" 17 "SERVICE_PENDING" 16 "LATCHED_DYNAMIC_EXTERNAL" 15 "DYNAMIC_PENDING" 14 "DYNAMIC_EXTERNAL" 13 "SUMMON_PARK" 12 "WINCHMODE_PENDING" 11 "PARK_PENDING" 10 "DYNAMIC_PARK" 9 "DIAGNOSTIC_OPEN" 8 "DIAGNOSTIC_PARK" 7 "SERVICE" 6 "WINCHMODE" 5 "SUMMON" 4 "DYNAMIC" 3 "OPEN" 2 "REAPPLY" 1 "PARK" 0 "INIT" ;
VAL_ 1448 EPBR_a177_faultStatus 3 "FAULT_IDLE" 2 "FAULT" 1 "RETRY" 0 "NOMINAL" ;
VAL_ 1448 EPBR_a177_monitorUnitStatus 23 "COUNT" 22 "AUTONOMY_OPEN" 21 "FREE_ROLL_MODE" 20 "DYNAMIC_PARKING" 19 "EXTERNAL_PARKING" 18 "RELEASING_FOR_EXTERNAL_PARK" 17 "EXTERNAL_DYNAMIC" 16 "SUMMON_PARKING" 15 "SUMMON_RELEASING" 14 "SUMMON" 13 "WINCHMODE_PENDING" 12 "PARK_PENDING" 11 "SERVICE_RELEASING" 10 "RELEASING" 9 "DYNAMIC_APPLYING" 8 "PARKING" 7 "WINCHMODE_RELEASING" 6 "WINCHMODE" 5 "SERVICE" 4 "START" 3 "PARK" 2 "DYNAMIC" 1 "OPEN" 0 "UNKNOWN" ;
VAL_ 1448 EPBR_a177_monitorFaultStatus 3 "FAULT_IDLE" 2 "FAULT" 1 "RETRY" 0 "NOMINAL" ;
VAL_ 1448 EPBR_a177_csmFaultReason 23 "REMOTE_MIA" 22 "NVM_MISMATCH" 21 "EPBM_MIA" 20 "MOTOR_NOT_READY" 19 "MOTOR_ACTIVE_FAULT" 18 "MOTOR_IDLE_FAULT" 17 "TIMEOUT_EPBM_START" 16 "TIMEOUT_NO_RAMP" 15 "TIMEOUT_EPBM_CUTOFF" 14 "TIMEOUT_RELEASE_COMPLETE" 13 "TIMEOUT_RELEASE_NO_LOAD" 12 "TIMEOUT_RELEASE_WAIT_FOR_ENDSTOP" 11 "TIMEOUT_RELEASE_INRUSH" 10 "TIMEOUT_EPBM_WAIT_FOR_CLAMP" 9 "TIMEOUT_EPB_WAIT_FOR_CLAMP" 8 "TIMEOUT_APPLY_INRUSH" 7 "TIMEOUT_APPLY_COMPLETE" 6 "RELEASE_BLOCKED" 5 "APPLY_BLOCKED" 4 "TIMEOUT_CALIBRATE" 3 "STATE_MISMATCH" 2 "EPBM_FAULTED" 1 "EPBM_DISABLED" 0 "NONE" ;
VAL_ 1448 EPBR_a177_esmOpTrigger 50 "ACTIVE_DECEL_DAS_STATIC" 49 "ACTIVE_DECEL_CDP_DOWN" 48 "AP_IS_LEAVING" 47 "RECOVERY_PARK" 46 "SPEED_SOURCES_LOST" 45 "ACTIVE_DECEL_OKTOPARK" 44 "ACTIVE_DECEL_FAST" 43 "STEERING_ACTIVE_DECEL" 42 "LV_ACTIVE_DECEL" 41 "CDP_PANIC_MODE_READY" 40 "CDP_PANIC_MODE_TIMEOUT" 39 "DI_PARK" 38 "FREE_ROLL_PARK_FOR_HANDLE_PULLED" 37 "LOW_BRAKE_FLUID_MODE_DYNAMIC" 36 "LOW_BRAKE_FLUID_MODE_DYNAMIC_PARK" 35 "LOW_BRAKE_FLUID_MODE_PARK" 34 "STATIONARY_DETECT" 33 "TOUCHSCREEN_INVALID" 32 "UI_DOOR_OPEN_REQUEST" 31 "AUTOPARK_END" 30 "DRIVER_IS_LEAVING" 29 "SYSTEM_APPLY" 28 "ACCELERATION" 27 "EPBM_DISQUALIFIED" 26 "DISQUALIFIED" 25 "SUMMON_FAULT" 24 "FAULT" 23 "SUMMON_COMPLETE" 22 "REAPPLY" 21 "SAVESTATE_ON_BOOT" 20 "TIMEOUT" 19 "SPEED_FAST" 18 "SPEED_OKAYTOPARK" 17 "SPEED_STOPPED" 16 "USER_CANCEL" 15 "USER_CONFIRMED" 14 "DIAG_EXIT" 13 "DIAG_OPEN" 12 "DIAG_CLOSE" 11 "SERVICE" 10 "WINCHMODE_UNAVAILABLE" 9 "WINCHMODE_ENTER" 8 "WINCHMODE_EXIT" 7 "TOUCHSCREEN" 6 "DI_UNPARK" 5 "ACTIVE_PARK_REQUEST" 4 "PBUTTON_RELEASED" 3 "PBUTTON_PRESSED_UNKNOWN" 2 "PBUTTON_PRESSED_FAST" 1 "PBUTTON_PRESSED_OKTOPARK" 0 "PBUTTON_PRESSED_STOPPED" ;
VAL_ 1448 EPBR_a177_nonterminalReason 23 "REMOTE_MIA" 22 "NVM_MISMATCH" 21 "EPBM_MIA" 20 "MOTOR_NOT_READY" 19 "MOTOR_ACTIVE_FAULT" 18 "MOTOR_IDLE_FAULT" 17 "TIMEOUT_EPBM_START" 16 "TIMEOUT_NO_RAMP" 15 "TIMEOUT_EPBM_CUTOFF" 14 "TIMEOUT_RELEASE_COMPLETE" 13 "TIMEOUT_RELEASE_NO_LOAD" 12 "TIMEOUT_RELEASE_WAIT_FOR_ENDSTOP" 11 "TIMEOUT_RELEASE_INRUSH" 10 "TIMEOUT_EPBM_WAIT_FOR_CLAMP" 9 "TIMEOUT_EPB_WAIT_FOR_CLAMP" 8 "TIMEOUT_APPLY_INRUSH" 7 "TIMEOUT_APPLY_COMPLETE" 6 "RELEASE_BLOCKED" 5 "APPLY_BLOCKED" 4 "TIMEOUT_CALIBRATE" 3 "STATE_MISMATCH" 2 "EPBM_FAULTED" 1 "EPBM_DISABLED" 0 "NONE" ;
VAL_ 1448 EPBR_a178_localCaliperState 6 "WINCHMODE" 5 "SERVICE" 4 "OPEN" 3 "PARK" 2 "REAPPLY" 1 "UNKNOWN" 0 "UNSAVED" ;
VAL_ 1448 EPBR_a178_monitorCaliperState 6 "WINCHMODE" 5 "SERVICE" 4 "OPEN" 3 "PARK" 2 "REAPPLY" 1 "UNKNOWN" 0 "UNSAVED" ;
VAL_ 1448 EPBR_a179_esmState 23 "UNKNOWN" 22 "AUTONOMY_DYNAMIC" 21 "AUTONOMY_OPEN" 20 "SYSTEM_DYNAMIC_EXTERNAL" 19 "FREE_ROLL_MODE" 18 "DYNAMIC_EXTERNAL_EXIT" 17 "SERVICE_PENDING" 16 "LATCHED_DYNAMIC_EXTERNAL" 15 "DYNAMIC_PENDING" 14 "DYNAMIC_EXTERNAL" 13 "SUMMON_PARK" 12 "WINCHMODE_PENDING" 11 "PARK_PENDING" 10 "DYNAMIC_PARK" 9 "DIAGNOSTIC_OPEN" 8 "DIAGNOSTIC_PARK" 7 "SERVICE" 6 "WINCHMODE" 5 "SUMMON" 4 "DYNAMIC" 3 "OPEN" 2 "REAPPLY" 1 "PARK" 0 "INIT" ;
VAL_ 1448 EPBR_a179_esmStateRequest 23 "UNKNOWN" 22 "AUTONOMY_DYNAMIC" 21 "AUTONOMY_OPEN" 20 "SYSTEM_DYNAMIC_EXTERNAL" 19 "FREE_ROLL_MODE" 18 "DYNAMIC_EXTERNAL_EXIT" 17 "SERVICE_PENDING" 16 "LATCHED_DYNAMIC_EXTERNAL" 15 "DYNAMIC_PENDING" 14 "DYNAMIC_EXTERNAL" 13 "SUMMON_PARK" 12 "WINCHMODE_PENDING" 11 "PARK_PENDING" 10 "DYNAMIC_PARK" 9 "DIAGNOSTIC_OPEN" 8 "DIAGNOSTIC_PARK" 7 "SERVICE" 6 "WINCHMODE" 5 "SUMMON" 4 "DYNAMIC" 3 "OPEN" 2 "REAPPLY" 1 "PARK" 0 "INIT" ;
VAL_ 1448 EPBR_a179_faultStatus 3 "FAULT_IDLE" 2 "FAULT" 1 "RETRY" 0 "NOMINAL" ;
VAL_ 1448 EPBR_a179_monitorUnitStatus 23 "COUNT" 22 "AUTONOMY_OPEN" 21 "FREE_ROLL_MODE" 20 "DYNAMIC_PARKING" 19 "EXTERNAL_PARKING" 18 "RELEASING_FOR_EXTERNAL_PARK" 17 "EXTERNAL_DYNAMIC" 16 "SUMMON_PARKING" 15 "SUMMON_RELEASING" 14 "SUMMON" 13 "WINCHMODE_PENDING" 12 "PARK_PENDING" 11 "SERVICE_RELEASING" 10 "RELEASING" 9 "DYNAMIC_APPLYING" 8 "PARKING" 7 "WINCHMODE_RELEASING" 6 "WINCHMODE" 5 "SERVICE" 4 "START" 3 "PARK" 2 "DYNAMIC" 1 "OPEN" 0 "UNKNOWN" ;
VAL_ 1448 EPBR_a179_monitorFaultStatus 3 "FAULT_IDLE" 2 "FAULT" 1 "RETRY" 0 "NOMINAL" ;
VAL_ 1448 EPBR_a179_csmFaultReason 23 "REMOTE_MIA" 22 "NVM_MISMATCH" 21 "EPBM_MIA" 20 "MOTOR_NOT_READY" 19 "MOTOR_ACTIVE_FAULT" 18 "MOTOR_IDLE_FAULT" 17 "TIMEOUT_EPBM_START" 16 "TIMEOUT_NO_RAMP" 15 "TIMEOUT_EPBM_CUTOFF" 14 "TIMEOUT_RELEASE_COMPLETE" 13 "TIMEOUT_RELEASE_NO_LOAD" 12 "TIMEOUT_RELEASE_WAIT_FOR_ENDSTOP" 11 "TIMEOUT_RELEASE_INRUSH" 10 "TIMEOUT_EPBM_WAIT_FOR_CLAMP" 9 "TIMEOUT_EPB_WAIT_FOR_CLAMP" 8 "TIMEOUT_APPLY_INRUSH" 7 "TIMEOUT_APPLY_COMPLETE" 6 "RELEASE_BLOCKED" 5 "APPLY_BLOCKED" 4 "TIMEOUT_CALIBRATE" 3 "STATE_MISMATCH" 2 "EPBM_FAULTED" 1 "EPBM_DISABLED" 0 "NONE" ;
VAL_ 1448 EPBR_a179_esmOpTrigger 50 "ACTIVE_DECEL_DAS_STATIC" 49 "ACTIVE_DECEL_CDP_DOWN" 48 "AP_IS_LEAVING" 47 "RECOVERY_PARK" 46 "SPEED_SOURCES_LOST" 45 "ACTIVE_DECEL_OKTOPARK" 44 "ACTIVE_DECEL_FAST" 43 "STEERING_ACTIVE_DECEL" 42 "LV_ACTIVE_DECEL" 41 "CDP_PANIC_MODE_READY" 40 "CDP_PANIC_MODE_TIMEOUT" 39 "DI_PARK" 38 "FREE_ROLL_PARK_FOR_HANDLE_PULLED" 37 "LOW_BRAKE_FLUID_MODE_DYNAMIC" 36 "LOW_BRAKE_FLUID_MODE_DYNAMIC_PARK" 35 "LOW_BRAKE_FLUID_MODE_PARK" 34 "STATIONARY_DETECT" 33 "TOUCHSCREEN_INVALID" 32 "UI_DOOR_OPEN_REQUEST" 31 "AUTOPARK_END" 30 "DRIVER_IS_LEAVING" 29 "SYSTEM_APPLY" 28 "ACCELERATION" 27 "EPBM_DISQUALIFIED" 26 "DISQUALIFIED" 25 "SUMMON_FAULT" 24 "FAULT" 23 "SUMMON_COMPLETE" 22 "REAPPLY" 21 "SAVESTATE_ON_BOOT" 20 "TIMEOUT" 19 "SPEED_FAST" 18 "SPEED_OKAYTOPARK" 17 "SPEED_STOPPED" 16 "USER_CANCEL" 15 "USER_CONFIRMED" 14 "DIAG_EXIT" 13 "DIAG_OPEN" 12 "DIAG_CLOSE" 11 "SERVICE" 10 "WINCHMODE_UNAVAILABLE" 9 "WINCHMODE_ENTER" 8 "WINCHMODE_EXIT" 7 "TOUCHSCREEN" 6 "DI_UNPARK" 5 "ACTIVE_PARK_REQUEST" 4 "PBUTTON_RELEASED" 3 "PBUTTON_PRESSED_UNKNOWN" 2 "PBUTTON_PRESSED_FAST" 1 "PBUTTON_PRESSED_OKTOPARK" 0 "PBUTTON_PRESSED_STOPPED" ;
VAL_ 1448 EPBR_a179_nonterminalReason 23 "REMOTE_MIA" 22 "NVM_MISMATCH" 21 "EPBM_MIA" 20 "MOTOR_NOT_READY" 19 "MOTOR_ACTIVE_FAULT" 18 "MOTOR_IDLE_FAULT" 17 "TIMEOUT_EPBM_START" 16 "TIMEOUT_NO_RAMP" 15 "TIMEOUT_EPBM_CUTOFF" 14 "TIMEOUT_RELEASE_COMPLETE" 13 "TIMEOUT_RELEASE_NO_LOAD" 12 "TIMEOUT_RELEASE_WAIT_FOR_ENDSTOP" 11 "TIMEOUT_RELEASE_INRUSH" 10 "TIMEOUT_EPBM_WAIT_FOR_CLAMP" 9 "TIMEOUT_EPB_WAIT_FOR_CLAMP" 8 "TIMEOUT_APPLY_INRUSH" 7 "TIMEOUT_APPLY_COMPLETE" 6 "RELEASE_BLOCKED" 5 "APPLY_BLOCKED" 4 "TIMEOUT_CALIBRATE" 3 "STATE_MISMATCH" 2 "EPBM_FAULTED" 1 "EPBM_DISABLED" 0 "NONE" ;
VAL_ 1448 EPBR_a180_esmOpTrigger 50 "ACTIVE_DECEL_DAS_STATIC" 49 "ACTIVE_DECEL_CDP_DOWN" 48 "AP_IS_LEAVING" 47 "RECOVERY_PARK" 46 "SPEED_SOURCES_LOST" 45 "ACTIVE_DECEL_OKTOPARK" 44 "ACTIVE_DECEL_FAST" 43 "STEERING_ACTIVE_DECEL" 42 "LV_ACTIVE_DECEL" 41 "CDP_PANIC_MODE_READY" 40 "CDP_PANIC_MODE_TIMEOUT" 39 "DI_PARK" 38 "FREE_ROLL_PARK_FOR_HANDLE_PULLED" 37 "LOW_BRAKE_FLUID_MODE_DYNAMIC" 36 "LOW_BRAKE_FLUID_MODE_DYNAMIC_PARK" 35 "LOW_BRAKE_FLUID_MODE_PARK" 34 "STATIONARY_DETECT" 33 "TOUCHSCREEN_INVALID" 32 "UI_DOOR_OPEN_REQUEST" 31 "AUTOPARK_END" 30 "DRIVER_IS_LEAVING" 29 "SYSTEM_APPLY" 28 "ACCELERATION" 27 "EPBM_DISQUALIFIED" 26 "DISQUALIFIED" 25 "SUMMON_FAULT" 24 "FAULT" 23 "SUMMON_COMPLETE" 22 "REAPPLY" 21 "SAVESTATE_ON_BOOT" 20 "TIMEOUT" 19 "SPEED_FAST" 18 "SPEED_OKAYTOPARK" 17 "SPEED_STOPPED" 16 "USER_CANCEL" 15 "USER_CONFIRMED" 14 "DIAG_EXIT" 13 "DIAG_OPEN" 12 "DIAG_CLOSE" 11 "SERVICE" 10 "WINCHMODE_UNAVAILABLE" 9 "WINCHMODE_ENTER" 8 "WINCHMODE_EXIT" 7 "TOUCHSCREEN" 6 "DI_UNPARK" 5 "ACTIVE_PARK_REQUEST" 4 "PBUTTON_RELEASED" 3 "PBUTTON_PRESSED_UNKNOWN" 2 "PBUTTON_PRESSED_FAST" 1 "PBUTTON_PRESSED_OKTOPARK" 0 "PBUTTON_PRESSED_STOPPED" ;
VAL_ 1448 EPBR_a180_previousState 23 "UNKNOWN" 22 "AUTONOMY_DYNAMIC" 21 "AUTONOMY_OPEN" 20 "SYSTEM_DYNAMIC_EXTERNAL" 19 "FREE_ROLL_MODE" 18 "DYNAMIC_EXTERNAL_EXIT" 17 "SERVICE_PENDING" 16 "LATCHED_DYNAMIC_EXTERNAL" 15 "DYNAMIC_PENDING" 14 "DYNAMIC_EXTERNAL" 13 "SUMMON_PARK" 12 "WINCHMODE_PENDING" 11 "PARK_PENDING" 10 "DYNAMIC_PARK" 9 "DIAGNOSTIC_OPEN" 8 "DIAGNOSTIC_PARK" 7 "SERVICE" 6 "WINCHMODE" 5 "SUMMON" 4 "DYNAMIC" 3 "OPEN" 2 "REAPPLY" 1 "PARK" 0 "INIT" ;
VAL_ 1448 EPBR_a180_nextState 23 "UNKNOWN" 22 "AUTONOMY_DYNAMIC" 21 "AUTONOMY_OPEN" 20 "SYSTEM_DYNAMIC_EXTERNAL" 19 "FREE_ROLL_MODE" 18 "DYNAMIC_EXTERNAL_EXIT" 17 "SERVICE_PENDING" 16 "LATCHED_DYNAMIC_EXTERNAL" 15 "DYNAMIC_PENDING" 14 "DYNAMIC_EXTERNAL" 13 "SUMMON_PARK" 12 "WINCHMODE_PENDING" 11 "PARK_PENDING" 10 "DYNAMIC_PARK" 9 "DIAGNOSTIC_OPEN" 8 "DIAGNOSTIC_PARK" 7 "SERVICE" 6 "WINCHMODE" 5 "SUMMON" 4 "DYNAMIC" 3 "OPEN" 2 "REAPPLY" 1 "PARK" 0 "INIT" ;
VAL_ 1448 EPBR_a182_epbSystemStatus 8 "MISMATCH" 7 "FAULT_SECURE" 6 "FAULT" 5 "RELEASING" 4 "PARKING" 3 "DYNAMIC" 2 "PARKED" 1 "RELEASED" 0 "UNKNOWN" ;
VAL_ 1448 EPBR_a183_localCdpState 2 "FAULT" 1 "VALID" 0 "UNKNOWN" ;
VAL_ 1448 EPBR_a183_remoteCdpState 2 "FAULT" 1 "VALID" 0 "UNKNOWN" ;
VAL_ 1448 EPBR_a183_espCdpStatus 2 "INVALID" 1 "VALID" 0 "IDLE" ;
VAL_ 1448 EPBR_a183_esmState 23 "UNKNOWN" 22 "AUTONOMY_DYNAMIC" 21 "AUTONOMY_OPEN" 20 "SYSTEM_DYNAMIC_EXTERNAL" 19 "FREE_ROLL_MODE" 18 "DYNAMIC_EXTERNAL_EXIT" 17 "SERVICE_PENDING" 16 "LATCHED_DYNAMIC_EXTERNAL" 15 "DYNAMIC_PENDING" 14 "DYNAMIC_EXTERNAL" 13 "SUMMON_PARK" 12 "WINCHMODE_PENDING" 11 "PARK_PENDING" 10 "DYNAMIC_PARK" 9 "DIAGNOSTIC_OPEN" 8 "DIAGNOSTIC_PARK" 7 "SERVICE" 6 "WINCHMODE" 5 "SUMMON" 4 "DYNAMIC" 3 "OPEN" 2 "REAPPLY" 1 "PARK" 0 "INIT" ;
VAL_ 1448 EPBR_a183_esmStateRequest 23 "UNKNOWN" 22 "AUTONOMY_DYNAMIC" 21 "AUTONOMY_OPEN" 20 "SYSTEM_DYNAMIC_EXTERNAL" 19 "FREE_ROLL_MODE" 18 "DYNAMIC_EXTERNAL_EXIT" 17 "SERVICE_PENDING" 16 "LATCHED_DYNAMIC_EXTERNAL" 15 "DYNAMIC_PENDING" 14 "DYNAMIC_EXTERNAL" 13 "SUMMON_PARK" 12 "WINCHMODE_PENDING" 11 "PARK_PENDING" 10 "DYNAMIC_PARK" 9 "DIAGNOSTIC_OPEN" 8 "DIAGNOSTIC_PARK" 7 "SERVICE" 6 "WINCHMODE" 5 "SUMMON" 4 "DYNAMIC" 3 "OPEN" 2 "REAPPLY" 1 "PARK" 0 "INIT" ;
VAL_ 1448 EPBR_a183_esmOperationTrigger 50 "ACTIVE_DECEL_DAS_STATIC" 49 "ACTIVE_DECEL_CDP_DOWN" 48 "AP_IS_LEAVING" 47 "RECOVERY_PARK" 46 "SPEED_SOURCES_LOST" 45 "ACTIVE_DECEL_OKTOPARK" 44 "ACTIVE_DECEL_FAST" 43 "STEERING_ACTIVE_DECEL" 42 "LV_ACTIVE_DECEL" 41 "CDP_PANIC_MODE_READY" 40 "CDP_PANIC_MODE_TIMEOUT" 39 "DI_PARK" 38 "FREE_ROLL_PARK_FOR_HANDLE_PULLED" 37 "LOW_BRAKE_FLUID_MODE_DYNAMIC" 36 "LOW_BRAKE_FLUID_MODE_DYNAMIC_PARK" 35 "LOW_BRAKE_FLUID_MODE_PARK" 34 "STATIONARY_DETECT" 33 "TOUCHSCREEN_INVALID" 32 "UI_DOOR_OPEN_REQUEST" 31 "AUTOPARK_END" 30 "DRIVER_IS_LEAVING" 29 "SYSTEM_APPLY" 28 "ACCELERATION" 27 "EPBM_DISQUALIFIED" 26 "DISQUALIFIED" 25 "SUMMON_FAULT" 24 "FAULT" 23 "SUMMON_COMPLETE" 22 "REAPPLY" 21 "SAVESTATE_ON_BOOT" 20 "TIMEOUT" 19 "SPEED_FAST" 18 "SPEED_OKAYTOPARK" 17 "SPEED_STOPPED" 16 "USER_CANCEL" 15 "USER_CONFIRMED" 14 "DIAG_EXIT" 13 "DIAG_OPEN" 12 "DIAG_CLOSE" 11 "SERVICE" 10 "WINCHMODE_UNAVAILABLE" 9 "WINCHMODE_ENTER" 8 "WINCHMODE_EXIT" 7 "TOUCHSCREEN" 6 "DI_UNPARK" 5 "ACTIVE_PARK_REQUEST" 4 "PBUTTON_RELEASED" 3 "PBUTTON_PRESSED_UNKNOWN" 2 "PBUTTON_PRESSED_FAST" 1 "PBUTTON_PRESSED_OKTOPARK" 0 "PBUTTON_PRESSED_STOPPED" ;
VAL_ 1448 EPBR_a184_esmOpTrigger 50 "ACTIVE_DECEL_DAS_STATIC" 49 "ACTIVE_DECEL_CDP_DOWN" 48 "AP_IS_LEAVING" 47 "RECOVERY_PARK" 46 "SPEED_SOURCES_LOST" 45 "ACTIVE_DECEL_OKTOPARK" 44 "ACTIVE_DECEL_FAST" 43 "STEERING_ACTIVE_DECEL" 42 "LV_ACTIVE_DECEL" 41 "CDP_PANIC_MODE_READY" 40 "CDP_PANIC_MODE_TIMEOUT" 39 "DI_PARK" 38 "FREE_ROLL_PARK_FOR_HANDLE_PULLED" 37 "LOW_BRAKE_FLUID_MODE_DYNAMIC" 36 "LOW_BRAKE_FLUID_MODE_DYNAMIC_PARK" 35 "LOW_BRAKE_FLUID_MODE_PARK" 34 "STATIONARY_DETECT" 33 "TOUCHSCREEN_INVALID" 32 "UI_DOOR_OPEN_REQUEST" 31 "AUTOPARK_END" 30 "DRIVER_IS_LEAVING" 29 "SYSTEM_APPLY" 28 "ACCELERATION" 27 "EPBM_DISQUALIFIED" 26 "DISQUALIFIED" 25 "SUMMON_FAULT" 24 "FAULT" 23 "SUMMON_COMPLETE" 22 "REAPPLY" 21 "SAVESTATE_ON_BOOT" 20 "TIMEOUT" 19 "SPEED_FAST" 18 "SPEED_OKAYTOPARK" 17 "SPEED_STOPPED" 16 "USER_CANCEL" 15 "USER_CONFIRMED" 14 "DIAG_EXIT" 13 "DIAG_OPEN" 12 "DIAG_CLOSE" 11 "SERVICE" 10 "WINCHMODE_UNAVAILABLE" 9 "WINCHMODE_ENTER" 8 "WINCHMODE_EXIT" 7 "TOUCHSCREEN" 6 "DI_UNPARK" 5 "ACTIVE_PARK_REQUEST" 4 "PBUTTON_RELEASED" 3 "PBUTTON_PRESSED_UNKNOWN" 2 "PBUTTON_PRESSED_FAST" 1 "PBUTTON_PRESSED_OKTOPARK" 0 "PBUTTON_PRESSED_STOPPED" ;
VAL_ 1448 EPBR_a184_previousState 23 "UNKNOWN" 22 "AUTONOMY_DYNAMIC" 21 "AUTONOMY_OPEN" 20 "SYSTEM_DYNAMIC_EXTERNAL" 19 "FREE_ROLL_MODE" 18 "DYNAMIC_EXTERNAL_EXIT" 17 "SERVICE_PENDING" 16 "LATCHED_DYNAMIC_EXTERNAL" 15 "DYNAMIC_PENDING" 14 "DYNAMIC_EXTERNAL" 13 "SUMMON_PARK" 12 "WINCHMODE_PENDING" 11 "PARK_PENDING" 10 "DYNAMIC_PARK" 9 "DIAGNOSTIC_OPEN" 8 "DIAGNOSTIC_PARK" 7 "SERVICE" 6 "WINCHMODE" 5 "SUMMON" 4 "DYNAMIC" 3 "OPEN" 2 "REAPPLY" 1 "PARK" 0 "INIT" ;
VAL_ 1448 EPBR_a184_nextState 23 "UNKNOWN" 22 "AUTONOMY_DYNAMIC" 21 "AUTONOMY_OPEN" 20 "SYSTEM_DYNAMIC_EXTERNAL" 19 "FREE_ROLL_MODE" 18 "DYNAMIC_EXTERNAL_EXIT" 17 "SERVICE_PENDING" 16 "LATCHED_DYNAMIC_EXTERNAL" 15 "DYNAMIC_PENDING" 14 "DYNAMIC_EXTERNAL" 13 "SUMMON_PARK" 12 "WINCHMODE_PENDING" 11 "PARK_PENDING" 10 "DYNAMIC_PARK" 9 "DIAGNOSTIC_OPEN" 8 "DIAGNOSTIC_PARK" 7 "SERVICE" 6 "WINCHMODE" 5 "SUMMON" 4 "DYNAMIC" 3 "OPEN" 2 "REAPPLY" 1 "PARK" 0 "INIT" ;
VAL_ 1448 EPBR_a187_esmOpTrigger 50 "ACTIVE_DECEL_DAS_STATIC" 49 "ACTIVE_DECEL_CDP_DOWN" 48 "AP_IS_LEAVING" 47 "RECOVERY_PARK" 46 "SPEED_SOURCES_LOST" 45 "ACTIVE_DECEL_OKTOPARK" 44 "ACTIVE_DECEL_FAST" 43 "STEERING_ACTIVE_DECEL" 42 "LV_ACTIVE_DECEL" 41 "CDP_PANIC_MODE_READY" 40 "CDP_PANIC_MODE_TIMEOUT" 39 "DI_PARK" 38 "FREE_ROLL_PARK_FOR_HANDLE_PULLED" 37 "LOW_BRAKE_FLUID_MODE_DYNAMIC" 36 "LOW_BRAKE_FLUID_MODE_DYNAMIC_PARK" 35 "LOW_BRAKE_FLUID_MODE_PARK" 34 "STATIONARY_DETECT" 33 "TOUCHSCREEN_INVALID" 32 "UI_DOOR_OPEN_REQUEST" 31 "AUTOPARK_END" 30 "DRIVER_IS_LEAVING" 29 "SYSTEM_APPLY" 28 "ACCELERATION" 27 "EPBM_DISQUALIFIED" 26 "DISQUALIFIED" 25 "SUMMON_FAULT" 24 "FAULT" 23 "SUMMON_COMPLETE" 22 "REAPPLY" 21 "SAVESTATE_ON_BOOT" 20 "TIMEOUT" 19 "SPEED_FAST" 18 "SPEED_OKAYTOPARK" 17 "SPEED_STOPPED" 16 "USER_CANCEL" 15 "USER_CONFIRMED" 14 "DIAG_EXIT" 13 "DIAG_OPEN" 12 "DIAG_CLOSE" 11 "SERVICE" 10 "WINCHMODE_UNAVAILABLE" 9 "WINCHMODE_ENTER" 8 "WINCHMODE_EXIT" 7 "TOUCHSCREEN" 6 "DI_UNPARK" 5 "ACTIVE_PARK_REQUEST" 4 "PBUTTON_RELEASED" 3 "PBUTTON_PRESSED_UNKNOWN" 2 "PBUTTON_PRESSED_FAST" 1 "PBUTTON_PRESSED_OKTOPARK" 0 "PBUTTON_PRESSED_STOPPED" ;
VAL_ 1448 EPBR_a187_previousState 23 "UNKNOWN" 22 "AUTONOMY_DYNAMIC" 21 "AUTONOMY_OPEN" 20 "SYSTEM_DYNAMIC_EXTERNAL" 19 "FREE_ROLL_MODE" 18 "DYNAMIC_EXTERNAL_EXIT" 17 "SERVICE_PENDING" 16 "LATCHED_DYNAMIC_EXTERNAL" 15 "DYNAMIC_PENDING" 14 "DYNAMIC_EXTERNAL" 13 "SUMMON_PARK" 12 "WINCHMODE_PENDING" 11 "PARK_PENDING" 10 "DYNAMIC_PARK" 9 "DIAGNOSTIC_OPEN" 8 "DIAGNOSTIC_PARK" 7 "SERVICE" 6 "WINCHMODE" 5 "SUMMON" 4 "DYNAMIC" 3 "OPEN" 2 "REAPPLY" 1 "PARK" 0 "INIT" ;
VAL_ 1448 EPBR_a187_nextState 23 "UNKNOWN" 22 "AUTONOMY_DYNAMIC" 21 "AUTONOMY_OPEN" 20 "SYSTEM_DYNAMIC_EXTERNAL" 19 "FREE_ROLL_MODE" 18 "DYNAMIC_EXTERNAL_EXIT" 17 "SERVICE_PENDING" 16 "LATCHED_DYNAMIC_EXTERNAL" 15 "DYNAMIC_PENDING" 14 "DYNAMIC_EXTERNAL" 13 "SUMMON_PARK" 12 "WINCHMODE_PENDING" 11 "PARK_PENDING" 10 "DYNAMIC_PARK" 9 "DIAGNOSTIC_OPEN" 8 "DIAGNOSTIC_PARK" 7 "SERVICE" 6 "WINCHMODE" 5 "SUMMON" 4 "DYNAMIC" 3 "OPEN" 2 "REAPPLY" 1 "PARK" 0 "INIT" ;
VAL_ 1448 EPBR_a188_esmOpTrigger 50 "ACTIVE_DECEL_DAS_STATIC" 49 "ACTIVE_DECEL_CDP_DOWN" 48 "AP_IS_LEAVING" 47 "RECOVERY_PARK" 46 "SPEED_SOURCES_LOST" 45 "ACTIVE_DECEL_OKTOPARK" 44 "ACTIVE_DECEL_FAST" 43 "STEERING_ACTIVE_DECEL" 42 "LV_ACTIVE_DECEL" 41 "CDP_PANIC_MODE_READY" 40 "CDP_PANIC_MODE_TIMEOUT" 39 "DI_PARK" 38 "FREE_ROLL_PARK_FOR_HANDLE_PULLED" 37 "LOW_BRAKE_FLUID_MODE_DYNAMIC" 36 "LOW_BRAKE_FLUID_MODE_DYNAMIC_PARK" 35 "LOW_BRAKE_FLUID_MODE_PARK" 34 "STATIONARY_DETECT" 33 "TOUCHSCREEN_INVALID" 32 "UI_DOOR_OPEN_REQUEST" 31 "AUTOPARK_END" 30 "DRIVER_IS_LEAVING" 29 "SYSTEM_APPLY" 28 "ACCELERATION" 27 "EPBM_DISQUALIFIED" 26 "DISQUALIFIED" 25 "SUMMON_FAULT" 24 "FAULT" 23 "SUMMON_COMPLETE" 22 "REAPPLY" 21 "SAVESTATE_ON_BOOT" 20 "TIMEOUT" 19 "SPEED_FAST" 18 "SPEED_OKAYTOPARK" 17 "SPEED_STOPPED" 16 "USER_CANCEL" 15 "USER_CONFIRMED" 14 "DIAG_EXIT" 13 "DIAG_OPEN" 12 "DIAG_CLOSE" 11 "SERVICE" 10 "WINCHMODE_UNAVAILABLE" 9 "WINCHMODE_ENTER" 8 "WINCHMODE_EXIT" 7 "TOUCHSCREEN" 6 "DI_UNPARK" 5 "ACTIVE_PARK_REQUEST" 4 "PBUTTON_RELEASED" 3 "PBUTTON_PRESSED_UNKNOWN" 2 "PBUTTON_PRESSED_FAST" 1 "PBUTTON_PRESSED_OKTOPARK" 0 "PBUTTON_PRESSED_STOPPED" ;
VAL_ 1448 EPBR_a188_previousState 23 "UNKNOWN" 22 "AUTONOMY_DYNAMIC" 21 "AUTONOMY_OPEN" 20 "SYSTEM_DYNAMIC_EXTERNAL" 19 "FREE_ROLL_MODE" 18 "DYNAMIC_EXTERNAL_EXIT" 17 "SERVICE_PENDING" 16 "LATCHED_DYNAMIC_EXTERNAL" 15 "DYNAMIC_PENDING" 14 "DYNAMIC_EXTERNAL" 13 "SUMMON_PARK" 12 "WINCHMODE_PENDING" 11 "PARK_PENDING" 10 "DYNAMIC_PARK" 9 "DIAGNOSTIC_OPEN" 8 "DIAGNOSTIC_PARK" 7 "SERVICE" 6 "WINCHMODE" 5 "SUMMON" 4 "DYNAMIC" 3 "OPEN" 2 "REAPPLY" 1 "PARK" 0 "INIT" ;
VAL_ 1448 EPBR_a188_nextState 23 "UNKNOWN" 22 "AUTONOMY_DYNAMIC" 21 "AUTONOMY_OPEN" 20 "SYSTEM_DYNAMIC_EXTERNAL" 19 "FREE_ROLL_MODE" 18 "DYNAMIC_EXTERNAL_EXIT" 17 "SERVICE_PENDING" 16 "LATCHED_DYNAMIC_EXTERNAL" 15 "DYNAMIC_PENDING" 14 "DYNAMIC_EXTERNAL" 13 "SUMMON_PARK" 12 "WINCHMODE_PENDING" 11 "PARK_PENDING" 10 "DYNAMIC_PARK" 9 "DIAGNOSTIC_OPEN" 8 "DIAGNOSTIC_PARK" 7 "SERVICE" 6 "WINCHMODE" 5 "SUMMON" 4 "DYNAMIC" 3 "OPEN" 2 "REAPPLY" 1 "PARK" 0 "INIT" ;
VAL_ 1448 EPBR_a189_esmOpTrigger 50 "ACTIVE_DECEL_DAS_STATIC" 49 "ACTIVE_DECEL_CDP_DOWN" 48 "AP_IS_LEAVING" 47 "RECOVERY_PARK" 46 "SPEED_SOURCES_LOST" 45 "ACTIVE_DECEL_OKTOPARK" 44 "ACTIVE_DECEL_FAST" 43 "STEERING_ACTIVE_DECEL" 42 "LV_ACTIVE_DECEL" 41 "CDP_PANIC_MODE_READY" 40 "CDP_PANIC_MODE_TIMEOUT" 39 "DI_PARK" 38 "FREE_ROLL_PARK_FOR_HANDLE_PULLED" 37 "LOW_BRAKE_FLUID_MODE_DYNAMIC" 36 "LOW_BRAKE_FLUID_MODE_DYNAMIC_PARK" 35 "LOW_BRAKE_FLUID_MODE_PARK" 34 "STATIONARY_DETECT" 33 "TOUCHSCREEN_INVALID" 32 "UI_DOOR_OPEN_REQUEST" 31 "AUTOPARK_END" 30 "DRIVER_IS_LEAVING" 29 "SYSTEM_APPLY" 28 "ACCELERATION" 27 "EPBM_DISQUALIFIED" 26 "DISQUALIFIED" 25 "SUMMON_FAULT" 24 "FAULT" 23 "SUMMON_COMPLETE" 22 "REAPPLY" 21 "SAVESTATE_ON_BOOT" 20 "TIMEOUT" 19 "SPEED_FAST" 18 "SPEED_OKAYTOPARK" 17 "SPEED_STOPPED" 16 "USER_CANCEL" 15 "USER_CONFIRMED" 14 "DIAG_EXIT" 13 "DIAG_OPEN" 12 "DIAG_CLOSE" 11 "SERVICE" 10 "WINCHMODE_UNAVAILABLE" 9 "WINCHMODE_ENTER" 8 "WINCHMODE_EXIT" 7 "TOUCHSCREEN" 6 "DI_UNPARK" 5 "ACTIVE_PARK_REQUEST" 4 "PBUTTON_RELEASED" 3 "PBUTTON_PRESSED_UNKNOWN" 2 "PBUTTON_PRESSED_FAST" 1 "PBUTTON_PRESSED_OKTOPARK" 0 "PBUTTON_PRESSED_STOPPED" ;
VAL_ 1448 EPBR_a189_previousState 23 "UNKNOWN" 22 "AUTONOMY_DYNAMIC" 21 "AUTONOMY_OPEN" 20 "SYSTEM_DYNAMIC_EXTERNAL" 19 "FREE_ROLL_MODE" 18 "DYNAMIC_EXTERNAL_EXIT" 17 "SERVICE_PENDING" 16 "LATCHED_DYNAMIC_EXTERNAL" 15 "DYNAMIC_PENDING" 14 "DYNAMIC_EXTERNAL" 13 "SUMMON_PARK" 12 "WINCHMODE_PENDING" 11 "PARK_PENDING" 10 "DYNAMIC_PARK" 9 "DIAGNOSTIC_OPEN" 8 "DIAGNOSTIC_PARK" 7 "SERVICE" 6 "WINCHMODE" 5 "SUMMON" 4 "DYNAMIC" 3 "OPEN" 2 "REAPPLY" 1 "PARK" 0 "INIT" ;
VAL_ 1448 EPBR_a189_nextState 23 "UNKNOWN" 22 "AUTONOMY_DYNAMIC" 21 "AUTONOMY_OPEN" 20 "SYSTEM_DYNAMIC_EXTERNAL" 19 "FREE_ROLL_MODE" 18 "DYNAMIC_EXTERNAL_EXIT" 17 "SERVICE_PENDING" 16 "LATCHED_DYNAMIC_EXTERNAL" 15 "DYNAMIC_PENDING" 14 "DYNAMIC_EXTERNAL" 13 "SUMMON_PARK" 12 "WINCHMODE_PENDING" 11 "PARK_PENDING" 10 "DYNAMIC_PARK" 9 "DIAGNOSTIC_OPEN" 8 "DIAGNOSTIC_PARK" 7 "SERVICE" 6 "WINCHMODE" 5 "SUMMON" 4 "DYNAMIC" 3 "OPEN" 2 "REAPPLY" 1 "PARK" 0 "INIT" ;
VAL_ 1448 EPBR_a190_esmState 23 "UNKNOWN" 22 "AUTONOMY_DYNAMIC" 21 "AUTONOMY_OPEN" 20 "SYSTEM_DYNAMIC_EXTERNAL" 19 "FREE_ROLL_MODE" 18 "DYNAMIC_EXTERNAL_EXIT" 17 "SERVICE_PENDING" 16 "LATCHED_DYNAMIC_EXTERNAL" 15 "DYNAMIC_PENDING" 14 "DYNAMIC_EXTERNAL" 13 "SUMMON_PARK" 12 "WINCHMODE_PENDING" 11 "PARK_PENDING" 10 "DYNAMIC_PARK" 9 "DIAGNOSTIC_OPEN" 8 "DIAGNOSTIC_PARK" 7 "SERVICE" 6 "WINCHMODE" 5 "SUMMON" 4 "DYNAMIC" 3 "OPEN" 2 "REAPPLY" 1 "PARK" 0 "INIT" ;
VAL_ 1448 EPBR_a190_esmStateRequest 23 "UNKNOWN" 22 "AUTONOMY_DYNAMIC" 21 "AUTONOMY_OPEN" 20 "SYSTEM_DYNAMIC_EXTERNAL" 19 "FREE_ROLL_MODE" 18 "DYNAMIC_EXTERNAL_EXIT" 17 "SERVICE_PENDING" 16 "LATCHED_DYNAMIC_EXTERNAL" 15 "DYNAMIC_PENDING" 14 "DYNAMIC_EXTERNAL" 13 "SUMMON_PARK" 12 "WINCHMODE_PENDING" 11 "PARK_PENDING" 10 "DYNAMIC_PARK" 9 "DIAGNOSTIC_OPEN" 8 "DIAGNOSTIC_PARK" 7 "SERVICE" 6 "WINCHMODE" 5 "SUMMON" 4 "DYNAMIC" 3 "OPEN" 2 "REAPPLY" 1 "PARK" 0 "INIT" ;
VAL_ 1448 EPBR_a190_faultStatus 3 "FAULT_IDLE" 2 "FAULT" 1 "RETRY" 0 "NOMINAL" ;
VAL_ 1448 EPBR_a190_monitorUnitStatus 23 "COUNT" 22 "AUTONOMY_OPEN" 21 "FREE_ROLL_MODE" 20 "DYNAMIC_PARKING" 19 "EXTERNAL_PARKING" 18 "RELEASING_FOR_EXTERNAL_PARK" 17 "EXTERNAL_DYNAMIC" 16 "SUMMON_PARKING" 15 "SUMMON_RELEASING" 14 "SUMMON" 13 "WINCHMODE_PENDING" 12 "PARK_PENDING" 11 "SERVICE_RELEASING" 10 "RELEASING" 9 "DYNAMIC_APPLYING" 8 "PARKING" 7 "WINCHMODE_RELEASING" 6 "WINCHMODE" 5 "SERVICE" 4 "START" 3 "PARK" 2 "DYNAMIC" 1 "OPEN" 0 "UNKNOWN" ;
VAL_ 1448 EPBR_a190_monitorFaultStatus 3 "FAULT_IDLE" 2 "FAULT" 1 "RETRY" 0 "NOMINAL" ;
VAL_ 1448 EPBR_a190_csmFaultReason 23 "REMOTE_MIA" 22 "NVM_MISMATCH" 21 "EPBM_MIA" 20 "MOTOR_NOT_READY" 19 "MOTOR_ACTIVE_FAULT" 18 "MOTOR_IDLE_FAULT" 17 "TIMEOUT_EPBM_START" 16 "TIMEOUT_NO_RAMP" 15 "TIMEOUT_EPBM_CUTOFF" 14 "TIMEOUT_RELEASE_COMPLETE" 13 "TIMEOUT_RELEASE_NO_LOAD" 12 "TIMEOUT_RELEASE_WAIT_FOR_ENDSTOP" 11 "TIMEOUT_RELEASE_INRUSH" 10 "TIMEOUT_EPBM_WAIT_FOR_CLAMP" 9 "TIMEOUT_EPB_WAIT_FOR_CLAMP" 8 "TIMEOUT_APPLY_INRUSH" 7 "TIMEOUT_APPLY_COMPLETE" 6 "RELEASE_BLOCKED" 5 "APPLY_BLOCKED" 4 "TIMEOUT_CALIBRATE" 3 "STATE_MISMATCH" 2 "EPBM_FAULTED" 1 "EPBM_DISABLED" 0 "NONE" ;
VAL_ 1448 EPBR_a190_esmOpTrigger 50 "ACTIVE_DECEL_DAS_STATIC" 49 "ACTIVE_DECEL_CDP_DOWN" 48 "AP_IS_LEAVING" 47 "RECOVERY_PARK" 46 "SPEED_SOURCES_LOST" 45 "ACTIVE_DECEL_OKTOPARK" 44 "ACTIVE_DECEL_FAST" 43 "STEERING_ACTIVE_DECEL" 42 "LV_ACTIVE_DECEL" 41 "CDP_PANIC_MODE_READY" 40 "CDP_PANIC_MODE_TIMEOUT" 39 "DI_PARK" 38 "FREE_ROLL_PARK_FOR_HANDLE_PULLED" 37 "LOW_BRAKE_FLUID_MODE_DYNAMIC" 36 "LOW_BRAKE_FLUID_MODE_DYNAMIC_PARK" 35 "LOW_BRAKE_FLUID_MODE_PARK" 34 "STATIONARY_DETECT" 33 "TOUCHSCREEN_INVALID" 32 "UI_DOOR_OPEN_REQUEST" 31 "AUTOPARK_END" 30 "DRIVER_IS_LEAVING" 29 "SYSTEM_APPLY" 28 "ACCELERATION" 27 "EPBM_DISQUALIFIED" 26 "DISQUALIFIED" 25 "SUMMON_FAULT" 24 "FAULT" 23 "SUMMON_COMPLETE" 22 "REAPPLY" 21 "SAVESTATE_ON_BOOT" 20 "TIMEOUT" 19 "SPEED_FAST" 18 "SPEED_OKAYTOPARK" 17 "SPEED_STOPPED" 16 "USER_CANCEL" 15 "USER_CONFIRMED" 14 "DIAG_EXIT" 13 "DIAG_OPEN" 12 "DIAG_CLOSE" 11 "SERVICE" 10 "WINCHMODE_UNAVAILABLE" 9 "WINCHMODE_ENTER" 8 "WINCHMODE_EXIT" 7 "TOUCHSCREEN" 6 "DI_UNPARK" 5 "ACTIVE_PARK_REQUEST" 4 "PBUTTON_RELEASED" 3 "PBUTTON_PRESSED_UNKNOWN" 2 "PBUTTON_PRESSED_FAST" 1 "PBUTTON_PRESSED_OKTOPARK" 0 "PBUTTON_PRESSED_STOPPED" ;
VAL_ 1448 EPBR_a190_nonterminalReason 23 "REMOTE_MIA" 22 "NVM_MISMATCH" 21 "EPBM_MIA" 20 "MOTOR_NOT_READY" 19 "MOTOR_ACTIVE_FAULT" 18 "MOTOR_IDLE_FAULT" 17 "TIMEOUT_EPBM_START" 16 "TIMEOUT_NO_RAMP" 15 "TIMEOUT_EPBM_CUTOFF" 14 "TIMEOUT_RELEASE_COMPLETE" 13 "TIMEOUT_RELEASE_NO_LOAD" 12 "TIMEOUT_RELEASE_WAIT_FOR_ENDSTOP" 11 "TIMEOUT_RELEASE_INRUSH" 10 "TIMEOUT_EPBM_WAIT_FOR_CLAMP" 9 "TIMEOUT_EPB_WAIT_FOR_CLAMP" 8 "TIMEOUT_APPLY_INRUSH" 7 "TIMEOUT_APPLY_COMPLETE" 6 "RELEASE_BLOCKED" 5 "APPLY_BLOCKED" 4 "TIMEOUT_CALIBRATE" 3 "STATE_MISMATCH" 2 "EPBM_FAULTED" 1 "EPBM_DISABLED" 0 "NONE" ;
VAL_ 1448 EPBR_a191_esmState 23 "UNKNOWN" 22 "AUTONOMY_DYNAMIC" 21 "AUTONOMY_OPEN" 20 "SYSTEM_DYNAMIC_EXTERNAL" 19 "FREE_ROLL_MODE" 18 "DYNAMIC_EXTERNAL_EXIT" 17 "SERVICE_PENDING" 16 "LATCHED_DYNAMIC_EXTERNAL" 15 "DYNAMIC_PENDING" 14 "DYNAMIC_EXTERNAL" 13 "SUMMON_PARK" 12 "WINCHMODE_PENDING" 11 "PARK_PENDING" 10 "DYNAMIC_PARK" 9 "DIAGNOSTIC_OPEN" 8 "DIAGNOSTIC_PARK" 7 "SERVICE" 6 "WINCHMODE" 5 "SUMMON" 4 "DYNAMIC" 3 "OPEN" 2 "REAPPLY" 1 "PARK" 0 "INIT" ;
VAL_ 1448 EPBR_a191_esmStateRequest 23 "UNKNOWN" 22 "AUTONOMY_DYNAMIC" 21 "AUTONOMY_OPEN" 20 "SYSTEM_DYNAMIC_EXTERNAL" 19 "FREE_ROLL_MODE" 18 "DYNAMIC_EXTERNAL_EXIT" 17 "SERVICE_PENDING" 16 "LATCHED_DYNAMIC_EXTERNAL" 15 "DYNAMIC_PENDING" 14 "DYNAMIC_EXTERNAL" 13 "SUMMON_PARK" 12 "WINCHMODE_PENDING" 11 "PARK_PENDING" 10 "DYNAMIC_PARK" 9 "DIAGNOSTIC_OPEN" 8 "DIAGNOSTIC_PARK" 7 "SERVICE" 6 "WINCHMODE" 5 "SUMMON" 4 "DYNAMIC" 3 "OPEN" 2 "REAPPLY" 1 "PARK" 0 "INIT" ;
VAL_ 1448 EPBR_a191_faultStatus 3 "FAULT_IDLE" 2 "FAULT" 1 "RETRY" 0 "NOMINAL" ;
VAL_ 1448 EPBR_a191_monitorUnitStatus 23 "COUNT" 22 "AUTONOMY_OPEN" 21 "FREE_ROLL_MODE" 20 "DYNAMIC_PARKING" 19 "EXTERNAL_PARKING" 18 "RELEASING_FOR_EXTERNAL_PARK" 17 "EXTERNAL_DYNAMIC" 16 "SUMMON_PARKING" 15 "SUMMON_RELEASING" 14 "SUMMON" 13 "WINCHMODE_PENDING" 12 "PARK_PENDING" 11 "SERVICE_RELEASING" 10 "RELEASING" 9 "DYNAMIC_APPLYING" 8 "PARKING" 7 "WINCHMODE_RELEASING" 6 "WINCHMODE" 5 "SERVICE" 4 "START" 3 "PARK" 2 "DYNAMIC" 1 "OPEN" 0 "UNKNOWN" ;
VAL_ 1448 EPBR_a191_monitorFaultStatus 3 "FAULT_IDLE" 2 "FAULT" 1 "RETRY" 0 "NOMINAL" ;
VAL_ 1448 EPBR_a191_csmFaultReason 23 "REMOTE_MIA" 22 "NVM_MISMATCH" 21 "EPBM_MIA" 20 "MOTOR_NOT_READY" 19 "MOTOR_ACTIVE_FAULT" 18 "MOTOR_IDLE_FAULT" 17 "TIMEOUT_EPBM_START" 16 "TIMEOUT_NO_RAMP" 15 "TIMEOUT_EPBM_CUTOFF" 14 "TIMEOUT_RELEASE_COMPLETE" 13 "TIMEOUT_RELEASE_NO_LOAD" 12 "TIMEOUT_RELEASE_WAIT_FOR_ENDSTOP" 11 "TIMEOUT_RELEASE_INRUSH" 10 "TIMEOUT_EPBM_WAIT_FOR_CLAMP" 9 "TIMEOUT_EPB_WAIT_FOR_CLAMP" 8 "TIMEOUT_APPLY_INRUSH" 7 "TIMEOUT_APPLY_COMPLETE" 6 "RELEASE_BLOCKED" 5 "APPLY_BLOCKED" 4 "TIMEOUT_CALIBRATE" 3 "STATE_MISMATCH" 2 "EPBM_FAULTED" 1 "EPBM_DISABLED" 0 "NONE" ;
VAL_ 1448 EPBR_a191_esmOpTrigger 50 "ACTIVE_DECEL_DAS_STATIC" 49 "ACTIVE_DECEL_CDP_DOWN" 48 "AP_IS_LEAVING" 47 "RECOVERY_PARK" 46 "SPEED_SOURCES_LOST" 45 "ACTIVE_DECEL_OKTOPARK" 44 "ACTIVE_DECEL_FAST" 43 "STEERING_ACTIVE_DECEL" 42 "LV_ACTIVE_DECEL" 41 "CDP_PANIC_MODE_READY" 40 "CDP_PANIC_MODE_TIMEOUT" 39 "DI_PARK" 38 "FREE_ROLL_PARK_FOR_HANDLE_PULLED" 37 "LOW_BRAKE_FLUID_MODE_DYNAMIC" 36 "LOW_BRAKE_FLUID_MODE_DYNAMIC_PARK" 35 "LOW_BRAKE_FLUID_MODE_PARK" 34 "STATIONARY_DETECT" 33 "TOUCHSCREEN_INVALID" 32 "UI_DOOR_OPEN_REQUEST" 31 "AUTOPARK_END" 30 "DRIVER_IS_LEAVING" 29 "SYSTEM_APPLY" 28 "ACCELERATION" 27 "EPBM_DISQUALIFIED" 26 "DISQUALIFIED" 25 "SUMMON_FAULT" 24 "FAULT" 23 "SUMMON_COMPLETE" 22 "REAPPLY" 21 "SAVESTATE_ON_BOOT" 20 "TIMEOUT" 19 "SPEED_FAST" 18 "SPEED_OKAYTOPARK" 17 "SPEED_STOPPED" 16 "USER_CANCEL" 15 "USER_CONFIRMED" 14 "DIAG_EXIT" 13 "DIAG_OPEN" 12 "DIAG_CLOSE" 11 "SERVICE" 10 "WINCHMODE_UNAVAILABLE" 9 "WINCHMODE_ENTER" 8 "WINCHMODE_EXIT" 7 "TOUCHSCREEN" 6 "DI_UNPARK" 5 "ACTIVE_PARK_REQUEST" 4 "PBUTTON_RELEASED" 3 "PBUTTON_PRESSED_UNKNOWN" 2 "PBUTTON_PRESSED_FAST" 1 "PBUTTON_PRESSED_OKTOPARK" 0 "PBUTTON_PRESSED_STOPPED" ;
VAL_ 1448 EPBR_a191_nonterminalReason 23 "REMOTE_MIA" 22 "NVM_MISMATCH" 21 "EPBM_MIA" 20 "MOTOR_NOT_READY" 19 "MOTOR_ACTIVE_FAULT" 18 "MOTOR_IDLE_FAULT" 17 "TIMEOUT_EPBM_START" 16 "TIMEOUT_NO_RAMP" 15 "TIMEOUT_EPBM_CUTOFF" 14 "TIMEOUT_RELEASE_COMPLETE" 13 "TIMEOUT_RELEASE_NO_LOAD" 12 "TIMEOUT_RELEASE_WAIT_FOR_ENDSTOP" 11 "TIMEOUT_RELEASE_INRUSH" 10 "TIMEOUT_EPBM_WAIT_FOR_CLAMP" 9 "TIMEOUT_EPB_WAIT_FOR_CLAMP" 8 "TIMEOUT_APPLY_INRUSH" 7 "TIMEOUT_APPLY_COMPLETE" 6 "RELEASE_BLOCKED" 5 "APPLY_BLOCKED" 4 "TIMEOUT_CALIBRATE" 3 "STATE_MISMATCH" 2 "EPBM_FAULTED" 1 "EPBM_DISABLED" 0 "NONE" ;
VAL_ 1448 EPBR_a202_localEpbConfig 11 "CT_MANDO" 10 "MODEL3_ZF" 9 "MODELS_CERAMIC" 8 "MODELY_PERFORMANCE_V2" 7 "MODEL3_PERFORMANCE_V2" 6 "MODELX_BASE" 5 "MODELY_PERFORMANCE" 4 "MODELY_BASE" 3 "MODELS_BASE" 2 "MODEL3_PERFORMANCE" 1 "MODEL3_BASE" 0 "UNKNOWN" ;
VAL_ 1448 EPBR_a202_remoteEpbConfig 11 "CT_MANDO" 10 "MODEL3_ZF" 9 "MODELS_CERAMIC" 8 "MODELY_PERFORMANCE_V2" 7 "MODEL3_PERFORMANCE_V2" 6 "MODELX_BASE" 5 "MODELY_PERFORMANCE" 4 "MODELY_BASE" 3 "MODELS_BASE" 2 "MODEL3_PERFORMANCE" 1 "MODEL3_BASE" 0 "UNKNOWN" ;
VAL_ 1448 EPBR_a203_gtwConfig 11 "CT_MANDO" 10 "MODEL3_ZF" 9 "MODELS_CERAMIC" 8 "MODELY_PERFORMANCE_V2" 7 "MODEL3_PERFORMANCE_V2" 6 "MODELX_BASE" 5 "MODELY_PERFORMANCE" 4 "MODELY_BASE" 3 "MODELS_BASE" 2 "MODEL3_PERFORMANCE" 1 "MODEL3_BASE" 0 "UNKNOWN" ;
VAL_ 1448 EPBR_a203_epbConfig 11 "CT_MANDO" 10 "MODEL3_ZF" 9 "MODELS_CERAMIC" 8 "MODELY_PERFORMANCE_V2" 7 "MODEL3_PERFORMANCE_V2" 6 "MODELX_BASE" 5 "MODELY_PERFORMANCE" 4 "MODELY_BASE" 3 "MODELS_BASE" 2 "MODEL3_PERFORMANCE" 1 "MODEL3_BASE" 0 "UNKNOWN" ;
VAL_ 1448 EPBR_a225_esmOpTrigger 50 "ACTIVE_DECEL_DAS_STATIC" 49 "ACTIVE_DECEL_CDP_DOWN" 48 "AP_IS_LEAVING" 47 "RECOVERY_PARK" 46 "SPEED_SOURCES_LOST" 45 "ACTIVE_DECEL_OKTOPARK" 44 "ACTIVE_DECEL_FAST" 43 "STEERING_ACTIVE_DECEL" 42 "LV_ACTIVE_DECEL" 41 "CDP_PANIC_MODE_READY" 40 "CDP_PANIC_MODE_TIMEOUT" 39 "DI_PARK" 38 "FREE_ROLL_PARK_FOR_HANDLE_PULLED" 37 "LOW_BRAKE_FLUID_MODE_DYNAMIC" 36 "LOW_BRAKE_FLUID_MODE_DYNAMIC_PARK" 35 "LOW_BRAKE_FLUID_MODE_PARK" 34 "STATIONARY_DETECT" 33 "TOUCHSCREEN_INVALID" 32 "UI_DOOR_OPEN_REQUEST" 31 "AUTOPARK_END" 30 "DRIVER_IS_LEAVING" 29 "SYSTEM_APPLY" 28 "ACCELERATION" 27 "EPBM_DISQUALIFIED" 26 "DISQUALIFIED" 25 "SUMMON_FAULT" 24 "FAULT" 23 "SUMMON_COMPLETE" 22 "REAPPLY" 21 "SAVESTATE_ON_BOOT" 20 "TIMEOUT" 19 "SPEED_FAST" 18 "SPEED_OKAYTOPARK" 17 "SPEED_STOPPED" 16 "USER_CANCEL" 15 "USER_CONFIRMED" 14 "DIAG_EXIT" 13 "DIAG_OPEN" 12 "DIAG_CLOSE" 11 "SERVICE" 10 "WINCHMODE_UNAVAILABLE" 9 "WINCHMODE_ENTER" 8 "WINCHMODE_EXIT" 7 "TOUCHSCREEN" 6 "DI_UNPARK" 5 "ACTIVE_PARK_REQUEST" 4 "PBUTTON_RELEASED" 3 "PBUTTON_PRESSED_UNKNOWN" 2 "PBUTTON_PRESSED_FAST" 1 "PBUTTON_PRESSED_OKTOPARK" 0 "PBUTTON_PRESSED_STOPPED" ;
VAL_ 1448 EPBR_a225_previousState 23 "UNKNOWN" 22 "AUTONOMY_DYNAMIC" 21 "AUTONOMY_OPEN" 20 "SYSTEM_DYNAMIC_EXTERNAL" 19 "FREE_ROLL_MODE" 18 "DYNAMIC_EXTERNAL_EXIT" 17 "SERVICE_PENDING" 16 "LATCHED_DYNAMIC_EXTERNAL" 15 "DYNAMIC_PENDING" 14 "DYNAMIC_EXTERNAL" 13 "SUMMON_PARK" 12 "WINCHMODE_PENDING" 11 "PARK_PENDING" 10 "DYNAMIC_PARK" 9 "DIAGNOSTIC_OPEN" 8 "DIAGNOSTIC_PARK" 7 "SERVICE" 6 "WINCHMODE" 5 "SUMMON" 4 "DYNAMIC" 3 "OPEN" 2 "REAPPLY" 1 "PARK" 0 "INIT" ;
VAL_ 1448 EPBR_a225_nextState 23 "UNKNOWN" 22 "AUTONOMY_DYNAMIC" 21 "AUTONOMY_OPEN" 20 "SYSTEM_DYNAMIC_EXTERNAL" 19 "FREE_ROLL_MODE" 18 "DYNAMIC_EXTERNAL_EXIT" 17 "SERVICE_PENDING" 16 "LATCHED_DYNAMIC_EXTERNAL" 15 "DYNAMIC_PENDING" 14 "DYNAMIC_EXTERNAL" 13 "SUMMON_PARK" 12 "WINCHMODE_PENDING" 11 "PARK_PENDING" 10 "DYNAMIC_PARK" 9 "DIAGNOSTIC_OPEN" 8 "DIAGNOSTIC_PARK" 7 "SERVICE" 6 "WINCHMODE" 5 "SUMMON" 4 "DYNAMIC" 3 "OPEN" 2 "REAPPLY" 1 "PARK" 0 "INIT" ;
VAL_ 1448 EPBR_a241_epbSysStatus 8 "MISMATCH" 7 "FAULT_SECURE" 6 "FAULT" 5 "RELEASING" 4 "PARKING" 3 "DYNAMIC" 2 "PARKED" 1 "RELEASED" 0 "UNKNOWN" ;
VAL_ 1448 EPBR_a241_vehiclePowerState 3 "DRIVE" 2 "ACCESSORY" 1 "CONDITIONING" 0 "OFF" ;
VAL_ 1448 EPBR_a242_hvState 6 "UP" 5 "UP_FOR_DC_CHARGE" 4 "UP_FOR_CHARGE" 3 "UP_FOR_DRIVE" 2 "GOING_DOWN" 1 "COMING_UP" 0 "DOWN" ;
VAL_ 1448 EPBR_a242_vehiclePowerState 3 "DRIVE" 2 "ACCESSORY" 1 "CONDITIONING" 0 "OFF" ;
VAL_ 1448 EPBR_a246_previousState 23 "UNKNOWN" 22 "AUTONOMY_DYNAMIC" 21 "AUTONOMY_OPEN" 20 "SYSTEM_DYNAMIC_EXTERNAL" 19 "FREE_ROLL_MODE" 18 "DYNAMIC_EXTERNAL_EXIT" 17 "SERVICE_PENDING" 16 "LATCHED_DYNAMIC_EXTERNAL" 15 "DYNAMIC_PENDING" 14 "DYNAMIC_EXTERNAL" 13 "SUMMON_PARK" 12 "WINCHMODE_PENDING" 11 "PARK_PENDING" 10 "DYNAMIC_PARK" 9 "DIAGNOSTIC_OPEN" 8 "DIAGNOSTIC_PARK" 7 "SERVICE" 6 "WINCHMODE" 5 "SUMMON" 4 "DYNAMIC" 3 "OPEN" 2 "REAPPLY" 1 "PARK" 0 "INIT" ;
VAL_ 1448 EPBR_a246_nextState 23 "UNKNOWN" 22 "AUTONOMY_DYNAMIC" 21 "AUTONOMY_OPEN" 20 "SYSTEM_DYNAMIC_EXTERNAL" 19 "FREE_ROLL_MODE" 18 "DYNAMIC_EXTERNAL_EXIT" 17 "SERVICE_PENDING" 16 "LATCHED_DYNAMIC_EXTERNAL" 15 "DYNAMIC_PENDING" 14 "DYNAMIC_EXTERNAL" 13 "SUMMON_PARK" 12 "WINCHMODE_PENDING" 11 "PARK_PENDING" 10 "DYNAMIC_PARK" 9 "DIAGNOSTIC_OPEN" 8 "DIAGNOSTIC_PARK" 7 "SERVICE" 6 "WINCHMODE" 5 "SUMMON" 4 "DYNAMIC" 3 "OPEN" 2 "REAPPLY" 1 "PARK" 0 "INIT" ;
VAL_ 1448 EPBR_a246_esmStateRequest 23 "UNKNOWN" 22 "AUTONOMY_DYNAMIC" 21 "AUTONOMY_OPEN" 20 "SYSTEM_DYNAMIC_EXTERNAL" 19 "FREE_ROLL_MODE" 18 "DYNAMIC_EXTERNAL_EXIT" 17 "SERVICE_PENDING" 16 "LATCHED_DYNAMIC_EXTERNAL" 15 "DYNAMIC_PENDING" 14 "DYNAMIC_EXTERNAL" 13 "SUMMON_PARK" 12 "WINCHMODE_PENDING" 11 "PARK_PENDING" 10 "DYNAMIC_PARK" 9 "DIAGNOSTIC_OPEN" 8 "DIAGNOSTIC_PARK" 7 "SERVICE" 6 "WINCHMODE" 5 "SUMMON" 4 "DYNAMIC" 3 "OPEN" 2 "REAPPLY" 1 "PARK" 0 "INIT" ;
VAL_ 1448 EPBR_a246_faultStatus 3 "FAULT_IDLE" 2 "FAULT" 1 "RETRY" 0 "NOMINAL" ;
VAL_ 1448 EPBR_a246_esmOpTrigger 50 "ACTIVE_DECEL_DAS_STATIC" 49 "ACTIVE_DECEL_CDP_DOWN" 48 "AP_IS_LEAVING" 47 "RECOVERY_PARK" 46 "SPEED_SOURCES_LOST" 45 "ACTIVE_DECEL_OKTOPARK" 44 "ACTIVE_DECEL_FAST" 43 "STEERING_ACTIVE_DECEL" 42 "LV_ACTIVE_DECEL" 41 "CDP_PANIC_MODE_READY" 40 "CDP_PANIC_MODE_TIMEOUT" 39 "DI_PARK" 38 "FREE_ROLL_PARK_FOR_HANDLE_PULLED" 37 "LOW_BRAKE_FLUID_MODE_DYNAMIC" 36 "LOW_BRAKE_FLUID_MODE_DYNAMIC_PARK" 35 "LOW_BRAKE_FLUID_MODE_PARK" 34 "STATIONARY_DETECT" 33 "TOUCHSCREEN_INVALID" 32 "UI_DOOR_OPEN_REQUEST" 31 "AUTOPARK_END" 30 "DRIVER_IS_LEAVING" 29 "SYSTEM_APPLY" 28 "ACCELERATION" 27 "EPBM_DISQUALIFIED" 26 "DISQUALIFIED" 25 "SUMMON_FAULT" 24 "FAULT" 23 "SUMMON_COMPLETE" 22 "REAPPLY" 21 "SAVESTATE_ON_BOOT" 20 "TIMEOUT" 19 "SPEED_FAST" 18 "SPEED_OKAYTOPARK" 17 "SPEED_STOPPED" 16 "USER_CANCEL" 15 "USER_CONFIRMED" 14 "DIAG_EXIT" 13 "DIAG_OPEN" 12 "DIAG_CLOSE" 11 "SERVICE" 10 "WINCHMODE_UNAVAILABLE" 9 "WINCHMODE_ENTER" 8 "WINCHMODE_EXIT" 7 "TOUCHSCREEN" 6 "DI_UNPARK" 5 "ACTIVE_PARK_REQUEST" 4 "PBUTTON_RELEASED" 3 "PBUTTON_PRESSED_UNKNOWN" 2 "PBUTTON_PRESSED_FAST" 1 "PBUTTON_PRESSED_OKTOPARK" 0 "PBUTTON_PRESSED_STOPPED" ;
VAL_ 1448 EPBR_a247_esmState 23 "UNKNOWN" 22 "AUTONOMY_DYNAMIC" 21 "AUTONOMY_OPEN" 20 "SYSTEM_DYNAMIC_EXTERNAL" 19 "FREE_ROLL_MODE" 18 "DYNAMIC_EXTERNAL_EXIT" 17 "SERVICE_PENDING" 16 "LATCHED_DYNAMIC_EXTERNAL" 15 "DYNAMIC_PENDING" 14 "DYNAMIC_EXTERNAL" 13 "SUMMON_PARK" 12 "WINCHMODE_PENDING" 11 "PARK_PENDING" 10 "DYNAMIC_PARK" 9 "DIAGNOSTIC_OPEN" 8 "DIAGNOSTIC_PARK" 7 "SERVICE" 6 "WINCHMODE" 5 "SUMMON" 4 "DYNAMIC" 3 "OPEN" 2 "REAPPLY" 1 "PARK" 0 "INIT" ;
VAL_ 1448 EPBR_a247_esmStateRequest 23 "UNKNOWN" 22 "AUTONOMY_DYNAMIC" 21 "AUTONOMY_OPEN" 20 "SYSTEM_DYNAMIC_EXTERNAL" 19 "FREE_ROLL_MODE" 18 "DYNAMIC_EXTERNAL_EXIT" 17 "SERVICE_PENDING" 16 "LATCHED_DYNAMIC_EXTERNAL" 15 "DYNAMIC_PENDING" 14 "DYNAMIC_EXTERNAL" 13 "SUMMON_PARK" 12 "WINCHMODE_PENDING" 11 "PARK_PENDING" 10 "DYNAMIC_PARK" 9 "DIAGNOSTIC_OPEN" 8 "DIAGNOSTIC_PARK" 7 "SERVICE" 6 "WINCHMODE" 5 "SUMMON" 4 "DYNAMIC" 3 "OPEN" 2 "REAPPLY" 1 "PARK" 0 "INIT" ;
VAL_ 1448 EPBR_a247_faultStatus 3 "FAULT_IDLE" 2 "FAULT" 1 "RETRY" 0 "NOMINAL" ;
VAL_ 1448 EPBR_a247_monitorUnitStatus 23 "COUNT" 22 "AUTONOMY_OPEN" 21 "FREE_ROLL_MODE" 20 "DYNAMIC_PARKING" 19 "EXTERNAL_PARKING" 18 "RELEASING_FOR_EXTERNAL_PARK" 17 "EXTERNAL_DYNAMIC" 16 "SUMMON_PARKING" 15 "SUMMON_RELEASING" 14 "SUMMON" 13 "WINCHMODE_PENDING" 12 "PARK_PENDING" 11 "SERVICE_RELEASING" 10 "RELEASING" 9 "DYNAMIC_APPLYING" 8 "PARKING" 7 "WINCHMODE_RELEASING" 6 "WINCHMODE" 5 "SERVICE" 4 "START" 3 "PARK" 2 "DYNAMIC" 1 "OPEN" 0 "UNKNOWN" ;
VAL_ 1448 EPBR_a247_monitorFaultStatus 3 "FAULT_IDLE" 2 "FAULT" 1 "RETRY" 0 "NOMINAL" ;
VAL_ 1448 EPBR_a247_csmFaultReason 23 "REMOTE_MIA" 22 "NVM_MISMATCH" 21 "EPBM_MIA" 20 "MOTOR_NOT_READY" 19 "MOTOR_ACTIVE_FAULT" 18 "MOTOR_IDLE_FAULT" 17 "TIMEOUT_EPBM_START" 16 "TIMEOUT_NO_RAMP" 15 "TIMEOUT_EPBM_CUTOFF" 14 "TIMEOUT_RELEASE_COMPLETE" 13 "TIMEOUT_RELEASE_NO_LOAD" 12 "TIMEOUT_RELEASE_WAIT_FOR_ENDSTOP" 11 "TIMEOUT_RELEASE_INRUSH" 10 "TIMEOUT_EPBM_WAIT_FOR_CLAMP" 9 "TIMEOUT_EPB_WAIT_FOR_CLAMP" 8 "TIMEOUT_APPLY_INRUSH" 7 "TIMEOUT_APPLY_COMPLETE" 6 "RELEASE_BLOCKED" 5 "APPLY_BLOCKED" 4 "TIMEOUT_CALIBRATE" 3 "STATE_MISMATCH" 2 "EPBM_FAULTED" 1 "EPBM_DISABLED" 0 "NONE" ;
VAL_ 1448 EPBR_a247_esmOpTrigger 50 "ACTIVE_DECEL_DAS_STATIC" 49 "ACTIVE_DECEL_CDP_DOWN" 48 "AP_IS_LEAVING" 47 "RECOVERY_PARK" 46 "SPEED_SOURCES_LOST" 45 "ACTIVE_DECEL_OKTOPARK" 44 "ACTIVE_DECEL_FAST" 43 "STEERING_ACTIVE_DECEL" 42 "LV_ACTIVE_DECEL" 41 "CDP_PANIC_MODE_READY" 40 "CDP_PANIC_MODE_TIMEOUT" 39 "DI_PARK" 38 "FREE_ROLL_PARK_FOR_HANDLE_PULLED" 37 "LOW_BRAKE_FLUID_MODE_DYNAMIC" 36 "LOW_BRAKE_FLUID_MODE_DYNAMIC_PARK" 35 "LOW_BRAKE_FLUID_MODE_PARK" 34 "STATIONARY_DETECT" 33 "TOUCHSCREEN_INVALID" 32 "UI_DOOR_OPEN_REQUEST" 31 "AUTOPARK_END" 30 "DRIVER_IS_LEAVING" 29 "SYSTEM_APPLY" 28 "ACCELERATION" 27 "EPBM_DISQUALIFIED" 26 "DISQUALIFIED" 25 "SUMMON_FAULT" 24 "FAULT" 23 "SUMMON_COMPLETE" 22 "REAPPLY" 21 "SAVESTATE_ON_BOOT" 20 "TIMEOUT" 19 "SPEED_FAST" 18 "SPEED_OKAYTOPARK" 17 "SPEED_STOPPED" 16 "USER_CANCEL" 15 "USER_CONFIRMED" 14 "DIAG_EXIT" 13 "DIAG_OPEN" 12 "DIAG_CLOSE" 11 "SERVICE" 10 "WINCHMODE_UNAVAILABLE" 9 "WINCHMODE_ENTER" 8 "WINCHMODE_EXIT" 7 "TOUCHSCREEN" 6 "DI_UNPARK" 5 "ACTIVE_PARK_REQUEST" 4 "PBUTTON_RELEASED" 3 "PBUTTON_PRESSED_UNKNOWN" 2 "PBUTTON_PRESSED_FAST" 1 "PBUTTON_PRESSED_OKTOPARK" 0 "PBUTTON_PRESSED_STOPPED" ;
VAL_ 1448 EPBR_a247_nonterminalReason 23 "REMOTE_MIA" 22 "NVM_MISMATCH" 21 "EPBM_MIA" 20 "MOTOR_NOT_READY" 19 "MOTOR_ACTIVE_FAULT" 18 "MOTOR_IDLE_FAULT" 17 "TIMEOUT_EPBM_START" 16 "TIMEOUT_NO_RAMP" 15 "TIMEOUT_EPBM_CUTOFF" 14 "TIMEOUT_RELEASE_COMPLETE" 13 "TIMEOUT_RELEASE_NO_LOAD" 12 "TIMEOUT_RELEASE_WAIT_FOR_ENDSTOP" 11 "TIMEOUT_RELEASE_INRUSH" 10 "TIMEOUT_EPBM_WAIT_FOR_CLAMP" 9 "TIMEOUT_EPB_WAIT_FOR_CLAMP" 8 "TIMEOUT_APPLY_INRUSH" 7 "TIMEOUT_APPLY_COMPLETE" 6 "RELEASE_BLOCKED" 5 "APPLY_BLOCKED" 4 "TIMEOUT_CALIBRATE" 3 "STATE_MISMATCH" 2 "EPBM_FAULTED" 1 "EPBM_DISABLED" 0 "NONE" ;
VAL_ 1448 EPBR_a248_esmState 23 "UNKNOWN" 22 "AUTONOMY_DYNAMIC" 21 "AUTONOMY_OPEN" 20 "SYSTEM_DYNAMIC_EXTERNAL" 19 "FREE_ROLL_MODE" 18 "DYNAMIC_EXTERNAL_EXIT" 17 "SERVICE_PENDING" 16 "LATCHED_DYNAMIC_EXTERNAL" 15 "DYNAMIC_PENDING" 14 "DYNAMIC_EXTERNAL" 13 "SUMMON_PARK" 12 "WINCHMODE_PENDING" 11 "PARK_PENDING" 10 "DYNAMIC_PARK" 9 "DIAGNOSTIC_OPEN" 8 "DIAGNOSTIC_PARK" 7 "SERVICE" 6 "WINCHMODE" 5 "SUMMON" 4 "DYNAMIC" 3 "OPEN" 2 "REAPPLY" 1 "PARK" 0 "INIT" ;
VAL_ 1448 EPBR_a248_esmStateRequest 23 "UNKNOWN" 22 "AUTONOMY_DYNAMIC" 21 "AUTONOMY_OPEN" 20 "SYSTEM_DYNAMIC_EXTERNAL" 19 "FREE_ROLL_MODE" 18 "DYNAMIC_EXTERNAL_EXIT" 17 "SERVICE_PENDING" 16 "LATCHED_DYNAMIC_EXTERNAL" 15 "DYNAMIC_PENDING" 14 "DYNAMIC_EXTERNAL" 13 "SUMMON_PARK" 12 "WINCHMODE_PENDING" 11 "PARK_PENDING" 10 "DYNAMIC_PARK" 9 "DIAGNOSTIC_OPEN" 8 "DIAGNOSTIC_PARK" 7 "SERVICE" 6 "WINCHMODE" 5 "SUMMON" 4 "DYNAMIC" 3 "OPEN" 2 "REAPPLY" 1 "PARK" 0 "INIT" ;
VAL_ 1448 EPBR_a248_faultStatus 3 "FAULT_IDLE" 2 "FAULT" 1 "RETRY" 0 "NOMINAL" ;
VAL_ 1448 EPBR_a248_monitorUnitStatus 23 "COUNT" 22 "AUTONOMY_OPEN" 21 "FREE_ROLL_MODE" 20 "DYNAMIC_PARKING" 19 "EXTERNAL_PARKING" 18 "RELEASING_FOR_EXTERNAL_PARK" 17 "EXTERNAL_DYNAMIC" 16 "SUMMON_PARKING" 15 "SUMMON_RELEASING" 14 "SUMMON" 13 "WINCHMODE_PENDING" 12 "PARK_PENDING" 11 "SERVICE_RELEASING" 10 "RELEASING" 9 "DYNAMIC_APPLYING" 8 "PARKING" 7 "WINCHMODE_RELEASING" 6 "WINCHMODE" 5 "SERVICE" 4 "START" 3 "PARK" 2 "DYNAMIC" 1 "OPEN" 0 "UNKNOWN" ;
VAL_ 1448 EPBR_a248_monitorFaultStatus 3 "FAULT_IDLE" 2 "FAULT" 1 "RETRY" 0 "NOMINAL" ;
VAL_ 1448 EPBR_a248_csmFaultReason 23 "REMOTE_MIA" 22 "NVM_MISMATCH" 21 "EPBM_MIA" 20 "MOTOR_NOT_READY" 19 "MOTOR_ACTIVE_FAULT" 18 "MOTOR_IDLE_FAULT" 17 "TIMEOUT_EPBM_START" 16 "TIMEOUT_NO_RAMP" 15 "TIMEOUT_EPBM_CUTOFF" 14 "TIMEOUT_RELEASE_COMPLETE" 13 "TIMEOUT_RELEASE_NO_LOAD" 12 "TIMEOUT_RELEASE_WAIT_FOR_ENDSTOP" 11 "TIMEOUT_RELEASE_INRUSH" 10 "TIMEOUT_EPBM_WAIT_FOR_CLAMP" 9 "TIMEOUT_EPB_WAIT_FOR_CLAMP" 8 "TIMEOUT_APPLY_INRUSH" 7 "TIMEOUT_APPLY_COMPLETE" 6 "RELEASE_BLOCKED" 5 "APPLY_BLOCKED" 4 "TIMEOUT_CALIBRATE" 3 "STATE_MISMATCH" 2 "EPBM_FAULTED" 1 "EPBM_DISABLED" 0 "NONE" ;
VAL_ 1448 EPBR_a248_esmOpTrigger 50 "ACTIVE_DECEL_DAS_STATIC" 49 "ACTIVE_DECEL_CDP_DOWN" 48 "AP_IS_LEAVING" 47 "RECOVERY_PARK" 46 "SPEED_SOURCES_LOST" 45 "ACTIVE_DECEL_OKTOPARK" 44 "ACTIVE_DECEL_FAST" 43 "STEERING_ACTIVE_DECEL" 42 "LV_ACTIVE_DECEL" 41 "CDP_PANIC_MODE_READY" 40 "CDP_PANIC_MODE_TIMEOUT" 39 "DI_PARK" 38 "FREE_ROLL_PARK_FOR_HANDLE_PULLED" 37 "LOW_BRAKE_FLUID_MODE_DYNAMIC" 36 "LOW_BRAKE_FLUID_MODE_DYNAMIC_PARK" 35 "LOW_BRAKE_FLUID_MODE_PARK" 34 "STATIONARY_DETECT" 33 "TOUCHSCREEN_INVALID" 32 "UI_DOOR_OPEN_REQUEST" 31 "AUTOPARK_END" 30 "DRIVER_IS_LEAVING" 29 "SYSTEM_APPLY" 28 "ACCELERATION" 27 "EPBM_DISQUALIFIED" 26 "DISQUALIFIED" 25 "SUMMON_FAULT" 24 "FAULT" 23 "SUMMON_COMPLETE" 22 "REAPPLY" 21 "SAVESTATE_ON_BOOT" 20 "TIMEOUT" 19 "SPEED_FAST" 18 "SPEED_OKAYTOPARK" 17 "SPEED_STOPPED" 16 "USER_CANCEL" 15 "USER_CONFIRMED" 14 "DIAG_EXIT" 13 "DIAG_OPEN" 12 "DIAG_CLOSE" 11 "SERVICE" 10 "WINCHMODE_UNAVAILABLE" 9 "WINCHMODE_ENTER" 8 "WINCHMODE_EXIT" 7 "TOUCHSCREEN" 6 "DI_UNPARK" 5 "ACTIVE_PARK_REQUEST" 4 "PBUTTON_RELEASED" 3 "PBUTTON_PRESSED_UNKNOWN" 2 "PBUTTON_PRESSED_FAST" 1 "PBUTTON_PRESSED_OKTOPARK" 0 "PBUTTON_PRESSED_STOPPED" ;
VAL_ 1448 EPBR_a248_nonterminalReason 23 "REMOTE_MIA" 22 "NVM_MISMATCH" 21 "EPBM_MIA" 20 "MOTOR_NOT_READY" 19 "MOTOR_ACTIVE_FAULT" 18 "MOTOR_IDLE_FAULT" 17 "TIMEOUT_EPBM_START" 16 "TIMEOUT_NO_RAMP" 15 "TIMEOUT_EPBM_CUTOFF" 14 "TIMEOUT_RELEASE_COMPLETE" 13 "TIMEOUT_RELEASE_NO_LOAD" 12 "TIMEOUT_RELEASE_WAIT_FOR_ENDSTOP" 11 "TIMEOUT_RELEASE_INRUSH" 10 "TIMEOUT_EPBM_WAIT_FOR_CLAMP" 9 "TIMEOUT_EPB_WAIT_FOR_CLAMP" 8 "TIMEOUT_APPLY_INRUSH" 7 "TIMEOUT_APPLY_COMPLETE" 6 "RELEASE_BLOCKED" 5 "APPLY_BLOCKED" 4 "TIMEOUT_CALIBRATE" 3 "STATE_MISMATCH" 2 "EPBM_FAULTED" 1 "EPBM_DISABLED" 0 "NONE" ;
VAL_ 1448 EPBR_a249_previousState 23 "UNKNOWN" 22 "AUTONOMY_DYNAMIC" 21 "AUTONOMY_OPEN" 20 "SYSTEM_DYNAMIC_EXTERNAL" 19 "FREE_ROLL_MODE" 18 "DYNAMIC_EXTERNAL_EXIT" 17 "SERVICE_PENDING" 16 "LATCHED_DYNAMIC_EXTERNAL" 15 "DYNAMIC_PENDING" 14 "DYNAMIC_EXTERNAL" 13 "SUMMON_PARK" 12 "WINCHMODE_PENDING" 11 "PARK_PENDING" 10 "DYNAMIC_PARK" 9 "DIAGNOSTIC_OPEN" 8 "DIAGNOSTIC_PARK" 7 "SERVICE" 6 "WINCHMODE" 5 "SUMMON" 4 "DYNAMIC" 3 "OPEN" 2 "REAPPLY" 1 "PARK" 0 "INIT" ;
VAL_ 1448 EPBR_a249_nextState 23 "UNKNOWN" 22 "AUTONOMY_DYNAMIC" 21 "AUTONOMY_OPEN" 20 "SYSTEM_DYNAMIC_EXTERNAL" 19 "FREE_ROLL_MODE" 18 "DYNAMIC_EXTERNAL_EXIT" 17 "SERVICE_PENDING" 16 "LATCHED_DYNAMIC_EXTERNAL" 15 "DYNAMIC_PENDING" 14 "DYNAMIC_EXTERNAL" 13 "SUMMON_PARK" 12 "WINCHMODE_PENDING" 11 "PARK_PENDING" 10 "DYNAMIC_PARK" 9 "DIAGNOSTIC_OPEN" 8 "DIAGNOSTIC_PARK" 7 "SERVICE" 6 "WINCHMODE" 5 "SUMMON" 4 "DYNAMIC" 3 "OPEN" 2 "REAPPLY" 1 "PARK" 0 "INIT" ;
VAL_ 1448 EPBR_a249_esmStateRequest 23 "UNKNOWN" 22 "AUTONOMY_DYNAMIC" 21 "AUTONOMY_OPEN" 20 "SYSTEM_DYNAMIC_EXTERNAL" 19 "FREE_ROLL_MODE" 18 "DYNAMIC_EXTERNAL_EXIT" 17 "SERVICE_PENDING" 16 "LATCHED_DYNAMIC_EXTERNAL" 15 "DYNAMIC_PENDING" 14 "DYNAMIC_EXTERNAL" 13 "SUMMON_PARK" 12 "WINCHMODE_PENDING" 11 "PARK_PENDING" 10 "DYNAMIC_PARK" 9 "DIAGNOSTIC_OPEN" 8 "DIAGNOSTIC_PARK" 7 "SERVICE" 6 "WINCHMODE" 5 "SUMMON" 4 "DYNAMIC" 3 "OPEN" 2 "REAPPLY" 1 "PARK" 0 "INIT" ;
VAL_ 1448 EPBR_a249_faultStatus 3 "FAULT_IDLE" 2 "FAULT" 1 "RETRY" 0 "NOMINAL" ;
VAL_ 1448 EPBR_a249_esmOpTrigger 50 "ACTIVE_DECEL_DAS_STATIC" 49 "ACTIVE_DECEL_CDP_DOWN" 48 "AP_IS_LEAVING" 47 "RECOVERY_PARK" 46 "SPEED_SOURCES_LOST" 45 "ACTIVE_DECEL_OKTOPARK" 44 "ACTIVE_DECEL_FAST" 43 "STEERING_ACTIVE_DECEL" 42 "LV_ACTIVE_DECEL" 41 "CDP_PANIC_MODE_READY" 40 "CDP_PANIC_MODE_TIMEOUT" 39 "DI_PARK" 38 "FREE_ROLL_PARK_FOR_HANDLE_PULLED" 37 "LOW_BRAKE_FLUID_MODE_DYNAMIC" 36 "LOW_BRAKE_FLUID_MODE_DYNAMIC_PARK" 35 "LOW_BRAKE_FLUID_MODE_PARK" 34 "STATIONARY_DETECT" 33 "TOUCHSCREEN_INVALID" 32 "UI_DOOR_OPEN_REQUEST" 31 "AUTOPARK_END" 30 "DRIVER_IS_LEAVING" 29 "SYSTEM_APPLY" 28 "ACCELERATION" 27 "EPBM_DISQUALIFIED" 26 "DISQUALIFIED" 25 "SUMMON_FAULT" 24 "FAULT" 23 "SUMMON_COMPLETE" 22 "REAPPLY" 21 "SAVESTATE_ON_BOOT" 20 "TIMEOUT" 19 "SPEED_FAST" 18 "SPEED_OKAYTOPARK" 17 "SPEED_STOPPED" 16 "USER_CANCEL" 15 "USER_CONFIRMED" 14 "DIAG_EXIT" 13 "DIAG_OPEN" 12 "DIAG_CLOSE" 11 "SERVICE" 10 "WINCHMODE_UNAVAILABLE" 9 "WINCHMODE_ENTER" 8 "WINCHMODE_EXIT" 7 "TOUCHSCREEN" 6 "DI_UNPARK" 5 "ACTIVE_PARK_REQUEST" 4 "PBUTTON_RELEASED" 3 "PBUTTON_PRESSED_UNKNOWN" 2 "PBUTTON_PRESSED_FAST" 1 "PBUTTON_PRESSED_OKTOPARK" 0 "PBUTTON_PRESSED_STOPPED" ;
VAL_ 1448 EPBR_a250_esmSpeedClass 4 "UNKNOWN" 3 "FAST" 2 "USER_APPLY_OK" 1 "SYSTEM_APPLY_OK" 0 "STOPPED" ;
VAL_ 1448 EPBR_a250_esmOperationTrigger 50 "ACTIVE_DECEL_DAS_STATIC" 49 "ACTIVE_DECEL_CDP_DOWN" 48 "AP_IS_LEAVING" 47 "RECOVERY_PARK" 46 "SPEED_SOURCES_LOST" 45 "ACTIVE_DECEL_OKTOPARK" 44 "ACTIVE_DECEL_FAST" 43 "STEERING_ACTIVE_DECEL" 42 "LV_ACTIVE_DECEL" 41 "CDP_PANIC_MODE_READY" 40 "CDP_PANIC_MODE_TIMEOUT" 39 "DI_PARK" 38 "FREE_ROLL_PARK_FOR_HANDLE_PULLED" 37 "LOW_BRAKE_FLUID_MODE_DYNAMIC" 36 "LOW_BRAKE_FLUID_MODE_DYNAMIC_PARK" 35 "LOW_BRAKE_FLUID_MODE_PARK" 34 "STATIONARY_DETECT" 33 "TOUCHSCREEN_INVALID" 32 "UI_DOOR_OPEN_REQUEST" 31 "AUTOPARK_END" 30 "DRIVER_IS_LEAVING" 29 "SYSTEM_APPLY" 28 "ACCELERATION" 27 "EPBM_DISQUALIFIED" 26 "DISQUALIFIED" 25 "SUMMON_FAULT" 24 "FAULT" 23 "SUMMON_COMPLETE" 22 "REAPPLY" 21 "SAVESTATE_ON_BOOT" 20 "TIMEOUT" 19 "SPEED_FAST" 18 "SPEED_OKAYTOPARK" 17 "SPEED_STOPPED" 16 "USER_CANCEL" 15 "USER_CONFIRMED" 14 "DIAG_EXIT" 13 "DIAG_OPEN" 12 "DIAG_CLOSE" 11 "SERVICE" 10 "WINCHMODE_UNAVAILABLE" 9 "WINCHMODE_ENTER" 8 "WINCHMODE_EXIT" 7 "TOUCHSCREEN" 6 "DI_UNPARK" 5 "ACTIVE_PARK_REQUEST" 4 "PBUTTON_RELEASED" 3 "PBUTTON_PRESSED_UNKNOWN" 2 "PBUTTON_PRESSED_FAST" 1 "PBUTTON_PRESSED_OKTOPARK" 0 "PBUTTON_PRESSED_STOPPED" ;
VAL_ 1448 EPBR_a272_expectedState 3 "DRIVE" 2 "ACCESSORY" 1 "CONDITIONING" 0 "OFF" ;
VAL_ 1448 EPBR_a272_actualState 3 "DRIVE" 2 "ACCESSORY" 1 "CONDITIONING" 0 "OFF" ;
VAL_ 1448 EPBR_a355_brakeHwConfig 11 "CT_MANDO" 10 "MODEL3_ZF" 9 "MODELS_CERAMIC" 8 "MODELY_PERFORMANCE_V2" 7 "MODEL3_PERFORMANCE_V2" 6 "MODELX_BASE" 5 "MODELY_PERFORMANCE" 4 "MODELY_BASE" 3 "MODELS_BASE" 2 "MODEL3_PERFORMANCE" 1 "MODEL3_BASE" 0 "UNKNOWN" ;
VAL_ 1448 EPBR_a355_epbHwConfig 11 "CT_MANDO" 10 "MODEL3_ZF" 9 "MODELS_CERAMIC" 8 "MODELY_PERFORMANCE_V2" 7 "MODEL3_PERFORMANCE_V2" 6 "MODELX_BASE" 5 "MODELY_PERFORMANCE" 4 "MODELY_BASE" 3 "MODELS_BASE" 2 "MODEL3_PERFORMANCE" 1 "MODEL3_BASE" 0 "UNKNOWN" ;
VAL_ 1448 EPBR_a357_epbSystemStatus 8 "MISMATCH" 7 "FAULT_SECURE" 6 "FAULT" 5 "RELEASING" 4 "PARKING" 3 "DYNAMIC" 2 "PARKED" 1 "RELEASED" 0 "UNKNOWN" ;
VAL_ 1448 EPBR_a358_epbSystemStatus 8 "MISMATCH" 7 "FAULT_SECURE" 6 "FAULT" 5 "RELEASING" 4 "PARKING" 3 "DYNAMIC" 2 "PARKED" 1 "RELEASED" 0 "UNKNOWN" ;
VAL_ 1448 EPBR_a365_epbSystemStatus 8 "MISMATCH" 7 "FAULT_SECURE" 6 "FAULT" 5 "RELEASING" 4 "PARKING" 3 "DYNAMIC" 2 "PARKED" 1 "RELEASED" 0 "UNKNOWN" ;
VAL_ 1448 EPBR_a366_epbSystemStatus 8 "MISMATCH" 7 "FAULT_SECURE" 6 "FAULT" 5 "RELEASING" 4 "PARKING" 3 "DYNAMIC" 2 "PARKED" 1 "RELEASED" 0 "UNKNOWN" ;
