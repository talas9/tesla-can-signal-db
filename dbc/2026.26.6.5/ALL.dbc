VERSION "dbc-export 1 2026.26.6.5"

NS_ :

BS_:

BU_: ADSP APB APP APS APSB BB BMS CC CMP CMPD CP DAS DI DIF DIR DPB EPAS3P EPAS3S EPASTP EPASTS EPBL EPBR ESP EVSE FC GTW HCML HCMR HVP IBST ICR IDB LS OCS1P PARK PCS PCS2 PM PMF PMR PNCD PTC RADC RCM RCM2 RCM3 RCU SCCM SCM SCS SDCR TAS TCU TCU2 TPMS TRCM UI UIS UMC USM V2G VC VCBATT VCBATT0 VCBATT1 VCBATT2 VCCC VCFRONT VCFRONT1 VCFRONT2 VCLEFT VCRIGHT VCSEAT2L VCSEAT2R VCSEC VEH

BO_ 954 USM_alertMatrix: 8 USM
 SG_ USM_matrixIndex M : 0|4@1+ (1,0) [0|15] "" Vector__XXX
 SG_ USM_a001_WatchdogReset m0 : 4|1@1+ (1,0) [0|1] "" Vector__XXX
 SG_ USM_a002_PowerLossReset m0 : 5|1@1+ (1,0) [0|1] "" Vector__XXX
 SG_ USM_a003_SWAssertion m0 : 6|1@1+ (1,0) [0|1] "" Vector__XXX
 SG_ USM_a005_CANTXError m0 : 8|1@1+ (1,0) [0|1] "" Vector__XXX
 SG_ USM_a006_CANTX_cyclicError m0 : 9|1@1+ (1,0) [0|1] "" Vector__XXX
 SG_ USM_a012_CPUReset m0 : 15|1@1+ (1,0) [0|1] "" Vector__XXX
 SG_ USM_a013_AlertManagerFault m0 : 16|1@1+ (1,0) [0|1] "" Vector__XXX
 SG_ USM_a015_NVMMError m0 : 18|1@1+ (1,0) [0|1] "" Vector__XXX
 SG_ USM_a016_NVMMRecordError m0 : 19|1@1+ (1,0) [0|1] "" Vector__XXX
 SG_ USM_a021_TaskSchedulerError m0 : 24|1@1+ (1,0) [0|1] "" Vector__XXX
 SG_ USM_a022_TaskInitError m0 : 25|1@1+ (1,0) [0|1] "" Vector__XXX
 SG_ USM_a029_CoreDump m0 : 32|1@1+ (1,0) [0|1] "" Vector__XXX
 SG_ USM_a030_ECULogUploadRequest m0 : 33|1@1+ (1,0) [0|1] "" Vector__XXX
 SG_ USM_a031_UDSActive m0 : 34|1@1+ (1,0) [0|1] "" Vector__XXX
 SG_ USM_a041_HighCPULoad m0 : 44|1@1+ (1,0) [0|1] "" Vector__XXX
 SG_ USM_a042_HighStackUsage m0 : 45|1@1+ (1,0) [0|1] "" Vector__XXX
 SG_ USM_a043_Task1msError m0 : 46|1@1+ (1,0) [0|1] "" Vector__XXX
 SG_ USM_a044_Task10msError m0 : 47|1@1+ (1,0) [0|1] "" Vector__XXX
 SG_ USM_a045_Task100msError m0 : 48|1@1+ (1,0) [0|1] "" Vector__XXX
 SG_ USM_a046_Task1000msError m0 : 49|1@1+ (1,0) [0|1] "" Vector__XXX
 SG_ USM_a057_HVP_MIA m0 : 60|1@1+ (1,0) [0|1] "" Vector__XXX
 SG_ USM_a058_inputRHighSyncDebug m0 : 61|1@1+ (1,0) [0|1] "" Vector__XXX
 SG_ USM_a059_inputResistanceHigh m0 : 62|1@1+ (1,0) [0|1] "" Vector__XXX
 SG_ USM_a060_engineeringBuild m0 : 63|1@1+ (1,0) [0|1] "" Vector__XXX
 SG_ USM_a061_XCPConnected m1 : 4|1@1+ (1,0) [0|1] "" Vector__XXX
 SG_ USM_a062_XCPWasConnected m1 : 5|1@1+ (1,0) [0|1] "" Vector__XXX
 SG_ USM_a063_SwitchFault m1 : 6|1@1+ (1,0) [0|1] "" Vector__XXX
 SG_ USM_a064_busSleepReqTimeout m1 : 7|1@1+ (1,0) [0|1] "" Vector__XXX
 SG_ USM_a082_VCRIGHT_IPC_MIA m1 : 25|1@1+ (1,0) [0|1] "" Vector__XXX
 SG_ USM_a083_VCLEFT_IPC_MIA m1 : 26|1@1+ (1,0) [0|1] "" Vector__XXX
 SG_ USM_a084_TPMS_MIA m1 : 27|1@1+ (1,0) [0|1] "" Vector__XXX
 SG_ USM_a085_CCCM_MIA m1 : 28|1@1+ (1,0) [0|1] "" Vector__XXX
 SG_ USM_a086_VCBATT_MIA m1 : 29|1@1+ (1,0) [0|1] "" Vector__XXX
 SG_ USM_a087_DIREL_MIA m1 : 30|1@1+ (1,0) [0|1] "" Vector__XXX
 SG_ USM_a088_DIRER_MIA m1 : 31|1@1+ (1,0) [0|1] "" Vector__XXX
 SG_ USM_a089_IBST_MIA m1 : 32|1@1+ (1,0) [0|1] "" Vector__XXX
 SG_ USM_a090_APS_MIA m1 : 33|1@1+ (1,0) [0|1] "" Vector__XXX
 SG_ USM_a091_CMPD_MIA m1 : 34|1@1+ (1,0) [0|1] "" Vector__XXX
 SG_ USM_a092_VCSEATD_MIA m1 : 35|1@1+ (1,0) [0|1] "" Vector__XXX
 SG_ USM_a093_VCSEATP_MIA m1 : 36|1@1+ (1,0) [0|1] "" Vector__XXX
 SG_ USM_a094_EPAS3P_MIA m1 : 37|1@1+ (1,0) [0|1] "" Vector__XXX
 SG_ USM_a095_CHG_MIA m1 : 38|1@1+ (1,0) [0|1] "" Vector__XXX
 SG_ USM_a096_OCS1P_MIA m1 : 39|1@1+ (1,0) [0|1] "" Vector__XXX
 SG_ USM_a097_CMP_MIA m1 : 40|1@1+ (1,0) [0|1] "" Vector__XXX
 SG_ USM_a098_DIR_MIA m1 : 41|1@1+ (1,0) [0|1] "" Vector__XXX
 SG_ USM_a099_PARK_MIA m1 : 42|1@1+ (1,0) [0|1] "" Vector__XXX
 SG_ USM_a100_CANbus_MIA m1 : 43|1@1+ (1,0) [0|1] "" Vector__XXX
 SG_ USM_a101_PM_MIA m1 : 44|1@1+ (1,0) [0|1] "" Vector__XXX
 SG_ USM_a102_PTC_MIA m1 : 45|1@1+ (1,0) [0|1] "" Vector__XXX
 SG_ USM_a103_CP_MIA m1 : 46|1@1+ (1,0) [0|1] "" Vector__XXX
 SG_ USM_a104_DAS_MIA m1 : 47|1@1+ (1,0) [0|1] "" Vector__XXX
 SG_ USM_a105_TAS_MIA m1 : 48|1@1+ (1,0) [0|1] "" Vector__XXX
 SG_ USM_a106_PCS_MIA m1 : 49|1@1+ (1,0) [0|1] "" Vector__XXX
 SG_ USM_a107_BMS_MIA m1 : 50|1@1+ (1,0) [0|1] "" Vector__XXX
 SG_ USM_a108_DIF_MIA m1 : 51|1@1+ (1,0) [0|1] "" Vector__XXX
 SG_ USM_a109_RCM_MIA m1 : 52|1@1+ (1,0) [0|1] "" Vector__XXX
 SG_ USM_a110_GTW_MIA m1 : 53|1@1+ (1,0) [0|1] "" Vector__XXX
 SG_ USM_a111_EPBR_MIA m1 : 54|1@1+ (1,0) [0|1] "" Vector__XXX
 SG_ USM_a112_EPBL_MIA m1 : 55|1@1+ (1,0) [0|1] "" Vector__XXX
 SG_ USM_a113_UI_MIA m1 : 56|1@1+ (1,0) [0|1] "" Vector__XXX
 SG_ USM_a114_ESP_MIA m1 : 57|1@1+ (1,0) [0|1] "" Vector__XXX
 SG_ USM_a115_VCSEC_MIA m1 : 58|1@1+ (1,0) [0|1] "" Vector__XXX
 SG_ USM_a116_VCRIGHT_MIA m1 : 59|1@1+ (1,0) [0|1] "" Vector__XXX
 SG_ USM_a117_VCLEFT_MIA m1 : 60|1@1+ (1,0) [0|1] "" Vector__XXX
 SG_ USM_a118_VCFRONT_MIA m1 : 61|1@1+ (1,0) [0|1] "" Vector__XXX
 SG_ USM_a119_SCCM_MIA m1 : 62|1@1+ (1,0) [0|1] "" Vector__XXX
 SG_ USM_a120_DI_DRIVE_MIA m1 : 63|1@1+ (1,0) [0|1] "" Vector__XXX
 SG_ USM_a131_s1ComError m2 : 14|1@1+ (1,0) [0|1] "" Vector__XXX
 SG_ USM_a132_s2ComError m2 : 15|1@1+ (1,0) [0|1] "" Vector__XXX
 SG_ USM_a133_s3ComError m2 : 16|1@1+ (1,0) [0|1] "" Vector__XXX
 SG_ USM_a134_s4ComError m2 : 17|1@1+ (1,0) [0|1] "" Vector__XXX
 SG_ USM_a135_s5ComError m2 : 18|1@1+ (1,0) [0|1] "" Vector__XXX
 SG_ USM_a136_s6ComError m2 : 19|1@1+ (1,0) [0|1] "" Vector__XXX
 SG_ USM_a137_s7ComError m2 : 20|1@1+ (1,0) [0|1] "" Vector__XXX
 SG_ USM_a138_s8ComError m2 : 21|1@1+ (1,0) [0|1] "" Vector__XXX
 SG_ USM_a139_s9ComError m2 : 22|1@1+ (1,0) [0|1] "" Vector__XXX
 SG_ USM_a140_s10ComError m2 : 23|1@1+ (1,0) [0|1] "" Vector__XXX
 SG_ USM_a141_s11ComError m2 : 24|1@1+ (1,0) [0|1] "" Vector__XXX
 SG_ USM_a142_s12ComError m2 : 25|1@1+ (1,0) [0|1] "" Vector__XXX
 SG_ USM_a143_s1HwError m2 : 26|1@1+ (1,0) [0|1] "" Vector__XXX
 SG_ USM_a144_s2HwError m2 : 27|1@1+ (1,0) [0|1] "" Vector__XXX
 SG_ USM_a145_s3HwError m2 : 28|1@1+ (1,0) [0|1] "" Vector__XXX
 SG_ USM_a146_s4HwError m2 : 29|1@1+ (1,0) [0|1] "" Vector__XXX
 SG_ USM_a147_s5HwError m2 : 30|1@1+ (1,0) [0|1] "" Vector__XXX
 SG_ USM_a148_s6HwError m2 : 31|1@1+ (1,0) [0|1] "" Vector__XXX
 SG_ USM_a149_s7HwError m2 : 32|1@1+ (1,0) [0|1] "" Vector__XXX
 SG_ USM_a150_s8HwError m2 : 33|1@1+ (1,0) [0|1] "" Vector__XXX
 SG_ USM_a151_s9HwError m2 : 34|1@1+ (1,0) [0|1] "" Vector__XXX
 SG_ USM_a152_s10HwError m2 : 35|1@1+ (1,0) [0|1] "" Vector__XXX
 SG_ USM_a153_s11HwError m2 : 36|1@1+ (1,0) [0|1] "" Vector__XXX
 SG_ USM_a154_s12HwError m2 : 37|1@1+ (1,0) [0|1] "" Vector__XXX
 SG_ USM_a155_s1OverTemp m2 : 38|1@1+ (1,0) [0|1] "" Vector__XXX
 SG_ USM_a156_s2OverTemp m2 : 39|1@1+ (1,0) [0|1] "" Vector__XXX
 SG_ USM_a157_s3OverTemp m2 : 40|1@1+ (1,0) [0|1] "" Vector__XXX
 SG_ USM_a158_s4OverTemp m2 : 41|1@1+ (1,0) [0|1] "" Vector__XXX
 SG_ USM_a159_s5OverTemp m2 : 42|1@1+ (1,0) [0|1] "" Vector__XXX
 SG_ USM_a160_s6OverTemp m2 : 43|1@1+ (1,0) [0|1] "" Vector__XXX
 SG_ USM_a161_s7OverTemp m2 : 44|1@1+ (1,0) [0|1] "" Vector__XXX
 SG_ USM_a162_s8OverTemp m2 : 45|1@1+ (1,0) [0|1] "" Vector__XXX
 SG_ USM_a163_s9OverTemp m2 : 46|1@1+ (1,0) [0|1] "" Vector__XXX
 SG_ USM_a164_s10OverTemp m2 : 47|1@1+ (1,0) [0|1] "" Vector__XXX
 SG_ USM_a165_s11OverTemp m2 : 48|1@1+ (1,0) [0|1] "" Vector__XXX
 SG_ USM_a166_s12OverTemp m2 : 49|1@1+ (1,0) [0|1] "" Vector__XXX
 SG_ USM_a177_s1Blocked m2 : 60|1@1+ (1,0) [0|1] "" Vector__XXX
 SG_ USM_a178_s2Blocked m2 : 61|1@1+ (1,0) [0|1] "" Vector__XXX
 SG_ USM_a179_s3Blocked m2 : 62|1@1+ (1,0) [0|1] "" Vector__XXX
 SG_ USM_a180_s4Blocked m2 : 63|1@1+ (1,0) [0|1] "" Vector__XXX
 SG_ USM_a181_s5Blocked m3 : 4|1@1+ (1,0) [0|1] "" Vector__XXX
 SG_ USM_a182_s6Blocked m3 : 5|1@1+ (1,0) [0|1] "" Vector__XXX
 SG_ USM_a183_s7Blocked m3 : 6|1@1+ (1,0) [0|1] "" Vector__XXX
 SG_ USM_a184_s8Blocked m3 : 7|1@1+ (1,0) [0|1] "" Vector__XXX
 SG_ USM_a185_s9Blocked m3 : 8|1@1+ (1,0) [0|1] "" Vector__XXX
 SG_ USM_a186_s10Blocked m3 : 9|1@1+ (1,0) [0|1] "" Vector__XXX
 SG_ USM_a187_s11Blocked m3 : 10|1@1+ (1,0) [0|1] "" Vector__XXX
 SG_ USM_a188_s12Blocked m3 : 11|1@1+ (1,0) [0|1] "" Vector__XXX
 SG_ USM_a189_s1Disconnected m3 : 12|1@1+ (1,0) [0|1] "" Vector__XXX
 SG_ USM_a190_s2Disconnected m3 : 13|1@1+ (1,0) [0|1] "" Vector__XXX
 SG_ USM_a191_s3Disconnected m3 : 14|1@1+ (1,0) [0|1] "" Vector__XXX
 SG_ USM_a192_s4Disconnected m3 : 15|1@1+ (1,0) [0|1] "" Vector__XXX
 SG_ USM_a193_s5Disconnected m3 : 16|1@1+ (1,0) [0|1] "" Vector__XXX
 SG_ USM_a194_s6Disconnected m3 : 17|1@1+ (1,0) [0|1] "" Vector__XXX
 SG_ USM_a195_s7Disconnected m3 : 18|1@1+ (1,0) [0|1] "" Vector__XXX
 SG_ USM_a196_s8Disconnected m3 : 19|1@1+ (1,0) [0|1] "" Vector__XXX
 SG_ USM_a197_s9Disconnected m3 : 20|1@1+ (1,0) [0|1] "" Vector__XXX
 SG_ USM_a198_s10Disconnected m3 : 21|1@1+ (1,0) [0|1] "" Vector__XXX
 SG_ USM_a199_s11Disconnected m3 : 22|1@1+ (1,0) [0|1] "" Vector__XXX
 SG_ USM_a200_s12Disconnected m3 : 23|1@1+ (1,0) [0|1] "" Vector__XXX
 SG_ USM_a201_e52142Fault m3 : 24|1@1+ (1,0) [0|1] "" Vector__XXX
 SG_ USM_a202_e52417Fault m3 : 25|1@1+ (1,0) [0|1] "" Vector__XXX
 SG_ USM_a203_s1NearFieldDetected m3 : 26|1@1+ (1,0) [0|1] "" Vector__XXX
 SG_ USM_a204_s2NearFieldDetected m3 : 27|1@1+ (1,0) [0|1] "" Vector__XXX
 SG_ USM_a205_s3NearFieldDetected m3 : 28|1@1+ (1,0) [0|1] "" Vector__XXX
 SG_ USM_a206_s4NearFieldDetected m3 : 29|1@1+ (1,0) [0|1] "" Vector__XXX
 SG_ USM_a207_s5NearFieldDetected m3 : 30|1@1+ (1,0) [0|1] "" Vector__XXX
 SG_ USM_a208_s6NearFieldDetected m3 : 31|1@1+ (1,0) [0|1] "" Vector__XXX
 SG_ USM_a209_s7NearFieldDetected m3 : 32|1@1+ (1,0) [0|1] "" Vector__XXX
 SG_ USM_a210_s8NearFieldDetected m3 : 33|1@1+ (1,0) [0|1] "" Vector__XXX
 SG_ USM_a211_s9NearFieldDetected m3 : 34|1@1+ (1,0) [0|1] "" Vector__XXX
 SG_ USM_a212_s10NearFieldDetected m3 : 35|1@1+ (1,0) [0|1] "" Vector__XXX
 SG_ USM_a213_s11NearFieldDetected m3 : 36|1@1+ (1,0) [0|1] "" Vector__XXX
 SG_ USM_a214_s12NearFieldDetected m3 : 37|1@1+ (1,0) [0|1] "" Vector__XXX
 SG_ USM_a215_s1DebugEepromInvalid m3 : 38|1@1+ (1,0) [0|1] "" Vector__XXX
 SG_ USM_a216_s2DebugEepromInvalid m3 : 39|1@1+ (1,0) [0|1] "" Vector__XXX
 SG_ USM_a217_s3DebugEepromInvalid m3 : 40|1@1+ (1,0) [0|1] "" Vector__XXX
 SG_ USM_a218_s4DebugEepromInvalid m3 : 41|1@1+ (1,0) [0|1] "" Vector__XXX
 SG_ USM_a219_s5DebugEepromInvalid m3 : 42|1@1+ (1,0) [0|1] "" Vector__XXX
 SG_ USM_a220_s6DebugEepromInvalid m3 : 43|1@1+ (1,0) [0|1] "" Vector__XXX
 SG_ USM_a221_s7DebugEepromInvalid m3 : 44|1@1+ (1,0) [0|1] "" Vector__XXX
 SG_ USM_a222_s8DebugEepromInvalid m3 : 45|1@1+ (1,0) [0|1] "" Vector__XXX
 SG_ USM_a223_s9DebugEepromInvalid m3 : 46|1@1+ (1,0) [0|1] "" Vector__XXX
 SG_ USM_a224_s10DebugEepromInvalid m3 : 47|1@1+ (1,0) [0|1] "" Vector__XXX
 SG_ USM_a225_s11DebugEepromInvalid m3 : 48|1@1+ (1,0) [0|1] "" Vector__XXX
 SG_ USM_a226_s12DebugEepromInvalid m3 : 49|1@1+ (1,0) [0|1] "" Vector__XXX
 SG_ USM_a227_s1InitError m3 : 50|1@1+ (1,0) [0|1] "" Vector__XXX
 SG_ USM_a228_s2InitError m3 : 51|1@1+ (1,0) [0|1] "" Vector__XXX
 SG_ USM_a229_s3InitError m3 : 52|1@1+ (1,0) [0|1] "" Vector__XXX
 SG_ USM_a230_s4InitError m3 : 53|1@1+ (1,0) [0|1] "" Vector__XXX
 SG_ USM_a231_s5InitError m3 : 54|1@1+ (1,0) [0|1] "" Vector__XXX
 SG_ USM_a232_s6InitError m3 : 55|1@1+ (1,0) [0|1] "" Vector__XXX
 SG_ USM_a233_s7InitError m3 : 56|1@1+ (1,0) [0|1] "" Vector__XXX
 SG_ USM_a234_s8InitError m3 : 57|1@1+ (1,0) [0|1] "" Vector__XXX
 SG_ USM_a235_s9InitError m3 : 58|1@1+ (1,0) [0|1] "" Vector__XXX
 SG_ USM_a236_s10InitError m3 : 59|1@1+ (1,0) [0|1] "" Vector__XXX
 SG_ USM_a237_s11InitError m3 : 60|1@1+ (1,0) [0|1] "" Vector__XXX
 SG_ USM_a238_s12InitError m3 : 61|1@1+ (1,0) [0|1] "" Vector__XXX
 SG_ USM_a240_s1HwComErrDiagnostics m3 : 63|1@1+ (1,0) [0|1] "" Vector__XXX
 SG_ USM_a241_s2HwComErrDiagnostics m4 : 4|1@1+ (1,0) [0|1] "" Vector__XXX
 SG_ USM_a242_s3HwComErrDiagnostics m4 : 5|1@1+ (1,0) [0|1] "" Vector__XXX
 SG_ USM_a243_s4HwComErrDiagnostics m4 : 6|1@1+ (1,0) [0|1] "" Vector__XXX
 SG_ USM_a244_s5HwComErrDiagnostics m4 : 7|1@1+ (1,0) [0|1] "" Vector__XXX
 SG_ USM_a245_s6HwComErrDiagnostics m4 : 8|1@1+ (1,0) [0|1] "" Vector__XXX
 SG_ USM_a246_s7HwComErrDiagnostics m4 : 9|1@1+ (1,0) [0|1] "" Vector__XXX
 SG_ USM_a247_s8HwComErrDiagnostics m4 : 10|1@1+ (1,0) [0|1] "" Vector__XXX
 SG_ USM_a248_s9HwComErrDiagnostics m4 : 11|1@1+ (1,0) [0|1] "" Vector__XXX
 SG_ USM_a249_s10HwComErrDiagnostics m4 : 12|1@1+ (1,0) [0|1] "" Vector__XXX
 SG_ USM_a250_s11HwComErrDiagnostics m4 : 13|1@1+ (1,0) [0|1] "" Vector__XXX
 SG_ USM_a251_s12HwComErrDiagnostics m4 : 14|1@1+ (1,0) [0|1] "" Vector__XXX
 SG_ USM_a252_anyComErrorSet m4 : 15|1@1+ (1,0) [0|1] "" Vector__XXX
 SG_ USM_a253_anyHwErrorSet m4 : 16|1@1+ (1,0) [0|1] "" Vector__XXX
 SG_ USM_a254_frontSensorsOvercurrent m4 : 17|1@1+ (1,0) [0|1] "" Vector__XXX
 SG_ USM_a255_rearSensorsOvercurrent m4 : 18|1@1+ (1,0) [0|1] "" Vector__XXX

BO_ 807 USM_info: 8 USM
 SG_ USM_infoIndex M : 0|8@1+ (1,0) [0|255] "" Vector__XXX
 SG_ USM_infoBuildType m10 : 8|3@1+ (1,0) [0|7] "" Vector__XXX
 SG_ USM_infoBuildConfigId m10 : 16|16@1+ (1,0) [0|65535] "" Vector__XXX
 SG_ USM_infoHardwareId m10 : 32|16@1+ (1,0) [0|65535] "" Vector__XXX
 SG_ USM_infoComponentId m10 : 48|16@1+ (1,0) [0|65535] "" Vector__XXX
 SG_ USM_infoPcbaId m11 : 8|8@1+ (1,0) [0|255] "" Vector__XXX
 SG_ USM_infoAssemblyId m11 : 16|8@1+ (1,0) [0|255] "" Vector__XXX
 SG_ USM_infoUsageId m11 : 24|16@1+ (1,0) [0|65535] "" Vector__XXX
 SG_ USM_infoSubUsageId m11 : 40|16@1+ (1,0) [0|65535] "" Vector__XXX
 SG_ USM_infoAppCrc m13 : 8|32@1+ (1,0) [0|4294967295] "" Vector__XXX

BO_ 1949 V2G_evseLogData: 8 V2G
 SG_ V2G_evseLogDataSelect M : 0|5@1+ (1,0) [0|31] "" Vector__XXX
 SG_ V2G_chgParamRes_respCode m7 : 8|5@1+ (1,0) [0|31] "" Vector__XXX
 SG_ V2G_chgParamRes_finished m7 : 13|1@1+ (1,0) [0|1] "" Vector__XXX
 SG_ V2G_chgParamRes_evseStatus m7 : 14|4@1+ (1,0) [0|15] "" Vector__XXX
 SG_ V2G_chgParamRes_evseMaxILim m7 : 18|8@1+ (7.032,0) [0|1793.16] "A" Vector__XXX
 SG_ V2G_chgParamRes_evseMaxVLim m7 : 26|8@1+ (4.688,0) [0|1195.44] "V" Vector__XXX
 SG_ V2G_chgParamRes_evseMinILim m7 : 34|8@1+ (7.032,0) [0|1793.16] "A" Vector__XXX
 SG_ V2G_chgParamRes_evseMinVLim m7 : 42|8@1+ (4.688,0) [0|1195.44] "V" Vector__XXX
 SG_ V2G_chgParamRes_evseMaxPowerLim m7 : 50|8@1+ (5.9766,0) [0|1524.033] "kW" Vector__XXX
 SG_ V2G_chgParamRes_evseMaxPower_val m7 : 58|1@1+ (1,0) [0|1] "" Vector__XXX
 SG_ V2G_chgParamRes_isoState m7 : 59|3@1+ (1,0) [0|7] "" Vector__XXX
 SG_ V2G_chgParamRes_isoState_val m7 : 62|1@1+ (1,0) [0|1] "" Vector__XXX

BO_ 1338 VCBATT0_alertLog: 8 VCBATT0
 SG_ VCBATT0_alertID M : 0|9@1+ (1,0) [0|511] "" Vector__XXX
 SG_ VCBATT0_alertState : 15|1@1+ (1,0) [0|1] "" Vector__XXX
 SG_ VCBATT0_a001_InternalWatchdog m1 : 16|1@1+ (1,0) [0|1] "" Vector__XXX
 SG_ VCBATT0_a015_NVMMMemOverflow m15 : 16|1@1+ (1,0) [0|1] "" Vector__XXX
 SG_ VCBATT0_a015_NVMMFilesystemError m15 : 17|1@1+ (1,0) [0|1] "" Vector__XXX
 SG_ VCBATT0_a015_NVMMRecordIDError m15 : 18|1@1+ (1,0) [0|1] "" Vector__XXX
 SG_ VCBATT0_a059_voltageDrop m59 : 16|12@1+ (0.005443676,0) [0|22.29185322] "" Vector__XXX
 SG_ VCBATT0_a059_resistanceEstimate m59 : 28|12@1+ (0.00244,0) [0|9.9918] "" Vector__XXX
 SG_ VCBATT0_a059_current m59 : 40|12@1+ (0.05,0) [0|204.75] "" Vector__XXX
 SG_ VCBATT0_a063_switchChannel m63 : 16|8@1+ (1,0) [0|255] "" Vector__XXX
 SG_ VCBATT0_a063_switchType m63 : 24|8@1+ (1,0) [0|255] "" Vector__XXX
 SG_ VCBATT0_a063_ADCVoltage m63 : 32|8@1+ (0.025,0) [0|6.375] "" Vector__XXX
 SG_ VCBATT0_a063_disconnected m63 : 40|1@1+ (1,0) [0|1] "" Vector__XXX
 SG_ VCBATT0_a063_indeterminate m63 : 41|1@1+ (1,0) [0|1] "" Vector__XXX
 SG_ VCBATT0_a063_stuckActive m63 : 42|1@1+ (1,0) [0|1] "" Vector__XXX
 SG_ VCBATT0_a063_faulted m63 : 43|1@1+ (1,0) [0|1] "" Vector__XXX

BO_ 973 VCBATT0_alertMatrix: 8 VCBATT0
 SG_ VCBATT0_matrixIndex M : 0|4@1+ (1,0) [0|15] "" Vector__XXX
 SG_ VCBATT0_a001_WatchdogReset m0 : 4|1@1+ (1,0) [0|1] "" Vector__XXX
 SG_ VCBATT0_a002_PowerLossReset m0 : 5|1@1+ (1,0) [0|1] "" Vector__XXX
 SG_ VCBATT0_a003_SWAssertion m0 : 6|1@1+ (1,0) [0|1] "" Vector__XXX
 SG_ VCBATT0_a005_CANTXError m0 : 8|1@1+ (1,0) [0|1] "" Vector__XXX
 SG_ VCBATT0_a006_CANTX_cyclicError m0 : 9|1@1+ (1,0) [0|1] "" Vector__XXX
 SG_ VCBATT0_a012_CPUReset m0 : 15|1@1+ (1,0) [0|1] "" Vector__XXX
 SG_ VCBATT0_a013_AlertManagerFault m0 : 16|1@1+ (1,0) [0|1] "" Vector__XXX
 SG_ VCBATT0_a015_NVMMError m0 : 18|1@1+ (1,0) [0|1] "" Vector__XXX
 SG_ VCBATT0_a016_NVMMRecordError m0 : 19|1@1+ (1,0) [0|1] "" Vector__XXX
 SG_ VCBATT0_a021_TaskSchedulerError m0 : 24|1@1+ (1,0) [0|1] "" Vector__XXX
 SG_ VCBATT0_a022_TaskInitError m0 : 25|1@1+ (1,0) [0|1] "" Vector__XXX
 SG_ VCBATT0_a029_CoreDump m0 : 32|1@1+ (1,0) [0|1] "" Vector__XXX
 SG_ VCBATT0_a030_ECULogUploadRequest m0 : 33|1@1+ (1,0) [0|1] "" Vector__XXX
 SG_ VCBATT0_a031_UDSActive m0 : 34|1@1+ (1,0) [0|1] "" Vector__XXX
 SG_ VCBATT0_a032_ipcWatchdogExpired m0 : 35|1@1+ (1,0) [0|1] "" Vector__XXX
 SG_ VCBATT0_a033_eccNonCorrectableEr m0 : 36|1@1+ (1,0) [0|1] "" Vector__XXX
 SG_ VCBATT0_a038_ProtFaultInfo m0 : 41|1@1+ (1,0) [0|1] "" Vector__XXX
 SG_ VCBATT0_a039_ProtFaultAddress m0 : 42|1@1+ (1,0) [0|1] "" Vector__XXX
 SG_ VCBATT0_a040_Backtrace m0 : 43|1@1+ (1,0) [0|1] "" Vector__XXX
 SG_ VCBATT0_a041_HighCPULoad m0 : 44|1@1+ (1,0) [0|1] "" Vector__XXX
 SG_ VCBATT0_a042_HighStackUsage m0 : 45|1@1+ (1,0) [0|1] "" Vector__XXX
 SG_ VCBATT0_a043_Task1msError m0 : 46|1@1+ (1,0) [0|1] "" Vector__XXX
 SG_ VCBATT0_a044_Task10msError m0 : 47|1@1+ (1,0) [0|1] "" Vector__XXX
 SG_ VCBATT0_a045_Task100msError m0 : 48|1@1+ (1,0) [0|1] "" Vector__XXX
 SG_ VCBATT0_a046_Task1000msError m0 : 49|1@1+ (1,0) [0|1] "" Vector__XXX
 SG_ VCBATT0_a047_resetReason m0 : 50|1@1+ (1,0) [0|1] "" Vector__XXX
 SG_ VCBATT0_a058_inputRHighSyncDebug m0 : 61|1@1+ (1,0) [0|1] "" Vector__XXX
 SG_ VCBATT0_a059_inputResistanceHigh m0 : 62|1@1+ (1,0) [0|1] "" Vector__XXX
 SG_ VCBATT0_a060_engineeringBuild m0 : 63|1@1+ (1,0) [0|1] "" Vector__XXX
 SG_ VCBATT0_a061_XCPConnected m1 : 4|1@1+ (1,0) [0|1] "" Vector__XXX
 SG_ VCBATT0_a062_XCPWasConnected m1 : 5|1@1+ (1,0) [0|1] "" Vector__XXX
 SG_ VCBATT0_a063_SwitchFault m1 : 6|1@1+ (1,0) [0|1] "" Vector__XXX
 SG_ VCBATT0_a064_busSleepReqTimeout m1 : 7|1@1+ (1,0) [0|1] "" Vector__XXX
 SG_ VCBATT0_a423_rtosSleepFailed m7 : 6|1@1+ (1,0) [0|1] "" Vector__XXX

BO_ 1618 VCBATT0_info: 8 VCBATT0
 SG_ VCBATT0_infoIndex M : 0|8@1+ (1,0) [0|255] "" Vector__XXX
 SG_ VCBATT0_infoBuildType m10 : 8|3@1+ (1,0) [0|7] "" Vector__XXX
 SG_ VCBATT0_infoBuildConfigId m10 : 16|16@1+ (1,0) [0|65535] "" Vector__XXX
 SG_ VCBATT0_infoHardwareId m10 : 32|16@1+ (1,0) [0|65535] "" Vector__XXX
 SG_ VCBATT0_infoComponentId m10 : 48|16@1+ (1,0) [0|65535] "" Vector__XXX
 SG_ VCBATT0_infoPcbaId m11 : 8|8@1+ (1,0) [0|255] "" Vector__XXX
 SG_ VCBATT0_infoAssemblyId m11 : 16|8@1+ (1,0) [0|255] "" Vector__XXX
 SG_ VCBATT0_infoUsageId m11 : 24|16@1+ (1,0) [0|65535] "" Vector__XXX
 SG_ VCBATT0_infoSubUsageId m11 : 40|16@1+ (1,0) [0|65535] "" Vector__XXX
 SG_ VCBATT0_infoAppCrc m13 : 8|32@1+ (1,0) [0|4294967295] "" Vector__XXX
 SG_ VCBATT0_infoAppGitHash m17 : 8|56@1+ (1,0) [0|7.20575940379e+16] "" Vector__XXX
 SG_ VCBATT0_infoBootGitHash m18 : 8|56@1+ (1,0) [0|7.20575940379e+16] "" Vector__XXX
 SG_ VCBATT0_infoBootUdsProtoVersion m20 : 8|16@1+ (1,0) [0|65535] "" Vector__XXX
 SG_ VCBATT0_infoBootCrc m20 : 24|32@1+ (1,0) [0|4294967295] "" Vector__XXX

BO_ 1858 VCBATT1_LVBMS_statusHigh: 8 VCBATT1
 SG_ VCBATT1_lvbmsStatusHighIndex M : 0|3@1+ (1,0) [0|7] "" Vector__XXX
 SG_ VCBATT1_LVBMS_packCurrent m0 : 3|22@1+ (0.001,-2000) [-2000|2194.302] "A" Vector__XXX
 SG_ VCBATT1_LVBMS_packVoltage m0 : 25|16@1+ (0.001,0) [0|65.534] "V" Vector__XXX
 SG_ VCBATT1_LVBMS_packTemperature m0 : 41|9@1+ (0.5,-50) [-50|205] "degC" Vector__XXX
 SG_ VCBATT1_LVBMS_MOSTemperature m0 : 50|12@1+ (0.5,-50) [-50|1997] "degC" Vector__XXX
 SG_ VCBATT1_LVBMS_sumCellVoltage m1 : 8|16@1+ (0.001,0) [0|65.534] "V" Vector__XXX
 SG_ VCBATT1_LVBMS_maxBrickVoltage m1 : 24|13@1+ (0.001,0) [0|8.19] "V" Vector__XXX
 SG_ VCBATT1_LVBMS_maxBrickVoltageInd m1 : 40|8@1+ (1,0) [0|255] "" Vector__XXX
 SG_ VCBATT1_totalLVLoadCurrent m2 : 8|14@1- (0.1,0) [-200|400] "A" Vector__XXX
 SG_ VCBATT1_LVPackChargeCurrentLimit m2 : 22|12@1+ (0.1,0) [0|400] "A" Vector__XXX
 SG_ VCBATT1_LVPackCurrent m2 : 34|14@1- (0.1,0) [-200|400] "A" Vector__XXX
 SG_ VCBATT1_LVBMS_estimatedPackOcv m2 : 48|16@1+ (0.001,0) [0|65.535] "V" Vector__XXX
 SG_ VCBATT1_LVBMS_voltageTarget m3 : 3|16@1+ (0.001,0) [0|65.535] "V" Vector__XXX
 SG_ VCBATT1_LVBMS_currentTarget m3 : 19|18@1+ (0.001,-122) [-120|120] "A" Vector__XXX
 SG_ VCBATT1_LVBMS_maxAllowedChargeCu m3 : 37|13@1+ (0.1,0) [0|819] "A" Vector__XXX
 SG_ VCBATT1_LVBMS_maxAllowedDischarg m3 : 50|13@1+ (0.1,0) [0|819] "A" Vector__XXX
 SG_ VCBATT1_LVBMS_MOSCommand m4 : 3|1@1+ (1,0) [0|1] "" Vector__XXX
 SG_ VCBATT1_LVBMS_ClearErrorCntrComm m4 : 4|1@1+ (1,0) [0|1] "" Vector__XXX
 SG_ VCBATT1_LVBMS_ClearHistoricFault m4 : 5|1@1+ (1,0) [0|1] "" Vector__XXX
 SG_ VCBATT1_LVBMS_ResetLVBMSCommand m4 : 6|1@1+ (1,0) [0|1] "" Vector__XXX
 SG_ VCBATT1_LVBMS_EnterHibernationCo m4 : 7|1@1+ (1,0) [0|1] "" Vector__XXX
 SG_ VCBATT1_LVBMS_ECPAState m4 : 8|2@1+ (1,0) [0|3] "" Vector__XXX
 SG_ VCBATT1_LVBMS_MOSState m4 : 10|2@1+ (1,0) [0|3] "" Vector__XXX
 SG_ VCBATT1_LVBMS_VehicleState m4 : 12|2@1+ (1,0) [0|3] "" Vector__XXX
 SG_ VCBATT1_LVBMS_LINWakeDisabled m4 : 14|1@1+ (1,0) [0|1] "" Vector__XXX
 SG_ VCBATT1_LVBMS_chargeType m4 : 16|3@1+ (1,0) [0|7] "" Vector__XXX
 SG_ VCBATT1_LVBMS_cellAndArcProtEnab m4 : 19|1@1+ (1,0) [0|1] "" Vector__XXX
 SG_ VCBATT1_LVBMS_avgBrickVoltage m4 : 24|13@1+ (0.001,0) [0|8.19] "V" Vector__XXX
 SG_ VCBATT1_LVBMS_minBrickVoltage m4 : 40|13@1+ (0.001,0) [0|8.19] "V" Vector__XXX
 SG_ VCBATT1_LVBMS_minBrickVoltageInd m4 : 56|8@1+ (1,0) [0|255] "" Vector__XXX

BO_ 1119 VCBATT1_LVSelfTests: 8 VCBATT1
 SG_ VCBATT1_LVSelfTestsChecksum : 0|8@1+ (1,0) [0|255] "" Vector__XXX
 SG_ VCBATT1_LVSelfTestsCounter : 8|4@1+ (1,0) [0|15] "" Vector__XXX
 SG_ VCBATT1_LVSelfTestsIndex M : 12|1@1+ (1,0) [0|1] "" Vector__XXX
 SG_ VCBATT1_lvProtectionSelfTestsEna m1 : 13|1@1+ (1,0) [0|1] "" Vector__XXX
 SG_ VCBATT1_startBattDomainOvercurre m1 : 14|1@1+ (1,0) [0|1] "" Vector__XXX
 SG_ VCBATT1_startBattDomainOvervolta m1 : 15|1@1+ (1,0) [0|1] "" Vector__XXX
 SG_ VCBATT1_startBattDomainUndervolt m1 : 16|1@1+ (1,0) [0|1] "" Vector__XXX
 SG_ VCBATT1_startDualPowerLoadsSelfT m1 : 17|1@1+ (1,0) [0|1] "" Vector__XXX
 SG_ VCBATT1_startVCBattBridgeEFuseAS m1 : 18|1@1+ (1,0) [0|1] "" Vector__XXX
 SG_ VCBATT1_startPCSOVShutdownSelfTe m1 : 19|1@1+ (1,0) [0|1] "" Vector__XXX
 SG_ VCBATT1_startPCSDomainOvervoltag m1 : 20|1@1+ (1,0) [0|1] "" Vector__XXX
 SG_ VCBATT1_startBattDomainUnde_0001 m1 : 21|1@1+ (1,0) [0|1] "" Vector__XXX
 SG_ VCBATT1_startPCSDomainUndervolta m1 : 22|1@1+ (1,0) [0|1] "" Vector__XXX
 SG_ VCBATT1_startVCFrontBridgeEFuseA m1 : 23|1@1+ (1,0) [0|1] "" Vector__XXX
 SG_ VCBATT1_battDomainOvercurrentSel m1 : 24|2@1+ (1,0) [0|3] "" Vector__XXX
 SG_ VCBATT1_battDomainOvercurre_0001 m1 : 26|3@1+ (1,0) [0|7] "" Vector__XXX
 SG_ VCBATT1_battDomainOvervoltageSel m1 : 29|2@1+ (1,0) [0|3] "" Vector__XXX
 SG_ VCBATT1_battDomainOvervolta_0001 m1 : 32|3@1+ (1,0) [0|7] "" Vector__XXX
 SG_ VCBATT1_battDomainUndervoltageSe m1 : 35|2@1+ (1,0) [0|3] "" Vector__XXX
 SG_ VCBATT1_battDomainUndervolt_0001 m1 : 37|3@1+ (1,0) [0|7] "" Vector__XXX
 SG_ VCBATT1_dualPowerLoadsSelfTestRe m1 : 40|2@1+ (1,0) [0|3] "" Vector__XXX
 SG_ VCBATT1_dualPowerLoadsSelfTestSt m1 : 42|3@1+ (1,0) [0|7] "" Vector__XXX
 SG_ VCBATT1_vcbattBridgeEFuseASICSel m1 : 45|2@1+ (1,0) [0|3] "" Vector__XXX
 SG_ VCBATT1_vcbattBridgeEFuseAS_0001 m1 : 48|3@1+ (1,0) [0|7] "" Vector__XXX
 SG_ VCBATT1_uvProtectionState m1 : 51|4@1+ (1,0) [0|15] "" Vector__XXX
 SG_ VCBATT1_undervoltageSelfTestFaul m1 : 55|1@1+ (1,0) [0|1] "" Vector__XXX
 SG_ VC_selfTestsRunningMode m1 : 56|3@1+ (1,0) [0|7] "" Vector__XXX

CM_ BO_ 954 "USM ECU message: alert matrix";
CM_ SG_ 954 USM_matrixIndex "USM ECU: matrix index";
CM_ SG_ 954 USM_a001_WatchdogReset "USM ECU: a001 watchdog reset";
CM_ SG_ 954 USM_a002_PowerLossReset "USM ECU: a002 power loss reset";
CM_ SG_ 954 USM_a003_SWAssertion "USM ECU: a003 SW assertion";
CM_ SG_ 954 USM_a005_CANTXError "USM ECU: a005 CANTX error";
CM_ SG_ 954 USM_a006_CANTX_cyclicError "USM ECU: a006 CANTX cyclic error";
CM_ SG_ 954 USM_a012_CPUReset "USM ECU: a012 CPU reset";
CM_ SG_ 954 USM_a013_AlertManagerFault "USM ECU: a013 alert manager fault";
CM_ SG_ 954 USM_a015_NVMMError "USM ECU: a015 NVMM error";
CM_ SG_ 954 USM_a016_NVMMRecordError "USM ECU: a016 NVMM record error";
CM_ SG_ 954 USM_a021_TaskSchedulerError "USM ECU: a021 task scheduler error";
CM_ SG_ 954 USM_a022_TaskInitError "USM ECU: a022 task init error";
CM_ SG_ 954 USM_a029_CoreDump "USM ECU: a029 core dump";
CM_ SG_ 954 USM_a030_ECULogUploadRequest "USM ECU: a030 ECU log upload request";
CM_ SG_ 954 USM_a031_UDSActive "USM ECU: a031 UDS active";
CM_ SG_ 954 USM_a041_HighCPULoad "USM ECU: a041 high CPU load";
CM_ SG_ 954 USM_a042_HighStackUsage "USM ECU: a042 high stack usage";
CM_ SG_ 954 USM_a043_Task1msError "USM ECU: a043 task1ms error";
CM_ SG_ 954 USM_a044_Task10msError "USM ECU: a044 task10ms error";
CM_ SG_ 954 USM_a045_Task100msError "USM ECU: a045 task100ms error";
CM_ SG_ 954 USM_a046_Task1000msError "USM ECU: a046 task1000ms error";
CM_ SG_ 954 USM_a057_HVP_MIA "USM ECU: a057 HVP MIA";
CM_ SG_ 954 USM_a058_inputRHighSyncDebug "USM ECU: a058 input r high sync debug";
CM_ SG_ 954 USM_a059_inputResistanceHigh "USM ECU: a059 input resistance high";
CM_ SG_ 954 USM_a060_engineeringBuild "USM ECU: a060 engineering build";
CM_ SG_ 954 USM_a061_XCPConnected "USM ECU: a061 XCP connected";
CM_ SG_ 954 USM_a062_XCPWasConnected "USM ECU: a062 XCP was connected";
CM_ SG_ 954 USM_a063_SwitchFault "USM ECU: a063 switch fault";
CM_ SG_ 954 USM_a064_busSleepReqTimeout "USM ECU: a064 bus sleep req timeout";
CM_ SG_ 954 USM_a082_VCRIGHT_IPC_MIA "USM ECU: a082 VCRIGHT IPC MIA";
CM_ SG_ 954 USM_a083_VCLEFT_IPC_MIA "USM ECU: a083 VCLEFT IPC MIA";
CM_ SG_ 954 USM_a084_TPMS_MIA "USM ECU: a084 TPMS MIA";
CM_ SG_ 954 USM_a085_CCCM_MIA "USM ECU: a085 CCCM MIA";
CM_ SG_ 954 USM_a086_VCBATT_MIA "USM ECU: a086 VCBATT MIA";
CM_ SG_ 954 USM_a087_DIREL_MIA "USM ECU: a087 DIREL MIA";
CM_ SG_ 954 USM_a088_DIRER_MIA "USM ECU: a088 DIRER MIA";
CM_ SG_ 954 USM_a089_IBST_MIA "USM ECU: a089 IBST MIA";
CM_ SG_ 954 USM_a090_APS_MIA "USM ECU: a090 APS MIA";
CM_ SG_ 954 USM_a091_CMPD_MIA "USM ECU: a091 CMPD MIA";
CM_ SG_ 954 USM_a092_VCSEATD_MIA "USM ECU: a092 VCSEATD MIA";
CM_ SG_ 954 USM_a093_VCSEATP_MIA "USM ECU: a093 VCSEATP MIA";
CM_ SG_ 954 USM_a094_EPAS3P_MIA "USM ECU: a094 EPAS3 p MIA";
CM_ SG_ 954 USM_a095_CHG_MIA "USM ECU: a095 CHG MIA";
CM_ SG_ 954 USM_a096_OCS1P_MIA "USM ECU: a096 OCS1 p MIA";
CM_ SG_ 954 USM_a097_CMP_MIA "USM ECU: a097 CMP MIA";
CM_ SG_ 954 USM_a098_DIR_MIA "USM ECU: a098 DIR MIA";
CM_ SG_ 954 USM_a099_PARK_MIA "USM ECU: a099 PARK MIA";
CM_ SG_ 954 USM_a100_CANbus_MIA "USM ECU: a100 CA nbus MIA";
CM_ SG_ 954 USM_a101_PM_MIA "USM ECU: a101 PM MIA";
CM_ SG_ 954 USM_a102_PTC_MIA "USM ECU: a102 PTC MIA";
CM_ SG_ 954 USM_a103_CP_MIA "USM ECU: a103 CP MIA";
CM_ SG_ 954 USM_a104_DAS_MIA "USM ECU: a104 DAS MIA";
CM_ SG_ 954 USM_a105_TAS_MIA "USM ECU: a105 TAS MIA";
CM_ SG_ 954 USM_a106_PCS_MIA "USM ECU: a106 PCS MIA";
CM_ SG_ 954 USM_a107_BMS_MIA "USM ECU: a107 BMS MIA";
CM_ SG_ 954 USM_a108_DIF_MIA "USM ECU: a108 DIF MIA";
CM_ SG_ 954 USM_a109_RCM_MIA "USM ECU: a109 RCM MIA";
CM_ SG_ 954 USM_a110_GTW_MIA "USM ECU: a110 GTW MIA";
CM_ SG_ 954 USM_a111_EPBR_MIA "USM ECU: a111 EPBR MIA";
CM_ SG_ 954 USM_a112_EPBL_MIA "USM ECU: a112 EPBL MIA";
CM_ SG_ 954 USM_a113_UI_MIA "USM ECU: a113 UI MIA";
CM_ SG_ 954 USM_a114_ESP_MIA "USM ECU: a114 ESP MIA";
CM_ SG_ 954 USM_a115_VCSEC_MIA "USM ECU: a115 VCSEC MIA";
CM_ SG_ 954 USM_a116_VCRIGHT_MIA "USM ECU: a116 VCRIGHT MIA";
CM_ SG_ 954 USM_a117_VCLEFT_MIA "USM ECU: a117 VCLEFT MIA";
CM_ SG_ 954 USM_a118_VCFRONT_MIA "USM ECU: a118 VCFRONT MIA";
CM_ SG_ 954 USM_a119_SCCM_MIA "USM ECU: a119 SCCM MIA";
CM_ SG_ 954 USM_a120_DI_DRIVE_MIA "USM ECU: a120 DI DRIVE MIA";
CM_ SG_ 954 USM_a131_s1ComError "USM ECU: a131 s1 com error";
CM_ SG_ 954 USM_a132_s2ComError "USM ECU: a132 s2 com error";
CM_ SG_ 954 USM_a133_s3ComError "USM ECU: a133 s3 com error";
CM_ SG_ 954 USM_a134_s4ComError "USM ECU: a134 s4 com error";
CM_ SG_ 954 USM_a135_s5ComError "USM ECU: a135 s5 com error";
CM_ SG_ 954 USM_a136_s6ComError "USM ECU: a136 s6 com error";
CM_ SG_ 954 USM_a137_s7ComError "USM ECU: a137 s7 com error";
CM_ SG_ 954 USM_a138_s8ComError "USM ECU: a138 s8 com error";
CM_ SG_ 954 USM_a139_s9ComError "USM ECU: a139 s9 com error";
CM_ SG_ 954 USM_a140_s10ComError "USM ECU: a140 s10 com error";
CM_ SG_ 954 USM_a141_s11ComError "USM ECU: a141 s11 com error";
CM_ SG_ 954 USM_a142_s12ComError "USM ECU: a142 s12 com error";
CM_ SG_ 954 USM_a143_s1HwError "USM ECU: a143 s1 hw error";
CM_ SG_ 954 USM_a144_s2HwError "USM ECU: a144 s2 hw error";
CM_ SG_ 954 USM_a145_s3HwError "USM ECU: a145 s3 hw error";
CM_ SG_ 954 USM_a146_s4HwError "USM ECU: a146 s4 hw error";
CM_ SG_ 954 USM_a147_s5HwError "USM ECU: a147 s5 hw error";
CM_ SG_ 954 USM_a148_s6HwError "USM ECU: a148 s6 hw error";
CM_ SG_ 954 USM_a149_s7HwError "USM ECU: a149 s7 hw error";
CM_ SG_ 954 USM_a150_s8HwError "USM ECU: a150 s8 hw error";
CM_ SG_ 954 USM_a151_s9HwError "USM ECU: a151 s9 hw error";
CM_ SG_ 954 USM_a152_s10HwError "USM ECU: a152 s10 hw error";
CM_ SG_ 954 USM_a153_s11HwError "USM ECU: a153 s11 hw error";
CM_ SG_ 954 USM_a154_s12HwError "USM ECU: a154 s12 hw error";
CM_ SG_ 954 USM_a155_s1OverTemp "USM ECU: a155 s1 over temp";
CM_ SG_ 954 USM_a156_s2OverTemp "USM ECU: a156 s2 over temp";
CM_ SG_ 954 USM_a157_s3OverTemp "USM ECU: a157 s3 over temp";
CM_ SG_ 954 USM_a158_s4OverTemp "USM ECU: a158 s4 over temp";
CM_ SG_ 954 USM_a159_s5OverTemp "USM ECU: a159 s5 over temp";
CM_ SG_ 954 USM_a160_s6OverTemp "USM ECU: a160 s6 over temp";
CM_ SG_ 954 USM_a161_s7OverTemp "USM ECU: a161 s7 over temp";
CM_ SG_ 954 USM_a162_s8OverTemp "USM ECU: a162 s8 over temp";
CM_ SG_ 954 USM_a163_s9OverTemp "USM ECU: a163 s9 over temp";
CM_ SG_ 954 USM_a164_s10OverTemp "USM ECU: a164 s10 over temp";
CM_ SG_ 954 USM_a165_s11OverTemp "USM ECU: a165 s11 over temp";
CM_ SG_ 954 USM_a166_s12OverTemp "USM ECU: a166 s12 over temp";
CM_ SG_ 954 USM_a177_s1Blocked "USM ECU: a177 s1 blocked";
CM_ SG_ 954 USM_a178_s2Blocked "USM ECU: a178 s2 blocked";
CM_ SG_ 954 USM_a179_s3Blocked "USM ECU: a179 s3 blocked";
CM_ SG_ 954 USM_a180_s4Blocked "USM ECU: a180 s4 blocked";
CM_ SG_ 954 USM_a181_s5Blocked "USM ECU: a181 s5 blocked";
CM_ SG_ 954 USM_a182_s6Blocked "USM ECU: a182 s6 blocked";
CM_ SG_ 954 USM_a183_s7Blocked "USM ECU: a183 s7 blocked";
CM_ SG_ 954 USM_a184_s8Blocked "USM ECU: a184 s8 blocked";
CM_ SG_ 954 USM_a185_s9Blocked "USM ECU: a185 s9 blocked";
CM_ SG_ 954 USM_a186_s10Blocked "USM ECU: a186 s10 blocked";
CM_ SG_ 954 USM_a187_s11Blocked "USM ECU: a187 s11 blocked";
CM_ SG_ 954 USM_a188_s12Blocked "USM ECU: a188 s12 blocked";
CM_ SG_ 954 USM_a189_s1Disconnected "USM ECU: a189 s1 disconnected";
CM_ SG_ 954 USM_a190_s2Disconnected "USM ECU: a190 s2 disconnected";
CM_ SG_ 954 USM_a191_s3Disconnected "USM ECU: a191 s3 disconnected";
CM_ SG_ 954 USM_a192_s4Disconnected "USM ECU: a192 s4 disconnected";
CM_ SG_ 954 USM_a193_s5Disconnected "USM ECU: a193 s5 disconnected";
CM_ SG_ 954 USM_a194_s6Disconnected "USM ECU: a194 s6 disconnected";
CM_ SG_ 954 USM_a195_s7Disconnected "USM ECU: a195 s7 disconnected";
CM_ SG_ 954 USM_a196_s8Disconnected "USM ECU: a196 s8 disconnected";
CM_ SG_ 954 USM_a197_s9Disconnected "USM ECU: a197 s9 disconnected";
CM_ SG_ 954 USM_a198_s10Disconnected "USM ECU: a198 s10 disconnected";
CM_ SG_ 954 USM_a199_s11Disconnected "USM ECU: a199 s11 disconnected";
CM_ SG_ 954 USM_a200_s12Disconnected "USM ECU: a200 s12 disconnected";
CM_ SG_ 954 USM_a201_e52142Fault "USM ECU: a201 e52142 fault";
CM_ SG_ 954 USM_a202_e52417Fault "USM ECU: a202 e52417 fault";
CM_ SG_ 954 USM_a203_s1NearFieldDetected "USM ECU: a203 s1 near field detected";
CM_ SG_ 954 USM_a204_s2NearFieldDetected "USM ECU: a204 s2 near field detected";
CM_ SG_ 954 USM_a205_s3NearFieldDetected "USM ECU: a205 s3 near field detected";
CM_ SG_ 954 USM_a206_s4NearFieldDetected "USM ECU: a206 s4 near field detected";
CM_ SG_ 954 USM_a207_s5NearFieldDetected "USM ECU: a207 s5 near field detected";
CM_ SG_ 954 USM_a208_s6NearFieldDetected "USM ECU: a208 s6 near field detected";
CM_ SG_ 954 USM_a209_s7NearFieldDetected "USM ECU: a209 s7 near field detected";
CM_ SG_ 954 USM_a210_s8NearFieldDetected "USM ECU: a210 s8 near field detected";
CM_ SG_ 954 USM_a211_s9NearFieldDetected "USM ECU: a211 s9 near field detected";
CM_ SG_ 954 USM_a212_s10NearFieldDetected "USM ECU: a212 s10 near field detected";
CM_ SG_ 954 USM_a213_s11NearFieldDetected "USM ECU: a213 s11 near field detected";
CM_ SG_ 954 USM_a214_s12NearFieldDetected "USM ECU: a214 s12 near field detected";
CM_ SG_ 954 USM_a215_s1DebugEepromInvalid "USM ECU: a215 s1 debug eeprom invalid";
CM_ SG_ 954 USM_a216_s2DebugEepromInvalid "USM ECU: a216 s2 debug eeprom invalid";
CM_ SG_ 954 USM_a217_s3DebugEepromInvalid "USM ECU: a217 s3 debug eeprom invalid";
CM_ SG_ 954 USM_a218_s4DebugEepromInvalid "USM ECU: a218 s4 debug eeprom invalid";
CM_ SG_ 954 USM_a219_s5DebugEepromInvalid "USM ECU: a219 s5 debug eeprom invalid";
CM_ SG_ 954 USM_a220_s6DebugEepromInvalid "USM ECU: a220 s6 debug eeprom invalid";
CM_ SG_ 954 USM_a221_s7DebugEepromInvalid "USM ECU: a221 s7 debug eeprom invalid";
CM_ SG_ 954 USM_a222_s8DebugEepromInvalid "USM ECU: a222 s8 debug eeprom invalid";
CM_ SG_ 954 USM_a223_s9DebugEepromInvalid "USM ECU: a223 s9 debug eeprom invalid";
CM_ SG_ 954 USM_a224_s10DebugEepromInvalid "USM ECU: a224 s10 debug eeprom invalid";
CM_ SG_ 954 USM_a225_s11DebugEepromInvalid "USM ECU: a225 s11 debug eeprom invalid";
CM_ SG_ 954 USM_a226_s12DebugEepromInvalid "USM ECU: a226 s12 debug eeprom invalid";
CM_ SG_ 954 USM_a227_s1InitError "USM ECU: a227 s1 init error";
CM_ SG_ 954 USM_a228_s2InitError "USM ECU: a228 s2 init error";
CM_ SG_ 954 USM_a229_s3InitError "USM ECU: a229 s3 init error";
CM_ SG_ 954 USM_a230_s4InitError "USM ECU: a230 s4 init error";
CM_ SG_ 954 USM_a231_s5InitError "USM ECU: a231 s5 init error";
CM_ SG_ 954 USM_a232_s6InitError "USM ECU: a232 s6 init error";
CM_ SG_ 954 USM_a233_s7InitError "USM ECU: a233 s7 init error";
CM_ SG_ 954 USM_a234_s8InitError "USM ECU: a234 s8 init error";
CM_ SG_ 954 USM_a235_s9InitError "USM ECU: a235 s9 init error";
CM_ SG_ 954 USM_a236_s10InitError "USM ECU: a236 s10 init error";
CM_ SG_ 954 USM_a237_s11InitError "USM ECU: a237 s11 init error";
CM_ SG_ 954 USM_a238_s12InitError "USM ECU: a238 s12 init error";
CM_ SG_ 954 USM_a240_s1HwComErrDiagnostics "USM ECU: a240 s1 hw com err diagnostics";
CM_ SG_ 954 USM_a241_s2HwComErrDiagnostics "USM ECU: a241 s2 hw com err diagnostics";
CM_ SG_ 954 USM_a242_s3HwComErrDiagnostics "USM ECU: a242 s3 hw com err diagnostics";
CM_ SG_ 954 USM_a243_s4HwComErrDiagnostics "USM ECU: a243 s4 hw com err diagnostics";
CM_ SG_ 954 USM_a244_s5HwComErrDiagnostics "USM ECU: a244 s5 hw com err diagnostics";
CM_ SG_ 954 USM_a245_s6HwComErrDiagnostics "USM ECU: a245 s6 hw com err diagnostics";
CM_ SG_ 954 USM_a246_s7HwComErrDiagnostics "USM ECU: a246 s7 hw com err diagnostics";
CM_ SG_ 954 USM_a247_s8HwComErrDiagnostics "USM ECU: a247 s8 hw com err diagnostics";
CM_ SG_ 954 USM_a248_s9HwComErrDiagnostics "USM ECU: a248 s9 hw com err diagnostics";
CM_ SG_ 954 USM_a249_s10HwComErrDiagnostics "USM ECU: a249 s10 hw com err diagnostics";
CM_ SG_ 954 USM_a250_s11HwComErrDiagnostics "USM ECU: a250 s11 hw com err diagnostics";
CM_ SG_ 954 USM_a251_s12HwComErrDiagnostics "USM ECU: a251 s12 hw com err diagnostics";
CM_ SG_ 954 USM_a252_anyComErrorSet "USM ECU: a252 any com error set";
CM_ SG_ 954 USM_a253_anyHwErrorSet "USM ECU: a253 any hw error set";
CM_ SG_ 954 USM_a254_frontSensorsOvercurrent "USM ECU: a254 front sensors overcurrent";
CM_ SG_ 954 USM_a255_rearSensorsOvercurrent "USM ECU: a255 rear sensors overcurrent";
CM_ BO_ 807 "USM ECU message: info";
CM_ SG_ 807 USM_infoIndex "USM ECU: info index";
CM_ SG_ 807 USM_infoBuildType "USM ECU: info build type";
CM_ SG_ 807 USM_infoBuildConfigId "USM ECU: info build config id";
CM_ SG_ 807 USM_infoHardwareId "USM ECU: info hardware id";
CM_ SG_ 807 USM_infoComponentId "USM ECU: info component id";
CM_ SG_ 807 USM_infoPcbaId "USM ECU: info pcba id";
CM_ SG_ 807 USM_infoAssemblyId "USM ECU: info assembly id";
CM_ SG_ 807 USM_infoUsageId "USM ECU: info usage id";
CM_ SG_ 807 USM_infoSubUsageId "USM ECU: info sub usage id";
CM_ SG_ 807 USM_infoAppCrc "USM ECU: info app crc";
CM_ BO_ 1949 "V2G ECU message: evse log data";
CM_ SG_ 1949 V2G_evseLogDataSelect "V2G ECU: evse log data select";
CM_ SG_ 1949 V2G_chgParamRes_respCode "Charge parameter response code reported by CCS DC charger";
CM_ SG_ 1949 V2G_chgParamRes_finished "V2G ECU: chg param res finished";
CM_ SG_ 1949 V2G_chgParamRes_evseStatus "Charge parameter discovery status reported by CCS DC charger";
CM_ SG_ 1949 V2G_chgParamRes_evseMaxILim "Maximum current limit reported by CCS DC charger in charge parameter discovery message";
CM_ SG_ 1949 V2G_chgParamRes_evseMaxVLim "Maximum voltage limit reported by CCS DC charger in charge parameter discovery message";
CM_ SG_ 1949 V2G_chgParamRes_evseMinILim "Minimum current limit reported by CCS DC charger in charge parameter discovery message";
CM_ SG_ 1949 V2G_chgParamRes_evseMinVLim "Minimum voltage limit reported by CCS DC charger in charge parameter discovery message";
CM_ SG_ 1949 V2G_chgParamRes_evseMaxPowerLim "Maximum power limit reported by CCS DC charger in charge parameter discovery message";
CM_ SG_ 1949 V2G_chgParamRes_evseMaxPower_val "Whether maximum power limit reported by CCS DC charger is valid in charge parameter discovery message";
CM_ SG_ 1949 V2G_chgParamRes_isoState "The EVSE's reported isolation status";
CM_ SG_ 1949 V2G_chgParamRes_isoState_val "The validity of the EVSE's reported isolation status";
CM_ BO_ 1338 "VCBATT0 ECU message: alert log";
CM_ SG_ 1338 VCBATT0_alertID "VCBATT0 ECU: alert ID";
CM_ SG_ 1338 VCBATT0_alertState "VCBATT0 ECU: alert state";
CM_ SG_ 1338 VCBATT0_a001_InternalWatchdog "VCBATT0 ECU: a001 internal watchdog";
CM_ SG_ 1338 VCBATT0_a015_NVMMMemOverflow "VCBATT0 ECU: a015 NVMM mem overflow";
CM_ SG_ 1338 VCBATT0_a015_NVMMFilesystemError "VCBATT0 ECU: a015 NVMM filesystem error";
CM_ SG_ 1338 VCBATT0_a015_NVMMRecordIDError "VCBATT0 ECU: a015 NVMM record ID error";
CM_ SG_ 1338 VCBATT0_a059_voltageDrop "VCBATT0 ECU: a059 voltage drop";
CM_ SG_ 1338 VCBATT0_a059_resistanceEstimate "VCBATT0 ECU: a059 resistance estimate";
CM_ SG_ 1338 VCBATT0_a059_current "VCBATT0 ECU: a059 current";
CM_ SG_ 1338 VCBATT0_a063_switchChannel "VCBATT0 ECU: a063 switch channel";
CM_ SG_ 1338 VCBATT0_a063_switchType "VCBATT0 ECU: a063 switch type";
CM_ SG_ 1338 VCBATT0_a063_ADCVoltage "VCBATT0 ECU: a063 ADC voltage";
CM_ SG_ 1338 VCBATT0_a063_disconnected "VCBATT0 ECU: a063 disconnected";
CM_ SG_ 1338 VCBATT0_a063_indeterminate "VCBATT0 ECU: a063 indeterminate";
CM_ SG_ 1338 VCBATT0_a063_stuckActive "VCBATT0 ECU: a063 stuck active";
CM_ SG_ 1338 VCBATT0_a063_faulted "VCBATT0 ECU: a063 faulted";
CM_ BO_ 973 "VCBATT0 ECU message: alert matrix";
CM_ SG_ 973 VCBATT0_matrixIndex "VCBATT0 ECU: matrix index";
CM_ SG_ 973 VCBATT0_a001_WatchdogReset "VCBATT0 ECU: a001 watchdog reset";
CM_ SG_ 973 VCBATT0_a002_PowerLossReset "VCBATT0 ECU: a002 power loss reset";
CM_ SG_ 973 VCBATT0_a003_SWAssertion "VCBATT0 ECU: a003 SW assertion";
CM_ SG_ 973 VCBATT0_a005_CANTXError "VCBATT0 ECU: a005 CANTX error";
CM_ SG_ 973 VCBATT0_a006_CANTX_cyclicError "VCBATT0 ECU: a006 CANTX cyclic error";
CM_ SG_ 973 VCBATT0_a012_CPUReset "VCBATT0 ECU: a012 CPU reset";
CM_ SG_ 973 VCBATT0_a013_AlertManagerFault "VCBATT0 ECU: a013 alert manager fault";
CM_ SG_ 973 VCBATT0_a015_NVMMError "VCBATT0 ECU: a015 NVMM error";
CM_ SG_ 973 VCBATT0_a016_NVMMRecordError "VCBATT0 ECU: a016 NVMM record error";
CM_ SG_ 973 VCBATT0_a021_TaskSchedulerError "VCBATT0 ECU: a021 task scheduler error";
CM_ SG_ 973 VCBATT0_a022_TaskInitError "VCBATT0 ECU: a022 task init error";
CM_ SG_ 973 VCBATT0_a029_CoreDump "VCBATT0 ECU: a029 core dump";
CM_ SG_ 973 VCBATT0_a030_ECULogUploadRequest "VCBATT0 ECU: a030 ECU log upload request";
CM_ SG_ 973 VCBATT0_a031_UDSActive "VCBATT0 ECU: a031 UDS active";
CM_ SG_ 973 VCBATT0_a032_ipcWatchdogExpired "VCBATT0 ECU: a032 ipc watchdog expired";
CM_ SG_ 973 VCBATT0_a033_eccNonCorrectableEr "VCBATT0 ECU: a033 ecc non correctable error";
CM_ SG_ 973 VCBATT0_a038_ProtFaultInfo "VCBATT0 ECU: a038 prot fault info";
CM_ SG_ 973 VCBATT0_a039_ProtFaultAddress "VCBATT0 ECU: a039 prot fault address";
CM_ SG_ 973 VCBATT0_a040_Backtrace "VCBATT0 ECU: a040 backtrace";
CM_ SG_ 973 VCBATT0_a041_HighCPULoad "VCBATT0 ECU: a041 high CPU load";
CM_ SG_ 973 VCBATT0_a042_HighStackUsage "VCBATT0 ECU: a042 high stack usage";
CM_ SG_ 973 VCBATT0_a043_Task1msError "VCBATT0 ECU: a043 task1ms error";
CM_ SG_ 973 VCBATT0_a044_Task10msError "VCBATT0 ECU: a044 task10ms error";
CM_ SG_ 973 VCBATT0_a045_Task100msError "VCBATT0 ECU: a045 task100ms error";
CM_ SG_ 973 VCBATT0_a046_Task1000msError "VCBATT0 ECU: a046 task1000ms error";
CM_ SG_ 973 VCBATT0_a047_resetReason "VCBATT0 ECU: a047 reset reason";
CM_ SG_ 973 VCBATT0_a058_inputRHighSyncDebug "VCBATT0 ECU: a058 input r high sync debug";
CM_ SG_ 973 VCBATT0_a059_inputResistanceHigh "VCBATT0 ECU: a059 input resistance high";
CM_ SG_ 973 VCBATT0_a060_engineeringBuild "VCBATT0 ECU: a060 engineering build";
CM_ SG_ 973 VCBATT0_a061_XCPConnected "VCBATT0 ECU: a061 XCP connected";
CM_ SG_ 973 VCBATT0_a062_XCPWasConnected "VCBATT0 ECU: a062 XCP was connected";
CM_ SG_ 973 VCBATT0_a063_SwitchFault "VCBATT0 ECU: a063 switch fault";
CM_ SG_ 973 VCBATT0_a064_busSleepReqTimeout "VCBATT0 ECU: a064 bus sleep req timeout";
CM_ SG_ 973 VCBATT0_a423_rtosSleepFailed "VCBATT0 ECU: a423 rtos sleep failed";
CM_ BO_ 1618 "VCBATT0 ECU message: info";
CM_ SG_ 1618 VCBATT0_infoIndex "VCBATT0 ECU: info index";
CM_ SG_ 1618 VCBATT0_infoBuildType "VCBATT0 ECU: info build type";
CM_ SG_ 1618 VCBATT0_infoBuildConfigId "VCBATT0 ECU: info build config id";
CM_ SG_ 1618 VCBATT0_infoHardwareId "VCBATT0 ECU: info hardware id";
CM_ SG_ 1618 VCBATT0_infoComponentId "VCBATT0 ECU: info component id";
CM_ SG_ 1618 VCBATT0_infoPcbaId "VCBATT0 ECU: info pcba id";
CM_ SG_ 1618 VCBATT0_infoAssemblyId "VCBATT0 ECU: info assembly id";
CM_ SG_ 1618 VCBATT0_infoUsageId "VCBATT0 ECU: info usage id";
CM_ SG_ 1618 VCBATT0_infoSubUsageId "VCBATT0 ECU: info sub usage id";
CM_ SG_ 1618 VCBATT0_infoAppCrc "VCBATT0 ECU: info app crc";
CM_ SG_ 1618 VCBATT0_infoAppGitHash "VCBATT0 ECU: info app git hash";
CM_ SG_ 1618 VCBATT0_infoBootGitHash "VCBATT0 ECU: info boot git hash";
CM_ SG_ 1618 VCBATT0_infoBootUdsProtoVersion "VCBATT0 ECU: info boot uds proto version";
CM_ SG_ 1618 VCBATT0_infoBootCrc "VCBATT0 ECU: info boot crc";
CM_ BO_ 1858 "VCBATT1 ECU message: LVBMS status high";
CM_ SG_ 1858 VCBATT1_lvbmsStatusHighIndex "VCBATT1 ECU: lvbms status high index";
CM_ SG_ 1858 VCBATT1_LVBMS_packCurrent "Electrical current into the low voltage battery";
CM_ SG_ 1858 VCBATT1_LVBMS_packVoltage "Voltage of the low voltage battery";
CM_ SG_ 1858 VCBATT1_LVBMS_packTemperature "Temperature of the low voltage battery";
CM_ SG_ 1858 VCBATT1_LVBMS_MOSTemperature "Temperature of the MOSFET on the low voltage battery";
CM_ SG_ 1858 VCBATT1_LVBMS_sumCellVoltage "Sum of the cell voltage of the low voltage battery";
CM_ SG_ 1858 VCBATT1_LVBMS_maxBrickVoltage "Maximum cell voltage in the low voltage battery";
CM_ SG_ 1858 VCBATT1_LVBMS_maxBrickVoltageInd "VCBATT1 ECU: LVBMS max brick voltage index";
CM_ SG_ 1858 VCBATT1_totalLVLoadCurrent "Total LV load current of the vehicle.";
CM_ SG_ 1858 VCBATT1_LVPackChargeCurrentLimit "Charge current limit for the LV battery pack.";
CM_ SG_ 1858 VCBATT1_LVPackCurrent "Current of the LV battery pack.";
CM_ SG_ 1858 VCBATT1_LVBMS_estimatedPackOcv "VCBATT1 ECU: LVBMS estimated pack ocv";
CM_ SG_ 1858 VCBATT1_LVBMS_voltageTarget "Voltage target of the LV battery";
CM_ SG_ 1858 VCBATT1_LVBMS_currentTarget "Target current requested by the LV battery";
CM_ SG_ 1858 VCBATT1_LVBMS_maxAllowedChargeCu "Maximum allowed charge current of the battery";
CM_ SG_ 1858 VCBATT1_LVBMS_maxAllowedDischarg "Maximum allowed discharge current of the battery";
CM_ SG_ 1858 VCBATT1_LVBMS_MOSCommand "Current state of the MOS command to the LV battery";
CM_ SG_ 1858 VCBATT1_LVBMS_ClearErrorCntrComm "VCBATT1 ECU: LVBMS clear error cntr command";
CM_ SG_ 1858 VCBATT1_LVBMS_ClearHistoricFault "VCBATT1 ECU: LVBMS clear historic fault command";
CM_ SG_ 1858 VCBATT1_LVBMS_ResetLVBMSCommand "Reset command issued to LVBMS, commanded by VC";
CM_ SG_ 1858 VCBATT1_LVBMS_EnterHibernationCo "VCBATT1 ECU: LVBMS enter hibernation command";
CM_ SG_ 1858 VCBATT1_LVBMS_ECPAState "Current state of the E-CPA on the LV battery";
CM_ SG_ 1858 VCBATT1_LVBMS_MOSState "Current state of the MOS on the LV battery";
CM_ SG_ 1858 VCBATT1_LVBMS_VehicleState "VCBATT1 ECU: LVBMS vehicle state";
CM_ SG_ 1858 VCBATT1_LVBMS_LINWakeDisabled "VCBATT1 ECU: LVBMS LIN wake disabled";
CM_ SG_ 1858 VCBATT1_LVBMS_chargeType "VCBATT1 ECU: LVBMS charge type";
CM_ SG_ 1858 VCBATT1_LVBMS_cellAndArcProtEnab "Indicates whether the VC has commanded cell protections to be active";
CM_ SG_ 1858 VCBATT1_LVBMS_avgBrickVoltage "Average voltage of all cells in the low voltage battery";
CM_ SG_ 1858 VCBATT1_LVBMS_minBrickVoltage "Minimum cell voltage in the low voltage battery";
CM_ SG_ 1858 VCBATT1_LVBMS_minBrickVoltageInd "VCBATT1 ECU: LVBMS min brick voltage index";
CM_ BO_ 1119 "VCBATT1 ECU message: LV self tests";
CM_ SG_ 1119 VCBATT1_LVSelfTestsChecksum "VCBATT1 ECU: LV self tests checksum";
CM_ SG_ 1119 VCBATT1_LVSelfTestsCounter "VCBATT1 ECU: LV self tests counter";
CM_ SG_ 1119 VCBATT1_LVSelfTestsIndex "VCBATT1 ECU: LV self tests index";
CM_ SG_ 1119 VCBATT1_lvProtectionSelfTestsEna "VCBATT1 ECU: lv protection self tests enabled";
CM_ SG_ 1119 VCBATT1_startBattDomainOvercurre "VCBATT1 ECU: start batt domain overcurrent self test";
CM_ SG_ 1119 VCBATT1_startBattDomainOvervolta "VCBATT1 ECU: start batt domain overvoltage self test";
CM_ SG_ 1119 VCBATT1_startBattDomainUndervolt "VCBATT1 ECU: start batt domain undervoltage self test";
CM_ SG_ 1119 VCBATT1_startDualPowerLoadsSelfT "VCBATT1 ECU: start dual power loads self test";
CM_ SG_ 1119 VCBATT1_startVCBattBridgeEFuseAS "VCBATT1 ECU: start VC batt bridge e fuse ASIC self test";
CM_ SG_ 1119 VCBATT1_startPCSOVShutdownSelfTe "VCBATT1 ECU: start PCSOV shutdown self test";
CM_ SG_ 1119 VCBATT1_startPCSDomainOvervoltag "VCBATT1 ECU: start PCS domain overvoltage self test";
CM_ SG_ 1119 VCBATT1_startBattDomainUnde_0001 "VCBATT1 ECU: start batt domain undervoltage VC left self test";
CM_ SG_ 1119 VCBATT1_startPCSDomainUndervolta "VCBATT1 ECU: start PCS domain undervoltage self test";
CM_ SG_ 1119 VCBATT1_startVCFrontBridgeEFuseA "VCBATT1 ECU: start VC front bridge e fuse ASIC self test";
CM_ SG_ 1119 VCBATT1_battDomainOvercurrentSel "Self-Test Result.";
CM_ SG_ 1119 VCBATT1_battDomainOvercurre_0001 "Self-Test State.";
CM_ SG_ 1119 VCBATT1_battDomainOvervoltageSel "Self-Test Result.";
CM_ SG_ 1119 VCBATT1_battDomainOvervolta_0001 "Self-Test State.";
CM_ SG_ 1119 VCBATT1_battDomainUndervoltageSe "Self-Test Result.";
CM_ SG_ 1119 VCBATT1_battDomainUndervolt_0001 "Self-Test State.";
CM_ SG_ 1119 VCBATT1_dualPowerLoadsSelfTestRe "Self-Test Result.";
CM_ SG_ 1119 VCBATT1_dualPowerLoadsSelfTestSt "Self-Test State.";
CM_ SG_ 1119 VCBATT1_vcbattBridgeEFuseASICSel "Self-Test Result.";
CM_ SG_ 1119 VCBATT1_vcbattBridgeEFuseAS_0001 "Self-Test State.";
CM_ SG_ 1119 VCBATT1_uvProtectionState "VCBATT1 ECU: uv protection state";
CM_ SG_ 1119 VCBATT1_undervoltageSelfTestFaul "VCBATT1 ECU: undervoltage self test fault injection ready";
CM_ SG_ 1119 VC_selfTestsRunningMode "VCBATT1 ECU: self tests running mode";
BA_DEF_ BO_ "GenMsgCycleTime" INT 0 3600000;
BA_DEF_ BO_ "GenMsgSendType" ENUM "Cyclic","NotUsed","NotUsed","NotUsed","NotUsed","NotUsed","NotUsed","IfActive","NoMsgSendType","NotUsed";
BA_DEF_ BO_ "VFrameFormat" ENUM "StandardCAN","ExtendedCAN","reserved","J1939PG","reserved","reserved","reserved","reserved","reserved","reserved","reserved","reserved","reserved","reserved","StandardCAN_FD","ExtendedCAN_FD";
BA_DEF_ BO_ "CANFD_BRS" ENUM "0","1";
BA_DEF_ SG_ "SystemSignalLongSymbol" STRING;
BA_DEF_ SG_ "Confidence" ENUM "layout-only","plausible","validated";
BA_DEF_DEF_ "GenMsgCycleTime" 0;
BA_DEF_DEF_ "GenMsgSendType" "NoMsgSendType";
BA_DEF_DEF_ "VFrameFormat" "StandardCAN";
BA_DEF_DEF_ "CANFD_BRS" "1";
BA_DEF_DEF_ "SystemSignalLongSymbol" "";
BA_DEF_DEF_ "Confidence" "layout-only";
BA_ "Confidence" SG_ 807 USM_infoBuildType 1;
BA_ "Confidence" SG_ 1949 V2G_chgParamRes_respCode 1;
BA_ "Confidence" SG_ 1949 V2G_chgParamRes_evseStatus 1;
BA_ "Confidence" SG_ 1949 V2G_chgParamRes_evseMaxILim 1;
BA_ "Confidence" SG_ 1949 V2G_chgParamRes_evseMaxVLim 1;
BA_ "Confidence" SG_ 1949 V2G_chgParamRes_evseMinILim 1;
BA_ "Confidence" SG_ 1949 V2G_chgParamRes_evseMinVLim 1;
BA_ "Confidence" SG_ 1949 V2G_chgParamRes_evseMaxPowerLim 1;
BA_ "Confidence" SG_ 1949 V2G_chgParamRes_evseMaxPower_val 1;
BA_ "Confidence" SG_ 1949 V2G_chgParamRes_isoState 1;
BA_ "Confidence" SG_ 1949 V2G_chgParamRes_isoState_val 1;
BA_ "SystemSignalLongSymbol" SG_ 973 VCBATT0_a033_eccNonCorrectableEr "VCBATT0_a033_eccNonCorrectableError";
BA_ "Confidence" SG_ 1618 VCBATT0_infoBuildType 1;
BA_ "Confidence" SG_ 1858 VCBATT1_LVBMS_packCurrent 1;
BA_ "Confidence" SG_ 1858 VCBATT1_LVBMS_packVoltage 1;
BA_ "Confidence" SG_ 1858 VCBATT1_LVBMS_packTemperature 1;
BA_ "Confidence" SG_ 1858 VCBATT1_LVBMS_MOSTemperature 1;
BA_ "Confidence" SG_ 1858 VCBATT1_LVBMS_sumCellVoltage 1;
BA_ "Confidence" SG_ 1858 VCBATT1_LVBMS_maxBrickVoltage 1;
BA_ "SystemSignalLongSymbol" SG_ 1858 VCBATT1_LVBMS_maxBrickVoltageInd "VCBATT1_LVBMS_maxBrickVoltageIndex";
BA_ "Confidence" SG_ 1858 VCBATT1_totalLVLoadCurrent 1;
BA_ "Confidence" SG_ 1858 VCBATT1_LVPackChargeCurrentLimit 1;
BA_ "Confidence" SG_ 1858 VCBATT1_LVPackCurrent 1;
BA_ "Confidence" SG_ 1858 VCBATT1_LVBMS_estimatedPackOcv 1;
BA_ "Confidence" SG_ 1858 VCBATT1_LVBMS_voltageTarget 1;
BA_ "Confidence" SG_ 1858 VCBATT1_LVBMS_currentTarget 1;
BA_ "Confidence" SG_ 1858 VCBATT1_LVBMS_maxAllowedChargeCu 1;
BA_ "SystemSignalLongSymbol" SG_ 1858 VCBATT1_LVBMS_maxAllowedChargeCu "VCBATT1_LVBMS_maxAllowedChargeCurrent";
BA_ "Confidence" SG_ 1858 VCBATT1_LVBMS_maxAllowedDischarg 1;
BA_ "SystemSignalLongSymbol" SG_ 1858 VCBATT1_LVBMS_maxAllowedDischarg "VCBATT1_LVBMS_maxAllowedDischargeCurrent";
BA_ "Confidence" SG_ 1858 VCBATT1_LVBMS_MOSCommand 1;
BA_ "SystemSignalLongSymbol" SG_ 1858 VCBATT1_LVBMS_ClearErrorCntrComm "VCBATT1_LVBMS_ClearErrorCntrCommand";
BA_ "SystemSignalLongSymbol" SG_ 1858 VCBATT1_LVBMS_ClearHistoricFault "VCBATT1_LVBMS_ClearHistoricFaultCommand";
BA_ "Confidence" SG_ 1858 VCBATT1_LVBMS_ResetLVBMSCommand 1;
BA_ "SystemSignalLongSymbol" SG_ 1858 VCBATT1_LVBMS_EnterHibernationCo "VCBATT1_LVBMS_EnterHibernationCommand";
BA_ "Confidence" SG_ 1858 VCBATT1_LVBMS_ECPAState 1;
BA_ "Confidence" SG_ 1858 VCBATT1_LVBMS_MOSState 1;
BA_ "Confidence" SG_ 1858 VCBATT1_LVBMS_VehicleState 1;
BA_ "Confidence" SG_ 1858 VCBATT1_LVBMS_LINWakeDisabled 1;
BA_ "Confidence" SG_ 1858 VCBATT1_LVBMS_chargeType 1;
BA_ "Confidence" SG_ 1858 VCBATT1_LVBMS_cellAndArcProtEnab 1;
BA_ "SystemSignalLongSymbol" SG_ 1858 VCBATT1_LVBMS_cellAndArcProtEnab "VCBATT1_LVBMS_cellAndArcProtEnabled";
BA_ "Confidence" SG_ 1858 VCBATT1_LVBMS_avgBrickVoltage 1;
BA_ "Confidence" SG_ 1858 VCBATT1_LVBMS_minBrickVoltage 1;
BA_ "SystemSignalLongSymbol" SG_ 1858 VCBATT1_LVBMS_minBrickVoltageInd "VCBATT1_LVBMS_minBrickVoltageIndex";
BA_ "SystemSignalLongSymbol" SG_ 1119 VCBATT1_lvProtectionSelfTestsEna "VCBATT1_lvProtectionSelfTestsEnabled";
BA_ "SystemSignalLongSymbol" SG_ 1119 VCBATT1_startBattDomainOvercurre "VCBATT1_startBattDomainOvercurrentSelfTest";
BA_ "SystemSignalLongSymbol" SG_ 1119 VCBATT1_startBattDomainOvervolta "VCBATT1_startBattDomainOvervoltageSelfTest";
BA_ "SystemSignalLongSymbol" SG_ 1119 VCBATT1_startBattDomainUndervolt "VCBATT1_startBattDomainUndervoltageSelfTest";
BA_ "SystemSignalLongSymbol" SG_ 1119 VCBATT1_startDualPowerLoadsSelfT "VCBATT1_startDualPowerLoadsSelfTest";
BA_ "SystemSignalLongSymbol" SG_ 1119 VCBATT1_startVCBattBridgeEFuseAS "VCBATT1_startVCBattBridgeEFuseASICSelfTest";
BA_ "SystemSignalLongSymbol" SG_ 1119 VCBATT1_startPCSOVShutdownSelfTe "VCBATT1_startPCSOVShutdownSelfTest";
BA_ "SystemSignalLongSymbol" SG_ 1119 VCBATT1_startPCSDomainOvervoltag "VCBATT1_startPCSDomainOvervoltageSelfTest";
BA_ "SystemSignalLongSymbol" SG_ 1119 VCBATT1_startBattDomainUnde_0001 "VCBATT1_startBattDomainUndervoltageVCLeftSelfTest";
BA_ "SystemSignalLongSymbol" SG_ 1119 VCBATT1_startPCSDomainUndervolta "VCBATT1_startPCSDomainUndervoltageSelfTest";
BA_ "SystemSignalLongSymbol" SG_ 1119 VCBATT1_startVCFrontBridgeEFuseA "VCBATT1_startVCFrontBridgeEFuseASICSelfTest";
BA_ "Confidence" SG_ 1119 VCBATT1_battDomainOvercurrentSel 1;
BA_ "SystemSignalLongSymbol" SG_ 1119 VCBATT1_battDomainOvercurrentSel "VCBATT1_battDomainOvercurrentSelfTestResult";
BA_ "Confidence" SG_ 1119 VCBATT1_battDomainOvercurre_0001 1;
BA_ "SystemSignalLongSymbol" SG_ 1119 VCBATT1_battDomainOvercurre_0001 "VCBATT1_battDomainOvercurrentSelfTestState";
BA_ "Confidence" SG_ 1119 VCBATT1_battDomainOvervoltageSel 1;
BA_ "SystemSignalLongSymbol" SG_ 1119 VCBATT1_battDomainOvervoltageSel "VCBATT1_battDomainOvervoltageSelfTestResult";
BA_ "Confidence" SG_ 1119 VCBATT1_battDomainOvervolta_0001 1;
BA_ "SystemSignalLongSymbol" SG_ 1119 VCBATT1_battDomainOvervolta_0001 "VCBATT1_battDomainOvervoltageSelfTestState";
BA_ "Confidence" SG_ 1119 VCBATT1_battDomainUndervoltageSe 1;
BA_ "SystemSignalLongSymbol" SG_ 1119 VCBATT1_battDomainUndervoltageSe "VCBATT1_battDomainUndervoltageSelfTestResult";
BA_ "Confidence" SG_ 1119 VCBATT1_battDomainUndervolt_0001 1;
BA_ "SystemSignalLongSymbol" SG_ 1119 VCBATT1_battDomainUndervolt_0001 "VCBATT1_battDomainUndervoltageSelfTestState";
BA_ "Confidence" SG_ 1119 VCBATT1_dualPowerLoadsSelfTestRe 1;
BA_ "SystemSignalLongSymbol" SG_ 1119 VCBATT1_dualPowerLoadsSelfTestRe "VCBATT1_dualPowerLoadsSelfTestResult";
BA_ "Confidence" SG_ 1119 VCBATT1_dualPowerLoadsSelfTestSt 1;
BA_ "SystemSignalLongSymbol" SG_ 1119 VCBATT1_dualPowerLoadsSelfTestSt "VCBATT1_dualPowerLoadsSelfTestState";
BA_ "Confidence" SG_ 1119 VCBATT1_vcbattBridgeEFuseASICSel 1;
BA_ "SystemSignalLongSymbol" SG_ 1119 VCBATT1_vcbattBridgeEFuseASICSel "VCBATT1_vcbattBridgeEFuseASICSelfTestResult";
BA_ "Confidence" SG_ 1119 VCBATT1_vcbattBridgeEFuseAS_0001 1;
BA_ "SystemSignalLongSymbol" SG_ 1119 VCBATT1_vcbattBridgeEFuseAS_0001 "VCBATT1_vcbattBridgeEFuseASICSelfTestState";
BA_ "Confidence" SG_ 1119 VCBATT1_uvProtectionState 1;
BA_ "SystemSignalLongSymbol" SG_ 1119 VCBATT1_undervoltageSelfTestFaul "VCBATT1_undervoltageSelfTestFaultInjectionReady";
BA_ "Confidence" SG_ 1119 VC_selfTestsRunningMode 1;
VAL_ 807 USM_infoBuildType 4 "INFO_MFG_BUILD" 3 "INFO_TRACEABLE_CI_BUILD" 2 "INFO_LOCAL_BUILD" 1 "INFO_PLATFORM_BUILD" 0 "INFO_UNKNOWN_BUILD" ;
VAL_ 1949 V2G_chgParamRes_respCode 27 "CCS_EVSE_RESP_CODE_MAX" 26 "CCS_EVSE_RESP_CODE_FAILED_CERT_REVOKED" 25 "CCS_EVSE_RESP_CODE_FAILED_CERT_NOT_ALLOWED_AT_EVSE" 24 "CCS_EVSE_RESP_CODE_FAILED_CONTACTOR_ERROR" 23 "CCS_EVSE_RESP_CODE_FAILED_NO_CHARGE_SERVICE_SELECTED" 22 "CCS_EVSE_RESP_CODE_FAILED_WRONG_ENERGY_TRANSFER_TYPE" 21 "CCS_EVSE_RESP_CODE_FAILED_METERING_SIGNATURE_NOT_VALID" 20 "CCS_EVSE_RESP_CODE_FAILED_EVSE_PRESENT_VOLTAGE_TOO_LOW" 19 "CCS_EVSE_RESP_CODE_FAILED_CHARGING_PROFILE_INVALID" 18 "CCS_EVSE_RESP_CODE_FAILED_TARIFF_SELECTION_INVALID" 17 "CCS_EVSE_RESP_CODE_FAILED_POWER_DELIVERY_NOT_APPLIED" 16 "CCS_EVSE_RESP_CODE_FAILED_WRONG_CHARGE_PARAMETER" 15 "CCS_EVSE_RESP_CODE_FAILED_CONTRACT_CANCELED" 14 "CCS_EVSE_RESP_CODE_FAILED_CHALLENGE_INVALID" 13 "CCS_EVSE_RESP_CODE_FAILED_CERT_CHAIN_ERROR" 12 "CCS_EVSE_RESP_CODE_FAILED_NO_CERTIFICATE_AVAILABLE" 11 "CCS_EVSE_RESP_CODE_FAILED_SIGNATURE_ERROR" 10 "CCS_EVSE_RESP_CODE_FAILED_CERTIFICATE_EXPIRED" 9 "CCS_EVSE_RESP_CODE_FAILED_PAYMENT_SELECTION_INVALID" 8 "CCS_EVSE_RESP_CODE_FAILED_SERVICE_SELECTION_INVALID" 7 "CCS_EVSE_RESP_CODE_FAILED_UNKNOWN_SESSION" 6 "CCS_EVSE_RESP_CODE_FAILED_SERVICE_ID_INVALID" 5 "CCS_EVSE_RESP_CODE_FAILED_SEQUENCE_ERROR" 4 "CCS_EVSE_RESP_CODE_FAILED" 3 "CCS_EVSE_RESP_CODE_OK_CERTIFICATE_EXPIRES_SOON" 2 "CCS_EVSE_RESP_CODE_OK_OLD_SESSION_JOINED" 1 "CCS_EVSE_RESP_CODE_OK_NEW_SESSION_ESTABLISHED" 0 "CCS_EVSE_RESP_CODE_OK" ;
VAL_ 1949 V2G_chgParamRes_evseStatus 12 "CCS_DC_EVSE_STATUS_MAX" 11 "CCS_DC_EVSE_STATUS_RESERVED_C" 10 "CCS_DC_EVSE_STATUS_RESERVED_B" 9 "CCS_DC_EVSE_STATUS_RESERVED_A" 8 "CCS_DC_EVSE_STATUS_RESERVED_9" 7 "CCS_DC_EVSE_STATUS_RESERVED_8" 6 "CCS_DC_EVSE_STATUS_MALFUNCTION" 5 "CCS_DC_EVSE_STATUS_EMERGENCY_SHUTDOWN" 4 "CCS_DC_EVSE_STATUS_ISOLATION_MONITORING_ACTIVE" 3 "CCS_DC_EVSE_STATUS_UTILITY_INTERRUPT_EVENT" 2 "CCS_DC_EVSE_STATUS_SHUTDOWN" 1 "CCS_DC_EVSE_STATUS_READY" 0 "CCS_DC_EVSE_STATUS_NOT_READY" ;
VAL_ 1949 V2G_chgParamRes_isoState 4 "CCS_ISOLATION_STATUS_NO_IMD" 3 "CCS_ISOLATION_STATUS_FAULT" 2 "CCS_ISOLATION_STATUS_WARNING" 1 "CCS_ISOLATION_STATUS_VALID" 0 "CCS_ISOLATION_STATUS_INVALID" ;
VAL_ 1618 VCBATT0_infoBuildType 4 "INFO_MFG_BUILD" 3 "INFO_TRACEABLE_CI_BUILD" 2 "INFO_LOCAL_BUILD" 1 "INFO_PLATFORM_BUILD" 0 "INFO_UNKNOWN_BUILD" ;
VAL_ 1858 VCBATT1_LVBMS_ECPAState 3 "LVBMS_ECPA_STATE_SNA" 2 "LVBMS_ECPA_STATE_INVALID" 1 "LVBMS_ECPA_STATE_CLOSED" 0 "LVBMS_ECPA_STATE_OPEN" ;
VAL_ 1858 VCBATT1_LVBMS_MOSState 3 "LVBMS_MOS_STATE_SNA" 2 "LVBMS_MOS_STATE_INVALID" 1 "LVBMS_MOS_STATE_CLOSED" 0 "LVBMS_MOS_STATE_OPEN" ;
VAL_ 1858 VCBATT1_LVBMS_VehicleState 3 "LVBMS_VEHICLE_STATE_OFF" 2 "LVBMS_VEHICLE_STATE_CONDITIONING" 1 "LVBMS_VEHICLE_STATE_ACCESSORY" 0 "LVBMS_VEHICLE_STATE_DRIVE" ;
VAL_ 1858 VCBATT1_LVBMS_LINWakeDisabled 1 "LVBMS_LIN_WAKE_DISABLED" 0 "LVBMS_LIN_WAKE_ENABLED" ;
VAL_ 1858 VCBATT1_LVBMS_chargeType 4 "LVBMS_CHARGE_SNA" 3 "LVBMS_CHARGE_COMPLETE" 2 "LVBMS_CHARGE_CONSTANT_VOLTAGE" 1 "LVBMS_CHARGE_CONSTANT_CURRENT" 0 "LVBMS_CHARGE_UNDEFINED" ;
VAL_ 1119 VCBATT1_battDomainOvercurrentSel 2 "VC_SELF_TEST_RESULT_PASSED" 1 "VC_SELF_TEST_RESULT_FAILED" 0 "VC_SELF_TEST_RESULT_INVALID" ;
VAL_ 1119 VCBATT1_battDomainOvercurre_0001 4 "VC_SELF_TEST_STATE_SNA" 3 "VC_SELF_TEST_STATE_NEW_RESULT" 2 "VC_SELF_TEST_STATE_RUNNING" 1 "VC_SELF_TEST_STATE_PENDING" 0 "VC_SELF_TEST_STATE_IDLE" ;
VAL_ 1119 VCBATT1_battDomainOvervoltageSel 2 "VC_SELF_TEST_RESULT_PASSED" 1 "VC_SELF_TEST_RESULT_FAILED" 0 "VC_SELF_TEST_RESULT_INVALID" ;
VAL_ 1119 VCBATT1_battDomainOvervolta_0001 4 "VC_SELF_TEST_STATE_SNA" 3 "VC_SELF_TEST_STATE_NEW_RESULT" 2 "VC_SELF_TEST_STATE_RUNNING" 1 "VC_SELF_TEST_STATE_PENDING" 0 "VC_SELF_TEST_STATE_IDLE" ;
VAL_ 1119 VCBATT1_battDomainUndervoltageSe 2 "VC_SELF_TEST_RESULT_PASSED" 1 "VC_SELF_TEST_RESULT_FAILED" 0 "VC_SELF_TEST_RESULT_INVALID" ;
VAL_ 1119 VCBATT1_battDomainUndervolt_0001 4 "VC_SELF_TEST_STATE_SNA" 3 "VC_SELF_TEST_STATE_NEW_RESULT" 2 "VC_SELF_TEST_STATE_RUNNING" 1 "VC_SELF_TEST_STATE_PENDING" 0 "VC_SELF_TEST_STATE_IDLE" ;
VAL_ 1119 VCBATT1_dualPowerLoadsSelfTestRe 2 "VC_SELF_TEST_RESULT_PASSED" 1 "VC_SELF_TEST_RESULT_FAILED" 0 "VC_SELF_TEST_RESULT_INVALID" ;
VAL_ 1119 VCBATT1_dualPowerLoadsSelfTestSt 4 "VC_SELF_TEST_STATE_SNA" 3 "VC_SELF_TEST_STATE_NEW_RESULT" 2 "VC_SELF_TEST_STATE_RUNNING" 1 "VC_SELF_TEST_STATE_PENDING" 0 "VC_SELF_TEST_STATE_IDLE" ;
VAL_ 1119 VCBATT1_vcbattBridgeEFuseASICSel 2 "VC_SELF_TEST_RESULT_PASSED" 1 "VC_SELF_TEST_RESULT_FAILED" 0 "VC_SELF_TEST_RESULT_INVALID" ;
VAL_ 1119 VCBATT1_vcbattBridgeEFuseAS_0001 4 "VC_SELF_TEST_STATE_SNA" 3 "VC_SELF_TEST_STATE_NEW_RESULT" 2 "VC_SELF_TEST_STATE_RUNNING" 1 "VC_SELF_TEST_STATE_PENDING" 0 "VC_SELF_TEST_STATE_IDLE" ;
VAL_ 1119 VCBATT1_uvProtectionState 12 "VC_UV_STATE_DELIBERATELY_TRIPPED" 11 "VC_UV_STATE_TRIPPED" 10 "VC_UV_STATE_ARMED" 9 "VC_UV_STATE_SELF_TEST_CLEAN_UP" 8 "VC_UV_STATE_SELF_TEST_CHECK_STUCK_ON" 7 "VC_UV_STATE_SELF_TEST_CHECK_STUCK_OFF_COMPLETE" 6 "VC_UV_STATE_SELF_TEST_CHECK_STUCK_OFF" 5 "VC_UV_STATE_SELF_TEST_LOADS_GOING_DOWN_COMPLETE" 4 "VC_UV_STATE_SELF_TEST_LOADS_GOING_DOWN" 3 "VC_UV_STATE_SELF_TEST_LOADS_ON" 2 "VC_UV_STATE_SELF_TEST_TURN_ON_LOADS" 1 "VC_UV_STATE_SELF_TEST_SETUP" 0 "VC_UV_STATE_IDLE" ;
VAL_ 1119 VC_selfTestsRunningMode 4 "DISABLED" 3 "REDUCED" 2 "FACTORY_REDUCED" 1 "FACTORY_NORMAL" 0 "NORMAL" ;
