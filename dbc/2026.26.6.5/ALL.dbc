VERSION "dbc-export 1 2026.26.6.5"

NS_ :

BS_:

BU_: ADSP APB APP APS APSB BB BMS CC CMP CMPD CP DAS DI DIF DIR DPB EPAS3P EPAS3S EPASTP EPASTS EPBL EPBR ESP EVSE FC GTW HCML HCMR HVP IBST ICR IDB LS OCS1P PARK PCS PCS2 PM PMF PMR PNCD PTC RADC RCM RCM2 RCM3 RCU SCCM SCM SCS SDCR TAS TCU TCU2 TPMS TRCM UI UIS UMC USM V2G VC VCBATT VCBATT0 VCBATT1 VCBATT2 VCCC VCFRONT VCFRONT1 VCFRONT2 VCLEFT VCRIGHT VCSEAT2L VCSEAT2R VCSEC VEH

BO_ 2013 VCLEFT_alertLog: 8 VCLEFT
 SG_ VCLEFT_alertID M : 0|10@1+ (1,0) [0|1023] "" Vector__XXX
 SG_ VCLEFT_a120_PARTY_status m120 : 25|1@1+ (1,0) [0|1] "" Vector__XXX
 SG_ VCLEFT_a120_PT_speed m120 : 26|1@1+ (1,0) [0|1] "" Vector__XXX
 SG_ VCLEFT_a120_PT_systemStatus m120 : 27|1@1+ (1,0) [0|1] "" Vector__XXX
 SG_ VCLEFT_a120_PARTY_vehicleEstimat m120 : 28|1@1+ (1,0) [0|1] "" Vector__XXX
 SG_ VCLEFT_a120_VEH_aggregatedAxleSp m120 : 29|1@1+ (1,0) [0|1] "" Vector__XXX
 SG_ VCLEFT_a120_PARTY_aggregatedAxle m120 : 30|1@1+ (1,0) [0|1] "" Vector__XXX
 SG_ VCLEFT_a120_VEH_systemPower m120 : 31|1@1+ (1,0) [0|1] "" Vector__XXX
 SG_ VCLEFT_a120_PARTY_autonomyHealth m120 : 32|1@1+ (1,0) [0|1] "" Vector__XXX
 SG_ VCLEFT_a120_VEH_autonomyHealth m120 : 33|1@1+ (1,0) [0|1] "" Vector__XXX
 SG_ VCLEFT_a120_PT_systemPower m120 : 34|1@1+ (1,0) [0|1] "" Vector__XXX
 SG_ VCLEFT_a120_PARTY_stalklessInter m120 : 35|1@1+ (1,0) [0|1] "" Vector__XXX
 SG_ VCLEFT_a120_CH_speed m120 : 36|1@1+ (1,0) [0|1] "" Vector__XXX
 SG_ VCLEFT_a120_VEH_estimatedBrakeTe m120 : 37|1@1+ (1,0) [0|1] "" Vector__XXX
 SG_ VCLEFT_a120_PARTY_prndControl m120 : 38|1@1+ (1,0) [0|1] "" Vector__XXX
 SG_ VCLEFT_a120_PARTY_locStatus2 m120 : 39|1@1+ (1,0) [0|1] "" Vector__XXX
 SG_ VCLEFT_a120_VEH_chassisCntl m120 : 40|1@1+ (1,0) [0|1] "" Vector__XXX
 SG_ VCLEFT_a120_CH_locStatus2 m120 : 41|1@1+ (1,0) [0|1] "" Vector__XXX
 SG_ VCLEFT_a120_VEH_locStatus m120 : 42|1@1+ (1,0) [0|1] "" Vector__XXX
 SG_ VCLEFT_a120_VEH_locStatus2 m120 : 43|1@1+ (1,0) [0|1] "" Vector__XXX
 SG_ VCLEFT_a120_VEH_prndControl m120 : 44|1@1+ (1,0) [0|1] "" Vector__XXX
 SG_ VCLEFT_a120_VEH_vehicleEstimates m120 : 45|1@1+ (1,0) [0|1] "" Vector__XXX
 SG_ VCLEFT_a120_PARTY_motorStatus m120 : 46|1@1+ (1,0) [0|1] "" Vector__XXX
 SG_ VCLEFT_a120_VEH_motorStatus m120 : 47|1@1+ (1,0) [0|1] "" Vector__XXX
 SG_ VCLEFT_a120_BDY_speed m120 : 48|1@1+ (1,0) [0|1] "" Vector__XXX
 SG_ VCLEFT_a121_OBD_status m121 : 16|1@1+ (1,0) [0|1] "" Vector__XXX
 SG_ VCLEFT_a123_OBD_alcoholInterlock m123 : 16|1@1+ (1,0) [0|1] "" Vector__XXX
 SG_ VCLEFT_a124_PARTY_status m124 : 16|1@1+ (1,0) [0|1] "" Vector__XXX
 SG_ VCLEFT_a124_BDY_status m124 : 17|1@1+ (1,0) [0|1] "" Vector__XXX
 SG_ VCLEFT_a124_VEH_status m124 : 18|1@1+ (1,0) [0|1] "" Vector__XXX
 SG_ VCLEFT_a125_PARTY_actuation m125 : 16|1@1+ (1,0) [0|1] "" Vector__XXX
 SG_ VCLEFT_a125_BDY_actuation m125 : 17|1@1+ (1,0) [0|1] "" Vector__XXX
 SG_ VCLEFT_a125_PARTY_status m125 : 18|1@1+ (1,0) [0|1] "" Vector__XXX
 SG_ VCLEFT_a125_BDY_status m125 : 19|1@1+ (1,0) [0|1] "" Vector__XXX
 SG_ VCLEFT_a129_overCurrentError m129 : 16|1@1+ (1,0) [0|1] "" Vector__XXX
 SG_ VCLEFT_a129_fetShortCircuit m129 : 17|1@1+ (1,0) [0|1] "" Vector__XXX
 SG_ VCLEFT_a129_lockedRotor m129 : 18|1@1+ (1,0) [0|1] "" Vector__XXX
 SG_ VCLEFT_a129_VDS_HA m129 : 19|1@1+ (1,0) [0|1] "" Vector__XXX
 SG_ VCLEFT_a129_VDS_LA m129 : 20|1@1+ (1,0) [0|1] "" Vector__XXX
 SG_ VCLEFT_a129_VDS_HB m129 : 21|1@1+ (1,0) [0|1] "" Vector__XXX
 SG_ VCLEFT_a129_VDS_LB m129 : 22|1@1+ (1,0) [0|1] "" Vector__XXX
 SG_ VCLEFT_a129_VDS_HC m129 : 23|1@1+ (1,0) [0|1] "" Vector__XXX
 SG_ VCLEFT_a129_VDS_LC m129 : 24|1@1+ (1,0) [0|1] "" Vector__XXX
 SG_ VCLEFT_a129_SNS_C_OCP m129 : 25|1@1+ (1,0) [0|1] "" Vector__XXX
 SG_ VCLEFT_a129_SNS_B_OCP m129 : 26|1@1+ (1,0) [0|1] "" Vector__XXX
 SG_ VCLEFT_a129_SNS_A_OCP m129 : 27|1@1+ (1,0) [0|1] "" Vector__XXX
 SG_ VCLEFT_a129_PVDD_UVLO2 m129 : 28|1@1+ (1,0) [0|1] "" Vector__XXX
 SG_ VCLEFT_a129_WD_FAULT m129 : 29|1@1+ (1,0) [0|1] "" Vector__XXX
 SG_ VCLEFT_a129_OTSD m129 : 30|1@1+ (1,0) [0|1] "" Vector__XXX
 SG_ VCLEFT_a129_VREG_UV m129 : 31|1@1+ (1,0) [0|1] "" Vector__XXX
 SG_ VCLEFT_a129_AVDD_UVLO m129 : 32|1@1+ (1,0) [0|1] "" Vector__XXX
 SG_ VCLEFT_a129_VCP_LSD_UVLO2 m129 : 33|1@1+ (1,0) [0|1] "" Vector__XXX
 SG_ VCLEFT_a129_VCPH_UVLO2 m129 : 34|1@1+ (1,0) [0|1] "" Vector__XXX
 SG_ VCLEFT_a129_VCPH_UVLO m129 : 35|1@1+ (1,0) [0|1] "" Vector__XXX
 SG_ VCLEFT_a129_VCPH_OVLO_ABS m129 : 36|1@1+ (1,0) [0|1] "" Vector__XXX
 SG_ VCLEFT_a129_VGS_HA m129 : 37|1@1+ (1,0) [0|1] "" Vector__XXX
 SG_ VCLEFT_a129_VGS_LA m129 : 38|1@1+ (1,0) [0|1] "" Vector__XXX
 SG_ VCLEFT_a129_VGS_HB m129 : 39|1@1+ (1,0) [0|1] "" Vector__XXX
 SG_ VCLEFT_a129_VGS_LB m129 : 40|1@1+ (1,0) [0|1] "" Vector__XXX
 SG_ VCLEFT_a129_VGS_HC m129 : 41|1@1+ (1,0) [0|1] "" Vector__XXX
 SG_ VCLEFT_a129_VGS_LC m129 : 42|1@1+ (1,0) [0|1] "" Vector__XXX
 SG_ VCLEFT_a130_junctionTempWarning m130 : 16|1@1+ (1,0) [0|1] "" Vector__XXX
 SG_ VCLEFT_a130_junctionOverTemp m130 : 17|1@1+ (1,0) [0|1] "" Vector__XXX
 SG_ VCLEFT_a130_startUpOperation m130 : 18|1@1+ (1,0) [0|1] "" Vector__XXX
 SG_ VCLEFT_a130_lossOfSpeedLock m130 : 19|1@1+ (1,0) [0|1] "" Vector__XXX
 SG_ VCLEFT_a130_vccUnderVoltage m130 : 20|1@1+ (1,0) [0|1] "" Vector__XXX
 SG_ VCLEFT_a130_TEMP_FLAG4 m130 : 21|1@1+ (1,0) [0|1] "" Vector__XXX
 SG_ VCLEFT_a130_PVDD_UVFL m130 : 22|1@1+ (1,0) [0|1] "" Vector__XXX
 SG_ VCLEFT_a130_PVDD_OVFL m130 : 23|1@1+ (1,0) [0|1] "" Vector__XXX
 SG_ VCLEFT_a130_VDS_STATUS m130 : 24|1@1+ (1,0) [0|1] "" Vector__XXX
 SG_ VCLEFT_a130_VCPH_UVFL m130 : 25|1@1+ (1,0) [0|1] "" Vector__XXX
 SG_ VCLEFT_a130_TEMP_FLAG1 m130 : 26|1@1+ (1,0) [0|1] "" Vector__XXX
 SG_ VCLEFT_a130_TEMP_FLAG2 m130 : 27|1@1+ (1,0) [0|1] "" Vector__XXX
 SG_ VCLEFT_a130_TEMP_FLAG3 m130 : 28|1@1+ (1,0) [0|1] "" Vector__XXX
 SG_ VCLEFT_a130_OTW m130 : 29|1@1+ (1,0) [0|1] "" Vector__XXX
 SG_ VCLEFT_a131_vsUnderVoltage m131 : 16|1@1+ (1,0) [0|1] "" Vector__XXX
 SG_ VCLEFT_a131_vsOverVoltage m131 : 17|1@1+ (1,0) [0|1] "" Vector__XXX
 SG_ VCLEFT_a131_chpUnderVoltage m131 : 18|1@1+ (1,0) [0|1] "" Vector__XXX
 SG_ VCLEFT_a131_vglUnderVoltage m131 : 19|1@1+ (1,0) [0|1] "" Vector__XXX
 SG_ VCLEFT_a131_thOverTemperature m131 : 20|1@1+ (1,0) [0|1] "" Vector__XXX
 SG_ VCLEFT_a132_RPMActual m132 : 16|10@1+ (10,0) [0|10230] "" Vector__XXX
 SG_ VCLEFT_a132_RPMTarget m132 : 26|10@1+ (10,0) [0|10230] "" Vector__XXX
 SG_ VCLEFT_a133_RPMActual m133 : 16|10@1+ (10,0) [0|10230] "" Vector__XXX
 SG_ VCLEFT_a133_RPMTarget m133 : 26|10@1+ (10,0) [0|10230] "" Vector__XXX
 SG_ VCLEFT_a141_outputCurrent m141 : 16|16@1+ (0.1,0) [0|6553.5] "" Vector__XXX
 SG_ VCLEFT_a145_brakeSwitch m145 : 16|2@1+ (1,0) [0|3] "" Vector__XXX
 SG_ VCLEFT_a145_ibstRodPosition m145 : 18|12@1+ (0.015625,-5) [-5|58.984375] "" Vector__XXX
 SG_ VCLEFT_a145_ibstRodPositionQF m145 : 30|2@1+ (1,0) [0|3] "" Vector__XXX
 SG_ VCLEFT_a150_windowPosition m150 : 16|9@1- (1.43137252331,197.529418945) [-168.901947022|562.529412389] "" Vector__XXX
 SG_ VCLEFT_a150_movementTimeMs m150 : 25|7@1+ (50,0) [0|6350] "" Vector__XXX
 SG_ VCLEFT_a150_windowPinchReason m150 : 32|3@1+ (1,0) [0|7] "" Vector__XXX
 SG_ VCLEFT_a150_lookbackIndex m150 : 35|6@1+ (1,0) [0|63] "" Vector__XXX
 SG_ VCLEFT_a150_absAccelExceedance m150 : 41|8@1+ (0.09803922,0) [0|25.0000011] "" Vector__XXX
 SG_ VCLEFT_a150_relAccelExceedance m150 : 49|8@1+ (0.09803922,0) [0|25.0000011] "" Vector__XXX
 SG_ VCLEFT_a150_speedExpScore m150 : 57|6@1- (0.0006451613,-0.009677419) [-0.0303225806|0.0103225813] "" Vector__XXX
 SG_ VCLEFT_a150_treatedInGear m150 : 63|1@1+ (1,0) [0|1] "" Vector__XXX
 SG_ VCLEFT_a151_windowPosition m151 : 16|9@1- (1.43137252331,197.529418945) [-168.901947022|562.529412389] "" Vector__XXX
 SG_ VCLEFT_a151_movementTimeMs m151 : 25|7@1+ (50,0) [0|6350] "" Vector__XXX
 SG_ VCLEFT_a151_windowPinchReason m151 : 32|3@1+ (1,0) [0|7] "" Vector__XXX
 SG_ VCLEFT_a151_lookbackIndex m151 : 35|6@1+ (1,0) [0|63] "" Vector__XXX
 SG_ VCLEFT_a151_absAccelExceedance m151 : 41|8@1+ (0.09803922,0) [0|25.0000011] "" Vector__XXX
 SG_ VCLEFT_a151_relAccelExceedance m151 : 49|8@1+ (0.09803922,0) [0|25.0000011] "" Vector__XXX
 SG_ VCLEFT_a151_speedExpScore m151 : 57|6@1- (0.0006451613,-0.009677419) [-0.0303225806|0.0103225813] "" Vector__XXX
 SG_ VCLEFT_a151_treatedInGear m151 : 63|1@1+ (1,0) [0|1] "" Vector__XXX
 SG_ VCLEFT_a152_zeroed m152 : 16|1@1+ (1,0) [0|1] "" Vector__XXX
 SG_ VCLEFT_a152_endStopTrusted m152 : 17|1@1+ (1,0) [0|1] "" Vector__XXX
 SG_ VCLEFT_a152_speedTableStatus m152 : 18|2@1+ (1,0) [0|3] "" Vector__XXX
 SG_ VCLEFT_a152_causedByBackoffs m152 : 20|1@1+ (1,0) [0|1] "" Vector__XXX
 SG_ VCLEFT_a153_zeroed m153 : 16|1@1+ (1,0) [0|1] "" Vector__XXX
 SG_ VCLEFT_a153_endStopTrusted m153 : 17|1@1+ (1,0) [0|1] "" Vector__XXX
 SG_ VCLEFT_a153_speedTableStatus m153 : 18|2@1+ (1,0) [0|3] "" Vector__XXX
 SG_ VCLEFT_a153_causedByBackoffs m153 : 20|1@1+ (1,0) [0|1] "" Vector__XXX
 SG_ VCLEFT_a154_windowThermalMode m154 : 16|2@1+ (1,0) [0|3] "" Vector__XXX
 SG_ VCLEFT_a154_lightShowActive m154 : 18|1@1+ (1,0) [0|1] "" Vector__XXX
 SG_ VCLEFT_a155_windowThermalMode m155 : 16|2@1+ (1,0) [0|3] "" Vector__XXX
 SG_ VCLEFT_a155_lightShowActive m155 : 18|1@1+ (1,0) [0|1] "" Vector__XXX
 SG_ VCLEFT_a180_intButtonPressed m180 : 16|1@1+ (1,0) [0|1] "" Vector__XXX
 SG_ VCLEFT_a180_extHandlePWM m180 : 24|8@1+ (1,0) [0|255] "" Vector__XXX
 SG_ VCLEFT_a180_extHandlePulled m180 : 32|1@1+ (1,0) [0|1] "" Vector__XXX
 SG_ VCLEFT_a180_releasePWM m180 : 40|8@1+ (1,0) [0|255] "" Vector__XXX
 SG_ VCLEFT_a180_latchStatus m180 : 48|4@1+ (1,0) [0|15] "" Vector__XXX
 SG_ VCLEFT_a180_latchClawStatus m180 : 52|1@1+ (1,0) [0|1] "" Vector__XXX
 SG_ VCLEFT_a181_intButtonPressed m181 : 16|1@1+ (1,0) [0|1] "" Vector__XXX
 SG_ VCLEFT_a181_extHandlePWM m181 : 24|8@1+ (1,0) [0|255] "" Vector__XXX
 SG_ VCLEFT_a181_extHandlePulled m181 : 32|1@1+ (1,0) [0|1] "" Vector__XXX
 SG_ VCLEFT_a181_releasePWM m181 : 40|8@1+ (1,0) [0|255] "" Vector__XXX
 SG_ VCLEFT_a181_latchStatus m181 : 48|4@1+ (1,0) [0|15] "" Vector__XXX
 SG_ VCLEFT_a181_latchClawStatus m181 : 52|1@1+ (1,0) [0|1] "" Vector__XXX
 SG_ VCLEFT_a186_voltage m186 : 16|7@1+ (0.15,0) [0|19.05] "" Vector__XXX
 SG_ VCLEFT_a186_temperature m186 : 24|8@1+ (0.5,-40) [-40|87.5] "" Vector__XXX
 SG_ VCLEFT_a187_voltage m187 : 16|7@1+ (0.15,0) [0|19.05] "" Vector__XXX
 SG_ VCLEFT_a187_temperature m187 : 24|8@1+ (0.5,-40) [-40|87.5] "" Vector__XXX
 SG_ VCLEFT_a188_voltage m188 : 16|7@1+ (0.15,0) [0|19.05] "" Vector__XXX
 SG_ VCLEFT_a188_temperature m188 : 24|8@1+ (0.5,-40) [-40|87.5] "" Vector__XXX
 SG_ VCLEFT_a189_voltage m189 : 16|7@1+ (0.15,0) [0|19.05] "" Vector__XXX
 SG_ VCLEFT_a189_temperature m189 : 24|8@1+ (0.5,-40) [-40|87.5] "" Vector__XXX
 SG_ VCLEFT_a190_eFuseTripCount m190 : 16|8@1+ (1,0) [0|255] "" Vector__XXX
 SG_ VCLEFT_a192_motorFaulted m192 : 16|1@1+ (1,0) [0|1] "" Vector__XXX
 SG_ VCLEFT_a192_motorLocked m192 : 17|1@1+ (1,0) [0|1] "" Vector__XXX
 SG_ VCLEFT_a192_ecuReset m192 : 18|1@1+ (1,0) [0|1] "" Vector__XXX
 SG_ VCLEFT_a192_fetTempIrrational m192 : 19|1@1+ (1,0) [0|1] "" Vector__XXX
 SG_ VCLEFT_a192_motorControlError m192 : 20|1@1+ (1,0) [0|1] "" Vector__XXX
 SG_ VCLEFT_a192_underVoltage m192 : 21|1@1+ (1,0) [0|1] "" Vector__XXX
 SG_ VCLEFT_a192_overVoltage m192 : 22|1@1+ (1,0) [0|1] "" Vector__XXX
 SG_ VCLEFT_a192_hardwareOvercurrent m192 : 23|1@1+ (1,0) [0|1] "" Vector__XXX
 SG_ VCLEFT_a192_motorOpenPhase m192 : 24|1@1+ (1,0) [0|1] "" Vector__XXX
 SG_ VCLEFT_a192_motorSoftOpenPhase m192 : 25|1@1+ (1,0) [0|1] "" Vector__XXX
 SG_ VCLEFT_a192_motorOvertemp m192 : 26|1@1+ (1,0) [0|1] "" Vector__XXX
 SG_ VCLEFT_a192_dcOvercurrent m192 : 27|1@1+ (1,0) [0|1] "" Vector__XXX
 SG_ VCLEFT_a192_motorStalled m192 : 28|1@1+ (1,0) [0|1] "" Vector__XXX
 SG_ VCLEFT_a192_selfTestFailed m192 : 29|1@1+ (1,0) [0|1] "" Vector__XXX
 SG_ VCLEFT_a192_selfTestResult m192 : 32|3@1+ (1,0) [0|7] "" Vector__XXX
 SG_ VCLEFT_a192_linChecksumError m192 : 35|1@1+ (1,0) [0|1] "" Vector__XXX
 SG_ VCLEFT_a192_linFramingError m192 : 36|1@1+ (1,0) [0|1] "" Vector__XXX
 SG_ VCLEFT_a192_phaseShorted m192 : 37|1@1+ (1,0) [0|1] "" Vector__XXX
 SG_ VCLEFT_a192_busVoltageIrrational m192 : 38|1@1+ (1,0) [0|1] "" Vector__XXX
 SG_ VCLEFT_a192_dcCurrentIrrational m192 : 39|1@1+ (1,0) [0|1] "" Vector__XXX
 SG_ VCLEFT_a192_motorSpeedIrrational m192 : 40|1@1+ (1,0) [0|1] "" Vector__XXX
 SG_ VCLEFT_a192_supplyVoltageIrratio m192 : 41|1@1+ (1,0) [0|1] "" Vector__XXX
 SG_ VCLEFT_a192_motorPhaseCurrentIrr m192 : 42|1@1+ (1,0) [0|1] "" Vector__XXX
 SG_ VCLEFT_a192_chipOvertemp m192 : 43|1@1+ (1,0) [0|1] "" Vector__XXX
 SG_ VCLEFT_a192_motorSpeedTooHigh m192 : 44|1@1+ (1,0) [0|1] "" Vector__XXX
 SG_ VCLEFT_a192_phaseOvercurrent m192 : 45|1@1+ (1,0) [0|1] "" Vector__XXX
 SG_ VCLEFT_a192_vddaOvercurrent m192 : 46|1@1+ (1,0) [0|1] "" Vector__XXX
 SG_ VCLEFT_a192_busVoltageUnhealthy m192 : 47|1@1+ (1,0) [0|1] "" Vector__XXX
 SG_ VCLEFT_a192_hsVdsOvervoltage m192 : 48|1@1+ (1,0) [0|1] "" Vector__XXX
 SG_ VCLEFT_a192_hsVdsOvervoltageMask m192 : 49|3@1+ (1,0) [0|7] "" Vector__XXX
 SG_ VCLEFT_a192_lsVdsOvervoltage m192 : 52|1@1+ (1,0) [0|1] "" Vector__XXX
 SG_ VCLEFT_a192_lsVdsOvervoltageMask m192 : 53|3@1+ (1,0) [0|7] "" Vector__XXX
 SG_ VCLEFT_a192_payloadBitsNotSet m192 : 56|1@1+ (1,0) [0|1] "" Vector__XXX
 SG_ VCLEFT_a192_motorNotIdentified m192 : 57|1@1+ (1,0) [0|1] "" Vector__XXX
 SG_ VCLEFT_a192_motorType m192 : 58|2@1+ (1,0) [0|3] "" Vector__XXX
 SG_ VCLEFT_a194_motorTypeUnknown m194 : 16|1@1+ (1,0) [0|1] "" Vector__XXX
 SG_ VCLEFT_a194_configurationMismatc m194 : 17|1@1+ (1,0) [0|1] "" Vector__XXX
 SG_ VCLEFT_a194_vcbldcMotorTypeUnkno m194 : 18|1@1+ (1,0) [0|1] "" Vector__XXX
 SG_ VCLEFT_a194_nvramMotorTypeUnknow m194 : 19|1@1+ (1,0) [0|1] "" Vector__XXX
 SG_ VCLEFT_a194_vcbldcMotorId m194 : 20|2@1+ (1,0) [0|3] "" Vector__XXX
 SG_ VCLEFT_a194_nvramMotorId m194 : 22|2@1+ (1,0) [0|3] "" Vector__XXX
 SG_ VCLEFT_a196_outputState m196 : 16|1@1+ (1,0) [0|1] "" Vector__XXX
 SG_ VCLEFT_a196_NVRAMState m196 : 17|1@1+ (1,0) [0|1] "" Vector__XXX
 SG_ VCLEFT_a196_lockoutState m196 : 18|1@1+ (1,0) [0|1] "" Vector__XXX
 SG_ VCLEFT_a197_outputState m197 : 16|1@1+ (1,0) [0|1] "" Vector__XXX
 SG_ VCLEFT_a197_NVRAMState m197 : 17|1@1+ (1,0) [0|1] "" Vector__XXX
 SG_ VCLEFT_a197_lockoutState m197 : 18|1@1+ (1,0) [0|1] "" Vector__XXX
 SG_ VCLEFT_a202_unknownAllowed m202 : 16|1@1+ (1,0) [0|1] "" Vector__XXX
 SG_ VCLEFT_a202_openAllowed m202 : 17|1@1+ (1,0) [0|1] "" Vector__XXX
 SG_ VCLEFT_a202_dynamicAllowed m202 : 18|1@1+ (1,0) [0|1] "" Vector__XXX
 SG_ VCLEFT_a202_parkAllowed m202 : 19|1@1+ (1,0) [0|1] "" Vector__XXX
 SG_ VCLEFT_a202_startAllowed m202 : 20|1@1+ (1,0) [0|1] "" Vector__XXX
 SG_ VCLEFT_a202_serviceAllowed m202 : 21|1@1+ (1,0) [0|1] "" Vector__XXX
 SG_ VCLEFT_a202_winchAllowed m202 : 22|1@1+ (1,0) [0|1] "" Vector__XXX
 SG_ VCLEFT_a202_winchReleaseAllowed m202 : 23|1@1+ (1,0) [0|1] "" Vector__XXX
 SG_ VCLEFT_a202_parkingAllowed m202 : 24|1@1+ (1,0) [0|1] "" Vector__XXX
 SG_ VCLEFT_a202_dynApplyAllowed m202 : 25|1@1+ (1,0) [0|1] "" Vector__XXX
 SG_ VCLEFT_a202_releaseAllowed m202 : 26|1@1+ (1,0) [0|1] "" Vector__XXX
 SG_ VCLEFT_a202_parkPendingAllowed m202 : 27|1@1+ (1,0) [0|1] "" Vector__XXX
 SG_ VCLEFT_a202_wenchPendingAllowed m202 : 28|1@1+ (1,0) [0|1] "" Vector__XXX
 SG_ VCLEFT_a202_desyncCount m202 : 32|6@1+ (1,0) [0|63] "" Vector__XXX
 SG_ VCLEFT_a202_current m202 : 38|10@1+ (0.05,0) [0|51.15] "" Vector__XXX
 SG_ VCLEFT_a202_epbConfig m202 : 48|4@1+ (1,0) [0|15] "" Vector__XXX
 SG_ VCLEFT_a203_unknownAllowed m203 : 16|1@1+ (1,0) [0|1] "" Vector__XXX
 SG_ VCLEFT_a203_openAllowed m203 : 17|1@1+ (1,0) [0|1] "" Vector__XXX
 SG_ VCLEFT_a203_dynamicAllowed m203 : 18|1@1+ (1,0) [0|1] "" Vector__XXX
 SG_ VCLEFT_a203_parkAllowed m203 : 19|1@1+ (1,0) [0|1] "" Vector__XXX
 SG_ VCLEFT_a203_startAllowed m203 : 20|1@1+ (1,0) [0|1] "" Vector__XXX
 SG_ VCLEFT_a203_serviceAllowed m203 : 21|1@1+ (1,0) [0|1] "" Vector__XXX
 SG_ VCLEFT_a203_winchAllowed m203 : 22|1@1+ (1,0) [0|1] "" Vector__XXX
 SG_ VCLEFT_a203_winchReleaseAllowed m203 : 23|1@1+ (1,0) [0|1] "" Vector__XXX
 SG_ VCLEFT_a203_parkingAllowed m203 : 24|1@1+ (1,0) [0|1] "" Vector__XXX
 SG_ VCLEFT_a203_dynApplyAllowed m203 : 25|1@1+ (1,0) [0|1] "" Vector__XXX
 SG_ VCLEFT_a203_releaseAllowed m203 : 26|1@1+ (1,0) [0|1] "" Vector__XXX
 SG_ VCLEFT_a203_parkPendingAllowed m203 : 27|1@1+ (1,0) [0|1] "" Vector__XXX
 SG_ VCLEFT_a203_wenchPendingAllowed m203 : 28|1@1+ (1,0) [0|1] "" Vector__XXX
 SG_ VCLEFT_a203_desyncCount m203 : 32|6@1+ (1,0) [0|63] "" Vector__XXX
 SG_ VCLEFT_a203_current m203 : 38|10@1+ (0.05,0) [0|51.15] "" Vector__XXX
 SG_ VCLEFT_a203_epbConfig m203 : 48|4@1+ (1,0) [0|15] "" Vector__XXX
 SG_ VCLEFT_a204_unknownAllowed m204 : 16|1@1+ (1,0) [0|1] "" Vector__XXX
 SG_ VCLEFT_a204_openAllowed m204 : 17|1@1+ (1,0) [0|1] "" Vector__XXX
 SG_ VCLEFT_a204_dynamicAllowed m204 : 18|1@1+ (1,0) [0|1] "" Vector__XXX
 SG_ VCLEFT_a204_parkAllowed m204 : 19|1@1+ (1,0) [0|1] "" Vector__XXX
 SG_ VCLEFT_a204_startAllowed m204 : 20|1@1+ (1,0) [0|1] "" Vector__XXX
 SG_ VCLEFT_a204_serviceAllowed m204 : 21|1@1+ (1,0) [0|1] "" Vector__XXX
 SG_ VCLEFT_a204_winchAllowed m204 : 22|1@1+ (1,0) [0|1] "" Vector__XXX
 SG_ VCLEFT_a204_winchReleaseAllowed m204 : 23|1@1+ (1,0) [0|1] "" Vector__XXX
 SG_ VCLEFT_a204_parkingAllowed m204 : 24|1@1+ (1,0) [0|1] "" Vector__XXX
 SG_ VCLEFT_a204_dynApplyAllowed m204 : 25|1@1+ (1,0) [0|1] "" Vector__XXX
 SG_ VCLEFT_a204_releaseAllowed m204 : 26|1@1+ (1,0) [0|1] "" Vector__XXX
 SG_ VCLEFT_a204_parkPendingAllowed m204 : 27|1@1+ (1,0) [0|1] "" Vector__XXX
 SG_ VCLEFT_a204_wenchPendingAllowed m204 : 28|1@1+ (1,0) [0|1] "" Vector__XXX
 SG_ VCLEFT_a204_desyncCount m204 : 32|6@1+ (1,0) [0|63] "" Vector__XXX
 SG_ VCLEFT_a204_current m204 : 38|10@1+ (0.05,0) [0|51.15] "" Vector__XXX
 SG_ VCLEFT_a204_epbConfig m204 : 48|4@1+ (1,0) [0|15] "" Vector__XXX
 SG_ VCLEFT_a205_unknownAllowed m205 : 16|1@1+ (1,0) [0|1] "" Vector__XXX
 SG_ VCLEFT_a205_openAllowed m205 : 17|1@1+ (1,0) [0|1] "" Vector__XXX
 SG_ VCLEFT_a205_dynamicAllowed m205 : 18|1@1+ (1,0) [0|1] "" Vector__XXX
 SG_ VCLEFT_a205_parkAllowed m205 : 19|1@1+ (1,0) [0|1] "" Vector__XXX
 SG_ VCLEFT_a205_startAllowed m205 : 20|1@1+ (1,0) [0|1] "" Vector__XXX
 SG_ VCLEFT_a205_serviceAllowed m205 : 21|1@1+ (1,0) [0|1] "" Vector__XXX
 SG_ VCLEFT_a205_winchAllowed m205 : 22|1@1+ (1,0) [0|1] "" Vector__XXX
 SG_ VCLEFT_a205_winchReleaseAllowed m205 : 23|1@1+ (1,0) [0|1] "" Vector__XXX
 SG_ VCLEFT_a205_parkingAllowed m205 : 24|1@1+ (1,0) [0|1] "" Vector__XXX
 SG_ VCLEFT_a205_dynApplyAllowed m205 : 25|1@1+ (1,0) [0|1] "" Vector__XXX
 SG_ VCLEFT_a205_releaseAllowed m205 : 26|1@1+ (1,0) [0|1] "" Vector__XXX
 SG_ VCLEFT_a205_parkPendingAllowed m205 : 27|1@1+ (1,0) [0|1] "" Vector__XXX
 SG_ VCLEFT_a205_wenchPendingAllowed m205 : 28|1@1+ (1,0) [0|1] "" Vector__XXX
 SG_ VCLEFT_a205_desyncCount m205 : 32|6@1+ (1,0) [0|63] "" Vector__XXX
 SG_ VCLEFT_a205_current m205 : 38|10@1+ (0.05,0) [0|51.15] "" Vector__XXX
 SG_ VCLEFT_a205_epbConfig m205 : 48|4@1+ (1,0) [0|15] "" Vector__XXX
 SG_ VCLEFT_a206_unknownAllowed m206 : 16|1@1+ (1,0) [0|1] "" Vector__XXX
 SG_ VCLEFT_a206_openAllowed m206 : 17|1@1+ (1,0) [0|1] "" Vector__XXX
 SG_ VCLEFT_a206_dynamicAllowed m206 : 18|1@1+ (1,0) [0|1] "" Vector__XXX
 SG_ VCLEFT_a206_parkAllowed m206 : 19|1@1+ (1,0) [0|1] "" Vector__XXX
 SG_ VCLEFT_a206_startAllowed m206 : 20|1@1+ (1,0) [0|1] "" Vector__XXX
 SG_ VCLEFT_a206_serviceAllowed m206 : 21|1@1+ (1,0) [0|1] "" Vector__XXX
 SG_ VCLEFT_a206_winchAllowed m206 : 22|1@1+ (1,0) [0|1] "" Vector__XXX
 SG_ VCLEFT_a206_winchReleaseAllowed m206 : 23|1@1+ (1,0) [0|1] "" Vector__XXX
 SG_ VCLEFT_a206_parkingAllowed m206 : 24|1@1+ (1,0) [0|1] "" Vector__XXX
 SG_ VCLEFT_a206_dynApplyAllowed m206 : 25|1@1+ (1,0) [0|1] "" Vector__XXX
 SG_ VCLEFT_a206_releaseAllowed m206 : 26|1@1+ (1,0) [0|1] "" Vector__XXX
 SG_ VCLEFT_a206_parkPendingAllowed m206 : 27|1@1+ (1,0) [0|1] "" Vector__XXX
 SG_ VCLEFT_a206_wenchPendingAllowed m206 : 28|1@1+ (1,0) [0|1] "" Vector__XXX
 SG_ VCLEFT_a206_unitStatusEPB m206 : 32|5@1+ (1,0) [0|31] "" Vector__XXX
 SG_ VCLEFT_a206_unitStatusEPBM m206 : 40|5@1+ (1,0) [0|31] "" Vector__XXX
 SG_ VCLEFT_a207_unknownAllowed m207 : 16|1@1+ (1,0) [0|1] "" Vector__XXX
 SG_ VCLEFT_a207_openAllowed m207 : 17|1@1+ (1,0) [0|1] "" Vector__XXX
 SG_ VCLEFT_a207_dynamicAllowed m207 : 18|1@1+ (1,0) [0|1] "" Vector__XXX
 SG_ VCLEFT_a207_parkAllowed m207 : 19|1@1+ (1,0) [0|1] "" Vector__XXX
 SG_ VCLEFT_a207_startAllowed m207 : 20|1@1+ (1,0) [0|1] "" Vector__XXX
 SG_ VCLEFT_a207_serviceAllowed m207 : 21|1@1+ (1,0) [0|1] "" Vector__XXX
 SG_ VCLEFT_a207_winchAllowed m207 : 22|1@1+ (1,0) [0|1] "" Vector__XXX
 SG_ VCLEFT_a207_winchReleaseAllowed m207 : 23|1@1+ (1,0) [0|1] "" Vector__XXX
 SG_ VCLEFT_a207_parkingAllowed m207 : 24|1@1+ (1,0) [0|1] "" Vector__XXX
 SG_ VCLEFT_a207_dynApplyAllowed m207 : 25|1@1+ (1,0) [0|1] "" Vector__XXX
 SG_ VCLEFT_a207_releaseAllowed m207 : 26|1@1+ (1,0) [0|1] "" Vector__XXX
 SG_ VCLEFT_a207_parkPendingAllowed m207 : 27|1@1+ (1,0) [0|1] "" Vector__XXX
 SG_ VCLEFT_a207_wenchPendingAllowed m207 : 28|1@1+ (1,0) [0|1] "" Vector__XXX
 SG_ VCLEFT_a207_unitStatusEPB m207 : 32|5@1+ (1,0) [0|31] "" Vector__XXX
 SG_ VCLEFT_a207_unitStatusEPBM m207 : 40|5@1+ (1,0) [0|31] "" Vector__XXX
 SG_ VCLEFT_a208_unknownAllowed m208 : 16|1@1+ (1,0) [0|1] "" Vector__XXX
 SG_ VCLEFT_a208_openAllowed m208 : 17|1@1+ (1,0) [0|1] "" Vector__XXX
 SG_ VCLEFT_a208_dynamicAllowed m208 : 18|1@1+ (1,0) [0|1] "" Vector__XXX
 SG_ VCLEFT_a208_parkAllowed m208 : 19|1@1+ (1,0) [0|1] "" Vector__XXX
 SG_ VCLEFT_a208_startAllowed m208 : 20|1@1+ (1,0) [0|1] "" Vector__XXX
 SG_ VCLEFT_a208_serviceAllowed m208 : 21|1@1+ (1,0) [0|1] "" Vector__XXX
 SG_ VCLEFT_a208_winchAllowed m208 : 22|1@1+ (1,0) [0|1] "" Vector__XXX
 SG_ VCLEFT_a208_winchReleaseAllowed m208 : 23|1@1+ (1,0) [0|1] "" Vector__XXX
 SG_ VCLEFT_a208_parkingAllowed m208 : 24|1@1+ (1,0) [0|1] "" Vector__XXX
 SG_ VCLEFT_a208_dynApplyAllowed m208 : 25|1@1+ (1,0) [0|1] "" Vector__XXX
 SG_ VCLEFT_a208_releaseAllowed m208 : 26|1@1+ (1,0) [0|1] "" Vector__XXX
 SG_ VCLEFT_a208_parkPendingAllowed m208 : 27|1@1+ (1,0) [0|1] "" Vector__XXX
 SG_ VCLEFT_a208_wenchPendingAllowed m208 : 28|1@1+ (1,0) [0|1] "" Vector__XXX
 SG_ VCLEFT_a208_unitStatusEPB m208 : 32|5@1+ (1,0) [0|31] "" Vector__XXX
 SG_ VCLEFT_a208_unitStatusEPBM m208 : 40|5@1+ (1,0) [0|31] "" Vector__XXX
 SG_ VCLEFT_a209_unknownAllowed m209 : 16|1@1+ (1,0) [0|1] "" Vector__XXX
 SG_ VCLEFT_a209_openAllowed m209 : 17|1@1+ (1,0) [0|1] "" Vector__XXX
 SG_ VCLEFT_a209_dynamicAllowed m209 : 18|1@1+ (1,0) [0|1] "" Vector__XXX
 SG_ VCLEFT_a209_parkAllowed m209 : 19|1@1+ (1,0) [0|1] "" Vector__XXX
 SG_ VCLEFT_a209_startAllowed m209 : 20|1@1+ (1,0) [0|1] "" Vector__XXX
 SG_ VCLEFT_a209_serviceAllowed m209 : 21|1@1+ (1,0) [0|1] "" Vector__XXX
 SG_ VCLEFT_a209_winchAllowed m209 : 22|1@1+ (1,0) [0|1] "" Vector__XXX
 SG_ VCLEFT_a209_winchReleaseAllowed m209 : 23|1@1+ (1,0) [0|1] "" Vector__XXX
 SG_ VCLEFT_a209_parkingAllowed m209 : 24|1@1+ (1,0) [0|1] "" Vector__XXX
 SG_ VCLEFT_a209_dynApplyAllowed m209 : 25|1@1+ (1,0) [0|1] "" Vector__XXX
 SG_ VCLEFT_a209_releaseAllowed m209 : 26|1@1+ (1,0) [0|1] "" Vector__XXX
 SG_ VCLEFT_a209_parkPendingAllowed m209 : 27|1@1+ (1,0) [0|1] "" Vector__XXX
 SG_ VCLEFT_a209_wenchPendingAllowed m209 : 28|1@1+ (1,0) [0|1] "" Vector__XXX
 SG_ VCLEFT_a209_unitStatusEPB m209 : 32|5@1+ (1,0) [0|31] "" Vector__XXX
 SG_ VCLEFT_a209_unitStatusEPBM m209 : 40|5@1+ (1,0) [0|31] "" Vector__XXX
 SG_ VCLEFT_a210_unknownAllowed m210 : 16|1@1+ (1,0) [0|1] "" Vector__XXX
 SG_ VCLEFT_a210_openAllowed m210 : 17|1@1+ (1,0) [0|1] "" Vector__XXX
 SG_ VCLEFT_a210_dynamicAllowed m210 : 18|1@1+ (1,0) [0|1] "" Vector__XXX
 SG_ VCLEFT_a210_parkAllowed m210 : 19|1@1+ (1,0) [0|1] "" Vector__XXX
 SG_ VCLEFT_a210_startAllowed m210 : 20|1@1+ (1,0) [0|1] "" Vector__XXX
 SG_ VCLEFT_a210_serviceAllowed m210 : 21|1@1+ (1,0) [0|1] "" Vector__XXX
 SG_ VCLEFT_a210_winchAllowed m210 : 22|1@1+ (1,0) [0|1] "" Vector__XXX
 SG_ VCLEFT_a210_winchReleaseAllowed m210 : 23|1@1+ (1,0) [0|1] "" Vector__XXX
 SG_ VCLEFT_a210_parkingAllowed m210 : 24|1@1+ (1,0) [0|1] "" Vector__XXX
 SG_ VCLEFT_a210_dynApplyAllowed m210 : 25|1@1+ (1,0) [0|1] "" Vector__XXX
 SG_ VCLEFT_a210_releaseAllowed m210 : 26|1@1+ (1,0) [0|1] "" Vector__XXX
 SG_ VCLEFT_a210_parkPendingAllowed m210 : 27|1@1+ (1,0) [0|1] "" Vector__XXX
 SG_ VCLEFT_a210_wenchPendingAllowed m210 : 28|1@1+ (1,0) [0|1] "" Vector__XXX
 SG_ VCLEFT_a210_unitStatusEPB m210 : 32|5@1+ (1,0) [0|31] "" Vector__XXX
 SG_ VCLEFT_a210_unitStatusEPBM m210 : 40|5@1+ (1,0) [0|31] "" Vector__XXX
 SG_ VCLEFT_a221_vbatProtVoltage m221 : 16|8@1+ (0.1,0) [0|25.5] "" Vector__XXX
 SG_ VCLEFT_a221_vbatProtCurrent m221 : 24|10@1+ (0.1,0) [0|102.3] "" Vector__XXX
 SG_ VCLEFT_a221_uvLoadshedVoltage m221 : 40|8@1+ (0.1,0) [0|25.5] "" Vector__XXX
 SG_ VCLEFT_a221_loadshedFromBattMoni m221 : 48|8@1+ (0.02,0) [0|5.1] "" Vector__XXX
 SG_ VCLEFT_a221_faultInjectActive m221 : 56|1@1+ (1,0) [0|1] "" Vector__XXX
 SG_ VCLEFT_a221_loadshedResetActive m221 : 57|1@1+ (1,0) [0|1] "" Vector__XXX
 SG_ VCLEFT_a221_loadshedArmPrimary m221 : 58|1@1+ (1,0) [0|1] "" Vector__XXX
 SG_ VCLEFT_a224_seatMotorCalibrated m224 : 16|1@1+ (1,0) [0|1] "" Vector__XXX
 SG_ VCLEFT_a224_seatMotorCurrent m224 : 17|12@1- (0.01,0) [-20.48|20.47] "" Vector__XXX
 SG_ VCLEFT_a224_seatMotorState m224 : 29|3@1+ (1,0) [0|7] "" Vector__XXX
 SG_ VCLEFT_a224_seatSwitchBack m224 : 32|2@1+ (1,0) [0|3] "" Vector__XXX
 SG_ VCLEFT_a224_seatSwitchForward m224 : 34|2@1+ (1,0) [0|3] "" Vector__XXX
 SG_ VCLEFT_a225_seatMotorCalibrated m225 : 16|1@1+ (1,0) [0|1] "" Vector__XXX
 SG_ VCLEFT_a225_seatMotorCurrent m225 : 17|12@1- (0.01,0) [-20.48|20.47] "" Vector__XXX
 SG_ VCLEFT_a225_seatMotorState m225 : 29|3@1+ (1,0) [0|7] "" Vector__XXX
 SG_ VCLEFT_a225_seatSwitchBack m225 : 32|2@1+ (1,0) [0|3] "" Vector__XXX
 SG_ VCLEFT_a225_seatSwitchForward m225 : 34|2@1+ (1,0) [0|3] "" Vector__XXX
 SG_ VCLEFT_a226_seatMotorCalibrated m226 : 16|1@1+ (1,0) [0|1] "" Vector__XXX
 SG_ VCLEFT_a226_seatMotorCurrent m226 : 17|12@1- (0.01,0) [-20.48|20.47] "" Vector__XXX
 SG_ VCLEFT_a226_seatMotorState m226 : 29|3@1+ (1,0) [0|7] "" Vector__XXX
 SG_ VCLEFT_a226_seatSwitchBack m226 : 32|2@1+ (1,0) [0|3] "" Vector__XXX
 SG_ VCLEFT_a226_seatSwitchForward m226 : 34|2@1+ (1,0) [0|3] "" Vector__XXX
 SG_ VCLEFT_a227_seatMotorCalibrated m227 : 16|1@1+ (1,0) [0|1] "" Vector__XXX
 SG_ VCLEFT_a227_seatMotorCurrent m227 : 17|12@1- (0.01,0) [-20.48|20.47] "" Vector__XXX
 SG_ VCLEFT_a227_seatMotorState m227 : 29|3@1+ (1,0) [0|7] "" Vector__XXX
 SG_ VCLEFT_a227_seatSwitchBack m227 : 32|2@1+ (1,0) [0|3] "" Vector__XXX
 SG_ VCLEFT_a227_seatSwitchForward m227 : 34|2@1+ (1,0) [0|3] "" Vector__XXX
 SG_ VCLEFT_a228_seatMotorCalibrated m228 : 16|1@1+ (1,0) [0|1] "" Vector__XXX
 SG_ VCLEFT_a228_seatMotorCurrent m228 : 17|12@1- (0.01,0) [-20.48|20.47] "" Vector__XXX
 SG_ VCLEFT_a228_seatMotorPosReal m228 : 32|12@1- (1,0) [-2048|2047] "" Vector__XXX
 SG_ VCLEFT_a228_seatMotorState m228 : 44|3@1+ (1,0) [0|7] "" Vector__XXX
 SG_ VCLEFT_a228_seatSwitchBack m228 : 48|2@1+ (1,0) [0|3] "" Vector__XXX
 SG_ VCLEFT_a228_seatSwitchForward m228 : 50|2@1+ (1,0) [0|3] "" Vector__XXX
 SG_ VCLEFT_a229_seatMotorCalibrated m229 : 16|1@1+ (1,0) [0|1] "" Vector__XXX
 SG_ VCLEFT_a229_seatMotorCurrent m229 : 17|12@1- (0.01,0) [-20.48|20.47] "" Vector__XXX
 SG_ VCLEFT_a229_seatMotorPosReal m229 : 32|12@1- (1,0) [-2048|2047] "" Vector__XXX
 SG_ VCLEFT_a229_seatMotorState m229 : 44|3@1+ (1,0) [0|7] "" Vector__XXX
 SG_ VCLEFT_a229_seatSwitchBack m229 : 48|2@1+ (1,0) [0|3] "" Vector__XXX
 SG_ VCLEFT_a229_seatSwitchForward m229 : 50|2@1+ (1,0) [0|3] "" Vector__XXX
 SG_ VCLEFT_a230_seatMotorCalibrated m230 : 16|1@1+ (1,0) [0|1] "" Vector__XXX
 SG_ VCLEFT_a230_seatMotorCurrent m230 : 17|12@1- (0.01,0) [-20.48|20.47] "" Vector__XXX
 SG_ VCLEFT_a230_seatMotorPosReal m230 : 32|12@1- (1,0) [-2048|2047] "" Vector__XXX
 SG_ VCLEFT_a230_seatMotorState m230 : 44|3@1+ (1,0) [0|7] "" Vector__XXX
 SG_ VCLEFT_a230_seatSwitchBack m230 : 48|2@1+ (1,0) [0|3] "" Vector__XXX
 SG_ VCLEFT_a230_seatSwitchForward m230 : 50|2@1+ (1,0) [0|3] "" Vector__XXX
 SG_ VCLEFT_a231_seatMotorCalibrated m231 : 16|1@1+ (1,0) [0|1] "" Vector__XXX
 SG_ VCLEFT_a231_seatMotorCurrent m231 : 17|12@1- (0.01,0) [-20.48|20.47] "" Vector__XXX
 SG_ VCLEFT_a231_seatMotorPosReal m231 : 32|12@1- (1,0) [-2048|2047] "" Vector__XXX
 SG_ VCLEFT_a231_seatMotorState m231 : 44|3@1+ (1,0) [0|7] "" Vector__XXX
 SG_ VCLEFT_a231_seatSwitchBack m231 : 48|2@1+ (1,0) [0|3] "" Vector__XXX
 SG_ VCLEFT_a231_seatSwitchForward m231 : 50|2@1+ (1,0) [0|3] "" Vector__XXX
 SG_ VCLEFT_a232_seatMotorCurrent m232 : 16|12@1- (0.01,0) [-20.48|20.47] "" Vector__XXX
 SG_ VCLEFT_a232_seatMotorPosReal m232 : 28|12@1- (1,0) [-2048|2047] "" Vector__XXX
 SG_ VCLEFT_a232_seatMotorState m232 : 40|3@1+ (1,0) [0|7] "" Vector__XXX
 SG_ VCLEFT_a232_seatSwitchBack m232 : 43|2@1+ (1,0) [0|3] "" Vector__XXX
 SG_ VCLEFT_a232_seatSwitchForward m232 : 45|2@1+ (1,0) [0|3] "" Vector__XXX
 SG_ VCLEFT_a233_seatMotorCurrent m233 : 16|12@1- (0.01,0) [-20.48|20.47] "" Vector__XXX
 SG_ VCLEFT_a233_seatMotorPosReal m233 : 28|12@1- (1,0) [-2048|2047] "" Vector__XXX
 SG_ VCLEFT_a233_seatMotorState m233 : 40|3@1+ (1,0) [0|7] "" Vector__XXX
 SG_ VCLEFT_a233_seatSwitchBack m233 : 43|2@1+ (1,0) [0|3] "" Vector__XXX
 SG_ VCLEFT_a233_seatSwitchForward m233 : 45|2@1+ (1,0) [0|3] "" Vector__XXX
 SG_ VCLEFT_a234_seatMotorCurrent m234 : 16|12@1- (0.01,0) [-20.48|20.47] "" Vector__XXX
 SG_ VCLEFT_a234_seatMotorPosReal m234 : 28|12@1- (1,0) [-2048|2047] "" Vector__XXX
 SG_ VCLEFT_a234_seatMotorState m234 : 40|3@1+ (1,0) [0|7] "" Vector__XXX
 SG_ VCLEFT_a234_seatSwitchBack m234 : 43|2@1+ (1,0) [0|3] "" Vector__XXX
 SG_ VCLEFT_a234_seatSwitchForward m234 : 45|2@1+ (1,0) [0|3] "" Vector__XXX
 SG_ VCLEFT_a235_seatMotorCurrent m235 : 16|12@1- (0.01,0) [-20.48|20.47] "" Vector__XXX
 SG_ VCLEFT_a235_seatMotorPosReal m235 : 28|12@1- (1,0) [-2048|2047] "" Vector__XXX
 SG_ VCLEFT_a235_seatMotorState m235 : 40|3@1+ (1,0) [0|7] "" Vector__XXX
 SG_ VCLEFT_a235_seatSwitchBack m235 : 43|2@1+ (1,0) [0|3] "" Vector__XXX
 SG_ VCLEFT_a235_seatSwitchForward m235 : 45|2@1+ (1,0) [0|3] "" Vector__XXX
 SG_ VCLEFT_a236_lumbarAPressureHpa m236 : 16|16@1+ (1,0) [0|65535] "" Vector__XXX
 SG_ VCLEFT_a236_lumbarBPressureHpa m236 : 32|16@1+ (1,0) [0|65535] "" Vector__XXX
 SG_ VCLEFT_a236_lumbarDiagStatus m236 : 48|1@1+ (1,0) [0|1] "" Vector__XXX
 SG_ VCLEFT_a236_lumbarAState m236 : 49|3@1+ (1,0) [0|7] "" Vector__XXX
 SG_ VCLEFT_a236_lumbarBState m236 : 52|3@1+ (1,0) [0|7] "" Vector__XXX
 SG_ VCLEFT_a237_lumbarAPressureHpa m237 : 16|16@1+ (1,0) [0|65535] "" Vector__XXX
 SG_ VCLEFT_a237_lumbarBPressureHpa m237 : 32|16@1+ (1,0) [0|65535] "" Vector__XXX
 SG_ VCLEFT_a237_lumbarDiagStatus m237 : 48|1@1+ (1,0) [0|1] "" Vector__XXX
 SG_ VCLEFT_a237_lumbarAState m237 : 49|3@1+ (1,0) [0|7] "" Vector__XXX
 SG_ VCLEFT_a237_lumbarBState m237 : 52|3@1+ (1,0) [0|7] "" Vector__XXX
 SG_ VCLEFT_a238_lumbarAPressureHpa m238 : 16|16@1+ (1,0) [0|65535] "" Vector__XXX
 SG_ VCLEFT_a238_lumbarBPressureHpa m238 : 32|16@1+ (1,0) [0|65535] "" Vector__XXX
 SG_ VCLEFT_a238_lumbarDiagStatus m238 : 48|1@1+ (1,0) [0|1] "" Vector__XXX
 SG_ VCLEFT_a238_lumbarAState m238 : 49|3@1+ (1,0) [0|7] "" Vector__XXX
 SG_ VCLEFT_a238_lumbarBState m238 : 52|3@1+ (1,0) [0|7] "" Vector__XXX
 SG_ VCLEFT_a239_seatHeatCurrent m239 : 16|12@1+ (0.01,0) [0|40.95] "" Vector__XXX
 SG_ VCLEFT_a239_seatHeatTmp m239 : 28|12@1- (0.05,0) [-102.4|102.35] "" Vector__XXX
 SG_ VCLEFT_a239_seatHeatTmpTarget m239 : 40|8@1- (0.5,0) [-64|63.5] "" Vector__XXX
 SG_ VCLEFT_a240_seatHeatCurrent m240 : 16|12@1+ (0.01,0) [0|40.95] "" Vector__XXX
 SG_ VCLEFT_a240_seatHeatTmp m240 : 28|12@1- (0.05,0) [-102.4|102.35] "" Vector__XXX
 SG_ VCLEFT_a241_seatHeatCurrent m241 : 16|12@1+ (0.01,0) [0|40.95] "" Vector__XXX
 SG_ VCLEFT_a241_seatHeatTmp m241 : 28|12@1- (0.05,0) [-102.4|102.35] "" Vector__XXX
 SG_ VCLEFT_a241_cushion m241 : 40|1@1+ (1,0) [0|1] "" Vector__XXX
 SG_ VCLEFT_a241_backrest m241 : 41|1@1+ (1,0) [0|1] "" Vector__XXX
 SG_ VCLEFT_a242_seatHeatCurrent m242 : 16|12@1+ (0.01,0) [0|40.95] "" Vector__XXX
 SG_ VCLEFT_a242_seatHeatTmp m242 : 28|12@1- (0.05,0) [-102.4|102.35] "" Vector__XXX
 SG_ VCLEFT_a242_seatHeatTmpTarget m242 : 40|8@1- (0.5,0) [-64|63.5] "" Vector__XXX
 SG_ VCLEFT_a243_seatHeatCurrent m243 : 16|12@1+ (0.01,0) [0|40.95] "" Vector__XXX
 SG_ VCLEFT_a243_seatHeatTmp m243 : 28|12@1- (0.05,0) [-102.4|102.35] "" Vector__XXX
 SG_ VCLEFT_a244_seatHeatCurrent m244 : 16|12@1+ (0.01,0) [0|40.95] "" Vector__XXX
 SG_ VCLEFT_a244_seatHeatTmp m244 : 28|12@1- (0.05,0) [-102.4|102.35] "" Vector__XXX
 SG_ VCLEFT_a244_cushion m244 : 40|1@1+ (1,0) [0|1] "" Vector__XXX
 SG_ VCLEFT_a244_backrest m244 : 41|1@1+ (1,0) [0|1] "" Vector__XXX
 SG_ VCLEFT_a245_seatHeatCurrent m245 : 16|12@1+ (0.01,0) [0|40.95] "" Vector__XXX
 SG_ VCLEFT_a245_seatHeatTmp m245 : 28|12@1- (0.05,0) [-102.4|102.35] "" Vector__XXX
 SG_ VCLEFT_a245_seatHeatTmpTarget m245 : 40|8@1- (0.5,0) [-64|63.5] "" Vector__XXX
 SG_ VCLEFT_a246_seatHeatCurrent m246 : 16|12@1+ (0.01,0) [0|40.95] "" Vector__XXX
 SG_ VCLEFT_a246_seatHeatTmp m246 : 28|12@1- (0.05,0) [-102.4|102.35] "" Vector__XXX
 SG_ VCLEFT_a247_seatHeatCurrent m247 : 16|12@1+ (0.01,0) [0|40.95] "" Vector__XXX
 SG_ VCLEFT_a247_seatHeatTmp m247 : 28|12@1- (0.05,0) [-102.4|102.35] "" Vector__XXX
 SG_ VCLEFT_a247_cushion m247 : 40|1@1+ (1,0) [0|1] "" Vector__XXX
 SG_ VCLEFT_a247_backrest m247 : 41|1@1+ (1,0) [0|1] "" Vector__XXX
 SG_ VCLEFT_a248_seatHeatCurrent m248 : 16|12@1+ (0.01,0) [0|40.95] "" Vector__XXX
 SG_ VCLEFT_a248_seatHeatTmp m248 : 28|12@1- (0.05,0) [-102.4|102.35] "" Vector__XXX
 SG_ VCLEFT_a248_seatHeatTmpTarget m248 : 40|8@1- (0.5,0) [-64|63.5] "" Vector__XXX
 SG_ VCLEFT_a249_seatHeatCurrent m249 : 16|12@1+ (0.01,0) [0|40.95] "" Vector__XXX
 SG_ VCLEFT_a249_seatHeatTmp m249 : 28|12@1- (0.05,0) [-102.4|102.35] "" Vector__XXX
 SG_ VCLEFT_a250_seatHeatCurrent m250 : 16|12@1+ (0.01,0) [0|40.95] "" Vector__XXX
 SG_ VCLEFT_a250_seatHeatTmp m250 : 28|12@1- (0.05,0) [-102.4|102.35] "" Vector__XXX
 SG_ VCLEFT_a250_cushion m250 : 40|1@1+ (1,0) [0|1] "" Vector__XXX
 SG_ VCLEFT_a250_backrest m250 : 41|1@1+ (1,0) [0|1] "" Vector__XXX
 SG_ VCLEFT_a251_seatMotorCurrent m251 : 16|12@1- (0.01,0) [-20.48|20.47] "" Vector__XXX
 SG_ VCLEFT_a251_seatMotorPosReal m251 : 28|12@1- (1,0) [-2048|2047] "" Vector__XXX
 SG_ VCLEFT_a251_seatMotorState m251 : 40|3@1+ (1,0) [0|7] "" Vector__XXX
 SG_ VCLEFT_a251_seatSwitchBack m251 : 43|2@1+ (1,0) [0|3] "" Vector__XXX
 SG_ VCLEFT_a251_seatSwitchForward m251 : 45|2@1+ (1,0) [0|3] "" Vector__XXX
 SG_ VCLEFT_a252_seatMotorCurrent m252 : 16|12@1- (0.01,0) [-20.48|20.47] "" Vector__XXX
 SG_ VCLEFT_a252_seatMotorPosReal m252 : 28|12@1- (1,0) [-2048|2047] "" Vector__XXX
 SG_ VCLEFT_a252_seatMotorState m252 : 40|3@1+ (1,0) [0|7] "" Vector__XXX
 SG_ VCLEFT_a252_seatSwitchBack m252 : 43|2@1+ (1,0) [0|3] "" Vector__XXX
 SG_ VCLEFT_a252_seatSwitchForward m252 : 45|2@1+ (1,0) [0|3] "" Vector__XXX
 SG_ VCLEFT_a253_seatMotorCurrent m253 : 16|12@1- (0.01,0) [-20.48|20.47] "" Vector__XXX
 SG_ VCLEFT_a253_seatMotorPosReal m253 : 28|12@1- (1,0) [-2048|2047] "" Vector__XXX
 SG_ VCLEFT_a253_seatMotorState m253 : 40|3@1+ (1,0) [0|7] "" Vector__XXX
 SG_ VCLEFT_a253_seatSwitchBack m253 : 43|2@1+ (1,0) [0|3] "" Vector__XXX
 SG_ VCLEFT_a253_seatSwitchForward m253 : 45|2@1+ (1,0) [0|3] "" Vector__XXX
 SG_ VCLEFT_a254_seatMotorCurrent m254 : 16|12@1- (0.01,0) [-20.48|20.47] "" Vector__XXX
 SG_ VCLEFT_a254_seatMotorPosReal m254 : 28|12@1- (1,0) [-2048|2047] "" Vector__XXX
 SG_ VCLEFT_a254_seatMotorState m254 : 40|3@1+ (1,0) [0|7] "" Vector__XXX
 SG_ VCLEFT_a254_seatSwitchBack m254 : 43|2@1+ (1,0) [0|3] "" Vector__XXX
 SG_ VCLEFT_a254_seatSwitchForward m254 : 45|2@1+ (1,0) [0|3] "" Vector__XXX
 SG_ VCLEFT_a263_seatMotorCurrent m263 : 16|12@1- (0.01,0) [-20.48|20.47] "" Vector__XXX
 SG_ VCLEFT_a263_seatMotorDCurrent m263 : 28|12@1- (0.01,0) [-20.48|20.47] "" Vector__XXX
 SG_ VCLEFT_a263_seatMotorPosReal m263 : 40|12@1- (1,0) [-2048|2047] "" Vector__XXX
 SG_ VCLEFT_a263_seatMotorState m263 : 52|3@1+ (1,0) [0|7] "" Vector__XXX
 SG_ VCLEFT_a264_seatMotorCurrent m264 : 16|12@1- (0.01,0) [-20.48|20.47] "" Vector__XXX
 SG_ VCLEFT_a264_seatMotorDCurrent m264 : 28|12@1- (0.01,0) [-20.48|20.47] "" Vector__XXX
 SG_ VCLEFT_a264_seatMotorPosReal m264 : 40|12@1- (1,0) [-2048|2047] "" Vector__XXX
 SG_ VCLEFT_a264_seatMotorState m264 : 52|3@1+ (1,0) [0|7] "" Vector__XXX
 SG_ VCLEFT_a265_seatMotorCurrent m265 : 16|12@1- (0.01,0) [-20.48|20.47] "" Vector__XXX
 SG_ VCLEFT_a265_seatMotorDCurrent m265 : 28|12@1- (0.01,0) [-20.48|20.47] "" Vector__XXX
 SG_ VCLEFT_a265_seatMotorPosReal m265 : 40|12@1- (1,0) [-2048|2047] "" Vector__XXX
 SG_ VCLEFT_a265_seatMotorState m265 : 52|3@1+ (1,0) [0|7] "" Vector__XXX
 SG_ VCLEFT_a266_seatMotorCurrent m266 : 16|12@1- (0.01,0) [-20.48|20.47] "" Vector__XXX
 SG_ VCLEFT_a266_seatMotorDCurrent m266 : 28|12@1- (0.01,0) [-20.48|20.47] "" Vector__XXX
 SG_ VCLEFT_a266_seatMotorPosReal m266 : 40|12@1- (1,0) [-2048|2047] "" Vector__XXX
 SG_ VCLEFT_a266_seatMotorState m266 : 52|3@1+ (1,0) [0|7] "" Vector__XXX
 SG_ VCLEFT_a267_seatMotorCurrent m267 : 16|12@1- (0.01,0) [-20.48|20.47] "" Vector__XXX
 SG_ VCLEFT_a267_seatMotorDCurrent m267 : 28|12@1- (0.01,0) [-20.48|20.47] "" Vector__XXX
 SG_ VCLEFT_a267_seatMotorPosReal m267 : 40|12@1- (1,0) [-2048|2047] "" Vector__XXX
 SG_ VCLEFT_a267_seatMotorState m267 : 52|3@1+ (1,0) [0|7] "" Vector__XXX
 SG_ VCLEFT_a268_seatMotorCurrent m268 : 16|12@1- (0.01,0) [-20.48|20.47] "" Vector__XXX
 SG_ VCLEFT_a268_seatMotorDCurrent m268 : 28|12@1- (0.01,0) [-20.48|20.47] "" Vector__XXX
 SG_ VCLEFT_a268_seatMotorPosReal m268 : 40|12@1- (1,0) [-2048|2047] "" Vector__XXX
 SG_ VCLEFT_a268_seatMotorState m268 : 52|3@1+ (1,0) [0|7] "" Vector__XXX
 SG_ VCLEFT_a269_seatMotorCurrent m269 : 16|12@1- (0.01,0) [-20.48|20.47] "" Vector__XXX
 SG_ VCLEFT_a269_seatMotorDCurrent m269 : 28|12@1- (0.01,0) [-20.48|20.47] "" Vector__XXX
 SG_ VCLEFT_a269_seatMotorPosReal m269 : 40|12@1- (1,0) [-2048|2047] "" Vector__XXX
 SG_ VCLEFT_a269_seatMotorState m269 : 52|3@1+ (1,0) [0|7] "" Vector__XXX
 SG_ VCLEFT_a270_seatMotorCurrent m270 : 16|12@1- (0.01,0) [-20.48|20.47] "" Vector__XXX
 SG_ VCLEFT_a270_seatMotorDCurrent m270 : 28|12@1- (0.01,0) [-20.48|20.47] "" Vector__XXX
 SG_ VCLEFT_a270_seatMotorPosReal m270 : 40|12@1- (1,0) [-2048|2047] "" Vector__XXX
 SG_ VCLEFT_a270_seatMotorState m270 : 52|3@1+ (1,0) [0|7] "" Vector__XXX
 SG_ VCLEFT_a272_expectedState m272 : 16|2@1+ (1,0) [0|3] "" Vector__XXX
 SG_ VCLEFT_a272_actualState m272 : 18|2@1+ (1,0) [0|3] "" Vector__XXX
 SG_ VCLEFT_a273_handlePWM m273 : 16|7@1+ (1,0) [0|127] "" Vector__XXX
 SG_ VCLEFT_a273_temperature m273 : 24|8@1+ (0.5,-40) [-40|87.5] "" Vector__XXX
 SG_ VCLEFT_a274_handlePWM m274 : 16|7@1+ (1,0) [0|127] "" Vector__XXX
 SG_ VCLEFT_a274_temperature m274 : 24|8@1+ (0.5,-40) [-40|87.5] "" Vector__XXX
 SG_ VCLEFT_a275_outputFaulted m275 : 16|1@1+ (1,0) [0|1] "" Vector__XXX
 SG_ VCLEFT_a275_currentSenseFaulted m275 : 17|1@1+ (1,0) [0|1] "" Vector__XXX
 SG_ VCLEFT_a275_tempSenseFaulted m275 : 18|1@1+ (1,0) [0|1] "" Vector__XXX
 SG_ VCLEFT_a275_underCurrent m275 : 19|1@1+ (1,0) [0|1] "" Vector__XXX
 SG_ VCLEFT_a275_overCurrent m275 : 20|1@1+ (1,0) [0|1] "" Vector__XXX
 SG_ VCLEFT_a275_overTemperature m275 : 21|1@1+ (1,0) [0|1] "" Vector__XXX
 SG_ VCLEFT_a282_voltage m282 : 16|7@1+ (0.15,0) [0|19.05] "" Vector__XXX
 SG_ VCLEFT_a282_temperature m282 : 24|8@1+ (0.5,-40) [-40|87.5] "" Vector__XXX
 SG_ VCLEFT_a283_voltage m283 : 16|7@1+ (0.15,0) [0|19.05] "" Vector__XXX
 SG_ VCLEFT_a283_temperature m283 : 24|8@1+ (0.5,-40) [-40|87.5] "" Vector__XXX
 SG_ VCLEFT_a290_isNetworkSwitch m290 : 16|1@1+ (1,0) [0|1] "" Vector__XXX
 SG_ VCLEFT_a290_occupancySensorV m290 : 17|12@1- (0.01,0) [-20.48|20.47] "" Vector__XXX
 SG_ VCLEFT_a290_railVoltage m290 : 32|12@1- (0.01,0) [-20.48|20.47] "" Vector__XXX
 SG_ VCLEFT_a291_buckleSensorVoltage m291 : 16|12@1+ (0.01,0) [0|40.95] "" Vector__XXX
 SG_ VCLEFT_a291_railVoltage m291 : 28|12@1+ (0.01,0) [0|40.95] "" Vector__XXX
 SG_ VCLEFT_a292_isNetworkSwitch m292 : 16|1@1+ (1,0) [0|1] "" Vector__XXX
 SG_ VCLEFT_a292_occupancySensorV m292 : 17|12@1- (0.01,0) [-20.48|20.47] "" Vector__XXX
 SG_ VCLEFT_a292_railV m292 : 32|12@1- (0.01,0) [-20.48|20.47] "" Vector__XXX
 SG_ VCLEFT_a293_isNetworkSwitch m293 : 16|1@1+ (1,0) [0|1] "" Vector__XXX
 SG_ VCLEFT_a293_occupancySensorV m293 : 17|12@1- (0.01,0) [-20.48|20.47] "" Vector__XXX
 SG_ VCLEFT_a293_railV m293 : 32|12@1- (0.01,0) [-20.48|20.47] "" Vector__XXX
 SG_ VCLEFT_a294_isNetworkSwitch m294 : 16|1@1+ (1,0) [0|1] "" Vector__XXX
 SG_ VCLEFT_a294_occupancySensorV m294 : 17|12@1- (0.01,0) [-20.48|20.47] "" Vector__XXX
 SG_ VCLEFT_a294_railV m294 : 32|12@1- (0.01,0) [-20.48|20.47] "" Vector__XXX
 SG_ VCLEFT_a295_buckleSensorVoltage m295 : 16|12@1- (0.01,0) [-20.48|20.47] "" Vector__XXX
 SG_ VCLEFT_a295_railV m295 : 28|12@1- (0.01,0) [-20.48|20.47] "" Vector__XXX
 SG_ VCLEFT_a296_buckleSensorVoltage m296 : 16|12@1- (0.01,0) [-20.48|20.47] "" Vector__XXX
 SG_ VCLEFT_a296_railV m296 : 28|12@1- (0.01,0) [-20.48|20.47] "" Vector__XXX
 SG_ VCLEFT_a297_cabinTmp m297 : 16|12@1- (0.1,0) [-204.8|204.7] "" Vector__XXX
 SG_ VCLEFT_a302_overVoltage m302 : 16|1@1+ (1,0) [0|1] "" Vector__XXX
 SG_ VCLEFT_a302_underVoltage m302 : 17|1@1+ (1,0) [0|1] "" Vector__XXX
 SG_ VCLEFT_a302_motorOverTemperature m302 : 18|1@1+ (1,0) [0|1] "" Vector__XXX
 SG_ VCLEFT_a302_moduleOverCurrent m302 : 19|1@1+ (1,0) [0|1] "" Vector__XXX
 SG_ VCLEFT_a302_overRMSCurrent m302 : 20|1@1+ (1,0) [0|1] "" Vector__XXX
 SG_ VCLEFT_a302_motorStall m302 : 21|1@1+ (1,0) [0|1] "" Vector__XXX
 SG_ VCLEFT_a302_overloadFault m302 : 22|1@1+ (1,0) [0|1] "" Vector__XXX
 SG_ VCLEFT_a302_motorLostPhase m302 : 23|1@1+ (1,0) [0|1] "" Vector__XXX
 SG_ VCLEFT_a302_currentUnbalance m302 : 24|1@1+ (1,0) [0|1] "" Vector__XXX
 SG_ VCLEFT_a302_overspeedFault m302 : 25|1@1+ (1,0) [0|1] "" Vector__XXX
 SG_ VCLEFT_a302_startupFailed m302 : 26|1@1+ (1,0) [0|1] "" Vector__XXX
 SG_ VCLEFT_a302_TMS320OverTempShutDw m302 : 27|1@1+ (1,0) [0|1] "" Vector__XXX
 SG_ VCLEFT_a302_fetOvertempShutdown m302 : 28|1@1+ (1,0) [0|1] "" Vector__XXX
 SG_ VCLEFT_a302_motorDisconnect m302 : 29|1@1+ (1,0) [0|1] "" Vector__XXX
 SG_ VCLEFT_a302_DRV_MIA m302 : 30|1@1+ (1,0) [0|1] "" Vector__XXX
 SG_ VCLEFT_a302_overCurrentLatch m302 : 31|1@1+ (1,0) [0|1] "" Vector__XXX
 SG_ VCLEFT_a302_CBC_MIA m302 : 32|1@1+ (1,0) [0|1] "" Vector__XXX
 SG_ VCLEFT_a302_CBC_UARTReset m302 : 33|1@1+ (1,0) [0|1] "" Vector__XXX
 SG_ VCLEFT_a302_DRVFault m302 : 34|1@1+ (1,0) [0|1] "" Vector__XXX
 SG_ VCLEFT_a303_eFuseTripCount m303 : 16|8@1+ (1,0) [0|255] "" Vector__XXX
 SG_ VCLEFT_a306_disconnectedTime m306 : 16|10@1+ (1,0) [0|1023] "" Vector__XXX
 SG_ VCLEFT_a307_disconnectedTime m307 : 16|10@1+ (1,0) [0|1023] "" Vector__XXX
 SG_ VCLEFT_a308_tamperDetected m308 : 16|1@1+ (1,0) [0|1] "" Vector__XXX
 SG_ VCLEFT_a309_5VMainVoltage m309 : 16|12@1- (0.01,0) [-20.48|20.47] "" Vector__XXX
 SG_ VCLEFT_a310_mirrorFoldTime m310 : 16|9@1+ (10,0) [0|5110] "" Vector__XXX
 SG_ VCLEFT_a310_foldingDirection m310 : 25|1@1+ (1,0) [0|1] "" Vector__XXX
 SG_ VCLEFT_a310_mirrorMaxFoldCurrent m310 : 32|7@1- (0.05,0) [-3.2|3.15] "" Vector__XXX
 SG_ VCLEFT_a310_ambientTemperature m310 : 40|8@1+ (0.5,-40) [-40|87.5] "" Vector__XXX
 SG_ VCLEFT_a311_outputFaulted m311 : 16|1@1+ (1,0) [0|1] "" Vector__XXX
 SG_ VCLEFT_a311_currentSenseFaulted m311 : 17|1@1+ (1,0) [0|1] "" Vector__XXX
 SG_ VCLEFT_a311_tempSenseFaulted m311 : 18|1@1+ (1,0) [0|1] "" Vector__XXX
 SG_ VCLEFT_a311_underCurrent m311 : 19|1@1+ (1,0) [0|1] "" Vector__XXX
 SG_ VCLEFT_a311_overCurrent m311 : 20|1@1+ (1,0) [0|1] "" Vector__XXX
 SG_ VCLEFT_a311_overTemperature m311 : 21|1@1+ (1,0) [0|1] "" Vector__XXX
 SG_ VCLEFT_a312_outputFaulted m312 : 16|1@1+ (1,0) [0|1] "" Vector__XXX
 SG_ VCLEFT_a312_currentSenseFaulted m312 : 17|1@1+ (1,0) [0|1] "" Vector__XXX
 SG_ VCLEFT_a312_tempSenseFaulted m312 : 18|1@1+ (1,0) [0|1] "" Vector__XXX
 SG_ VCLEFT_a312_underCurrent m312 : 19|1@1+ (1,0) [0|1] "" Vector__XXX
 SG_ VCLEFT_a312_overCurrent m312 : 20|1@1+ (1,0) [0|1] "" Vector__XXX
 SG_ VCLEFT_a312_overTemperature m312 : 21|1@1+ (1,0) [0|1] "" Vector__XXX
 SG_ VCLEFT_a313_outputFaulted m313 : 16|1@1+ (1,0) [0|1] "" Vector__XXX
 SG_ VCLEFT_a313_currentSenseFaulted m313 : 17|1@1+ (1,0) [0|1] "" Vector__XXX
 SG_ VCLEFT_a313_tempSenseFaulted m313 : 18|1@1+ (1,0) [0|1] "" Vector__XXX
 SG_ VCLEFT_a313_underCurrent m313 : 19|1@1+ (1,0) [0|1] "" Vector__XXX
 SG_ VCLEFT_a313_overCurrent m313 : 20|1@1+ (1,0) [0|1] "" Vector__XXX
 SG_ VCLEFT_a313_overTemperature m313 : 21|1@1+ (1,0) [0|1] "" Vector__XXX
 SG_ VCLEFT_a314_outputFaulted m314 : 16|1@1+ (1,0) [0|1] "" Vector__XXX
 SG_ VCLEFT_a314_currentSenseFaulted m314 : 17|1@1+ (1,0) [0|1] "" Vector__XXX
 SG_ VCLEFT_a314_tempSenseFaulted m314 : 18|1@1+ (1,0) [0|1] "" Vector__XXX
 SG_ VCLEFT_a314_underCurrent m314 : 19|1@1+ (1,0) [0|1] "" Vector__XXX
 SG_ VCLEFT_a314_overCurrent m314 : 20|1@1+ (1,0) [0|1] "" Vector__XXX
 SG_ VCLEFT_a314_overTemperature m314 : 21|1@1+ (1,0) [0|1] "" Vector__XXX
 SG_ VCLEFT_a315_outputFaulted m315 : 16|1@1+ (1,0) [0|1] "" Vector__XXX
 SG_ VCLEFT_a315_currentSenseFaulted m315 : 17|1@1+ (1,0) [0|1] "" Vector__XXX
 SG_ VCLEFT_a315_tempSenseFaulted m315 : 18|1@1+ (1,0) [0|1] "" Vector__XXX
 SG_ VCLEFT_a315_underCurrent m315 : 19|1@1+ (1,0) [0|1] "" Vector__XXX
 SG_ VCLEFT_a315_overCurrent m315 : 20|1@1+ (1,0) [0|1] "" Vector__XXX
 SG_ VCLEFT_a315_overTemperature m315 : 21|1@1+ (1,0) [0|1] "" Vector__XXX
 SG_ VCLEFT_a316_foldState m316 : 16|3@1+ (1,0) [0|7] "" Vector__XXX
 SG_ VCLEFT_a316_actuationDurationMs m316 : 19|10@1+ (10,0) [0|10230] "" Vector__XXX
 SG_ VCLEFT_a316_maxCurrentAmps m316 : 32|12@1+ (0.01,0) [0|40.95] "" Vector__XXX
 SG_ VCLEFT_a316_averageCurrentAmps m316 : 44|12@1+ (0.01,0) [0|40.95] "" Vector__XXX
 SG_ VCLEFT_a316_ambientTemperatureDe m316 : 56|8@1+ (0.5,-40) [-40|87.5] "" Vector__XXX
 SG_ VCLEFT_a318_configExpected m318 : 16|2@1+ (1,0) [0|3] "" Vector__XXX
 SG_ VCLEFT_a318_hardwareIdActual m318 : 24|8@1+ (1,0) [0|255] "" Vector__XXX
 SG_ VCLEFT_a319_IBSTsOutputRodDriver m319 : 16|12@1+ (0.015625,-5) [-5|58.984375] "" Vector__XXX
 SG_ VCLEFT_a319_IBSTsOutputRodD_0001 m319 : 28|2@1+ (1,0) [0|3] "" Vector__XXX
 SG_ VCLEFT_a319_fallbackIndex m319 : 32|3@1+ (1,0) [0|7] "" Vector__XXX
 SG_ VCLEFT_a324_mirrorHeatCurrent m324 : 16|10@1+ (0.01,0) [0|10.23] "" Vector__XXX
 SG_ VCLEFT_a325_PWMdutyCycleFL m325 : 16|16@1+ (0.0025,0) [0|163.8375] "" Vector__XXX
 SG_ VCLEFT_a325_PWMfrequencyFL m325 : 32|16@1+ (0.025,0) [0|1638.375] "" Vector__XXX
 SG_ VCLEFT_a325_PWMfaultFL m325 : 48|4@1+ (1,0) [0|15] "" Vector__XXX
 SG_ VCLEFT_a326_PWMdutyCycleRL m326 : 16|16@1+ (0.0025,0) [0|163.8375] "" Vector__XXX
 SG_ VCLEFT_a326_PWMfrequencyRL m326 : 32|16@1+ (0.025,0) [0|1638.375] "" Vector__XXX
 SG_ VCLEFT_a326_PWMfaultRL m326 : 48|4@1+ (1,0) [0|15] "" Vector__XXX
 SG_ VCLEFT_a327_PWMdutyCycleFL m327 : 16|16@1+ (0.0025,0) [0|163.8375] "" Vector__XXX
 SG_ VCLEFT_a327_PWMfrequencyFL m327 : 32|16@1+ (0.025,0) [0|1638.375] "" Vector__XXX
 SG_ VCLEFT_a327_PWMfaultFL m327 : 48|4@1+ (1,0) [0|15] "" Vector__XXX
 SG_ VCLEFT_a328_PWMdutyCycleRL m328 : 16|16@1+ (0.0025,0) [0|163.8375] "" Vector__XXX
 SG_ VCLEFT_a328_PWMfrequencyRL m328 : 32|16@1+ (0.025,0) [0|1638.375] "" Vector__XXX
 SG_ VCLEFT_a328_PWMfaultRL m328 : 48|4@1+ (1,0) [0|15] "" Vector__XXX
 SG_ VCLEFT_a330_voltage m330 : 16|7@1+ (0.15,0) [0|19.05] "" Vector__XXX
 SG_ VCLEFT_a330_maxCurrent m330 : 24|7@1+ (0.25,0) [0|31.75] "" Vector__XXX
 SG_ VCLEFT_a330_temperature m330 : 32|8@1+ (0.5,-40) [-40|87.5] "" Vector__XXX
 SG_ VCLEFT_a331_voltage m331 : 16|7@1+ (0.15,0) [0|19.05] "" Vector__XXX
 SG_ VCLEFT_a331_maxCurrent m331 : 24|7@1+ (0.25,0) [0|31.75] "" Vector__XXX
 SG_ VCLEFT_a331_temperature m331 : 32|8@1+ (0.5,-40) [-40|87.5] "" Vector__XXX
 SG_ VCLEFT_a334_OHCDiagnosticMask m334 : 16|32@1+ (1,0) [0|4294967295] "" Vector__XXX
 SG_ VCLEFT_a335_USSSelfTestResult m335 : 16|1@1+ (1,0) [0|1] "" Vector__XXX
 SG_ VCLEFT_a335_EEPROMSelfTestResult m335 : 17|1@1+ (1,0) [0|1] "" Vector__XXX
 SG_ VCLEFT_a335_LMSelfTestResult m335 : 18|1@1+ (1,0) [0|1] "" Vector__XXX
 SG_ VCLEFT_a335_SystemError m335 : 19|1@1+ (1,0) [0|1] "" Vector__XXX
 SG_ VCLEFT_a335_SelfTestStatus m335 : 20|1@1+ (1,0) [0|1] "" Vector__XXX
 SG_ VCLEFT_a341_leftTurn m341 : 16|1@1+ (1,0) [0|1] "" Vector__XXX
 SG_ VCLEFT_a341_rightTurn m341 : 17|1@1+ (1,0) [0|1] "" Vector__XXX
 SG_ VCLEFT_a341_tail m341 : 18|1@1+ (1,0) [0|1] "" Vector__XXX
 SG_ VCLEFT_a341_stop m341 : 19|1@1+ (1,0) [0|1] "" Vector__XXX
 SG_ VCLEFT_a341_fog m341 : 20|1@1+ (1,0) [0|1] "" Vector__XXX
 SG_ VCLEFT_a341_reverse m341 : 21|1@1+ (1,0) [0|1] "" Vector__XXX
 SG_ VCLEFT_a342_OverVoltage m342 : 16|1@1+ (1,0) [0|1] "" Vector__XXX
 SG_ VCLEFT_a342_UnderVoltage m342 : 17|1@1+ (1,0) [0|1] "" Vector__XXX
 SG_ VCLEFT_a342_5VRailStatus m342 : 18|1@1+ (1,0) [0|1] "" Vector__XXX
 SG_ VCLEFT_a342_OverTemperature m342 : 19|1@1+ (1,0) [0|1] "" Vector__XXX
 SG_ VCLEFT_a345_secondsSinceWakeUp m345 : 16|32@1+ (0.001,0) [0|4294967.295] "" Vector__XXX
 SG_ VCLEFT_a345_powerCycleCount m345 : 48|12@1+ (1,0) [0|4095] "" Vector__XXX
 SG_ VCLEFT_a346_eFuseTripCount m346 : 16|8@1+ (1,0) [0|255] "" Vector__XXX
 SG_ VCLEFT_a348_current m348 : 16|16@1+ (0.001,0) [0|65.535] "" Vector__XXX
 SG_ VCLEFT_a349_voltage m349 : 16|16@1+ (0.1,0) [0|6553.5] "" Vector__XXX
 SG_ VCLEFT_a350_ensPeriod m350 : 16|16@1+ (0.0001,0) [0|6.5535] "" Vector__XXX
 SG_ VCLEFT_a350_ensDuty m350 : 32|10@1+ (0.00098,0) [0|1.00254] "" Vector__XXX
 SG_ VCLEFT_a350_ensTimedOut m350 : 42|1@1+ (1,0) [0|1] "" Vector__XXX
 SG_ VCLEFT_a352_liftgatePosition m352 : 16|7@1- (1,43) [-21|106] "" Vector__XXX
 SG_ VCLEFT_a352_liftgateVelocityNear m352 : 24|7@1- (0.5,-17) [-49|14.5] "" Vector__XXX
 SG_ VCLEFT_a352_liftgateClosingCount m352 : 32|16@1+ (1,0) [0|65535] "" Vector__XXX
 SG_ VCLEFT_a352_liftgateClosingFaile m352 : 48|16@1+ (1,0) [0|65535] "" Vector__XXX
 SG_ VCLEFT_a353_eFuseTripCount m353 : 16|8@1+ (1,0) [0|255] "" Vector__XXX
 SG_ VCLEFT_a354_eFuseTripCount m354 : 16|8@1+ (1,0) [0|255] "" Vector__XXX
 SG_ VCLEFT_a355_liftgateStoppingCond m355 : 16|4@1+ (1,0) [0|15] "" Vector__XXX
 SG_ VCLEFT_a355_liftgateLastState m355 : 20|4@1+ (1,0) [0|15] "" Vector__XXX
 SG_ VCLEFT_a355_liftgatePosition m355 : 24|7@1- (1,43) [-21|106] "" Vector__XXX
 SG_ VCLEFT_a355_liftgateLatchStatus m355 : 32|4@1+ (1,0) [0|15] "" Vector__XXX
 SG_ VCLEFT_a355_ambientTemperature m355 : 40|8@1+ (0.5,-40) [-40|87.5] "" Vector__XXX
 SG_ VCLEFT_a357_liftgateState m357 : 16|4@1+ (1,0) [0|15] "" Vector__XXX
 SG_ VCLEFT_a357_liftgatePosition m357 : 24|7@1- (1,43) [-21|106] "" Vector__XXX
 SG_ VCLEFT_a357_liftgateLatchStatus m357 : 32|4@1+ (1,0) [0|15] "" Vector__XXX
 SG_ VCLEFT_a373_windowChannel m373 : 16|2@1+ (1,0) [0|3] "" Vector__XXX
 SG_ VCLEFT_a374_leftTurn m374 : 16|2@1+ (1,0) [0|3] "" Vector__XXX
 SG_ VCLEFT_a374_rightTurn m374 : 18|2@1+ (1,0) [0|3] "" Vector__XXX
 SG_ VCLEFT_a374_tail m374 : 20|2@1+ (1,0) [0|3] "" Vector__XXX
 SG_ VCLEFT_a374_brake m374 : 22|2@1+ (1,0) [0|3] "" Vector__XXX
 SG_ VCLEFT_a374_fog m374 : 24|2@1+ (1,0) [0|3] "" Vector__XXX
 SG_ VCLEFT_a374_reverse m374 : 26|2@1+ (1,0) [0|3] "" Vector__XXX
 SG_ VCLEFT_a374_trailerMode m374 : 28|1@1+ (1,0) [0|1] "" Vector__XXX
 SG_ VCLEFT_a375_windowFront m375 : 16|1@1+ (1,0) [0|1] "" Vector__XXX
 SG_ VCLEFT_a376_2RowSeatTrackActuato m376 : 16|12@1- (0.01,0) [-20.48|20.47] "" Vector__XXX
 SG_ VCLEFT_a376_2RowSeatTrackAc_0001 m376 : 28|12@1- (0.1,0) [-204.8|204.7] "" Vector__XXX
 SG_ VCLEFT_a376_2RowSeatEasyEntrySta m376 : 40|3@1+ (1,0) [0|7] "" Vector__XXX
 SG_ VCLEFT_a376_2RowSeatTrackPositio m376 : 43|2@1+ (1,0) [0|3] "" Vector__XXX
 SG_ VCLEFT_a380_inOutAxis m380 : 16|1@1+ (1,0) [0|1] "" Vector__XXX
 SG_ VCLEFT_a380_upDownAxis m380 : 17|1@1+ (1,0) [0|1] "" Vector__XXX
 SG_ VCLEFT_a391_averageSpeed m391 : 16|6@1+ (10,-100) [-100|530] "" Vector__XXX
 SG_ VCLEFT_a391_averageGrade m391 : 24|7@1- (0.01,0) [-0.64|0.63] "" Vector__XXX
 SG_ VCLEFT_a391_averagePower m391 : 32|7@1+ (10,-200) [-200|1070] "" Vector__XXX
 SG_ VCLEFT_a391_massEstimate m391 : 40|6@1+ (25,1900) [1900|3475] "" Vector__XXX
 SG_ VCLEFT_a391_pitchEstimateIMU m391 : 48|7@1- (0.001,0) [-0.064|0.063] "" Vector__XXX
 SG_ VCLEFT_a395_leftSteeringWheelSwi m395 : 16|1@1+ (1,0) [0|1] "" Vector__XXX
 SG_ VCLEFT_a395_rightSteeringWheelSw m395 : 17|1@1+ (1,0) [0|1] "" Vector__XXX
 SG_ VCLEFT_a396_button1Touch m396 : 16|1@1+ (1,0) [0|1] "" Vector__XXX
 SG_ VCLEFT_a396_button2Touch m396 : 17|1@1+ (1,0) [0|1] "" Vector__XXX
 SG_ VCLEFT_a396_button3Touch m396 : 18|1@1+ (1,0) [0|1] "" Vector__XXX
 SG_ VCLEFT_a396_button4Touch m396 : 19|1@1+ (1,0) [0|1] "" Vector__XXX
 SG_ VCLEFT_a396_button5Touch m396 : 20|1@1+ (1,0) [0|1] "" Vector__XXX
 SG_ VCLEFT_a396_button6Touch m396 : 21|1@1+ (1,0) [0|1] "" Vector__XXX
 SG_ VCLEFT_a397_button1Touch m397 : 16|1@1+ (1,0) [0|1] "" Vector__XXX
 SG_ VCLEFT_a397_button2Touch m397 : 17|1@1+ (1,0) [0|1] "" Vector__XXX
 SG_ VCLEFT_a397_button3Touch m397 : 18|1@1+ (1,0) [0|1] "" Vector__XXX
 SG_ VCLEFT_a397_button4Touch m397 : 19|1@1+ (1,0) [0|1] "" Vector__XXX
 SG_ VCLEFT_a397_button5Touch m397 : 20|1@1+ (1,0) [0|1] "" Vector__XXX
 SG_ VCLEFT_a397_button6Touch m397 : 21|1@1+ (1,0) [0|1] "" Vector__XXX
 SG_ VCLEFT_a398_button1Touch m398 : 16|1@1+ (1,0) [0|1] "" Vector__XXX
 SG_ VCLEFT_a398_button2Touch m398 : 17|1@1+ (1,0) [0|1] "" Vector__XXX
 SG_ VCLEFT_a398_button3Touch m398 : 18|1@1+ (1,0) [0|1] "" Vector__XXX
 SG_ VCLEFT_a398_button4Touch m398 : 19|1@1+ (1,0) [0|1] "" Vector__XXX
 SG_ VCLEFT_a398_button5Touch m398 : 20|1@1+ (1,0) [0|1] "" Vector__XXX
 SG_ VCLEFT_a398_button6Touch m398 : 21|1@1+ (1,0) [0|1] "" Vector__XXX
 SG_ VCLEFT_a399_leftSteeringWheelSwi m399 : 16|1@1+ (1,0) [0|1] "" Vector__XXX
 SG_ VCLEFT_a399_rightSteeringWheelSw m399 : 17|1@1+ (1,0) [0|1] "" Vector__XXX
 SG_ VCLEFT_a399_leftNormalizedNoiseV m399 : 24|8@1+ (1,0) [0|255] "" Vector__XXX
 SG_ VCLEFT_a399_rightNormalizedNoise m399 : 32|8@1+ (1,0) [0|255] "" Vector__XXX
 SG_ VCLEFT_a401_button1Status m401 : 16|1@1+ (1,0) [0|1] "" Vector__XXX
 SG_ VCLEFT_a401_button2Status m401 : 17|1@1+ (1,0) [0|1] "" Vector__XXX
 SG_ VCLEFT_a401_button3Status m401 : 18|1@1+ (1,0) [0|1] "" Vector__XXX
 SG_ VCLEFT_a401_button4Status m401 : 19|1@1+ (1,0) [0|1] "" Vector__XXX
 SG_ VCLEFT_a401_button5Status m401 : 20|1@1+ (1,0) [0|1] "" Vector__XXX
 SG_ VCLEFT_a401_button6Status m401 : 21|1@1+ (1,0) [0|1] "" Vector__XXX
 SG_ VCLEFT_a402_button1Status m402 : 16|1@1+ (1,0) [0|1] "" Vector__XXX
 SG_ VCLEFT_a402_button2Status m402 : 17|1@1+ (1,0) [0|1] "" Vector__XXX
 SG_ VCLEFT_a402_button3Status m402 : 18|1@1+ (1,0) [0|1] "" Vector__XXX
 SG_ VCLEFT_a402_button4Status m402 : 19|1@1+ (1,0) [0|1] "" Vector__XXX
 SG_ VCLEFT_a402_button5Status m402 : 20|1@1+ (1,0) [0|1] "" Vector__XXX
 SG_ VCLEFT_a402_button6Status m402 : 21|1@1+ (1,0) [0|1] "" Vector__XXX
 SG_ VCLEFT_a403_leftSteeringWheelSwi m403 : 16|1@1+ (1,0) [0|1] "" Vector__XXX
 SG_ VCLEFT_a403_rightSteeringWheelSw m403 : 17|1@1+ (1,0) [0|1] "" Vector__XXX
 SG_ VCLEFT_a404_leftSteeringWheelSwi m404 : 16|1@1+ (1,0) [0|1] "" Vector__XXX
 SG_ VCLEFT_a404_rightSteeringWheelSw m404 : 17|1@1+ (1,0) [0|1] "" Vector__XXX
 SG_ VCLEFT_a405_leftSteeringWheelSwi m405 : 16|1@1+ (1,0) [0|1] "" Vector__XXX
 SG_ VCLEFT_a405_rightSteeringWheelSw m405 : 17|1@1+ (1,0) [0|1] "" Vector__XXX
 SG_ VCLEFT_a406_leftSteeringWheelSwi m406 : 16|1@1+ (1,0) [0|1] "" Vector__XXX
 SG_ VCLEFT_a406_rightSteeringWheelSw m406 : 17|1@1+ (1,0) [0|1] "" Vector__XXX
 SG_ VCLEFT_a407_leftSteeringWheelSwi m407 : 16|1@1+ (1,0) [0|1] "" Vector__XXX
 SG_ VCLEFT_a407_rightSteeringWheelSw m407 : 17|1@1+ (1,0) [0|1] "" Vector__XXX
 SG_ VCLEFT_a409_leftScrollWheelFault m409 : 16|1@1+ (1,0) [0|1] "" Vector__XXX
 SG_ VCLEFT_a409_rightScrollWheelFaul m409 : 17|1@1+ (1,0) [0|1] "" Vector__XXX
 SG_ VCLEFT_a409_rightScrollWheelPrev m409 : 18|1@1+ (1,0) [0|1] "" Vector__XXX
 SG_ VCLEFT_a409_rightScrollWheelChal m409 : 24|16@1+ (1,0) [0|65535] "" Vector__XXX
 SG_ VCLEFT_a409_rightScrollWheelRaw0 m409 : 40|8@1+ (1,0) [0|255] "" Vector__XXX
 SG_ VCLEFT_a409_rightScrollWheelRaw1 m409 : 48|8@1+ (1,0) [0|255] "" Vector__XXX
 SG_ VCLEFT_a410_leftScrollWheelFault m410 : 16|1@1+ (1,0) [0|1] "" Vector__XXX
 SG_ VCLEFT_a410_rightScrollWheelFaul m410 : 17|1@1+ (1,0) [0|1] "" Vector__XXX
 SG_ VCLEFT_a411_leftScrollWheelFault m411 : 16|1@1+ (1,0) [0|1] "" Vector__XXX
 SG_ VCLEFT_a411_rightScrollWheelFaul m411 : 17|1@1+ (1,0) [0|1] "" Vector__XXX
 SG_ VCLEFT_a412_outputFaulted m412 : 16|1@1+ (1,0) [0|1] "" Vector__XXX
 SG_ VCLEFT_a412_currentSenseFaulted m412 : 17|1@1+ (1,0) [0|1] "" Vector__XXX
 SG_ VCLEFT_a412_tempSenseFaulted m412 : 18|1@1+ (1,0) [0|1] "" Vector__XXX
 SG_ VCLEFT_a412_underCurrent m412 : 19|1@1+ (1,0) [0|1] "" Vector__XXX
 SG_ VCLEFT_a412_overCurrent m412 : 20|1@1+ (1,0) [0|1] "" Vector__XXX
 SG_ VCLEFT_a412_overTemperature m412 : 21|1@1+ (1,0) [0|1] "" Vector__XXX
 SG_ VCLEFT_a413_failureReason m413 : 16|6@1+ (1,0) [0|63] "" Vector__XXX
 SG_ VCLEFT_a413_loadUnattemptedOnFai m413 : 22|1@1+ (1,0) [0|1] "" Vector__XXX
 SG_ VCLEFT_a413_deviceStuckOnFailure m413 : 23|1@1+ (1,0) [0|1] "" Vector__XXX
 SG_ VCLEFT_a413_uvLoadshedVsenseDigI m413 : 24|1@1+ (1,0) [0|1] "" Vector__XXX
 SG_ VCLEFT_a413_uvLoadshedVoltage m413 : 25|9@1+ (0.05,0) [0|25.55] "" Vector__XXX
 SG_ VCLEFT_a414_leftHapticMotorFault m414 : 16|1@1+ (1,0) [0|1] "" Vector__XXX
 SG_ VCLEFT_a414_rightHapticMotorFaul m414 : 17|1@1+ (1,0) [0|1] "" Vector__XXX
 SG_ VCLEFT_a415_leftVbatUndervoltage m415 : 16|1@1+ (1,0) [0|1] "" Vector__XXX
 SG_ VCLEFT_a415_rightVbatUndervoltag m415 : 17|1@1+ (1,0) [0|1] "" Vector__XXX
 SG_ VCLEFT_a415_leftVbatOvervoltageF m415 : 18|1@1+ (1,0) [0|1] "" Vector__XXX
 SG_ VCLEFT_a415_rightVbatOvervoltage m415 : 19|1@1+ (1,0) [0|1] "" Vector__XXX
 SG_ VCLEFT_a417_leftDomeTouch m417 : 16|1@1+ (1,0) [0|1] "" Vector__XXX
 SG_ VCLEFT_a417_parkButtonTouch m417 : 17|1@1+ (1,0) [0|1] "" Vector__XXX
 SG_ VCLEFT_a417_reverseButtonTouch m417 : 18|1@1+ (1,0) [0|1] "" Vector__XXX
 SG_ VCLEFT_a417_hazardButtonTouch m417 : 19|1@1+ (1,0) [0|1] "" Vector__XXX
 SG_ VCLEFT_a417_neutralButtonTouch m417 : 20|1@1+ (1,0) [0|1] "" Vector__XXX
 SG_ VCLEFT_a417_driveButtonTouch m417 : 21|1@1+ (1,0) [0|1] "" Vector__XXX
 SG_ VCLEFT_a417_rightDomeTouch m417 : 22|1@1+ (1,0) [0|1] "" Vector__XXX
 SG_ VCLEFT_a419_leftDomeTouch m419 : 16|1@1+ (1,0) [0|1] "" Vector__XXX
 SG_ VCLEFT_a419_parkButtonTouch m419 : 17|1@1+ (1,0) [0|1] "" Vector__XXX
 SG_ VCLEFT_a419_reverseButtonTouch m419 : 18|1@1+ (1,0) [0|1] "" Vector__XXX
 SG_ VCLEFT_a419_hazardButtonTouch m419 : 19|1@1+ (1,0) [0|1] "" Vector__XXX
 SG_ VCLEFT_a419_neutralButtonTouch m419 : 20|1@1+ (1,0) [0|1] "" Vector__XXX
 SG_ VCLEFT_a419_driveButtonTouch m419 : 21|1@1+ (1,0) [0|1] "" Vector__XXX
 SG_ VCLEFT_a419_rightDomeTouch m419 : 22|1@1+ (1,0) [0|1] "" Vector__XXX
 SG_ VCLEFT_a420_leftDomeTouch m420 : 16|1@1+ (1,0) [0|1] "" Vector__XXX
 SG_ VCLEFT_a420_parkButtonTouch m420 : 17|1@1+ (1,0) [0|1] "" Vector__XXX
 SG_ VCLEFT_a420_reverseButtonTouch m420 : 18|1@1+ (1,0) [0|1] "" Vector__XXX
 SG_ VCLEFT_a420_hazardButtonTouch m420 : 19|1@1+ (1,0) [0|1] "" Vector__XXX
 SG_ VCLEFT_a420_neutralButtonTouch m420 : 20|1@1+ (1,0) [0|1] "" Vector__XXX
 SG_ VCLEFT_a420_driveButtonTouch m420 : 21|1@1+ (1,0) [0|1] "" Vector__XXX
 SG_ VCLEFT_a420_rightDomeTouch m420 : 22|1@1+ (1,0) [0|1] "" Vector__XXX
 SG_ VCLEFT_a421_parkButtonForce m421 : 16|1@1+ (1,0) [0|1] "" Vector__XXX
 SG_ VCLEFT_a421_reverseButtonForce m421 : 17|1@1+ (1,0) [0|1] "" Vector__XXX
 SG_ VCLEFT_a421_hazardButtonForce m421 : 18|1@1+ (1,0) [0|1] "" Vector__XXX
 SG_ VCLEFT_a421_neutralButtonForce m421 : 19|1@1+ (1,0) [0|1] "" Vector__XXX
 SG_ VCLEFT_a421_driveButtonForce m421 : 20|1@1+ (1,0) [0|1] "" Vector__XXX
 SG_ VCLEFT_a422_seat2RControllerStuc m422 : 16|1@1+ (1,0) [0|1] "" Vector__XXX
 SG_ VCLEFT_a422_auxSocketRearStuckOf m422 : 17|1@1+ (1,0) [0|1] "" Vector__XXX
 SG_ VCLEFT_a422_seat2RAllHeatersStuc m422 : 18|1@1+ (1,0) [0|1] "" Vector__XXX
 SG_ VCLEFT_a422_trailerLightEcuStuck m422 : 19|1@1+ (1,0) [0|1] "" Vector__XXX
 SG_ VCLEFT_a422_accessoryFeed3StuckO m422 : 20|1@1+ (1,0) [0|1] "" Vector__XXX
 SG_ VCLEFT_a422_vbatProtFusedSeatStu m422 : 21|1@1+ (1,0) [0|1] "" Vector__XXX
 SG_ VCLEFT_a422_usbPortsStuckOff m422 : 22|1@1+ (1,0) [0|1] "" Vector__XXX
 SG_ VCLEFT_a422_auxSocketFrontStuckO m422 : 23|1@1+ (1,0) [0|1] "" Vector__XXX
 SG_ VCLEFT_a422_lumbarEcuStuckOff m422 : 24|1@1+ (1,0) [0|1] "" Vector__XXX
 SG_ VCLEFT_a422_ambientRgbRightStuck m422 : 25|1@1+ (1,0) [0|1] "" Vector__XXX
 SG_ VCLEFT_a422_ambientRgbMiddleStuc m422 : 26|1@1+ (1,0) [0|1] "" Vector__XXX
 SG_ VCLEFT_a422_ambientRgbLeftStuckO m422 : 27|1@1+ (1,0) [0|1] "" Vector__XXX
 SG_ VCLEFT_a422_door1rRgbStuckOff m422 : 28|1@1+ (1,0) [0|1] "" Vector__XXX
 SG_ VCLEFT_a422_door2rRgbStuckOff m422 : 29|1@1+ (1,0) [0|1] "" Vector__XXX
 SG_ VCLEFT_a422_seat1rVentFanBackres m422 : 30|1@1+ (1,0) [0|1] "" Vector__XXX
 SG_ VCLEFT_a422_seat1rVentFanCushion m422 : 31|1@1+ (1,0) [0|1] "" Vector__XXX
 SG_ VCLEFT_a422_trailerBrakeEcuStuck m422 : 32|1@1+ (1,0) [0|1] "" Vector__XXX
 SG_ VCLEFT_a422_trailerAuxStuckOff m422 : 33|1@1+ (1,0) [0|1] "" Vector__XXX
 SG_ VCLEFT_a422_vbatFusedStuckOff m422 : 34|1@1+ (1,0) [0|1] "" Vector__XXX
 SG_ VCLEFT_a424_parkButtonLED m424 : 16|1@1+ (1,0) [0|1] "" Vector__XXX
 SG_ VCLEFT_a424_reverseButtonLED m424 : 17|1@1+ (1,0) [0|1] "" Vector__XXX
 SG_ VCLEFT_a424_neutralButtonLED m424 : 18|1@1+ (1,0) [0|1] "" Vector__XXX
 SG_ VCLEFT_a424_driveButtonLED m424 : 19|1@1+ (1,0) [0|1] "" Vector__XXX
 SG_ VCLEFT_a424_commonButtonLED m424 : 20|1@1+ (1,0) [0|1] "" Vector__XXX
 SG_ VCLEFT_a425_leftVisorLightStatus m425 : 16|1@1+ (1,0) [0|1] "" Vector__XXX
 SG_ VCLEFT_a425_rightVisorLightStatu m425 : 17|1@1+ (1,0) [0|1] "" Vector__XXX
 SG_ VCLEFT_a426_seatMotorCalibrated m426 : 16|1@1+ (1,0) [0|1] "" Vector__XXX
 SG_ VCLEFT_a426_seatMotorCurrent m426 : 17|12@1- (0.01,0) [-20.48|20.47] "" Vector__XXX
 SG_ VCLEFT_a426_seatMotorPosReal m426 : 32|12@1- (1,0) [-2048|2047] "" Vector__XXX
 SG_ VCLEFT_a426_seatMotorState m426 : 44|3@1+ (1,0) [0|7] "" Vector__XXX
 SG_ VCLEFT_a426_seatSwitchBack m426 : 48|2@1+ (1,0) [0|3] "" Vector__XXX
 SG_ VCLEFT_a426_seatSwitchForward m426 : 50|2@1+ (1,0) [0|3] "" Vector__XXX
 SG_ VCLEFT_a426_cabinTmp m426 : 52|12@1- (0.1,0) [-204.8|204.7] "" Vector__XXX
 SG_ VCLEFT_a427_seatMotorCalibrated m427 : 16|1@1+ (1,0) [0|1] "" Vector__XXX
 SG_ VCLEFT_a427_seatMotorCurrent m427 : 17|12@1- (0.01,0) [-20.48|20.47] "" Vector__XXX
 SG_ VCLEFT_a427_seatMotorPosReal m427 : 32|12@1- (1,0) [-2048|2047] "" Vector__XXX
 SG_ VCLEFT_a427_seatMotorState m427 : 44|3@1+ (1,0) [0|7] "" Vector__XXX
 SG_ VCLEFT_a427_seatSwitchBack m427 : 48|2@1+ (1,0) [0|3] "" Vector__XXX
 SG_ VCLEFT_a427_seatSwitchForward m427 : 50|2@1+ (1,0) [0|3] "" Vector__XXX
 SG_ VCLEFT_a427_cabinTmp m427 : 52|12@1- (0.1,0) [-204.8|204.7] "" Vector__XXX
 SG_ VCLEFT_a428_seatMotorCalibrated m428 : 16|1@1+ (1,0) [0|1] "" Vector__XXX
 SG_ VCLEFT_a428_seatMotorCurrent m428 : 17|12@1- (0.01,0) [-20.48|20.47] "" Vector__XXX
 SG_ VCLEFT_a428_seatMotorPosReal m428 : 32|12@1- (1,0) [-2048|2047] "" Vector__XXX
 SG_ VCLEFT_a428_seatMotorState m428 : 44|3@1+ (1,0) [0|7] "" Vector__XXX
 SG_ VCLEFT_a428_seatSwitchBack m428 : 48|2@1+ (1,0) [0|3] "" Vector__XXX
 SG_ VCLEFT_a428_seatSwitchForward m428 : 50|2@1+ (1,0) [0|3] "" Vector__XXX
 SG_ VCLEFT_a428_cabinTmp m428 : 52|12@1- (0.1,0) [-204.8|204.7] "" Vector__XXX
 SG_ VCLEFT_a429_seatMotorCalibrated m429 : 16|1@1+ (1,0) [0|1] "" Vector__XXX
 SG_ VCLEFT_a429_seatMotorCurrent m429 : 17|12@1- (0.01,0) [-20.48|20.47] "" Vector__XXX
 SG_ VCLEFT_a429_seatMotorPosReal m429 : 32|12@1- (1,0) [-2048|2047] "" Vector__XXX
 SG_ VCLEFT_a429_seatMotorState m429 : 44|3@1+ (1,0) [0|7] "" Vector__XXX
 SG_ VCLEFT_a429_seatSwitchBack m429 : 48|2@1+ (1,0) [0|3] "" Vector__XXX
 SG_ VCLEFT_a429_seatSwitchForward m429 : 50|2@1+ (1,0) [0|3] "" Vector__XXX
 SG_ VCLEFT_a429_cabinTmp m429 : 52|12@1- (0.1,0) [-204.8|204.7] "" Vector__XXX
 SG_ VCLEFT_a430_leftRearDomeLightPow m430 : 16|1@1+ (1,0) [0|1] "" Vector__XXX
 SG_ VCLEFT_a430_rightRearDomeLightPo m430 : 17|1@1+ (1,0) [0|1] "" Vector__XXX
 SG_ VCLEFT_a431_dcdcVoltageFailure m431 : 16|1@1+ (1,0) [0|1] "" Vector__XXX
 SG_ VCLEFT_a431_overVoltageDetected m431 : 17|1@1+ (1,0) [0|1] "" Vector__XXX
 SG_ VCLEFT_a431_underVoltageDetected m431 : 18|1@1+ (1,0) [0|1] "" Vector__XXX
 SG_ VCLEFT_a431_brownoutDetected m431 : 19|1@1+ (1,0) [0|1] "" Vector__XXX
 SG_ VCLEFT_a444_retriesAvailable m444 : 16|8@1+ (1,0) [0|255] "" Vector__XXX
 SG_ VCLEFT_a444_channel m444 : 24|8@1+ (1,0) [0|255] "" Vector__XXX
 SG_ VCLEFT_a444_watchdog m444 : 32|1@1+ (1,0) [0|1] "" Vector__XXX
 SG_ VCLEFT_a444_gateDriver m444 : 33|1@1+ (1,0) [0|1] "" Vector__XXX
 SG_ VCLEFT_a444_overcurrent m444 : 34|1@1+ (1,0) [0|1] "" Vector__XXX
 SG_ VCLEFT_a444_supplyUndervoltage m444 : 35|1@1+ (1,0) [0|1] "" Vector__XXX
 SG_ VCLEFT_a444_cpUndervoltage m444 : 36|1@1+ (1,0) [0|1] "" Vector__XXX
 SG_ VCLEFT_a444_overTempShutdown m444 : 37|1@1+ (1,0) [0|1] "" Vector__XXX
 SG_ VCLEFT_a444_overTempWarning m444 : 38|1@1+ (1,0) [0|1] "" Vector__XXX
 SG_ VCLEFT_a444_highSide2GateDriver m444 : 39|1@1+ (1,0) [0|1] "" Vector__XXX
 SG_ VCLEFT_a444_lowSide2GateDriver m444 : 40|1@1+ (1,0) [0|1] "" Vector__XXX
 SG_ VCLEFT_a444_highSide1GateDriver m444 : 41|1@1+ (1,0) [0|1] "" Vector__XXX
 SG_ VCLEFT_a444_lowSide1GateDriver m444 : 42|1@1+ (1,0) [0|1] "" Vector__XXX
 SG_ VCLEFT_a444_highSide2OverCurent m444 : 43|1@1+ (1,0) [0|1] "" Vector__XXX
 SG_ VCLEFT_a444_lowSide2OverCurent m444 : 44|1@1+ (1,0) [0|1] "" Vector__XXX
 SG_ VCLEFT_a444_highSide1OverCurent m444 : 45|1@1+ (1,0) [0|1] "" Vector__XXX
 SG_ VCLEFT_a444_lowSide1OverCurent m444 : 46|1@1+ (1,0) [0|1] "" Vector__XXX
 SG_ VCLEFT_a444_spiInit m444 : 47|1@1+ (1,0) [0|1] "" Vector__XXX
 SG_ VCLEFT_a444_spiPeriodicCheck m444 : 48|1@1+ (1,0) [0|1] "" Vector__XXX
 SG_ VCLEFT_a444_spiFault m444 : 49|1@1+ (1,0) [0|1] "" Vector__XXX
 SG_ VCLEFT_a444_voltageMonitor m444 : 50|1@1+ (1,0) [0|1] "" Vector__XXX
 SG_ VCLEFT_a444_enableLow m444 : 51|1@1+ (1,0) [0|1] "" Vector__XXX
 SG_ VCLEFT_a447_endstopPositionMM m447 : 16|16@1- (0.01,0) [-327.68|327.67] "" Vector__XXX
 SG_ VCLEFT_a447_motorType m447 : 32|2@1+ (1,0) [0|3] "" Vector__XXX
 SG_ VCLEFT_a448_endstopPositionMM m448 : 16|16@1- (0.01,0) [-327.68|327.67] "" Vector__XXX
 SG_ VCLEFT_a448_motorType m448 : 32|2@1+ (1,0) [0|3] "" Vector__XXX
 SG_ VCLEFT_a453_liftgatePosition m453 : 16|7@1- (1,43) [-21|106] "" Vector__XXX
 SG_ VCLEFT_a455_liftgateState m455 : 16|4@1+ (1,0) [0|15] "" Vector__XXX
 SG_ VCLEFT_a466_hvac2RLeftAirwaveVer m466 : 16|1@1+ (1,0) [0|1] "" Vector__XXX
 SG_ VCLEFT_a469_hvac2RLeftAirwaveLat m469 : 16|1@1+ (1,0) [0|1] "" Vector__XXX
 SG_ VCLEFT_a472_hvac2RRightAirwaveVe m472 : 16|1@1+ (1,0) [0|1] "" Vector__XXX
 SG_ VCLEFT_a475_hvac2RRightAirwaveLa m475 : 16|1@1+ (1,0) [0|1] "" Vector__XXX
 SG_ VCLEFT_a480_reset m480 : 16|1@1+ (1,0) [0|1] "" Vector__XXX
 SG_ VCLEFT_a480_spiError m480 : 17|1@1+ (1,0) [0|1] "" Vector__XXX
 SG_ VCLEFT_a480_autoOn m480 : 18|1@1+ (1,0) [0|1] "" Vector__XXX
 SG_ VCLEFT_a480_diagnosticBit m480 : 19|1@1+ (1,0) [0|1] "" Vector__XXX
 SG_ VCLEFT_a480_deviceError m480 : 20|1@1+ (1,0) [0|1] "" Vector__XXX
 SG_ VCLEFT_a480_overcurrent m480 : 21|1@1+ (1,0) [0|1] "" Vector__XXX
 SG_ VCLEFT_a480_unexpectedLock m480 : 22|1@1+ (1,0) [0|1] "" Vector__XXX
 SG_ VCLEFT_a480_disableOutputFault m480 : 23|1@1+ (1,0) [0|1] "" Vector__XXX
 SG_ VCLEFT_a480_vsUndervoltage m480 : 24|1@1+ (1,0) [0|1] "" Vector__XXX
 SG_ VCLEFT_a480_hardShort m480 : 25|1@1+ (1,0) [0|1] "" Vector__XXX
 SG_ VCLEFT_a480_vdsMax m480 : 26|1@1+ (1,0) [0|1] "" Vector__XXX
 SG_ VCLEFT_a480_bypassSaturation m480 : 27|1@1+ (1,0) [0|1] "" Vector__XXX
 SG_ VCLEFT_a480_fuseLatch m480 : 28|1@1+ (1,0) [0|1] "" Vector__XXX
 SG_ VCLEFT_a480_deviceOvertemperatur m480 : 29|1@1+ (1,0) [0|1] "" Vector__XXX
 SG_ VCLEFT_a480_ntcOvertemperature m480 : 30|1@1+ (1,0) [0|1] "" Vector__XXX
 SG_ VCLEFT_a480_vgsLow m480 : 31|1@1+ (1,0) [0|1] "" Vector__XXX
 SG_ VCLEFT_a480_chargePumpLow m480 : 32|1@1+ (1,0) [0|1] "" Vector__XXX
 SG_ VCLEFT_a480_watchdog m480 : 33|1@1+ (1,0) [0|1] "" Vector__XXX
 SG_ VCLEFT_a480_spiNotDone m480 : 34|1@1+ (1,0) [0|1] "" Vector__XXX
 SG_ VCLEFT_a480_configIncorrect m480 : 35|1@1+ (1,0) [0|1] "" Vector__XXX
 SG_ VCLEFT_a480_bufferFull m480 : 36|1@1+ (1,0) [0|1] "" Vector__XXX
 SG_ VCLEFT_a480_hitAlertRateLimit m480 : 37|1@1+ (1,0) [0|1] "" Vector__XXX
 SG_ VCLEFT_a480_hwlo m480 : 38|1@1+ (1,0) [0|1] "" Vector__XXX
 SG_ VCLEFT_a480_enable m480 : 39|1@1+ (1,0) [0|1] "" Vector__XXX
 SG_ VCLEFT_a482_channel m482 : 16|6@1+ (1,0) [0|63] "" Vector__XXX
 SG_ VCLEFT_a482_spiFault m482 : 22|1@1+ (1,0) [0|1] "" Vector__XXX
 SG_ VCLEFT_a482_resetBar m482 : 23|1@1+ (1,0) [0|1] "" Vector__XXX
 SG_ VCLEFT_a482_overTempShutdown m482 : 24|1@1+ (1,0) [0|1] "" Vector__XXX
 SG_ VCLEFT_a482_thermalWarning m482 : 25|1@1+ (1,0) [0|1] "" Vector__XXX
 SG_ VCLEFT_a482_underOrOverVoltageOr m482 : 26|1@1+ (1,0) [0|1] "" Vector__XXX
 SG_ VCLEFT_a482_underloadDetected m482 : 27|1@1+ (1,0) [0|1] "" Vector__XXX
 SG_ VCLEFT_a485_seat2RControllerUnat m485 : 16|1@1+ (1,0) [0|1] "" Vector__XXX
 SG_ VCLEFT_a485_auxSocketRearUnattem m485 : 17|1@1+ (1,0) [0|1] "" Vector__XXX
 SG_ VCLEFT_a485_seat2RAllHeatersUnat m485 : 18|1@1+ (1,0) [0|1] "" Vector__XXX
 SG_ VCLEFT_a485_trailerLightEcuUnatt m485 : 19|1@1+ (1,0) [0|1] "" Vector__XXX
 SG_ VCLEFT_a485_accessoryFeed3Unatte m485 : 20|1@1+ (1,0) [0|1] "" Vector__XXX
 SG_ VCLEFT_a485_vbatProtFusedSeatUna m485 : 21|1@1+ (1,0) [0|1] "" Vector__XXX
 SG_ VCLEFT_a485_usbPortsUnattemptedO m485 : 22|1@1+ (1,0) [0|1] "" Vector__XXX
 SG_ VCLEFT_a485_auxSocketFrontUnatte m485 : 23|1@1+ (1,0) [0|1] "" Vector__XXX
 SG_ VCLEFT_a485_lumbarEcuUnattempted m485 : 24|1@1+ (1,0) [0|1] "" Vector__XXX
 SG_ VCLEFT_a485_ambientRgbRightUnatt m485 : 25|1@1+ (1,0) [0|1] "" Vector__XXX
 SG_ VCLEFT_a485_ambientRgbMiddleUnat m485 : 26|1@1+ (1,0) [0|1] "" Vector__XXX
 SG_ VCLEFT_a485_ambientRgbLeftUnatte m485 : 27|1@1+ (1,0) [0|1] "" Vector__XXX
 SG_ VCLEFT_a485_door1rRgbUnattempted m485 : 28|1@1+ (1,0) [0|1] "" Vector__XXX
 SG_ VCLEFT_a485_door2rRgbUnattempted m485 : 29|1@1+ (1,0) [0|1] "" Vector__XXX
 SG_ VCLEFT_a485_seat1rVentFanBackres m485 : 30|1@1+ (1,0) [0|1] "" Vector__XXX
 SG_ VCLEFT_a485_seat1rVentFanCushion m485 : 31|1@1+ (1,0) [0|1] "" Vector__XXX
 SG_ VCLEFT_a485_trailerBrakeEcuUnatt m485 : 32|1@1+ (1,0) [0|1] "" Vector__XXX
 SG_ VCLEFT_a485_trailerAuxUnattempte m485 : 33|1@1+ (1,0) [0|1] "" Vector__XXX
 SG_ VCLEFT_a485_vbatFusedUnattempted m485 : 34|1@1+ (1,0) [0|1] "" Vector__XXX
 SG_ VCLEFT_a489_seat2RControllerStuc m489 : 16|1@1+ (1,0) [0|1] "" Vector__XXX
 SG_ VCLEFT_a489_auxSocketRearStuckOn m489 : 17|1@1+ (1,0) [0|1] "" Vector__XXX
 SG_ VCLEFT_a489_seat2RAllHeatersStuc m489 : 18|1@1+ (1,0) [0|1] "" Vector__XXX
 SG_ VCLEFT_a489_trailerLightEcuStuck m489 : 19|1@1+ (1,0) [0|1] "" Vector__XXX
 SG_ VCLEFT_a489_accessoryFeed3StuckO m489 : 20|1@1+ (1,0) [0|1] "" Vector__XXX
 SG_ VCLEFT_a489_vbatProtFusedSeatStu m489 : 21|1@1+ (1,0) [0|1] "" Vector__XXX
 SG_ VCLEFT_a489_usbPortsStuckOn m489 : 22|1@1+ (1,0) [0|1] "" Vector__XXX
 SG_ VCLEFT_a489_auxSocketFrontStuckO m489 : 23|1@1+ (1,0) [0|1] "" Vector__XXX
 SG_ VCLEFT_a489_lumbarEcuStuckOn m489 : 24|1@1+ (1,0) [0|1] "" Vector__XXX
 SG_ VCLEFT_a489_ambientRgbRightStuck m489 : 25|1@1+ (1,0) [0|1] "" Vector__XXX
 SG_ VCLEFT_a489_ambientRgbMiddleStuc m489 : 26|1@1+ (1,0) [0|1] "" Vector__XXX
 SG_ VCLEFT_a489_ambientRgbLeftStuckO m489 : 27|1@1+ (1,0) [0|1] "" Vector__XXX
 SG_ VCLEFT_a489_door1rRgbStuckOn m489 : 28|1@1+ (1,0) [0|1] "" Vector__XXX
 SG_ VCLEFT_a489_door2rRgbStuckOn m489 : 29|1@1+ (1,0) [0|1] "" Vector__XXX
 SG_ VCLEFT_a489_seat1rVentFanBackres m489 : 30|1@1+ (1,0) [0|1] "" Vector__XXX
 SG_ VCLEFT_a489_seat1rVentFanCushion m489 : 31|1@1+ (1,0) [0|1] "" Vector__XXX
 SG_ VCLEFT_a489_trailerBrakeEcuStuck m489 : 32|1@1+ (1,0) [0|1] "" Vector__XXX
 SG_ VCLEFT_a489_trailerAuxStuckOn m489 : 33|1@1+ (1,0) [0|1] "" Vector__XXX
 SG_ VCLEFT_a489_vbatFusedStuckOn m489 : 34|1@1+ (1,0) [0|1] "" Vector__XXX
 SG_ VCLEFT_a489_vbatProtVoltage m489 : 35|9@1+ (0.0391389429569,0) [0|19.999999851] "" Vector__XXX
 SG_ VCLEFT_a489_loadshedCommonBusVol m489 : 44|9@1+ (0.0391389429569,0) [0|19.999999851] "" Vector__XXX
 SG_ VCLEFT_a489_loadshedCommonBusMon m489 : 56|7@1+ (1,0) [0|127] "" Vector__XXX
 SG_ VCLEFT_a493_12vSocketFrontEFuseC m493 : 16|9@1+ (0.1,0) [0|51.1] "" Vector__XXX
 SG_ VCLEFT_a494_12vSocketRearEFuseCu m494 : 16|9@1+ (0.1,0) [0|51.1] "" Vector__XXX
 SG_ VCLEFT_a497_ecuUnprovisioned m497 : 16|1@1+ (1,0) [0|1] "" Vector__XXX
 SG_ VCLEFT_a500_channel m500 : 16|8@1+ (1,0) [0|255] "" Vector__XXX
 SG_ VCLEFT_a500_mismatchedState m500 : 24|3@1+ (1,0) [0|7] "" Vector__XXX
 SG_ VCLEFT_a510_isRearwardEndstopUnc m510 : 16|1@1+ (1,0) [0|1] "" Vector__XXX
 SG_ VCLEFT_a510_isAbsPosSensorUncali m510 : 17|1@1+ (1,0) [0|1] "" Vector__XXX
 SG_ VCLEFT_a510_seatState m510 : 18|4@1+ (1,0) [0|15] "" Vector__XXX
 SG_ VCLEFT_a510_motorType m510 : 22|1@1+ (1,0) [0|1] "" Vector__XXX
 SG_ VCLEFT_a510_absPosSensState m510 : 24|2@1+ (1,0) [0|3] "" Vector__XXX
 SG_ VCLEFT_a513_calibrated m513 : 16|1@1+ (1,0) [0|1] "" Vector__XXX
 SG_ VCLEFT_a513_angle m513 : 17|8@1- (0.5,59) [-5|122.5] "" Vector__XXX
 SG_ VCLEFT_a513_seatStatePrev m513 : 25|4@1+ (1,0) [0|15] "" Vector__XXX
 SG_ VCLEFT_a513_obstacleDetectReason m513 : 29|4@1+ (1,0) [0|15] "" Vector__XXX
 SG_ VCLEFT_a513_accelLookbackTripDep m513 : 33|7@1+ (1,0) [0|127] "" Vector__XXX
 SG_ VCLEFT_a513_duty m513 : 40|8@1- (1,0) [-128|127] "" Vector__XXX
 SG_ VCLEFT_a513_currentAbsFilt m513 : 48|8@1+ (0.25,0) [0|63.75] "" Vector__XXX
 SG_ VCLEFT_a513_motorType m513 : 56|1@1+ (1,0) [0|1] "" Vector__XXX
 SG_ VCLEFT_a513_absolutePosSensorFor m513 : 57|1@1+ (1,0) [0|1] "" Vector__XXX
 SG_ VCLEFT_a513_cabinTemp m513 : 58|6@1- (2,20) [-44|82] "" Vector__XXX
 SG_ VCLEFT_a517_isRearwardEndstopUnc m517 : 16|1@1+ (1,0) [0|1] "" Vector__XXX
 SG_ VCLEFT_a517_isAbsPosSensorUncali m517 : 17|1@1+ (1,0) [0|1] "" Vector__XXX
 SG_ VCLEFT_a518_seatState m518 : 16|4@1+ (1,0) [0|15] "" Vector__XXX
 SG_ VCLEFT_a520_epbConfig m520 : 16|4@1+ (1,0) [0|15] "" Vector__XXX
 SG_ VCLEFT_a520_gtwEpbConfig m520 : 20|4@1+ (1,0) [0|15] "" Vector__XXX
 SG_ VCLEFT_a523_channel m523 : 16|8@1+ (1,0) [0|255] "" Vector__XXX
 SG_ VCLEFT_a523_control2Byte1 m523 : 24|8@1+ (1,0) [0|255] "" Vector__XXX
 SG_ VCLEFT_a523_control2Byte2 m523 : 32|8@1+ (1,0) [0|255] "" Vector__XXX
 SG_ VCLEFT_a523_control2Byte3 m523 : 40|8@1+ (1,0) [0|255] "" Vector__XXX
 SG_ VCLEFT_a523_control3Byte2 m523 : 48|8@1+ (1,0) [0|255] "" Vector__XXX
 SG_ VCLEFT_a523_control3Byte3 m523 : 56|8@1+ (1,0) [0|255] "" Vector__XXX
 SG_ VCLEFT_a525_GTW_twelveVBatteryTy m525 : 16|3@1+ (1,0) [0|7] "" Vector__XXX
 SG_ VCLEFT_a525_newLVBatteryType m525 : 19|3@1+ (1,0) [0|7] "" Vector__XXX
 SG_ VCLEFT_a525_initialLVBatteryType m525 : 24|3@1+ (1,0) [0|7] "" Vector__XXX
 SG_ VCLEFT_a525_serviceMode m525 : 27|1@1+ (1,0) [0|1] "" Vector__XXX
 SG_ VCLEFT_a525_factoryGated m525 : 28|1@1+ (1,0) [0|1] "" Vector__XXX
 SG_ VCLEFT_a525_frunkOpen m525 : 29|1@1+ (1,0) [0|1] "" Vector__XXX
 SG_ VCLEFT_a536_trunkFoldFlatSwitchS m536 : 16|2@1+ (1,0) [0|3] "" Vector__XXX
 SG_ VCLEFT_a536_trunkFoldFlatLeftSwi m536 : 18|10@1+ (0.00488758552819,0) [0|4.99999999534] "" Vector__XXX
 SG_ VCLEFT_a545_GTW_twelveVBatteryTy m545 : 16|3@1+ (1,0) [0|7] "" Vector__XXX
 SG_ VCLEFT_a545_newLVBatteryType m545 : 19|3@1+ (1,0) [0|7] "" Vector__XXX
 SG_ VCLEFT_a545_serviceMode m545 : 22|1@1+ (1,0) [0|1] "" Vector__XXX
 SG_ VCLEFT_a545_factoryGated m545 : 23|1@1+ (1,0) [0|1] "" Vector__XXX
 SG_ VCLEFT_a545_frunkOpen m545 : 24|1@1+ (1,0) [0|1] "" Vector__XXX
 SG_ VCLEFT_a551_restrictDoorReleaseS m551 : 16|1@1+ (1,0) [0|1] "" Vector__XXX
 SG_ VCLEFT_a551_interiorReleaseReqCo m551 : 24|8@1+ (1,0) [0|255] "" Vector__XXX
 SG_ VCLEFT_a551_lastRequestSourceFro m551 : 32|3@1+ (1,0) [0|7] "" Vector__XXX
 SG_ VCLEFT_a551_restrictDoorRel_0001 m551 : 35|1@1+ (1,0) [0|1] "" Vector__XXX
 SG_ VCLEFT_a551_interiorRelease_0001 m551 : 40|8@1+ (1,0) [0|255] "" Vector__XXX
 SG_ VCLEFT_a551_lastRequestSourceRea m551 : 48|3@1+ (1,0) [0|7] "" Vector__XXX
 SG_ VCLEFT_a555_heaterPWMCommand m555 : 16|8@1+ (1,0) [0|255] "" Vector__XXX
 SG_ VCLEFT_a555_ntcTemperature m555 : 24|8@1+ (1,0) [0|255] "" Vector__XXX
 SG_ VCLEFT_a560_isRearwardEndstopUnc m560 : 16|1@1+ (1,0) [0|1] "" Vector__XXX
 SG_ VCLEFT_a560_isAbsPosSensorUncali m560 : 17|1@1+ (1,0) [0|1] "" Vector__XXX
 SG_ VCLEFT_a560_seatState m560 : 18|4@1+ (1,0) [0|15] "" Vector__XXX
 SG_ VCLEFT_a560_motorType m560 : 22|1@1+ (1,0) [0|1] "" Vector__XXX
 SG_ VCLEFT_a560_absPosSensState m560 : 24|2@1+ (1,0) [0|3] "" Vector__XXX
 SG_ VCLEFT_a563_calibrated m563 : 16|1@1+ (1,0) [0|1] "" Vector__XXX
 SG_ VCLEFT_a563_angle m563 : 17|8@1- (0.5,59) [-5|122.5] "" Vector__XXX
 SG_ VCLEFT_a563_seatStatePrev m563 : 25|4@1+ (1,0) [0|15] "" Vector__XXX
 SG_ VCLEFT_a563_obstacleDetectReason m563 : 29|4@1+ (1,0) [0|15] "" Vector__XXX
 SG_ VCLEFT_a563_accelLookbackTripDep m563 : 33|7@1+ (1,0) [0|127] "" Vector__XXX
 SG_ VCLEFT_a563_duty m563 : 40|8@1- (1,0) [-128|127] "" Vector__XXX
 SG_ VCLEFT_a563_currentAbsFilt m563 : 48|8@1+ (0.25,0) [0|63.75] "" Vector__XXX
 SG_ VCLEFT_a563_motorType m563 : 56|1@1+ (1,0) [0|1] "" Vector__XXX
 SG_ VCLEFT_a563_absolutePosSensorFor m563 : 57|1@1+ (1,0) [0|1] "" Vector__XXX
 SG_ VCLEFT_a563_cabinTemp m563 : 58|6@1- (2,20) [-44|82] "" Vector__XXX
 SG_ VCLEFT_a567_isRearwardEndstopUnc m567 : 16|1@1+ (1,0) [0|1] "" Vector__XXX
 SG_ VCLEFT_a567_isAbsPosSensorUncali m567 : 17|1@1+ (1,0) [0|1] "" Vector__XXX
 SG_ VCLEFT_a568_seatState m568 : 16|4@1+ (1,0) [0|15] "" Vector__XXX
 SG_ VCLEFT_a570_seatHeatCurrent m570 : 16|12@1+ (0.01,0) [0|40.95] "" Vector__XXX
 SG_ VCLEFT_a570_seatHeatTmp m570 : 28|12@1- (0.05,0) [-102.4|102.35] "" Vector__XXX
 SG_ VCLEFT_a571_seatHeatCurrent m571 : 16|12@1+ (0.01,0) [0|40.95] "" Vector__XXX
 SG_ VCLEFT_a571_seatHeatTmp m571 : 28|12@1- (0.05,0) [-102.4|102.35] "" Vector__XXX
 SG_ VCLEFT_a572_seatHeatCurrent m572 : 16|12@1+ (0.01,0) [0|40.95] "" Vector__XXX
 SG_ VCLEFT_a572_seatHeatTmp m572 : 28|12@1- (0.05,0) [-102.4|102.35] "" Vector__XXX
 SG_ VCLEFT_a573_seatHeatCurrent m573 : 16|12@1+ (0.01,0) [0|40.95] "" Vector__XXX
 SG_ VCLEFT_a573_seatHeatTmp m573 : 28|12@1- (0.05,0) [-102.4|102.35] "" Vector__XXX
 SG_ VCLEFT_a577_outputFaulted m577 : 16|1@1+ (1,0) [0|1] "" Vector__XXX
 SG_ VCLEFT_a577_currentSenseFaulted m577 : 17|1@1+ (1,0) [0|1] "" Vector__XXX
 SG_ VCLEFT_a577_tempSenseFaulted m577 : 18|1@1+ (1,0) [0|1] "" Vector__XXX
 SG_ VCLEFT_a577_underCurrent m577 : 19|1@1+ (1,0) [0|1] "" Vector__XXX
 SG_ VCLEFT_a577_overCurrent m577 : 20|1@1+ (1,0) [0|1] "" Vector__XXX
 SG_ VCLEFT_a577_overTemperature m577 : 21|1@1+ (1,0) [0|1] "" Vector__XXX
 SG_ VCLEFT_a578_openCircuitDashFL m578 : 16|1@1+ (1,0) [0|1] "" Vector__XXX
 SG_ VCLEFT_a578_shortCircuitDashFL m578 : 17|1@1+ (1,0) [0|1] "" Vector__XXX
 SG_ VCLEFT_a578_miaDashFL m578 : 18|1@1+ (1,0) [0|1] "" Vector__XXX
 SG_ VCLEFT_a578_openCircuitDashFR m578 : 19|1@1+ (1,0) [0|1] "" Vector__XXX
 SG_ VCLEFT_a578_shortCircuitDashFR m578 : 20|1@1+ (1,0) [0|1] "" Vector__XXX
 SG_ VCLEFT_a578_miaDashFR m578 : 21|1@1+ (1,0) [0|1] "" Vector__XXX
 SG_ VCLEFT_a578_openCircuitDoorFL m578 : 22|1@1+ (1,0) [0|1] "" Vector__XXX
 SG_ VCLEFT_a578_shortCircuitDoorFL m578 : 23|1@1+ (1,0) [0|1] "" Vector__XXX
 SG_ VCLEFT_a578_miaDoorFL m578 : 24|1@1+ (1,0) [0|1] "" Vector__XXX
 SG_ VCLEFT_a578_openCircuitDoorRL m578 : 25|1@1+ (1,0) [0|1] "" Vector__XXX
 SG_ VCLEFT_a578_shortCircuitDoorRL m578 : 26|1@1+ (1,0) [0|1] "" Vector__XXX
 SG_ VCLEFT_a578_miaDoorRL m578 : 27|1@1+ (1,0) [0|1] "" Vector__XXX
 SG_ VCLEFT_a579_gtwConfigType m579 : 16|3@1+ (1,0) [0|7] "" Vector__XXX
 SG_ VCLEFT_a579_installedHwid m579 : 24|32@1+ (1,0) [0|4294967295] "" Vector__XXX
 SG_ VCLEFT_a580_gtwConfigType m580 : 16|3@1+ (1,0) [0|7] "" Vector__XXX
 SG_ VCLEFT_a580_installedHwid m580 : 24|32@1+ (1,0) [0|4294967295] "" Vector__XXX
 SG_ VCLEFT_a581_outputFaulted m581 : 16|1@1+ (1,0) [0|1] "" Vector__XXX
 SG_ VCLEFT_a581_currentSenseFaulted m581 : 17|1@1+ (1,0) [0|1] "" Vector__XXX
 SG_ VCLEFT_a581_tempSenseFaulted m581 : 18|1@1+ (1,0) [0|1] "" Vector__XXX
 SG_ VCLEFT_a581_underCurrent m581 : 19|1@1+ (1,0) [0|1] "" Vector__XXX
 SG_ VCLEFT_a581_overCurrent m581 : 20|1@1+ (1,0) [0|1] "" Vector__XXX
 SG_ VCLEFT_a581_overTemperature m581 : 21|1@1+ (1,0) [0|1] "" Vector__XXX
 SG_ VCLEFT_a582_outputCurrent m582 : 16|10@1+ (0.1,0) [0|102.3] "" Vector__XXX
 SG_ VCLEFT_a585_ambientTemp m585 : 16|8@1+ (0.5,-40) [-40|87.5] "" Vector__XXX
 SG_ VCLEFT_a586_ambientTemp m586 : 16|8@1+ (0.5,-40) [-40|87.5] "" Vector__XXX
 SG_ VCLEFT_a587_VEH_seatStatus2 m587 : 62|1@1+ (1,0) [0|1] "" Vector__XXX
 SG_ VCLEFT_a587_VEH_switchStatus m587 : 63|1@1+ (1,0) [0|1] "" Vector__XXX
 SG_ VCLEFT_a590_seatMotorCalibrated m590 : 16|1@1+ (1,0) [0|1] "" Vector__XXX
 SG_ VCLEFT_a590_seatMotorCurrent m590 : 17|12@1- (0.01,0) [-20.48|20.47] "" Vector__XXX
 SG_ VCLEFT_a590_seatMotorState m590 : 29|3@1+ (1,0) [0|7] "" Vector__XXX
 SG_ VCLEFT_a590_seatSwitchBack m590 : 32|2@1+ (1,0) [0|3] "" Vector__XXX
 SG_ VCLEFT_a590_seatSwitchForward m590 : 34|2@1+ (1,0) [0|3] "" Vector__XXX
 SG_ VCLEFT_a591_seatMotorCurrent m591 : 16|12@1- (0.01,0) [-20.48|20.47] "" Vector__XXX
 SG_ VCLEFT_a591_seatMotorPosReal m591 : 28|12@1- (1,0) [-2048|2047] "" Vector__XXX
 SG_ VCLEFT_a591_seatMotorState m591 : 40|3@1+ (1,0) [0|7] "" Vector__XXX
 SG_ VCLEFT_a591_seatSwitchBack m591 : 43|2@1+ (1,0) [0|3] "" Vector__XXX
 SG_ VCLEFT_a591_seatSwitchForward m591 : 45|2@1+ (1,0) [0|3] "" Vector__XXX
 SG_ VCLEFT_a592_seatMotorCurrent m592 : 16|12@1- (0.01,0) [-20.48|20.47] "" Vector__XXX
 SG_ VCLEFT_a592_seatMotorPosReal m592 : 28|12@1- (1,0) [-2048|2047] "" Vector__XXX
 SG_ VCLEFT_a592_seatMotorState m592 : 40|3@1+ (1,0) [0|7] "" Vector__XXX
 SG_ VCLEFT_a592_seatSwitchBack m592 : 43|2@1+ (1,0) [0|3] "" Vector__XXX
 SG_ VCLEFT_a592_seatSwitchForward m592 : 45|2@1+ (1,0) [0|3] "" Vector__XXX
 SG_ VCLEFT_a593_seatMotorCalibrated m593 : 16|1@1+ (1,0) [0|1] "" Vector__XXX
 SG_ VCLEFT_a593_seatMotorCurrent m593 : 17|12@1- (0.01,0) [-20.48|20.47] "" Vector__XXX
 SG_ VCLEFT_a593_seatMotorPosReal m593 : 32|12@1- (1,0) [-2048|2047] "" Vector__XXX
 SG_ VCLEFT_a593_seatMotorState m593 : 44|3@1+ (1,0) [0|7] "" Vector__XXX
 SG_ VCLEFT_a593_seatSwitchBack m593 : 48|2@1+ (1,0) [0|3] "" Vector__XXX
 SG_ VCLEFT_a593_seatSwitchForward m593 : 50|2@1+ (1,0) [0|3] "" Vector__XXX
 SG_ VCLEFT_a594_seatMotorCurrent m594 : 16|12@1- (0.01,0) [-20.48|20.47] "" Vector__XXX
 SG_ VCLEFT_a594_seatMotorDCurrent m594 : 28|12@1- (0.01,0) [-20.48|20.47] "" Vector__XXX
 SG_ VCLEFT_a594_seatMotorPosReal m594 : 40|12@1- (1,0) [-2048|2047] "" Vector__XXX
 SG_ VCLEFT_a594_seatMotorState m594 : 52|3@1+ (1,0) [0|7] "" Vector__XXX
 SG_ VCLEFT_a595_seatMotorCurrent m595 : 16|12@1- (0.01,0) [-20.48|20.47] "" Vector__XXX
 SG_ VCLEFT_a595_seatMotorDCurrent m595 : 28|12@1- (0.01,0) [-20.48|20.47] "" Vector__XXX
 SG_ VCLEFT_a595_seatMotorPosReal m595 : 40|12@1- (1,0) [-2048|2047] "" Vector__XXX
 SG_ VCLEFT_a595_seatMotorState m595 : 52|3@1+ (1,0) [0|7] "" Vector__XXX
 SG_ VCLEFT_a596_frontDoorLatchAjarSw m596 : 16|12@1+ (1.25,0) [0|5118.75] "" Vector__XXX
 SG_ VCLEFT_a597_rearDoorLatchAjarSwi m597 : 16|12@1+ (1.25,0) [0|5118.75] "" Vector__XXX
 SG_ VCLEFT_a599_GTW_twelveVBatteryTy m599 : 16|3@1+ (1,0) [0|7] "" Vector__XXX
 SG_ VCLEFT_a599_newLVBatteryType m599 : 19|3@1+ (1,0) [0|7] "" Vector__XXX
 SG_ VCLEFT_a599_initialLVBatteryType m599 : 24|3@1+ (1,0) [0|7] "" Vector__XXX
 SG_ VCLEFT_a599_serviceMode m599 : 27|1@1+ (1,0) [0|1] "" Vector__XXX
 SG_ VCLEFT_a599_factoryGated m599 : 28|1@1+ (1,0) [0|1] "" Vector__XXX
 SG_ VCLEFT_a599_frunkOpen m599 : 29|1@1+ (1,0) [0|1] "" Vector__XXX
 SG_ VCLEFT_a605_excessiveMacFailures m605 : 16|1@1+ (1,0) [0|1] "" Vector__XXX

CM_ SG_ 2013 VCLEFT_a120_PARTY_status "Left body controller: a120 PARTY status";
CM_ SG_ 2013 VCLEFT_a120_PT_speed "Left body controller: a120 PT speed";
CM_ SG_ 2013 VCLEFT_a120_PT_systemStatus "Left body controller: a120 PT system status";
CM_ SG_ 2013 VCLEFT_a120_PARTY_vehicleEstimat "Left body controller: a120 PARTY vehicle estimates";
CM_ SG_ 2013 VCLEFT_a120_VEH_aggregatedAxleSp "Left body controller: a120 VEH aggregated axle speed";
CM_ SG_ 2013 VCLEFT_a120_PARTY_aggregatedAxle "Left body controller: a120 PARTY aggregated axle speed";
CM_ SG_ 2013 VCLEFT_a120_VEH_systemPower "Left body controller: a120 VEH system power";
CM_ SG_ 2013 VCLEFT_a120_PARTY_autonomyHealth "Left body controller: a120 PARTY autonomy health";
CM_ SG_ 2013 VCLEFT_a120_VEH_autonomyHealth "Left body controller: a120 VEH autonomy health";
CM_ SG_ 2013 VCLEFT_a120_PT_systemPower "Left body controller: a120 PT system power";
CM_ SG_ 2013 VCLEFT_a120_PARTY_stalklessInter "Left body controller: a120 PARTY stalkless interfaces";
CM_ SG_ 2013 VCLEFT_a120_CH_speed "Left body controller: a120 CH speed";
CM_ SG_ 2013 VCLEFT_a120_VEH_estimatedBrakeTe "Left body controller: a120 VEH estimated brake temp";
CM_ SG_ 2013 VCLEFT_a120_PARTY_prndControl "Left body controller: a120 PARTY prnd control";
CM_ SG_ 2013 VCLEFT_a120_PARTY_locStatus2 "Left body controller: a120 PARTY loc status2";
CM_ SG_ 2013 VCLEFT_a120_VEH_chassisCntl "Left body controller: a120 VEH chassis cntl";
CM_ SG_ 2013 VCLEFT_a120_CH_locStatus2 "Left body controller: a120 CH loc status2";
CM_ SG_ 2013 VCLEFT_a120_VEH_locStatus "Left body controller: a120 VEH loc status";
CM_ SG_ 2013 VCLEFT_a120_VEH_locStatus2 "Left body controller: a120 VEH loc status2";
CM_ SG_ 2013 VCLEFT_a120_VEH_prndControl "Left body controller: a120 VEH prnd control";
CM_ SG_ 2013 VCLEFT_a120_VEH_vehicleEstimates "Left body controller: a120 VEH vehicle estimates";
CM_ SG_ 2013 VCLEFT_a120_PARTY_motorStatus "Left body controller: a120 PARTY motor status";
CM_ SG_ 2013 VCLEFT_a120_VEH_motorStatus "Left body controller: a120 VEH motor status";
CM_ SG_ 2013 VCLEFT_a120_BDY_speed "Left body controller: a120 BDY speed";
CM_ SG_ 2013 VCLEFT_a121_OBD_status "Left body controller: a121 OBD status";
CM_ SG_ 2013 VCLEFT_a123_OBD_alcoholInterlock "Left body controller: a123 OBD alcohol interlock request";
CM_ SG_ 2013 VCLEFT_a124_PARTY_status "Left body controller: a124 PARTY status";
CM_ SG_ 2013 VCLEFT_a124_BDY_status "Left body controller: a124 BDY status";
CM_ SG_ 2013 VCLEFT_a124_VEH_status "Left body controller: a124 VEH status";
CM_ SG_ 2013 VCLEFT_a125_PARTY_actuation "Left body controller: a125 PARTY actuation";
CM_ SG_ 2013 VCLEFT_a125_BDY_actuation "Left body controller: a125 BDY actuation";
CM_ SG_ 2013 VCLEFT_a125_PARTY_status "Left body controller: a125 PARTY status";
CM_ SG_ 2013 VCLEFT_a125_BDY_status "Left body controller: a125 BDY status";
CM_ SG_ 2013 VCLEFT_a129_overCurrentError "Left body controller: a129 over current error";
CM_ SG_ 2013 VCLEFT_a129_fetShortCircuit "Left body controller: a129 fet short circuit";
CM_ SG_ 2013 VCLEFT_a129_lockedRotor "Left body controller: a129 locked rotor";
CM_ SG_ 2013 VCLEFT_a129_VDS_HA "Left body controller: a129 VDS HA";
CM_ SG_ 2013 VCLEFT_a129_VDS_LA "Left body controller: a129 VDS LA";
CM_ SG_ 2013 VCLEFT_a129_VDS_HB "Left body controller: a129 VDS HB";
CM_ SG_ 2013 VCLEFT_a129_VDS_LB "Left body controller: a129 VDS LB";
CM_ SG_ 2013 VCLEFT_a129_VDS_HC "Left body controller: a129 VDS HC";
CM_ SG_ 2013 VCLEFT_a129_VDS_LC "Left body controller: a129 VDS LC";
CM_ SG_ 2013 VCLEFT_a129_SNS_C_OCP "Left body controller: a129 SNS c OCP";
CM_ SG_ 2013 VCLEFT_a129_SNS_B_OCP "Left body controller: a129 SNS b OCP";
CM_ SG_ 2013 VCLEFT_a129_SNS_A_OCP "Left body controller: a129 SNS a OCP";
CM_ SG_ 2013 VCLEFT_a129_PVDD_UVLO2 "Left body controller: a129 PVDD UVLO2";
CM_ SG_ 2013 VCLEFT_a129_WD_FAULT "Left body controller: a129 WD FAULT";
CM_ SG_ 2013 VCLEFT_a129_OTSD "Left body controller: a129 OTSD";
CM_ SG_ 2013 VCLEFT_a129_VREG_UV "Left body controller: a129 VREG UV";
CM_ SG_ 2013 VCLEFT_a129_AVDD_UVLO "Left body controller: a129 AVDD UVLO";
CM_ SG_ 2013 VCLEFT_a129_VCP_LSD_UVLO2 "Left body controller: a129 VCP LSD UVLO2";
CM_ SG_ 2013 VCLEFT_a129_VCPH_UVLO2 "Left body controller: a129 VCPH UVLO2";
CM_ SG_ 2013 VCLEFT_a129_VCPH_UVLO "Left body controller: a129 VCPH UVLO";
CM_ SG_ 2013 VCLEFT_a129_VCPH_OVLO_ABS "Left body controller: a129 VCPH OVLO ABS";
CM_ SG_ 2013 VCLEFT_a129_VGS_HA "Left body controller: a129 VGS HA";
CM_ SG_ 2013 VCLEFT_a129_VGS_LA "Left body controller: a129 VGS LA";
CM_ SG_ 2013 VCLEFT_a129_VGS_HB "Left body controller: a129 VGS HB";
CM_ SG_ 2013 VCLEFT_a129_VGS_LB "Left body controller: a129 VGS LB";
CM_ SG_ 2013 VCLEFT_a129_VGS_HC "Left body controller: a129 VGS HC";
CM_ SG_ 2013 VCLEFT_a129_VGS_LC "Left body controller: a129 VGS LC";
CM_ SG_ 2013 VCLEFT_a130_junctionTempWarning "Left body controller: a130 junction temp warning";
CM_ SG_ 2013 VCLEFT_a130_junctionOverTemp "Left body controller: a130 junction over temp";
CM_ SG_ 2013 VCLEFT_a130_startUpOperation "Left body controller: a130 start up operation";
CM_ SG_ 2013 VCLEFT_a130_lossOfSpeedLock "Left body controller: a130 loss of speed lock";
CM_ SG_ 2013 VCLEFT_a130_vccUnderVoltage "Left body controller: a130 vcc under voltage";
CM_ SG_ 2013 VCLEFT_a130_TEMP_FLAG4 "Left body controller: a130 TEMP FLAG4";
CM_ SG_ 2013 VCLEFT_a130_PVDD_UVFL "Left body controller: a130 PVDD UVFL";
CM_ SG_ 2013 VCLEFT_a130_PVDD_OVFL "Left body controller: a130 PVDD OVFL";
CM_ SG_ 2013 VCLEFT_a130_VDS_STATUS "Left body controller: a130 VDS STATUS";
CM_ SG_ 2013 VCLEFT_a130_VCPH_UVFL "Left body controller: a130 VCPH UVFL";
CM_ SG_ 2013 VCLEFT_a130_TEMP_FLAG1 "Left body controller: a130 TEMP FLAG1";
CM_ SG_ 2013 VCLEFT_a130_TEMP_FLAG2 "Left body controller: a130 TEMP FLAG2";
CM_ SG_ 2013 VCLEFT_a130_TEMP_FLAG3 "Left body controller: a130 TEMP FLAG3";
CM_ SG_ 2013 VCLEFT_a130_OTW "Left body controller: a130 OTW";
CM_ SG_ 2013 VCLEFT_a131_vsUnderVoltage "Left body controller: a131 vs under voltage";
CM_ SG_ 2013 VCLEFT_a131_vsOverVoltage "Left body controller: a131 vs over voltage";
CM_ SG_ 2013 VCLEFT_a131_chpUnderVoltage "Left body controller: a131 chp under voltage";
CM_ SG_ 2013 VCLEFT_a131_vglUnderVoltage "Left body controller: a131 vgl under voltage";
CM_ SG_ 2013 VCLEFT_a131_thOverTemperature "Left body controller: a131 th over temperature";
CM_ SG_ 2013 VCLEFT_a132_RPMActual "Left body controller: a132 RPM actual";
CM_ SG_ 2013 VCLEFT_a132_RPMTarget "Left body controller: a132 RPM target";
CM_ SG_ 2013 VCLEFT_a133_RPMActual "Left body controller: a133 RPM actual";
CM_ SG_ 2013 VCLEFT_a133_RPMTarget "Left body controller: a133 RPM target";
CM_ SG_ 2013 VCLEFT_a141_outputCurrent "Left body controller: a141 output current";
CM_ SG_ 2013 VCLEFT_a145_brakeSwitch "Left body controller: a145 brake switch";
CM_ SG_ 2013 VCLEFT_a145_ibstRodPosition "Left body controller: a145 ibst rod position";
CM_ SG_ 2013 VCLEFT_a145_ibstRodPositionQF "Left body controller: a145 ibst rod position QF";
CM_ SG_ 2013 VCLEFT_a150_windowPosition "Left body controller: a150 window position";
CM_ SG_ 2013 VCLEFT_a150_movementTimeMs "Left body controller: a150 movement time ms";
CM_ SG_ 2013 VCLEFT_a150_windowPinchReason "Left body controller: a150 window pinch reason";
CM_ SG_ 2013 VCLEFT_a150_lookbackIndex "Left body controller: a150 lookback index";
CM_ SG_ 2013 VCLEFT_a150_absAccelExceedance "Left body controller: a150 abs accel exceedance";
CM_ SG_ 2013 VCLEFT_a150_relAccelExceedance "Left body controller: a150 rel accel exceedance";
CM_ SG_ 2013 VCLEFT_a150_speedExpScore "Left body controller: a150 speed exp score";
CM_ SG_ 2013 VCLEFT_a150_treatedInGear "Left body controller: a150 treated in gear";
CM_ SG_ 2013 VCLEFT_a151_windowPosition "Left body controller: a151 window position";
CM_ SG_ 2013 VCLEFT_a151_movementTimeMs "Left body controller: a151 movement time ms";
CM_ SG_ 2013 VCLEFT_a151_windowPinchReason "Left body controller: a151 window pinch reason";
CM_ SG_ 2013 VCLEFT_a151_lookbackIndex "Left body controller: a151 lookback index";
CM_ SG_ 2013 VCLEFT_a151_absAccelExceedance "Left body controller: a151 abs accel exceedance";
CM_ SG_ 2013 VCLEFT_a151_relAccelExceedance "Left body controller: a151 rel accel exceedance";
CM_ SG_ 2013 VCLEFT_a151_speedExpScore "Left body controller: a151 speed exp score";
CM_ SG_ 2013 VCLEFT_a151_treatedInGear "Left body controller: a151 treated in gear";
CM_ SG_ 2013 VCLEFT_a152_zeroed "Left body controller: a152 zeroed";
CM_ SG_ 2013 VCLEFT_a152_endStopTrusted "Left body controller: a152 end stop trusted";
CM_ SG_ 2013 VCLEFT_a152_speedTableStatus "Left body controller: a152 speed table status";
CM_ SG_ 2013 VCLEFT_a152_causedByBackoffs "Left body controller: a152 caused by backoffs";
CM_ SG_ 2013 VCLEFT_a153_zeroed "Left body controller: a153 zeroed";
CM_ SG_ 2013 VCLEFT_a153_endStopTrusted "Left body controller: a153 end stop trusted";
CM_ SG_ 2013 VCLEFT_a153_speedTableStatus "Left body controller: a153 speed table status";
CM_ SG_ 2013 VCLEFT_a153_causedByBackoffs "Left body controller: a153 caused by backoffs";
CM_ SG_ 2013 VCLEFT_a154_windowThermalMode "Left body controller: a154 window thermal mode";
CM_ SG_ 2013 VCLEFT_a154_lightShowActive "Left body controller: a154 light show active";
CM_ SG_ 2013 VCLEFT_a155_windowThermalMode "Left body controller: a155 window thermal mode";
CM_ SG_ 2013 VCLEFT_a155_lightShowActive "Left body controller: a155 light show active";
CM_ SG_ 2013 VCLEFT_a180_intButtonPressed "Left body controller: a180 int button pressed";
CM_ SG_ 2013 VCLEFT_a180_extHandlePWM "Left body controller: a180 ext handle PWM";
CM_ SG_ 2013 VCLEFT_a180_extHandlePulled "Left body controller: a180 ext handle pulled";
CM_ SG_ 2013 VCLEFT_a180_releasePWM "Left body controller: a180 release PWM";
CM_ SG_ 2013 VCLEFT_a180_latchStatus "Left body controller: a180 latch status";
CM_ SG_ 2013 VCLEFT_a180_latchClawStatus "Left body controller: a180 latch claw status";
CM_ SG_ 2013 VCLEFT_a181_intButtonPressed "Left body controller: a181 int button pressed";
CM_ SG_ 2013 VCLEFT_a181_extHandlePWM "Left body controller: a181 ext handle PWM";
CM_ SG_ 2013 VCLEFT_a181_extHandlePulled "Left body controller: a181 ext handle pulled";
CM_ SG_ 2013 VCLEFT_a181_releasePWM "Left body controller: a181 release PWM";
CM_ SG_ 2013 VCLEFT_a181_latchStatus "Left body controller: a181 latch status";
CM_ SG_ 2013 VCLEFT_a181_latchClawStatus "Left body controller: a181 latch claw status";
CM_ SG_ 2013 VCLEFT_a186_voltage "Left body controller: a186 voltage";
CM_ SG_ 2013 VCLEFT_a186_temperature "Left body controller: a186 temperature";
CM_ SG_ 2013 VCLEFT_a187_voltage "Left body controller: a187 voltage";
CM_ SG_ 2013 VCLEFT_a187_temperature "Left body controller: a187 temperature";
CM_ SG_ 2013 VCLEFT_a188_voltage "Left body controller: a188 voltage";
CM_ SG_ 2013 VCLEFT_a188_temperature "Left body controller: a188 temperature";
CM_ SG_ 2013 VCLEFT_a189_voltage "Left body controller: a189 voltage";
CM_ SG_ 2013 VCLEFT_a189_temperature "Left body controller: a189 temperature";
CM_ SG_ 2013 VCLEFT_a190_eFuseTripCount "Left body controller: a190 e fuse trip count";
CM_ SG_ 2013 VCLEFT_a192_motorFaulted "Left body controller: a192 motor faulted";
CM_ SG_ 2013 VCLEFT_a192_motorLocked "Left body controller: a192 motor locked";
CM_ SG_ 2013 VCLEFT_a192_ecuReset "Left body controller: a192 ecu reset";
CM_ SG_ 2013 VCLEFT_a192_fetTempIrrational "Left body controller: a192 fet temp irrational";
CM_ SG_ 2013 VCLEFT_a192_motorControlError "Left body controller: a192 motor control error";
CM_ SG_ 2013 VCLEFT_a192_underVoltage "Left body controller: a192 under voltage";
CM_ SG_ 2013 VCLEFT_a192_overVoltage "Left body controller: a192 over voltage";
CM_ SG_ 2013 VCLEFT_a192_hardwareOvercurrent "Left body controller: a192 hardware overcurrent";
CM_ SG_ 2013 VCLEFT_a192_motorOpenPhase "Left body controller: a192 motor open phase";
CM_ SG_ 2013 VCLEFT_a192_motorSoftOpenPhase "Left body controller: a192 motor soft open phase";
CM_ SG_ 2013 VCLEFT_a192_motorOvertemp "Left body controller: a192 motor overtemp";
CM_ SG_ 2013 VCLEFT_a192_dcOvercurrent "Left body controller: a192 dc overcurrent";
CM_ SG_ 2013 VCLEFT_a192_motorStalled "Left body controller: a192 motor stalled";
CM_ SG_ 2013 VCLEFT_a192_selfTestFailed "Left body controller: a192 self test failed";
CM_ SG_ 2013 VCLEFT_a192_selfTestResult "Left body controller: a192 self test result";
CM_ SG_ 2013 VCLEFT_a192_linChecksumError "Left body controller: a192 lin checksum error";
CM_ SG_ 2013 VCLEFT_a192_linFramingError "Left body controller: a192 lin framing error";
CM_ SG_ 2013 VCLEFT_a192_phaseShorted "Left body controller: a192 phase shorted";
CM_ SG_ 2013 VCLEFT_a192_busVoltageIrrational "Left body controller: a192 bus voltage irrational";
CM_ SG_ 2013 VCLEFT_a192_dcCurrentIrrational "Left body controller: a192 dc current irrational";
CM_ SG_ 2013 VCLEFT_a192_motorSpeedIrrational "Left body controller: a192 motor speed irrational";
CM_ SG_ 2013 VCLEFT_a192_supplyVoltageIrratio "Left body controller: a192 supply voltage irrational";
CM_ SG_ 2013 VCLEFT_a192_motorPhaseCurrentIrr "Left body controller: a192 motor phase current irrational";
CM_ SG_ 2013 VCLEFT_a192_chipOvertemp "Left body controller: a192 chip overtemp";
CM_ SG_ 2013 VCLEFT_a192_motorSpeedTooHigh "Left body controller: a192 motor speed too high";
CM_ SG_ 2013 VCLEFT_a192_phaseOvercurrent "Left body controller: a192 phase overcurrent";
CM_ SG_ 2013 VCLEFT_a192_vddaOvercurrent "Left body controller: a192 vdda overcurrent";
CM_ SG_ 2013 VCLEFT_a192_busVoltageUnhealthy "Left body controller: a192 bus voltage unhealthy";
CM_ SG_ 2013 VCLEFT_a192_hsVdsOvervoltage "Left body controller: a192 hs vds overvoltage";
CM_ SG_ 2013 VCLEFT_a192_hsVdsOvervoltageMask "Left body controller: a192 hs vds overvoltage mask";
CM_ SG_ 2013 VCLEFT_a192_lsVdsOvervoltage "Left body controller: a192 ls vds overvoltage";
CM_ SG_ 2013 VCLEFT_a192_lsVdsOvervoltageMask "Left body controller: a192 ls vds overvoltage mask";
CM_ SG_ 2013 VCLEFT_a192_payloadBitsNotSet "Left body controller: a192 payload bits not set";
CM_ SG_ 2013 VCLEFT_a192_motorNotIdentified "Left body controller: a192 motor not identified";
CM_ SG_ 2013 VCLEFT_a192_motorType "Left body controller: a192 motor type";
CM_ SG_ 2013 VCLEFT_a194_motorTypeUnknown "Left body controller: a194 motor type unknown";
CM_ SG_ 2013 VCLEFT_a194_configurationMismatc "Left body controller: a194 configuration mismatch";
CM_ SG_ 2013 VCLEFT_a194_vcbldcMotorTypeUnkno "Left body controller: a194 vcbldc motor type unknown";
CM_ SG_ 2013 VCLEFT_a194_nvramMotorTypeUnknow "Left body controller: a194 nvram motor type unknown";
CM_ SG_ 2013 VCLEFT_a194_vcbldcMotorId "Left body controller: a194 vcbldc motor id";
CM_ SG_ 2013 VCLEFT_a194_nvramMotorId "Left body controller: a194 nvram motor id";
CM_ SG_ 2013 VCLEFT_a196_outputState "Left body controller: a196 output state";
CM_ SG_ 2013 VCLEFT_a196_NVRAMState "Left body controller: a196 NVRAM state";
CM_ SG_ 2013 VCLEFT_a196_lockoutState "Left body controller: a196 lockout state";
CM_ SG_ 2013 VCLEFT_a197_outputState "Left body controller: a197 output state";
CM_ SG_ 2013 VCLEFT_a197_NVRAMState "Left body controller: a197 NVRAM state";
CM_ SG_ 2013 VCLEFT_a197_lockoutState "Left body controller: a197 lockout state";
CM_ SG_ 2013 VCLEFT_a202_unknownAllowed "Left body controller: a202 unknown allowed";
CM_ SG_ 2013 VCLEFT_a202_openAllowed "Left body controller: a202 open allowed";
CM_ SG_ 2013 VCLEFT_a202_dynamicAllowed "Left body controller: a202 dynamic allowed";
CM_ SG_ 2013 VCLEFT_a202_parkAllowed "Left body controller: a202 park allowed";
CM_ SG_ 2013 VCLEFT_a202_startAllowed "Left body controller: a202 start allowed";
CM_ SG_ 2013 VCLEFT_a202_serviceAllowed "Left body controller: a202 service allowed";
CM_ SG_ 2013 VCLEFT_a202_winchAllowed "Left body controller: a202 winch allowed";
CM_ SG_ 2013 VCLEFT_a202_winchReleaseAllowed "Left body controller: a202 winch release allowed";
CM_ SG_ 2013 VCLEFT_a202_parkingAllowed "Left body controller: a202 parking allowed";
CM_ SG_ 2013 VCLEFT_a202_dynApplyAllowed "Left body controller: a202 dyn apply allowed";
CM_ SG_ 2013 VCLEFT_a202_releaseAllowed "Left body controller: a202 release allowed";
CM_ SG_ 2013 VCLEFT_a202_parkPendingAllowed "Left body controller: a202 park pending allowed";
CM_ SG_ 2013 VCLEFT_a202_wenchPendingAllowed "Left body controller: a202 wench pending allowed";
CM_ SG_ 2013 VCLEFT_a202_desyncCount "Left body controller: a202 desync count";
CM_ SG_ 2013 VCLEFT_a202_current "Left body controller: a202 current";
CM_ SG_ 2013 VCLEFT_a202_epbConfig "Left body controller: a202 epb config";
CM_ SG_ 2013 VCLEFT_a203_unknownAllowed "Left body controller: a203 unknown allowed";
CM_ SG_ 2013 VCLEFT_a203_openAllowed "Left body controller: a203 open allowed";
CM_ SG_ 2013 VCLEFT_a203_dynamicAllowed "Left body controller: a203 dynamic allowed";
CM_ SG_ 2013 VCLEFT_a203_parkAllowed "Left body controller: a203 park allowed";
CM_ SG_ 2013 VCLEFT_a203_startAllowed "Left body controller: a203 start allowed";
CM_ SG_ 2013 VCLEFT_a203_serviceAllowed "Left body controller: a203 service allowed";
CM_ SG_ 2013 VCLEFT_a203_winchAllowed "Left body controller: a203 winch allowed";
CM_ SG_ 2013 VCLEFT_a203_winchReleaseAllowed "Left body controller: a203 winch release allowed";
CM_ SG_ 2013 VCLEFT_a203_parkingAllowed "Left body controller: a203 parking allowed";
CM_ SG_ 2013 VCLEFT_a203_dynApplyAllowed "Left body controller: a203 dyn apply allowed";
CM_ SG_ 2013 VCLEFT_a203_releaseAllowed "Left body controller: a203 release allowed";
CM_ SG_ 2013 VCLEFT_a203_parkPendingAllowed "Left body controller: a203 park pending allowed";
CM_ SG_ 2013 VCLEFT_a203_wenchPendingAllowed "Left body controller: a203 wench pending allowed";
CM_ SG_ 2013 VCLEFT_a203_desyncCount "Left body controller: a203 desync count";
CM_ SG_ 2013 VCLEFT_a203_current "Left body controller: a203 current";
CM_ SG_ 2013 VCLEFT_a203_epbConfig "Left body controller: a203 epb config";
CM_ SG_ 2013 VCLEFT_a204_unknownAllowed "Left body controller: a204 unknown allowed";
CM_ SG_ 2013 VCLEFT_a204_openAllowed "Left body controller: a204 open allowed";
CM_ SG_ 2013 VCLEFT_a204_dynamicAllowed "Left body controller: a204 dynamic allowed";
CM_ SG_ 2013 VCLEFT_a204_parkAllowed "Left body controller: a204 park allowed";
CM_ SG_ 2013 VCLEFT_a204_startAllowed "Left body controller: a204 start allowed";
CM_ SG_ 2013 VCLEFT_a204_serviceAllowed "Left body controller: a204 service allowed";
CM_ SG_ 2013 VCLEFT_a204_winchAllowed "Left body controller: a204 winch allowed";
CM_ SG_ 2013 VCLEFT_a204_winchReleaseAllowed "Left body controller: a204 winch release allowed";
CM_ SG_ 2013 VCLEFT_a204_parkingAllowed "Left body controller: a204 parking allowed";
CM_ SG_ 2013 VCLEFT_a204_dynApplyAllowed "Left body controller: a204 dyn apply allowed";
CM_ SG_ 2013 VCLEFT_a204_releaseAllowed "Left body controller: a204 release allowed";
CM_ SG_ 2013 VCLEFT_a204_parkPendingAllowed "Left body controller: a204 park pending allowed";
CM_ SG_ 2013 VCLEFT_a204_wenchPendingAllowed "Left body controller: a204 wench pending allowed";
CM_ SG_ 2013 VCLEFT_a204_desyncCount "Left body controller: a204 desync count";
CM_ SG_ 2013 VCLEFT_a204_current "Left body controller: a204 current";
CM_ SG_ 2013 VCLEFT_a204_epbConfig "Left body controller: a204 epb config";
CM_ SG_ 2013 VCLEFT_a205_unknownAllowed "Left body controller: a205 unknown allowed";
CM_ SG_ 2013 VCLEFT_a205_openAllowed "Left body controller: a205 open allowed";
CM_ SG_ 2013 VCLEFT_a205_dynamicAllowed "Left body controller: a205 dynamic allowed";
CM_ SG_ 2013 VCLEFT_a205_parkAllowed "Left body controller: a205 park allowed";
CM_ SG_ 2013 VCLEFT_a205_startAllowed "Left body controller: a205 start allowed";
CM_ SG_ 2013 VCLEFT_a205_serviceAllowed "Left body controller: a205 service allowed";
CM_ SG_ 2013 VCLEFT_a205_winchAllowed "Left body controller: a205 winch allowed";
CM_ SG_ 2013 VCLEFT_a205_winchReleaseAllowed "Left body controller: a205 winch release allowed";
CM_ SG_ 2013 VCLEFT_a205_parkingAllowed "Left body controller: a205 parking allowed";
CM_ SG_ 2013 VCLEFT_a205_dynApplyAllowed "Left body controller: a205 dyn apply allowed";
CM_ SG_ 2013 VCLEFT_a205_releaseAllowed "Left body controller: a205 release allowed";
CM_ SG_ 2013 VCLEFT_a205_parkPendingAllowed "Left body controller: a205 park pending allowed";
CM_ SG_ 2013 VCLEFT_a205_wenchPendingAllowed "Left body controller: a205 wench pending allowed";
CM_ SG_ 2013 VCLEFT_a205_desyncCount "Left body controller: a205 desync count";
CM_ SG_ 2013 VCLEFT_a205_current "Left body controller: a205 current";
CM_ SG_ 2013 VCLEFT_a205_epbConfig "Left body controller: a205 epb config";
CM_ SG_ 2013 VCLEFT_a206_unknownAllowed "Left body controller: a206 unknown allowed";
CM_ SG_ 2013 VCLEFT_a206_openAllowed "Left body controller: a206 open allowed";
CM_ SG_ 2013 VCLEFT_a206_dynamicAllowed "Left body controller: a206 dynamic allowed";
CM_ SG_ 2013 VCLEFT_a206_parkAllowed "Left body controller: a206 park allowed";
CM_ SG_ 2013 VCLEFT_a206_startAllowed "Left body controller: a206 start allowed";
CM_ SG_ 2013 VCLEFT_a206_serviceAllowed "Left body controller: a206 service allowed";
CM_ SG_ 2013 VCLEFT_a206_winchAllowed "Left body controller: a206 winch allowed";
CM_ SG_ 2013 VCLEFT_a206_winchReleaseAllowed "Left body controller: a206 winch release allowed";
CM_ SG_ 2013 VCLEFT_a206_parkingAllowed "Left body controller: a206 parking allowed";
CM_ SG_ 2013 VCLEFT_a206_dynApplyAllowed "Left body controller: a206 dyn apply allowed";
CM_ SG_ 2013 VCLEFT_a206_releaseAllowed "Left body controller: a206 release allowed";
CM_ SG_ 2013 VCLEFT_a206_parkPendingAllowed "Left body controller: a206 park pending allowed";
CM_ SG_ 2013 VCLEFT_a206_wenchPendingAllowed "Left body controller: a206 wench pending allowed";
CM_ SG_ 2013 VCLEFT_a206_unitStatusEPB "Left body controller: a206 unit status EPB";
CM_ SG_ 2013 VCLEFT_a206_unitStatusEPBM "Left body controller: a206 unit status EPBM";
CM_ SG_ 2013 VCLEFT_a207_unknownAllowed "Left body controller: a207 unknown allowed";
CM_ SG_ 2013 VCLEFT_a207_openAllowed "Left body controller: a207 open allowed";
CM_ SG_ 2013 VCLEFT_a207_dynamicAllowed "Left body controller: a207 dynamic allowed";
CM_ SG_ 2013 VCLEFT_a207_parkAllowed "Left body controller: a207 park allowed";
CM_ SG_ 2013 VCLEFT_a207_startAllowed "Left body controller: a207 start allowed";
CM_ SG_ 2013 VCLEFT_a207_serviceAllowed "Left body controller: a207 service allowed";
CM_ SG_ 2013 VCLEFT_a207_winchAllowed "Left body controller: a207 winch allowed";
CM_ SG_ 2013 VCLEFT_a207_winchReleaseAllowed "Left body controller: a207 winch release allowed";
CM_ SG_ 2013 VCLEFT_a207_parkingAllowed "Left body controller: a207 parking allowed";
CM_ SG_ 2013 VCLEFT_a207_dynApplyAllowed "Left body controller: a207 dyn apply allowed";
CM_ SG_ 2013 VCLEFT_a207_releaseAllowed "Left body controller: a207 release allowed";
CM_ SG_ 2013 VCLEFT_a207_parkPendingAllowed "Left body controller: a207 park pending allowed";
CM_ SG_ 2013 VCLEFT_a207_wenchPendingAllowed "Left body controller: a207 wench pending allowed";
CM_ SG_ 2013 VCLEFT_a207_unitStatusEPB "Left body controller: a207 unit status EPB";
CM_ SG_ 2013 VCLEFT_a207_unitStatusEPBM "Left body controller: a207 unit status EPBM";
CM_ SG_ 2013 VCLEFT_a208_unknownAllowed "Left body controller: a208 unknown allowed";
CM_ SG_ 2013 VCLEFT_a208_openAllowed "Left body controller: a208 open allowed";
CM_ SG_ 2013 VCLEFT_a208_dynamicAllowed "Left body controller: a208 dynamic allowed";
CM_ SG_ 2013 VCLEFT_a208_parkAllowed "Left body controller: a208 park allowed";
CM_ SG_ 2013 VCLEFT_a208_startAllowed "Left body controller: a208 start allowed";
CM_ SG_ 2013 VCLEFT_a208_serviceAllowed "Left body controller: a208 service allowed";
CM_ SG_ 2013 VCLEFT_a208_winchAllowed "Left body controller: a208 winch allowed";
CM_ SG_ 2013 VCLEFT_a208_winchReleaseAllowed "Left body controller: a208 winch release allowed";
CM_ SG_ 2013 VCLEFT_a208_parkingAllowed "Left body controller: a208 parking allowed";
CM_ SG_ 2013 VCLEFT_a208_dynApplyAllowed "Left body controller: a208 dyn apply allowed";
CM_ SG_ 2013 VCLEFT_a208_releaseAllowed "Left body controller: a208 release allowed";
CM_ SG_ 2013 VCLEFT_a208_parkPendingAllowed "Left body controller: a208 park pending allowed";
CM_ SG_ 2013 VCLEFT_a208_wenchPendingAllowed "Left body controller: a208 wench pending allowed";
CM_ SG_ 2013 VCLEFT_a208_unitStatusEPB "Left body controller: a208 unit status EPB";
CM_ SG_ 2013 VCLEFT_a208_unitStatusEPBM "Left body controller: a208 unit status EPBM";
CM_ SG_ 2013 VCLEFT_a209_unknownAllowed "Left body controller: a209 unknown allowed";
CM_ SG_ 2013 VCLEFT_a209_openAllowed "Left body controller: a209 open allowed";
CM_ SG_ 2013 VCLEFT_a209_dynamicAllowed "Left body controller: a209 dynamic allowed";
CM_ SG_ 2013 VCLEFT_a209_parkAllowed "Left body controller: a209 park allowed";
CM_ SG_ 2013 VCLEFT_a209_startAllowed "Left body controller: a209 start allowed";
CM_ SG_ 2013 VCLEFT_a209_serviceAllowed "Left body controller: a209 service allowed";
CM_ SG_ 2013 VCLEFT_a209_winchAllowed "Left body controller: a209 winch allowed";
CM_ SG_ 2013 VCLEFT_a209_winchReleaseAllowed "Left body controller: a209 winch release allowed";
CM_ SG_ 2013 VCLEFT_a209_parkingAllowed "Left body controller: a209 parking allowed";
CM_ SG_ 2013 VCLEFT_a209_dynApplyAllowed "Left body controller: a209 dyn apply allowed";
CM_ SG_ 2013 VCLEFT_a209_releaseAllowed "Left body controller: a209 release allowed";
CM_ SG_ 2013 VCLEFT_a209_parkPendingAllowed "Left body controller: a209 park pending allowed";
CM_ SG_ 2013 VCLEFT_a209_wenchPendingAllowed "Left body controller: a209 wench pending allowed";
CM_ SG_ 2013 VCLEFT_a209_unitStatusEPB "Left body controller: a209 unit status EPB";
CM_ SG_ 2013 VCLEFT_a209_unitStatusEPBM "Left body controller: a209 unit status EPBM";
CM_ SG_ 2013 VCLEFT_a210_unknownAllowed "Left body controller: a210 unknown allowed";
CM_ SG_ 2013 VCLEFT_a210_openAllowed "Left body controller: a210 open allowed";
CM_ SG_ 2013 VCLEFT_a210_dynamicAllowed "Left body controller: a210 dynamic allowed";
CM_ SG_ 2013 VCLEFT_a210_parkAllowed "Left body controller: a210 park allowed";
CM_ SG_ 2013 VCLEFT_a210_startAllowed "Left body controller: a210 start allowed";
CM_ SG_ 2013 VCLEFT_a210_serviceAllowed "Left body controller: a210 service allowed";
CM_ SG_ 2013 VCLEFT_a210_winchAllowed "Left body controller: a210 winch allowed";
CM_ SG_ 2013 VCLEFT_a210_winchReleaseAllowed "Left body controller: a210 winch release allowed";
CM_ SG_ 2013 VCLEFT_a210_parkingAllowed "Left body controller: a210 parking allowed";
CM_ SG_ 2013 VCLEFT_a210_dynApplyAllowed "Left body controller: a210 dyn apply allowed";
CM_ SG_ 2013 VCLEFT_a210_releaseAllowed "Left body controller: a210 release allowed";
CM_ SG_ 2013 VCLEFT_a210_parkPendingAllowed "Left body controller: a210 park pending allowed";
CM_ SG_ 2013 VCLEFT_a210_wenchPendingAllowed "Left body controller: a210 wench pending allowed";
CM_ SG_ 2013 VCLEFT_a210_unitStatusEPB "Left body controller: a210 unit status EPB";
CM_ SG_ 2013 VCLEFT_a210_unitStatusEPBM "Left body controller: a210 unit status EPBM";
CM_ SG_ 2013 VCLEFT_a221_vbatProtVoltage "Left body controller: a221 vbat prot voltage";
CM_ SG_ 2013 VCLEFT_a221_vbatProtCurrent "Left body controller: a221 vbat prot current";
CM_ SG_ 2013 VCLEFT_a221_uvLoadshedVoltage "Left body controller: a221 uv loadshed voltage";
CM_ SG_ 2013 VCLEFT_a221_loadshedFromBattMoni "Left body controller: a221 loadshed from batt monitor";
CM_ SG_ 2013 VCLEFT_a221_faultInjectActive "Left body controller: a221 fault inject active";
CM_ SG_ 2013 VCLEFT_a221_loadshedResetActive "Left body controller: a221 loadshed reset active";
CM_ SG_ 2013 VCLEFT_a221_loadshedArmPrimary "Left body controller: a221 loadshed arm primary";
CM_ SG_ 2013 VCLEFT_a224_seatMotorCalibrated "Left body controller: a224 seat motor calibrated";
CM_ SG_ 2013 VCLEFT_a224_seatMotorCurrent "Left body controller: a224 seat motor current";
CM_ SG_ 2013 VCLEFT_a224_seatMotorState "Left body controller: a224 seat motor state";
CM_ SG_ 2013 VCLEFT_a224_seatSwitchBack "Left body controller: a224 seat switch back";
CM_ SG_ 2013 VCLEFT_a224_seatSwitchForward "Left body controller: a224 seat switch forward";
CM_ SG_ 2013 VCLEFT_a225_seatMotorCalibrated "Left body controller: a225 seat motor calibrated";
CM_ SG_ 2013 VCLEFT_a225_seatMotorCurrent "Left body controller: a225 seat motor current";
CM_ SG_ 2013 VCLEFT_a225_seatMotorState "Left body controller: a225 seat motor state";
CM_ SG_ 2013 VCLEFT_a225_seatSwitchBack "Left body controller: a225 seat switch back";
CM_ SG_ 2013 VCLEFT_a225_seatSwitchForward "Left body controller: a225 seat switch forward";
CM_ SG_ 2013 VCLEFT_a226_seatMotorCalibrated "Left body controller: a226 seat motor calibrated";
CM_ SG_ 2013 VCLEFT_a226_seatMotorCurrent "Left body controller: a226 seat motor current";
CM_ SG_ 2013 VCLEFT_a226_seatMotorState "Left body controller: a226 seat motor state";
CM_ SG_ 2013 VCLEFT_a226_seatSwitchBack "Left body controller: a226 seat switch back";
CM_ SG_ 2013 VCLEFT_a226_seatSwitchForward "Left body controller: a226 seat switch forward";
CM_ SG_ 2013 VCLEFT_a227_seatMotorCalibrated "Left body controller: a227 seat motor calibrated";
CM_ SG_ 2013 VCLEFT_a227_seatMotorCurrent "Left body controller: a227 seat motor current";
CM_ SG_ 2013 VCLEFT_a227_seatMotorState "Left body controller: a227 seat motor state";
CM_ SG_ 2013 VCLEFT_a227_seatSwitchBack "Left body controller: a227 seat switch back";
CM_ SG_ 2013 VCLEFT_a227_seatSwitchForward "Left body controller: a227 seat switch forward";
CM_ SG_ 2013 VCLEFT_a228_seatMotorCalibrated "Left body controller: a228 seat motor calibrated";
CM_ SG_ 2013 VCLEFT_a228_seatMotorCurrent "Left body controller: a228 seat motor current";
CM_ SG_ 2013 VCLEFT_a228_seatMotorPosReal "Left body controller: a228 seat motor pos real";
CM_ SG_ 2013 VCLEFT_a228_seatMotorState "Left body controller: a228 seat motor state";
CM_ SG_ 2013 VCLEFT_a228_seatSwitchBack "Left body controller: a228 seat switch back";
CM_ SG_ 2013 VCLEFT_a228_seatSwitchForward "Left body controller: a228 seat switch forward";
CM_ SG_ 2013 VCLEFT_a229_seatMotorCalibrated "Left body controller: a229 seat motor calibrated";
CM_ SG_ 2013 VCLEFT_a229_seatMotorCurrent "Left body controller: a229 seat motor current";
CM_ SG_ 2013 VCLEFT_a229_seatMotorPosReal "Left body controller: a229 seat motor pos real";
CM_ SG_ 2013 VCLEFT_a229_seatMotorState "Left body controller: a229 seat motor state";
CM_ SG_ 2013 VCLEFT_a229_seatSwitchBack "Left body controller: a229 seat switch back";
CM_ SG_ 2013 VCLEFT_a229_seatSwitchForward "Left body controller: a229 seat switch forward";
CM_ SG_ 2013 VCLEFT_a230_seatMotorCalibrated "Left body controller: a230 seat motor calibrated";
CM_ SG_ 2013 VCLEFT_a230_seatMotorCurrent "Left body controller: a230 seat motor current";
CM_ SG_ 2013 VCLEFT_a230_seatMotorPosReal "Left body controller: a230 seat motor pos real";
CM_ SG_ 2013 VCLEFT_a230_seatMotorState "Left body controller: a230 seat motor state";
CM_ SG_ 2013 VCLEFT_a230_seatSwitchBack "Left body controller: a230 seat switch back";
CM_ SG_ 2013 VCLEFT_a230_seatSwitchForward "Left body controller: a230 seat switch forward";
CM_ SG_ 2013 VCLEFT_a231_seatMotorCalibrated "Left body controller: a231 seat motor calibrated";
CM_ SG_ 2013 VCLEFT_a231_seatMotorCurrent "Left body controller: a231 seat motor current";
CM_ SG_ 2013 VCLEFT_a231_seatMotorPosReal "Left body controller: a231 seat motor pos real";
CM_ SG_ 2013 VCLEFT_a231_seatMotorState "Left body controller: a231 seat motor state";
CM_ SG_ 2013 VCLEFT_a231_seatSwitchBack "Left body controller: a231 seat switch back";
CM_ SG_ 2013 VCLEFT_a231_seatSwitchForward "Left body controller: a231 seat switch forward";
CM_ SG_ 2013 VCLEFT_a232_seatMotorCurrent "Left body controller: a232 seat motor current";
CM_ SG_ 2013 VCLEFT_a232_seatMotorPosReal "Left body controller: a232 seat motor pos real";
CM_ SG_ 2013 VCLEFT_a232_seatMotorState "Left body controller: a232 seat motor state";
CM_ SG_ 2013 VCLEFT_a232_seatSwitchBack "Left body controller: a232 seat switch back";
CM_ SG_ 2013 VCLEFT_a232_seatSwitchForward "Left body controller: a232 seat switch forward";
CM_ SG_ 2013 VCLEFT_a233_seatMotorCurrent "Left body controller: a233 seat motor current";
CM_ SG_ 2013 VCLEFT_a233_seatMotorPosReal "Left body controller: a233 seat motor pos real";
CM_ SG_ 2013 VCLEFT_a233_seatMotorState "Left body controller: a233 seat motor state";
CM_ SG_ 2013 VCLEFT_a233_seatSwitchBack "Left body controller: a233 seat switch back";
CM_ SG_ 2013 VCLEFT_a233_seatSwitchForward "Left body controller: a233 seat switch forward";
CM_ SG_ 2013 VCLEFT_a234_seatMotorCurrent "Left body controller: a234 seat motor current";
CM_ SG_ 2013 VCLEFT_a234_seatMotorPosReal "Left body controller: a234 seat motor pos real";
CM_ SG_ 2013 VCLEFT_a234_seatMotorState "Left body controller: a234 seat motor state";
CM_ SG_ 2013 VCLEFT_a234_seatSwitchBack "Left body controller: a234 seat switch back";
CM_ SG_ 2013 VCLEFT_a234_seatSwitchForward "Left body controller: a234 seat switch forward";
CM_ SG_ 2013 VCLEFT_a235_seatMotorCurrent "Left body controller: a235 seat motor current";
CM_ SG_ 2013 VCLEFT_a235_seatMotorPosReal "Left body controller: a235 seat motor pos real";
CM_ SG_ 2013 VCLEFT_a235_seatMotorState "Left body controller: a235 seat motor state";
CM_ SG_ 2013 VCLEFT_a235_seatSwitchBack "Left body controller: a235 seat switch back";
CM_ SG_ 2013 VCLEFT_a235_seatSwitchForward "Left body controller: a235 seat switch forward";
CM_ SG_ 2013 VCLEFT_a236_lumbarAPressureHpa "Left body controller: a236 lumbar a pressure hpa";
CM_ SG_ 2013 VCLEFT_a236_lumbarBPressureHpa "Left body controller: a236 lumbar b pressure hpa";
CM_ SG_ 2013 VCLEFT_a236_lumbarDiagStatus "Left body controller: a236 lumbar diag status";
CM_ SG_ 2013 VCLEFT_a236_lumbarAState "Left body controller: a236 lumbar a state";
CM_ SG_ 2013 VCLEFT_a236_lumbarBState "Left body controller: a236 lumbar b state";
CM_ SG_ 2013 VCLEFT_a237_lumbarAPressureHpa "Left body controller: a237 lumbar a pressure hpa";
CM_ SG_ 2013 VCLEFT_a237_lumbarBPressureHpa "Left body controller: a237 lumbar b pressure hpa";
CM_ SG_ 2013 VCLEFT_a237_lumbarDiagStatus "Left body controller: a237 lumbar diag status";
CM_ SG_ 2013 VCLEFT_a237_lumbarAState "Left body controller: a237 lumbar a state";
CM_ SG_ 2013 VCLEFT_a237_lumbarBState "Left body controller: a237 lumbar b state";
CM_ SG_ 2013 VCLEFT_a238_lumbarAPressureHpa "Left body controller: a238 lumbar a pressure hpa";
CM_ SG_ 2013 VCLEFT_a238_lumbarBPressureHpa "Left body controller: a238 lumbar b pressure hpa";
CM_ SG_ 2013 VCLEFT_a238_lumbarDiagStatus "Left body controller: a238 lumbar diag status";
CM_ SG_ 2013 VCLEFT_a238_lumbarAState "Left body controller: a238 lumbar a state";
CM_ SG_ 2013 VCLEFT_a238_lumbarBState "Left body controller: a238 lumbar b state";
CM_ SG_ 2013 VCLEFT_a239_seatHeatCurrent "Left body controller: a239 seat heat current";
CM_ SG_ 2013 VCLEFT_a239_seatHeatTmp "Left body controller: a239 seat heat tmp";
CM_ SG_ 2013 VCLEFT_a239_seatHeatTmpTarget "Left body controller: a239 seat heat tmp target";
CM_ SG_ 2013 VCLEFT_a240_seatHeatCurrent "Left body controller: a240 seat heat current";
CM_ SG_ 2013 VCLEFT_a240_seatHeatTmp "Left body controller: a240 seat heat tmp";
CM_ SG_ 2013 VCLEFT_a241_seatHeatCurrent "Left body controller: a241 seat heat current";
CM_ SG_ 2013 VCLEFT_a241_seatHeatTmp "Left body controller: a241 seat heat tmp";
CM_ SG_ 2013 VCLEFT_a241_cushion "Left body controller: a241 cushion";
CM_ SG_ 2013 VCLEFT_a241_backrest "Left body controller: a241 backrest";
CM_ SG_ 2013 VCLEFT_a242_seatHeatCurrent "Left body controller: a242 seat heat current";
CM_ SG_ 2013 VCLEFT_a242_seatHeatTmp "Left body controller: a242 seat heat tmp";
CM_ SG_ 2013 VCLEFT_a242_seatHeatTmpTarget "Left body controller: a242 seat heat tmp target";
CM_ SG_ 2013 VCLEFT_a243_seatHeatCurrent "Left body controller: a243 seat heat current";
CM_ SG_ 2013 VCLEFT_a243_seatHeatTmp "Left body controller: a243 seat heat tmp";
CM_ SG_ 2013 VCLEFT_a244_seatHeatCurrent "Left body controller: a244 seat heat current";
CM_ SG_ 2013 VCLEFT_a244_seatHeatTmp "Left body controller: a244 seat heat tmp";
CM_ SG_ 2013 VCLEFT_a244_cushion "Left body controller: a244 cushion";
CM_ SG_ 2013 VCLEFT_a244_backrest "Left body controller: a244 backrest";
CM_ SG_ 2013 VCLEFT_a245_seatHeatCurrent "Left body controller: a245 seat heat current";
CM_ SG_ 2013 VCLEFT_a245_seatHeatTmp "Left body controller: a245 seat heat tmp";
CM_ SG_ 2013 VCLEFT_a245_seatHeatTmpTarget "Left body controller: a245 seat heat tmp target";
CM_ SG_ 2013 VCLEFT_a246_seatHeatCurrent "Left body controller: a246 seat heat current";
CM_ SG_ 2013 VCLEFT_a246_seatHeatTmp "Left body controller: a246 seat heat tmp";
CM_ SG_ 2013 VCLEFT_a247_seatHeatCurrent "Left body controller: a247 seat heat current";
CM_ SG_ 2013 VCLEFT_a247_seatHeatTmp "Left body controller: a247 seat heat tmp";
CM_ SG_ 2013 VCLEFT_a247_cushion "Left body controller: a247 cushion";
CM_ SG_ 2013 VCLEFT_a247_backrest "Left body controller: a247 backrest";
CM_ SG_ 2013 VCLEFT_a248_seatHeatCurrent "Left body controller: a248 seat heat current";
CM_ SG_ 2013 VCLEFT_a248_seatHeatTmp "Left body controller: a248 seat heat tmp";
CM_ SG_ 2013 VCLEFT_a248_seatHeatTmpTarget "Left body controller: a248 seat heat tmp target";
CM_ SG_ 2013 VCLEFT_a249_seatHeatCurrent "Left body controller: a249 seat heat current";
CM_ SG_ 2013 VCLEFT_a249_seatHeatTmp "Left body controller: a249 seat heat tmp";
CM_ SG_ 2013 VCLEFT_a250_seatHeatCurrent "Left body controller: a250 seat heat current";
CM_ SG_ 2013 VCLEFT_a250_seatHeatTmp "Left body controller: a250 seat heat tmp";
CM_ SG_ 2013 VCLEFT_a250_cushion "Left body controller: a250 cushion";
CM_ SG_ 2013 VCLEFT_a250_backrest "Left body controller: a250 backrest";
CM_ SG_ 2013 VCLEFT_a251_seatMotorCurrent "Left body controller: a251 seat motor current";
CM_ SG_ 2013 VCLEFT_a251_seatMotorPosReal "Left body controller: a251 seat motor pos real";
CM_ SG_ 2013 VCLEFT_a251_seatMotorState "Left body controller: a251 seat motor state";
CM_ SG_ 2013 VCLEFT_a251_seatSwitchBack "Left body controller: a251 seat switch back";
CM_ SG_ 2013 VCLEFT_a251_seatSwitchForward "Left body controller: a251 seat switch forward";
CM_ SG_ 2013 VCLEFT_a252_seatMotorCurrent "Left body controller: a252 seat motor current";
CM_ SG_ 2013 VCLEFT_a252_seatMotorPosReal "Left body controller: a252 seat motor pos real";
CM_ SG_ 2013 VCLEFT_a252_seatMotorState "Left body controller: a252 seat motor state";
CM_ SG_ 2013 VCLEFT_a252_seatSwitchBack "Left body controller: a252 seat switch back";
CM_ SG_ 2013 VCLEFT_a252_seatSwitchForward "Left body controller: a252 seat switch forward";
CM_ SG_ 2013 VCLEFT_a253_seatMotorCurrent "Left body controller: a253 seat motor current";
CM_ SG_ 2013 VCLEFT_a253_seatMotorPosReal "Left body controller: a253 seat motor pos real";
CM_ SG_ 2013 VCLEFT_a253_seatMotorState "Left body controller: a253 seat motor state";
CM_ SG_ 2013 VCLEFT_a253_seatSwitchBack "Left body controller: a253 seat switch back";
CM_ SG_ 2013 VCLEFT_a253_seatSwitchForward "Left body controller: a253 seat switch forward";
CM_ SG_ 2013 VCLEFT_a254_seatMotorCurrent "Left body controller: a254 seat motor current";
CM_ SG_ 2013 VCLEFT_a254_seatMotorPosReal "Left body controller: a254 seat motor pos real";
CM_ SG_ 2013 VCLEFT_a254_seatMotorState "Left body controller: a254 seat motor state";
CM_ SG_ 2013 VCLEFT_a254_seatSwitchBack "Left body controller: a254 seat switch back";
CM_ SG_ 2013 VCLEFT_a254_seatSwitchForward "Left body controller: a254 seat switch forward";
CM_ SG_ 2013 VCLEFT_a263_seatMotorCurrent "Left body controller: a263 seat motor current";
CM_ SG_ 2013 VCLEFT_a263_seatMotorDCurrent "Left body controller: a263 seat motor d current";
CM_ SG_ 2013 VCLEFT_a263_seatMotorPosReal "Left body controller: a263 seat motor pos real";
CM_ SG_ 2013 VCLEFT_a263_seatMotorState "Left body controller: a263 seat motor state";
CM_ SG_ 2013 VCLEFT_a264_seatMotorCurrent "Left body controller: a264 seat motor current";
CM_ SG_ 2013 VCLEFT_a264_seatMotorDCurrent "Left body controller: a264 seat motor d current";
CM_ SG_ 2013 VCLEFT_a264_seatMotorPosReal "Left body controller: a264 seat motor pos real";
CM_ SG_ 2013 VCLEFT_a264_seatMotorState "Left body controller: a264 seat motor state";
CM_ SG_ 2013 VCLEFT_a265_seatMotorCurrent "Left body controller: a265 seat motor current";
CM_ SG_ 2013 VCLEFT_a265_seatMotorDCurrent "Left body controller: a265 seat motor d current";
CM_ SG_ 2013 VCLEFT_a265_seatMotorPosReal "Left body controller: a265 seat motor pos real";
CM_ SG_ 2013 VCLEFT_a265_seatMotorState "Left body controller: a265 seat motor state";
CM_ SG_ 2013 VCLEFT_a266_seatMotorCurrent "Left body controller: a266 seat motor current";
CM_ SG_ 2013 VCLEFT_a266_seatMotorDCurrent "Left body controller: a266 seat motor d current";
CM_ SG_ 2013 VCLEFT_a266_seatMotorPosReal "Left body controller: a266 seat motor pos real";
CM_ SG_ 2013 VCLEFT_a266_seatMotorState "Left body controller: a266 seat motor state";
CM_ SG_ 2013 VCLEFT_a267_seatMotorCurrent "Left body controller: a267 seat motor current";
CM_ SG_ 2013 VCLEFT_a267_seatMotorDCurrent "Left body controller: a267 seat motor d current";
CM_ SG_ 2013 VCLEFT_a267_seatMotorPosReal "Left body controller: a267 seat motor pos real";
CM_ SG_ 2013 VCLEFT_a267_seatMotorState "Left body controller: a267 seat motor state";
CM_ SG_ 2013 VCLEFT_a268_seatMotorCurrent "Left body controller: a268 seat motor current";
CM_ SG_ 2013 VCLEFT_a268_seatMotorDCurrent "Left body controller: a268 seat motor d current";
CM_ SG_ 2013 VCLEFT_a268_seatMotorPosReal "Left body controller: a268 seat motor pos real";
CM_ SG_ 2013 VCLEFT_a268_seatMotorState "Left body controller: a268 seat motor state";
CM_ SG_ 2013 VCLEFT_a269_seatMotorCurrent "Left body controller: a269 seat motor current";
CM_ SG_ 2013 VCLEFT_a269_seatMotorDCurrent "Left body controller: a269 seat motor d current";
CM_ SG_ 2013 VCLEFT_a269_seatMotorPosReal "Left body controller: a269 seat motor pos real";
CM_ SG_ 2013 VCLEFT_a269_seatMotorState "Left body controller: a269 seat motor state";
CM_ SG_ 2013 VCLEFT_a270_seatMotorCurrent "Left body controller: a270 seat motor current";
CM_ SG_ 2013 VCLEFT_a270_seatMotorDCurrent "Left body controller: a270 seat motor d current";
CM_ SG_ 2013 VCLEFT_a270_seatMotorPosReal "Left body controller: a270 seat motor pos real";
CM_ SG_ 2013 VCLEFT_a270_seatMotorState "Left body controller: a270 seat motor state";
CM_ SG_ 2013 VCLEFT_a272_expectedState "Left body controller: a272 expected state";
CM_ SG_ 2013 VCLEFT_a272_actualState "Left body controller: a272 actual state";
CM_ SG_ 2013 VCLEFT_a273_handlePWM "Left body controller: a273 handle PWM";
CM_ SG_ 2013 VCLEFT_a273_temperature "Left body controller: a273 temperature";
CM_ SG_ 2013 VCLEFT_a274_handlePWM "Left body controller: a274 handle PWM";
CM_ SG_ 2013 VCLEFT_a274_temperature "Left body controller: a274 temperature";
CM_ SG_ 2013 VCLEFT_a275_outputFaulted "Left body controller: a275 output faulted";
CM_ SG_ 2013 VCLEFT_a275_currentSenseFaulted "Left body controller: a275 current sense faulted";
CM_ SG_ 2013 VCLEFT_a275_tempSenseFaulted "Left body controller: a275 temp sense faulted";
CM_ SG_ 2013 VCLEFT_a275_underCurrent "Left body controller: a275 under current";
CM_ SG_ 2013 VCLEFT_a275_overCurrent "Left body controller: a275 over current";
CM_ SG_ 2013 VCLEFT_a275_overTemperature "Left body controller: a275 over temperature";
CM_ SG_ 2013 VCLEFT_a282_voltage "Left body controller: a282 voltage";
CM_ SG_ 2013 VCLEFT_a282_temperature "Left body controller: a282 temperature";
CM_ SG_ 2013 VCLEFT_a283_voltage "Left body controller: a283 voltage";
CM_ SG_ 2013 VCLEFT_a283_temperature "Left body controller: a283 temperature";
CM_ SG_ 2013 VCLEFT_a290_isNetworkSwitch "Left body controller: a290 is network switch";
CM_ SG_ 2013 VCLEFT_a290_occupancySensorV "Left body controller: a290 occupancy sensor v";
CM_ SG_ 2013 VCLEFT_a290_railVoltage "Left body controller: a290 rail voltage";
CM_ SG_ 2013 VCLEFT_a291_buckleSensorVoltage "Left body controller: a291 buckle sensor voltage";
CM_ SG_ 2013 VCLEFT_a291_railVoltage "Left body controller: a291 rail voltage";
CM_ SG_ 2013 VCLEFT_a292_isNetworkSwitch "Left body controller: a292 is network switch";
CM_ SG_ 2013 VCLEFT_a292_occupancySensorV "Left body controller: a292 occupancy sensor v";
CM_ SG_ 2013 VCLEFT_a292_railV "Left body controller: a292 rail v";
CM_ SG_ 2013 VCLEFT_a293_isNetworkSwitch "Left body controller: a293 is network switch";
CM_ SG_ 2013 VCLEFT_a293_occupancySensorV "Left body controller: a293 occupancy sensor v";
CM_ SG_ 2013 VCLEFT_a293_railV "Left body controller: a293 rail v";
CM_ SG_ 2013 VCLEFT_a294_isNetworkSwitch "Left body controller: a294 is network switch";
CM_ SG_ 2013 VCLEFT_a294_occupancySensorV "Left body controller: a294 occupancy sensor v";
CM_ SG_ 2013 VCLEFT_a294_railV "Left body controller: a294 rail v";
CM_ SG_ 2013 VCLEFT_a295_buckleSensorVoltage "Left body controller: a295 buckle sensor voltage";
CM_ SG_ 2013 VCLEFT_a295_railV "Left body controller: a295 rail v";
CM_ SG_ 2013 VCLEFT_a296_buckleSensorVoltage "Left body controller: a296 buckle sensor voltage";
CM_ SG_ 2013 VCLEFT_a296_railV "Left body controller: a296 rail v";
CM_ SG_ 2013 VCLEFT_a297_cabinTmp "Left body controller: a297 cabin tmp";
CM_ SG_ 2013 VCLEFT_a302_overVoltage "Left body controller: a302 over voltage";
CM_ SG_ 2013 VCLEFT_a302_underVoltage "Left body controller: a302 under voltage";
CM_ SG_ 2013 VCLEFT_a302_motorOverTemperature "Left body controller: a302 motor over temperature";
CM_ SG_ 2013 VCLEFT_a302_moduleOverCurrent "Left body controller: a302 module over current";
CM_ SG_ 2013 VCLEFT_a302_overRMSCurrent "Left body controller: a302 over RMS current";
CM_ SG_ 2013 VCLEFT_a302_motorStall "Left body controller: a302 motor stall";
CM_ SG_ 2013 VCLEFT_a302_overloadFault "Left body controller: a302 overload fault";
CM_ SG_ 2013 VCLEFT_a302_motorLostPhase "Left body controller: a302 motor lost phase";
CM_ SG_ 2013 VCLEFT_a302_currentUnbalance "Left body controller: a302 current unbalance";
CM_ SG_ 2013 VCLEFT_a302_overspeedFault "Left body controller: a302 overspeed fault";
CM_ SG_ 2013 VCLEFT_a302_startupFailed "Left body controller: a302 startup failed";
CM_ SG_ 2013 VCLEFT_a302_TMS320OverTempShutDw "Left body controller: a302 TMS320 over temp shut dwn";
CM_ SG_ 2013 VCLEFT_a302_fetOvertempShutdown "Left body controller: a302 fet overtemp shutdown";
CM_ SG_ 2013 VCLEFT_a302_motorDisconnect "Left body controller: a302 motor disconnect";
CM_ SG_ 2013 VCLEFT_a302_DRV_MIA "Left body controller: a302 DRV MIA";
CM_ SG_ 2013 VCLEFT_a302_overCurrentLatch "Left body controller: a302 over current latch";
CM_ SG_ 2013 VCLEFT_a302_CBC_MIA "Left body controller: a302 CBC MIA";
CM_ SG_ 2013 VCLEFT_a302_CBC_UARTReset "Left body controller: a302 CBC UART reset";
CM_ SG_ 2013 VCLEFT_a302_DRVFault "Left body controller: a302 DRV fault";
CM_ SG_ 2013 VCLEFT_a303_eFuseTripCount "Left body controller: a303 e fuse trip count";
CM_ SG_ 2013 VCLEFT_a306_disconnectedTime "Left body controller: a306 disconnected time";
CM_ SG_ 2013 VCLEFT_a307_disconnectedTime "Left body controller: a307 disconnected time";
CM_ SG_ 2013 VCLEFT_a308_tamperDetected "Left body controller: a308 tamper detected";
CM_ SG_ 2013 VCLEFT_a309_5VMainVoltage "Left body controller: a309 5 v main voltage";
CM_ SG_ 2013 VCLEFT_a310_mirrorFoldTime "Left body controller: a310 mirror fold time";
CM_ SG_ 2013 VCLEFT_a310_foldingDirection "Left body controller: a310 folding direction";
CM_ SG_ 2013 VCLEFT_a310_mirrorMaxFoldCurrent "Left body controller: a310 mirror max fold current";
CM_ SG_ 2013 VCLEFT_a310_ambientTemperature "Left body controller: a310 ambient temperature";
CM_ SG_ 2013 VCLEFT_a311_outputFaulted "Left body controller: a311 output faulted";
CM_ SG_ 2013 VCLEFT_a311_currentSenseFaulted "Left body controller: a311 current sense faulted";
CM_ SG_ 2013 VCLEFT_a311_tempSenseFaulted "Left body controller: a311 temp sense faulted";
CM_ SG_ 2013 VCLEFT_a311_underCurrent "Left body controller: a311 under current";
CM_ SG_ 2013 VCLEFT_a311_overCurrent "Left body controller: a311 over current";
CM_ SG_ 2013 VCLEFT_a311_overTemperature "Left body controller: a311 over temperature";
CM_ SG_ 2013 VCLEFT_a312_outputFaulted "Left body controller: a312 output faulted";
CM_ SG_ 2013 VCLEFT_a312_currentSenseFaulted "Left body controller: a312 current sense faulted";
CM_ SG_ 2013 VCLEFT_a312_tempSenseFaulted "Left body controller: a312 temp sense faulted";
CM_ SG_ 2013 VCLEFT_a312_underCurrent "Left body controller: a312 under current";
CM_ SG_ 2013 VCLEFT_a312_overCurrent "Left body controller: a312 over current";
CM_ SG_ 2013 VCLEFT_a312_overTemperature "Left body controller: a312 over temperature";
CM_ SG_ 2013 VCLEFT_a313_outputFaulted "Left body controller: a313 output faulted";
CM_ SG_ 2013 VCLEFT_a313_currentSenseFaulted "Left body controller: a313 current sense faulted";
CM_ SG_ 2013 VCLEFT_a313_tempSenseFaulted "Left body controller: a313 temp sense faulted";
CM_ SG_ 2013 VCLEFT_a313_underCurrent "Left body controller: a313 under current";
CM_ SG_ 2013 VCLEFT_a313_overCurrent "Left body controller: a313 over current";
CM_ SG_ 2013 VCLEFT_a313_overTemperature "Left body controller: a313 over temperature";
CM_ SG_ 2013 VCLEFT_a314_outputFaulted "Left body controller: a314 output faulted";
CM_ SG_ 2013 VCLEFT_a314_currentSenseFaulted "Left body controller: a314 current sense faulted";
CM_ SG_ 2013 VCLEFT_a314_tempSenseFaulted "Left body controller: a314 temp sense faulted";
CM_ SG_ 2013 VCLEFT_a314_underCurrent "Left body controller: a314 under current";
CM_ SG_ 2013 VCLEFT_a314_overCurrent "Left body controller: a314 over current";
CM_ SG_ 2013 VCLEFT_a314_overTemperature "Left body controller: a314 over temperature";
CM_ SG_ 2013 VCLEFT_a315_outputFaulted "Left body controller: a315 output faulted";
CM_ SG_ 2013 VCLEFT_a315_currentSenseFaulted "Left body controller: a315 current sense faulted";
CM_ SG_ 2013 VCLEFT_a315_tempSenseFaulted "Left body controller: a315 temp sense faulted";
CM_ SG_ 2013 VCLEFT_a315_underCurrent "Left body controller: a315 under current";
CM_ SG_ 2013 VCLEFT_a315_overCurrent "Left body controller: a315 over current";
CM_ SG_ 2013 VCLEFT_a315_overTemperature "Left body controller: a315 over temperature";
CM_ SG_ 2013 VCLEFT_a316_foldState "Left body controller: a316 fold state";
CM_ SG_ 2013 VCLEFT_a316_actuationDurationMs "Left body controller: a316 actuation duration ms";
CM_ SG_ 2013 VCLEFT_a316_maxCurrentAmps "Left body controller: a316 max current amps";
CM_ SG_ 2013 VCLEFT_a316_averageCurrentAmps "Left body controller: a316 average current amps";
CM_ SG_ 2013 VCLEFT_a316_ambientTemperatureDe "Left body controller: a316 ambient temperature deg c";
CM_ SG_ 2013 VCLEFT_a318_configExpected "Left body controller: a318 config expected";
CM_ SG_ 2013 VCLEFT_a318_hardwareIdActual "Left body controller: a318 hardware id actual";
CM_ SG_ 2013 VCLEFT_a319_IBSTsOutputRodDriver "Left body controller: a319 IBS ts output rod driver";
CM_ SG_ 2013 VCLEFT_a319_IBSTsOutputRodD_0001 "Left body controller: a319 IBS ts output rod driver QF";
CM_ SG_ 2013 VCLEFT_a319_fallbackIndex "Left body controller: a319 fallback index";
CM_ SG_ 2013 VCLEFT_a324_mirrorHeatCurrent "Left body controller: a324 mirror heat current";
CM_ SG_ 2013 VCLEFT_a325_PWMdutyCycleFL "Left body controller: a325 PW mduty cycle FL";
CM_ SG_ 2013 VCLEFT_a325_PWMfrequencyFL "Left body controller: a325 PW mfrequency FL";
CM_ SG_ 2013 VCLEFT_a325_PWMfaultFL "Left body controller: a325 PW mfault FL";
CM_ SG_ 2013 VCLEFT_a326_PWMdutyCycleRL "Left body controller: a326 PW mduty cycle RL";
CM_ SG_ 2013 VCLEFT_a326_PWMfrequencyRL "Left body controller: a326 PW mfrequency RL";
CM_ SG_ 2013 VCLEFT_a326_PWMfaultRL "Left body controller: a326 PW mfault RL";
CM_ SG_ 2013 VCLEFT_a327_PWMdutyCycleFL "Left body controller: a327 PW mduty cycle FL";
CM_ SG_ 2013 VCLEFT_a327_PWMfrequencyFL "Left body controller: a327 PW mfrequency FL";
CM_ SG_ 2013 VCLEFT_a327_PWMfaultFL "Left body controller: a327 PW mfault FL";
CM_ SG_ 2013 VCLEFT_a328_PWMdutyCycleRL "Left body controller: a328 PW mduty cycle RL";
CM_ SG_ 2013 VCLEFT_a328_PWMfrequencyRL "Left body controller: a328 PW mfrequency RL";
CM_ SG_ 2013 VCLEFT_a328_PWMfaultRL "Left body controller: a328 PW mfault RL";
CM_ SG_ 2013 VCLEFT_a330_voltage "Left body controller: a330 voltage";
CM_ SG_ 2013 VCLEFT_a330_maxCurrent "Left body controller: a330 max current";
CM_ SG_ 2013 VCLEFT_a330_temperature "Left body controller: a330 temperature";
CM_ SG_ 2013 VCLEFT_a331_voltage "Left body controller: a331 voltage";
CM_ SG_ 2013 VCLEFT_a331_maxCurrent "Left body controller: a331 max current";
CM_ SG_ 2013 VCLEFT_a331_temperature "Left body controller: a331 temperature";
CM_ SG_ 2013 VCLEFT_a334_OHCDiagnosticMask "Left body controller: a334 OHC diagnostic mask";
CM_ SG_ 2013 VCLEFT_a335_USSSelfTestResult "Left body controller: a335 USS self test result";
CM_ SG_ 2013 VCLEFT_a335_EEPROMSelfTestResult "Left body controller: a335 EEPROM self test result";
CM_ SG_ 2013 VCLEFT_a335_LMSelfTestResult "Left body controller: a335 LM self test result";
CM_ SG_ 2013 VCLEFT_a335_SystemError "Left body controller: a335 system error";
CM_ SG_ 2013 VCLEFT_a335_SelfTestStatus "Left body controller: a335 self test status";
CM_ SG_ 2013 VCLEFT_a341_leftTurn "Left body controller: a341 left turn";
CM_ SG_ 2013 VCLEFT_a341_rightTurn "Left body controller: a341 right turn";
CM_ SG_ 2013 VCLEFT_a341_tail "Left body controller: a341 tail";
CM_ SG_ 2013 VCLEFT_a341_stop "Left body controller: a341 stop";
CM_ SG_ 2013 VCLEFT_a341_fog "Left body controller: a341 fog";
CM_ SG_ 2013 VCLEFT_a341_reverse "Left body controller: a341 reverse";
CM_ SG_ 2013 VCLEFT_a342_OverVoltage "Left body controller: a342 over voltage";
CM_ SG_ 2013 VCLEFT_a342_UnderVoltage "Left body controller: a342 under voltage";
CM_ SG_ 2013 VCLEFT_a342_5VRailStatus "Left body controller: a342 5 v rail status";
CM_ SG_ 2013 VCLEFT_a342_OverTemperature "Left body controller: a342 over temperature";
CM_ SG_ 2013 VCLEFT_a345_secondsSinceWakeUp "Left body controller: a345 seconds since wake up";
CM_ SG_ 2013 VCLEFT_a345_powerCycleCount "Left body controller: a345 power cycle count";
CM_ SG_ 2013 VCLEFT_a346_eFuseTripCount "Left body controller: a346 e fuse trip count";
CM_ SG_ 2013 VCLEFT_a348_current "Left body controller: a348 current";
CM_ SG_ 2013 VCLEFT_a349_voltage "Left body controller: a349 voltage";
CM_ SG_ 2013 VCLEFT_a350_ensPeriod "Left body controller: a350 ens period";
CM_ SG_ 2013 VCLEFT_a350_ensDuty "Left body controller: a350 ens duty";
CM_ SG_ 2013 VCLEFT_a350_ensTimedOut "Left body controller: a350 ens timed out";
CM_ SG_ 2013 VCLEFT_a352_liftgatePosition "Left body controller: a352 liftgate position";
CM_ SG_ 2013 VCLEFT_a352_liftgateVelocityNear "Left body controller: a352 liftgate velocity near latch";
CM_ SG_ 2013 VCLEFT_a352_liftgateClosingCount "Left body controller: a352 liftgate closing count";
CM_ SG_ 2013 VCLEFT_a352_liftgateClosingFaile "Left body controller: a352 liftgate closing failed count";
CM_ SG_ 2013 VCLEFT_a353_eFuseTripCount "Left body controller: a353 e fuse trip count";
CM_ SG_ 2013 VCLEFT_a354_eFuseTripCount "Left body controller: a354 e fuse trip count";
CM_ SG_ 2013 VCLEFT_a355_liftgateStoppingCond "Left body controller: a355 liftgate stopping condition";
CM_ SG_ 2013 VCLEFT_a355_liftgateLastState "Left body controller: a355 liftgate last state";
CM_ SG_ 2013 VCLEFT_a355_liftgatePosition "Left body controller: a355 liftgate position";
CM_ SG_ 2013 VCLEFT_a355_liftgateLatchStatus "Left body controller: a355 liftgate latch status";
CM_ SG_ 2013 VCLEFT_a355_ambientTemperature "Left body controller: a355 ambient temperature";
CM_ SG_ 2013 VCLEFT_a357_liftgateState "Left body controller: a357 liftgate state";
CM_ SG_ 2013 VCLEFT_a357_liftgatePosition "Left body controller: a357 liftgate position";
CM_ SG_ 2013 VCLEFT_a357_liftgateLatchStatus "Left body controller: a357 liftgate latch status";
CM_ SG_ 2013 VCLEFT_a373_windowChannel "Left body controller: a373 window channel";
CM_ SG_ 2013 VCLEFT_a374_leftTurn "Left body controller: a374 left turn";
CM_ SG_ 2013 VCLEFT_a374_rightTurn "Left body controller: a374 right turn";
CM_ SG_ 2013 VCLEFT_a374_tail "Left body controller: a374 tail";
CM_ SG_ 2013 VCLEFT_a374_brake "Left body controller: a374 brake";
CM_ SG_ 2013 VCLEFT_a374_fog "Left body controller: a374 fog";
CM_ SG_ 2013 VCLEFT_a374_reverse "Left body controller: a374 reverse";
CM_ SG_ 2013 VCLEFT_a374_trailerMode "Left body controller: a374 trailer mode";
CM_ SG_ 2013 VCLEFT_a375_windowFront "Left body controller: a375 window front";
CM_ SG_ 2013 VCLEFT_a376_2RowSeatTrackActuato "Left body controller: a376 2 row seat track actuator current";
CM_ SG_ 2013 VCLEFT_a376_2RowSeatTrackAc_0001 "Left body controller: a376 2 row seat track actuator duty";
CM_ SG_ 2013 VCLEFT_a376_2RowSeatEasyEntrySta "Left body controller: a376 2 row seat easy entry state";
CM_ SG_ 2013 VCLEFT_a376_2RowSeatTrackPositio "Left body controller: a376 2 row seat track position switch";
CM_ SG_ 2013 VCLEFT_a380_inOutAxis "Left body controller: a380 in out axis";
CM_ SG_ 2013 VCLEFT_a380_upDownAxis "Left body controller: a380 up down axis";
CM_ SG_ 2013 VCLEFT_a391_averageSpeed "Left body controller: a391 average speed";
CM_ SG_ 2013 VCLEFT_a391_averageGrade "Left body controller: a391 average grade";
CM_ SG_ 2013 VCLEFT_a391_averagePower "Left body controller: a391 average power";
CM_ SG_ 2013 VCLEFT_a391_massEstimate "Left body controller: a391 mass estimate";
CM_ SG_ 2013 VCLEFT_a391_pitchEstimateIMU "Left body controller: a391 pitch estimate IMU";
CM_ SG_ 2013 VCLEFT_a395_leftSteeringWheelSwi "Left body controller: a395 left steering wheel switch";
CM_ SG_ 2013 VCLEFT_a395_rightSteeringWheelSw "Left body controller: a395 right steering wheel switch";
CM_ SG_ 2013 VCLEFT_a396_button1Touch "Left body controller: a396 button1 touch";
CM_ SG_ 2013 VCLEFT_a396_button2Touch "Left body controller: a396 button2 touch";
CM_ SG_ 2013 VCLEFT_a396_button3Touch "Left body controller: a396 button3 touch";
CM_ SG_ 2013 VCLEFT_a396_button4Touch "Left body controller: a396 button4 touch";
CM_ SG_ 2013 VCLEFT_a396_button5Touch "Left body controller: a396 button5 touch";
CM_ SG_ 2013 VCLEFT_a396_button6Touch "Left body controller: a396 button6 touch";
CM_ SG_ 2013 VCLEFT_a397_button1Touch "Left body controller: a397 button1 touch";
CM_ SG_ 2013 VCLEFT_a397_button2Touch "Left body controller: a397 button2 touch";
CM_ SG_ 2013 VCLEFT_a397_button3Touch "Left body controller: a397 button3 touch";
CM_ SG_ 2013 VCLEFT_a397_button4Touch "Left body controller: a397 button4 touch";
CM_ SG_ 2013 VCLEFT_a397_button5Touch "Left body controller: a397 button5 touch";
CM_ SG_ 2013 VCLEFT_a397_button6Touch "Left body controller: a397 button6 touch";
CM_ SG_ 2013 VCLEFT_a398_button1Touch "Left body controller: a398 button1 touch";
CM_ SG_ 2013 VCLEFT_a398_button2Touch "Left body controller: a398 button2 touch";
CM_ SG_ 2013 VCLEFT_a398_button3Touch "Left body controller: a398 button3 touch";
CM_ SG_ 2013 VCLEFT_a398_button4Touch "Left body controller: a398 button4 touch";
CM_ SG_ 2013 VCLEFT_a398_button5Touch "Left body controller: a398 button5 touch";
CM_ SG_ 2013 VCLEFT_a398_button6Touch "Left body controller: a398 button6 touch";
CM_ SG_ 2013 VCLEFT_a399_leftSteeringWheelSwi "Left body controller: a399 left steering wheel switch";
CM_ SG_ 2013 VCLEFT_a399_rightSteeringWheelSw "Left body controller: a399 right steering wheel switch";
CM_ SG_ 2013 VCLEFT_a399_leftNormalizedNoiseV "Left body controller: a399 left normalized noise value";
CM_ SG_ 2013 VCLEFT_a399_rightNormalizedNoise "Left body controller: a399 right normalized noise value";
CM_ SG_ 2013 VCLEFT_a401_button1Status "Left body controller: a401 button1 status";
CM_ SG_ 2013 VCLEFT_a401_button2Status "Left body controller: a401 button2 status";
CM_ SG_ 2013 VCLEFT_a401_button3Status "Left body controller: a401 button3 status";
CM_ SG_ 2013 VCLEFT_a401_button4Status "Left body controller: a401 button4 status";
CM_ SG_ 2013 VCLEFT_a401_button5Status "Left body controller: a401 button5 status";
CM_ SG_ 2013 VCLEFT_a401_button6Status "Left body controller: a401 button6 status";
CM_ SG_ 2013 VCLEFT_a402_button1Status "Left body controller: a402 button1 status";
CM_ SG_ 2013 VCLEFT_a402_button2Status "Left body controller: a402 button2 status";
CM_ SG_ 2013 VCLEFT_a402_button3Status "Left body controller: a402 button3 status";
CM_ SG_ 2013 VCLEFT_a402_button4Status "Left body controller: a402 button4 status";
CM_ SG_ 2013 VCLEFT_a402_button5Status "Left body controller: a402 button5 status";
CM_ SG_ 2013 VCLEFT_a402_button6Status "Left body controller: a402 button6 status";
CM_ SG_ 2013 VCLEFT_a403_leftSteeringWheelSwi "Left body controller: a403 left steering wheel switch";
CM_ SG_ 2013 VCLEFT_a403_rightSteeringWheelSw "Left body controller: a403 right steering wheel switch";
CM_ SG_ 2013 VCLEFT_a404_leftSteeringWheelSwi "Left body controller: a404 left steering wheel switch";
CM_ SG_ 2013 VCLEFT_a404_rightSteeringWheelSw "Left body controller: a404 right steering wheel switch";
CM_ SG_ 2013 VCLEFT_a405_leftSteeringWheelSwi "Left body controller: a405 left steering wheel switch";
CM_ SG_ 2013 VCLEFT_a405_rightSteeringWheelSw "Left body controller: a405 right steering wheel switch";
CM_ SG_ 2013 VCLEFT_a406_leftSteeringWheelSwi "Left body controller: a406 left steering wheel switch";
CM_ SG_ 2013 VCLEFT_a406_rightSteeringWheelSw "Left body controller: a406 right steering wheel switch";
CM_ SG_ 2013 VCLEFT_a407_leftSteeringWheelSwi "Left body controller: a407 left steering wheel switch";
CM_ SG_ 2013 VCLEFT_a407_rightSteeringWheelSw "Left body controller: a407 right steering wheel switch";
CM_ SG_ 2013 VCLEFT_a409_leftScrollWheelFault "Left body controller: a409 left scroll wheel fault";
CM_ SG_ 2013 VCLEFT_a409_rightScrollWheelFaul "Left body controller: a409 right scroll wheel fault";
CM_ SG_ 2013 VCLEFT_a409_rightScrollWheelPrev "Left body controller: a409 right scroll wheel previous";
CM_ SG_ 2013 VCLEFT_a409_rightScrollWheelChal "Left body controller: a409 right scroll wheel challenge";
CM_ SG_ 2013 VCLEFT_a409_rightScrollWheelRaw0 "Left body controller: a409 right scroll wheel raw0";
CM_ SG_ 2013 VCLEFT_a409_rightScrollWheelRaw1 "Left body controller: a409 right scroll wheel raw1";
CM_ SG_ 2013 VCLEFT_a410_leftScrollWheelFault "Left body controller: a410 left scroll wheel fault";
CM_ SG_ 2013 VCLEFT_a410_rightScrollWheelFaul "Left body controller: a410 right scroll wheel fault";
CM_ SG_ 2013 VCLEFT_a411_leftScrollWheelFault "Left body controller: a411 left scroll wheel fault";
CM_ SG_ 2013 VCLEFT_a411_rightScrollWheelFaul "Left body controller: a411 right scroll wheel fault";
CM_ SG_ 2013 VCLEFT_a412_outputFaulted "Left body controller: a412 output faulted";
CM_ SG_ 2013 VCLEFT_a412_currentSenseFaulted "Left body controller: a412 current sense faulted";
CM_ SG_ 2013 VCLEFT_a412_tempSenseFaulted "Left body controller: a412 temp sense faulted";
CM_ SG_ 2013 VCLEFT_a412_underCurrent "Left body controller: a412 under current";
CM_ SG_ 2013 VCLEFT_a412_overCurrent "Left body controller: a412 over current";
CM_ SG_ 2013 VCLEFT_a412_overTemperature "Left body controller: a412 over temperature";
CM_ SG_ 2013 VCLEFT_a413_failureReason "Left body controller: a413 failure reason";
CM_ SG_ 2013 VCLEFT_a413_loadUnattemptedOnFai "Left body controller: a413 load unattempted on failure";
CM_ SG_ 2013 VCLEFT_a413_deviceStuckOnFailure "Left body controller: a413 device stuck on failure";
CM_ SG_ 2013 VCLEFT_a413_uvLoadshedVsenseDigI "Left body controller: a413 uv loadshed vsense dig in";
CM_ SG_ 2013 VCLEFT_a413_uvLoadshedVoltage "Left body controller: a413 uv loadshed voltage";
CM_ SG_ 2013 VCLEFT_a414_leftHapticMotorFault "Left body controller: a414 left haptic motor fault";
CM_ SG_ 2013 VCLEFT_a414_rightHapticMotorFaul "Left body controller: a414 right haptic motor fault";
CM_ SG_ 2013 VCLEFT_a415_leftVbatUndervoltage "Left body controller: a415 left vbat undervoltage fault";
CM_ SG_ 2013 VCLEFT_a415_rightVbatUndervoltag "Left body controller: a415 right vbat undervoltage fault";
CM_ SG_ 2013 VCLEFT_a415_leftVbatOvervoltageF "Left body controller: a415 left vbat overvoltage fault";
CM_ SG_ 2013 VCLEFT_a415_rightVbatOvervoltage "Left body controller: a415 right vbat overvoltage fault";
CM_ SG_ 2013 VCLEFT_a417_leftDomeTouch "Left body controller: a417 left dome touch";
CM_ SG_ 2013 VCLEFT_a417_parkButtonTouch "Left body controller: a417 park button touch";
CM_ SG_ 2013 VCLEFT_a417_reverseButtonTouch "Left body controller: a417 reverse button touch";
CM_ SG_ 2013 VCLEFT_a417_hazardButtonTouch "Left body controller: a417 hazard button touch";
CM_ SG_ 2013 VCLEFT_a417_neutralButtonTouch "Left body controller: a417 neutral button touch";
CM_ SG_ 2013 VCLEFT_a417_driveButtonTouch "Left body controller: a417 drive button touch";
CM_ SG_ 2013 VCLEFT_a417_rightDomeTouch "Left body controller: a417 right dome touch";
CM_ SG_ 2013 VCLEFT_a419_leftDomeTouch "Left body controller: a419 left dome touch";
CM_ SG_ 2013 VCLEFT_a419_parkButtonTouch "Left body controller: a419 park button touch";
CM_ SG_ 2013 VCLEFT_a419_reverseButtonTouch "Left body controller: a419 reverse button touch";
CM_ SG_ 2013 VCLEFT_a419_hazardButtonTouch "Left body controller: a419 hazard button touch";
CM_ SG_ 2013 VCLEFT_a419_neutralButtonTouch "Left body controller: a419 neutral button touch";
CM_ SG_ 2013 VCLEFT_a419_driveButtonTouch "Left body controller: a419 drive button touch";
CM_ SG_ 2013 VCLEFT_a419_rightDomeTouch "Left body controller: a419 right dome touch";
CM_ SG_ 2013 VCLEFT_a420_leftDomeTouch "Left body controller: a420 left dome touch";
CM_ SG_ 2013 VCLEFT_a420_parkButtonTouch "Left body controller: a420 park button touch";
CM_ SG_ 2013 VCLEFT_a420_reverseButtonTouch "Left body controller: a420 reverse button touch";
CM_ SG_ 2013 VCLEFT_a420_hazardButtonTouch "Left body controller: a420 hazard button touch";
CM_ SG_ 2013 VCLEFT_a420_neutralButtonTouch "Left body controller: a420 neutral button touch";
CM_ SG_ 2013 VCLEFT_a420_driveButtonTouch "Left body controller: a420 drive button touch";
CM_ SG_ 2013 VCLEFT_a420_rightDomeTouch "Left body controller: a420 right dome touch";
CM_ SG_ 2013 VCLEFT_a421_parkButtonForce "Left body controller: a421 park button force";
CM_ SG_ 2013 VCLEFT_a421_reverseButtonForce "Left body controller: a421 reverse button force";
CM_ SG_ 2013 VCLEFT_a421_hazardButtonForce "Left body controller: a421 hazard button force";
CM_ SG_ 2013 VCLEFT_a421_neutralButtonForce "Left body controller: a421 neutral button force";
CM_ SG_ 2013 VCLEFT_a421_driveButtonForce "Left body controller: a421 drive button force";
CM_ SG_ 2013 VCLEFT_a422_seat2RControllerStuc "Left body controller: a422 seat2 r controller stuck off";
CM_ SG_ 2013 VCLEFT_a422_auxSocketRearStuckOf "Left body controller: a422 aux socket rear stuck off";
CM_ SG_ 2013 VCLEFT_a422_seat2RAllHeatersStuc "Left body controller: a422 seat2 r all heaters stuck off";
CM_ SG_ 2013 VCLEFT_a422_trailerLightEcuStuck "Left body controller: a422 trailer light ecu stuck off";
CM_ SG_ 2013 VCLEFT_a422_accessoryFeed3StuckO "Left body controller: a422 accessory feed3 stuck off";
CM_ SG_ 2013 VCLEFT_a422_vbatProtFusedSeatStu "Left body controller: a422 vbat prot fused seat stuck off";
CM_ SG_ 2013 VCLEFT_a422_usbPortsStuckOff "Left body controller: a422 usb ports stuck off";
CM_ SG_ 2013 VCLEFT_a422_auxSocketFrontStuckO "Left body controller: a422 aux socket front stuck off";
CM_ SG_ 2013 VCLEFT_a422_lumbarEcuStuckOff "Left body controller: a422 lumbar ecu stuck off";
CM_ SG_ 2013 VCLEFT_a422_ambientRgbRightStuck "Left body controller: a422 ambient rgb right stuck off";
CM_ SG_ 2013 VCLEFT_a422_ambientRgbMiddleStuc "Left body controller: a422 ambient rgb middle stuck off";
CM_ SG_ 2013 VCLEFT_a422_ambientRgbLeftStuckO "Left body controller: a422 ambient rgb left stuck off";
CM_ SG_ 2013 VCLEFT_a422_door1rRgbStuckOff "Left body controller: a422 door1r rgb stuck off";
CM_ SG_ 2013 VCLEFT_a422_door2rRgbStuckOff "Left body controller: a422 door2r rgb stuck off";
CM_ SG_ 2013 VCLEFT_a422_seat1rVentFanBackres "Left body controller: a422 seat1r vent fan backrest stuck off";
CM_ SG_ 2013 VCLEFT_a422_seat1rVentFanCushion "Left body controller: a422 seat1r vent fan cushion stuck off";
CM_ SG_ 2013 VCLEFT_a422_trailerBrakeEcuStuck "Left body controller: a422 trailer brake ecu stuck off";
CM_ SG_ 2013 VCLEFT_a422_trailerAuxStuckOff "Left body controller: a422 trailer aux stuck off";
CM_ SG_ 2013 VCLEFT_a422_vbatFusedStuckOff "Left body controller: a422 vbat fused stuck off";
CM_ SG_ 2013 VCLEFT_a424_parkButtonLED "Left body controller: a424 park button LED";
CM_ SG_ 2013 VCLEFT_a424_reverseButtonLED "Left body controller: a424 reverse button LED";
CM_ SG_ 2013 VCLEFT_a424_neutralButtonLED "Left body controller: a424 neutral button LED";
CM_ SG_ 2013 VCLEFT_a424_driveButtonLED "Left body controller: a424 drive button LED";
CM_ SG_ 2013 VCLEFT_a424_commonButtonLED "Left body controller: a424 common button LED";
CM_ SG_ 2013 VCLEFT_a425_leftVisorLightStatus "Left body controller: a425 left visor light status";
CM_ SG_ 2013 VCLEFT_a425_rightVisorLightStatu "Left body controller: a425 right visor light status";
CM_ SG_ 2013 VCLEFT_a426_seatMotorCalibrated "Left body controller: a426 seat motor calibrated";
CM_ SG_ 2013 VCLEFT_a426_seatMotorCurrent "Left body controller: a426 seat motor current";
CM_ SG_ 2013 VCLEFT_a426_seatMotorPosReal "Left body controller: a426 seat motor pos real";
CM_ SG_ 2013 VCLEFT_a426_seatMotorState "Left body controller: a426 seat motor state";
CM_ SG_ 2013 VCLEFT_a426_seatSwitchBack "Left body controller: a426 seat switch back";
CM_ SG_ 2013 VCLEFT_a426_seatSwitchForward "Left body controller: a426 seat switch forward";
CM_ SG_ 2013 VCLEFT_a426_cabinTmp "Left body controller: a426 cabin tmp";
CM_ SG_ 2013 VCLEFT_a427_seatMotorCalibrated "Left body controller: a427 seat motor calibrated";
CM_ SG_ 2013 VCLEFT_a427_seatMotorCurrent "Left body controller: a427 seat motor current";
CM_ SG_ 2013 VCLEFT_a427_seatMotorPosReal "Left body controller: a427 seat motor pos real";
CM_ SG_ 2013 VCLEFT_a427_seatMotorState "Left body controller: a427 seat motor state";
CM_ SG_ 2013 VCLEFT_a427_seatSwitchBack "Left body controller: a427 seat switch back";
CM_ SG_ 2013 VCLEFT_a427_seatSwitchForward "Left body controller: a427 seat switch forward";
CM_ SG_ 2013 VCLEFT_a427_cabinTmp "Left body controller: a427 cabin tmp";
CM_ SG_ 2013 VCLEFT_a428_seatMotorCalibrated "Left body controller: a428 seat motor calibrated";
CM_ SG_ 2013 VCLEFT_a428_seatMotorCurrent "Left body controller: a428 seat motor current";
CM_ SG_ 2013 VCLEFT_a428_seatMotorPosReal "Left body controller: a428 seat motor pos real";
CM_ SG_ 2013 VCLEFT_a428_seatMotorState "Left body controller: a428 seat motor state";
CM_ SG_ 2013 VCLEFT_a428_seatSwitchBack "Left body controller: a428 seat switch back";
CM_ SG_ 2013 VCLEFT_a428_seatSwitchForward "Left body controller: a428 seat switch forward";
CM_ SG_ 2013 VCLEFT_a428_cabinTmp "Left body controller: a428 cabin tmp";
CM_ SG_ 2013 VCLEFT_a429_seatMotorCalibrated "Left body controller: a429 seat motor calibrated";
CM_ SG_ 2013 VCLEFT_a429_seatMotorCurrent "Left body controller: a429 seat motor current";
CM_ SG_ 2013 VCLEFT_a429_seatMotorPosReal "Left body controller: a429 seat motor pos real";
CM_ SG_ 2013 VCLEFT_a429_seatMotorState "Left body controller: a429 seat motor state";
CM_ SG_ 2013 VCLEFT_a429_seatSwitchBack "Left body controller: a429 seat switch back";
CM_ SG_ 2013 VCLEFT_a429_seatSwitchForward "Left body controller: a429 seat switch forward";
CM_ SG_ 2013 VCLEFT_a429_cabinTmp "Left body controller: a429 cabin tmp";
CM_ SG_ 2013 VCLEFT_a430_leftRearDomeLightPow "Left body controller: a430 left rear dome light power supply status";
CM_ SG_ 2013 VCLEFT_a430_rightRearDomeLightPo "Left body controller: a430 right rear dome light power supply status";
CM_ SG_ 2013 VCLEFT_a431_dcdcVoltageFailure "Left body controller: a431 dcdc voltage failure";
CM_ SG_ 2013 VCLEFT_a431_overVoltageDetected "Left body controller: a431 over voltage detected";
CM_ SG_ 2013 VCLEFT_a431_underVoltageDetected "Left body controller: a431 under voltage detected";
CM_ SG_ 2013 VCLEFT_a431_brownoutDetected "Left body controller: a431 brownout detected";
CM_ SG_ 2013 VCLEFT_a444_retriesAvailable "Left body controller: a444 retries available";
CM_ SG_ 2013 VCLEFT_a444_channel "Left body controller: a444 channel";
CM_ SG_ 2013 VCLEFT_a444_watchdog "Left body controller: a444 watchdog";
CM_ SG_ 2013 VCLEFT_a444_gateDriver "Left body controller: a444 gate driver";
CM_ SG_ 2013 VCLEFT_a444_overcurrent "Left body controller: a444 overcurrent";
CM_ SG_ 2013 VCLEFT_a444_supplyUndervoltage "Left body controller: a444 supply undervoltage";
CM_ SG_ 2013 VCLEFT_a444_cpUndervoltage "Left body controller: a444 cp undervoltage";
CM_ SG_ 2013 VCLEFT_a444_overTempShutdown "Left body controller: a444 over temp shutdown";
CM_ SG_ 2013 VCLEFT_a444_overTempWarning "Left body controller: a444 over temp warning";
CM_ SG_ 2013 VCLEFT_a444_highSide2GateDriver "Left body controller: a444 high side2 gate driver";
CM_ SG_ 2013 VCLEFT_a444_lowSide2GateDriver "Left body controller: a444 low side2 gate driver";
CM_ SG_ 2013 VCLEFT_a444_highSide1GateDriver "Left body controller: a444 high side1 gate driver";
CM_ SG_ 2013 VCLEFT_a444_lowSide1GateDriver "Left body controller: a444 low side1 gate driver";
CM_ SG_ 2013 VCLEFT_a444_highSide2OverCurent "Left body controller: a444 high side2 over curent";
CM_ SG_ 2013 VCLEFT_a444_lowSide2OverCurent "Left body controller: a444 low side2 over curent";
CM_ SG_ 2013 VCLEFT_a444_highSide1OverCurent "Left body controller: a444 high side1 over curent";
CM_ SG_ 2013 VCLEFT_a444_lowSide1OverCurent "Left body controller: a444 low side1 over curent";
CM_ SG_ 2013 VCLEFT_a444_spiInit "Left body controller: a444 spi init";
CM_ SG_ 2013 VCLEFT_a444_spiPeriodicCheck "Left body controller: a444 spi periodic check";
CM_ SG_ 2013 VCLEFT_a444_spiFault "Left body controller: a444 spi fault";
CM_ SG_ 2013 VCLEFT_a444_voltageMonitor "Left body controller: a444 voltage monitor";
CM_ SG_ 2013 VCLEFT_a444_enableLow "Left body controller: a444 enable low";
CM_ SG_ 2013 VCLEFT_a447_endstopPositionMM "Left body controller: a447 endstop position MM";
CM_ SG_ 2013 VCLEFT_a447_motorType "Left body controller: a447 motor type";
CM_ SG_ 2013 VCLEFT_a448_endstopPositionMM "Left body controller: a448 endstop position MM";
CM_ SG_ 2013 VCLEFT_a448_motorType "Left body controller: a448 motor type";
CM_ SG_ 2013 VCLEFT_a453_liftgatePosition "Left body controller: a453 liftgate position";
CM_ SG_ 2013 VCLEFT_a455_liftgateState "Left body controller: a455 liftgate state";
CM_ SG_ 2013 VCLEFT_a466_hvac2RLeftAirwaveVer "Left body controller: a466 hvac2 r left airwave vertical stall";
CM_ SG_ 2013 VCLEFT_a469_hvac2RLeftAirwaveLat "Left body controller: a469 hvac2 r left airwave lateral stall";
CM_ SG_ 2013 VCLEFT_a472_hvac2RRightAirwaveVe "Left body controller: a472 hvac2 r right airwave vertical stall";
CM_ SG_ 2013 VCLEFT_a475_hvac2RRightAirwaveLa "Left body controller: a475 hvac2 r right airwave lateral stall";
CM_ SG_ 2013 VCLEFT_a480_reset "Left body controller: a480 reset";
CM_ SG_ 2013 VCLEFT_a480_spiError "Left body controller: a480 spi error";
CM_ SG_ 2013 VCLEFT_a480_autoOn "Left body controller: a480 auto on";
CM_ SG_ 2013 VCLEFT_a480_diagnosticBit "Left body controller: a480 diagnostic bit";
CM_ SG_ 2013 VCLEFT_a480_deviceError "Left body controller: a480 device error";
CM_ SG_ 2013 VCLEFT_a480_overcurrent "Left body controller: a480 overcurrent";
CM_ SG_ 2013 VCLEFT_a480_unexpectedLock "Left body controller: a480 unexpected lock";
CM_ SG_ 2013 VCLEFT_a480_disableOutputFault "Left body controller: a480 disable output fault";
CM_ SG_ 2013 VCLEFT_a480_vsUndervoltage "Left body controller: a480 vs undervoltage";
CM_ SG_ 2013 VCLEFT_a480_hardShort "Left body controller: a480 hard short";
CM_ SG_ 2013 VCLEFT_a480_vdsMax "Left body controller: a480 vds max";
CM_ SG_ 2013 VCLEFT_a480_bypassSaturation "Left body controller: a480 bypass saturation";
CM_ SG_ 2013 VCLEFT_a480_fuseLatch "Left body controller: a480 fuse latch";
CM_ SG_ 2013 VCLEFT_a480_deviceOvertemperatur "Left body controller: a480 device overtemperature";
CM_ SG_ 2013 VCLEFT_a480_ntcOvertemperature "Left body controller: a480 ntc overtemperature";
CM_ SG_ 2013 VCLEFT_a480_vgsLow "Left body controller: a480 vgs low";
CM_ SG_ 2013 VCLEFT_a480_chargePumpLow "Left body controller: a480 charge pump low";
CM_ SG_ 2013 VCLEFT_a480_watchdog "Left body controller: a480 watchdog";
CM_ SG_ 2013 VCLEFT_a480_spiNotDone "Left body controller: a480 spi not done";
CM_ SG_ 2013 VCLEFT_a480_configIncorrect "Left body controller: a480 config incorrect";
CM_ SG_ 2013 VCLEFT_a480_bufferFull "Left body controller: a480 buffer full";
CM_ SG_ 2013 VCLEFT_a480_hitAlertRateLimit "Left body controller: a480 hit alert rate limit";
CM_ SG_ 2013 VCLEFT_a480_hwlo "Left body controller: a480 hwlo";
CM_ SG_ 2013 VCLEFT_a480_enable "Left body controller: a480 enable";
CM_ SG_ 2013 VCLEFT_a482_channel "Left body controller: a482 channel";
CM_ SG_ 2013 VCLEFT_a482_spiFault "Left body controller: a482 spi fault";
CM_ SG_ 2013 VCLEFT_a482_resetBar "Left body controller: a482 reset bar";
CM_ SG_ 2013 VCLEFT_a482_overTempShutdown "Left body controller: a482 over temp shutdown";
CM_ SG_ 2013 VCLEFT_a482_thermalWarning "Left body controller: a482 thermal warning";
CM_ SG_ 2013 VCLEFT_a482_underOrOverVoltageOr "Left body controller: a482 under or over voltage or over current";
CM_ SG_ 2013 VCLEFT_a482_underloadDetected "Left body controller: a482 underload detected";
CM_ SG_ 2013 VCLEFT_a485_seat2RControllerUnat "Left body controller: a485 seat2 r controller unattempted on";
CM_ SG_ 2013 VCLEFT_a485_auxSocketRearUnattem "Left body controller: a485 aux socket rear unattempted on";
CM_ SG_ 2013 VCLEFT_a485_seat2RAllHeatersUnat "Left body controller: a485 seat2 r all heaters unattempted on";
CM_ SG_ 2013 VCLEFT_a485_trailerLightEcuUnatt "Left body controller: a485 trailer light ecu unattempted on";
CM_ SG_ 2013 VCLEFT_a485_accessoryFeed3Unatte "Left body controller: a485 accessory feed3 unattempted on";
CM_ SG_ 2013 VCLEFT_a485_vbatProtFusedSeatUna "Left body controller: a485 vbat prot fused seat unattempted on";
CM_ SG_ 2013 VCLEFT_a485_usbPortsUnattemptedO "Left body controller: a485 usb ports unattempted on";
CM_ SG_ 2013 VCLEFT_a485_auxSocketFrontUnatte "Left body controller: a485 aux socket front unattempted on";
CM_ SG_ 2013 VCLEFT_a485_lumbarEcuUnattempted "Left body controller: a485 lumbar ecu unattempted on";
CM_ SG_ 2013 VCLEFT_a485_ambientRgbRightUnatt "Left body controller: a485 ambient rgb right unattempted on";
CM_ SG_ 2013 VCLEFT_a485_ambientRgbMiddleUnat "Left body controller: a485 ambient rgb middle unattempted on";
CM_ SG_ 2013 VCLEFT_a485_ambientRgbLeftUnatte "Left body controller: a485 ambient rgb left unattempted on";
CM_ SG_ 2013 VCLEFT_a485_door1rRgbUnattempted "Left body controller: a485 door1r rgb unattempted on";
CM_ SG_ 2013 VCLEFT_a485_door2rRgbUnattempted "Left body controller: a485 door2r rgb unattempted on";
CM_ SG_ 2013 VCLEFT_a485_seat1rVentFanBackres "Left body controller: a485 seat1r vent fan backrest unattempted on";
CM_ SG_ 2013 VCLEFT_a485_seat1rVentFanCushion "Left body controller: a485 seat1r vent fan cushion unattempted on";
CM_ SG_ 2013 VCLEFT_a485_trailerBrakeEcuUnatt "Left body controller: a485 trailer brake ecu unattempted on";
CM_ SG_ 2013 VCLEFT_a485_trailerAuxUnattempte "Left body controller: a485 trailer aux unattempted on";
CM_ SG_ 2013 VCLEFT_a485_vbatFusedUnattempted "Left body controller: a485 vbat fused unattempted on";
CM_ SG_ 2013 VCLEFT_a489_seat2RControllerStuc "Left body controller: a489 seat2 r controller stuck on";
CM_ SG_ 2013 VCLEFT_a489_auxSocketRearStuckOn "Left body controller: a489 aux socket rear stuck on";
CM_ SG_ 2013 VCLEFT_a489_seat2RAllHeatersStuc "Left body controller: a489 seat2 r all heaters stuck on";
CM_ SG_ 2013 VCLEFT_a489_trailerLightEcuStuck "Left body controller: a489 trailer light ecu stuck on";
CM_ SG_ 2013 VCLEFT_a489_accessoryFeed3StuckO "Left body controller: a489 accessory feed3 stuck on";
CM_ SG_ 2013 VCLEFT_a489_vbatProtFusedSeatStu "Left body controller: a489 vbat prot fused seat stuck on";
CM_ SG_ 2013 VCLEFT_a489_usbPortsStuckOn "Left body controller: a489 usb ports stuck on";
CM_ SG_ 2013 VCLEFT_a489_auxSocketFrontStuckO "Left body controller: a489 aux socket front stuck on";
CM_ SG_ 2013 VCLEFT_a489_lumbarEcuStuckOn "Left body controller: a489 lumbar ecu stuck on";
CM_ SG_ 2013 VCLEFT_a489_ambientRgbRightStuck "Left body controller: a489 ambient rgb right stuck on";
CM_ SG_ 2013 VCLEFT_a489_ambientRgbMiddleStuc "Left body controller: a489 ambient rgb middle stuck on";
CM_ SG_ 2013 VCLEFT_a489_ambientRgbLeftStuckO "Left body controller: a489 ambient rgb left stuck on";
CM_ SG_ 2013 VCLEFT_a489_door1rRgbStuckOn "Left body controller: a489 door1r rgb stuck on";
CM_ SG_ 2013 VCLEFT_a489_door2rRgbStuckOn "Left body controller: a489 door2r rgb stuck on";
CM_ SG_ 2013 VCLEFT_a489_seat1rVentFanBackres "Left body controller: a489 seat1r vent fan backrest stuck on";
CM_ SG_ 2013 VCLEFT_a489_seat1rVentFanCushion "Left body controller: a489 seat1r vent fan cushion stuck on";
CM_ SG_ 2013 VCLEFT_a489_trailerBrakeEcuStuck "Left body controller: a489 trailer brake ecu stuck on";
CM_ SG_ 2013 VCLEFT_a489_trailerAuxStuckOn "Left body controller: a489 trailer aux stuck on";
CM_ SG_ 2013 VCLEFT_a489_vbatFusedStuckOn "Left body controller: a489 vbat fused stuck on";
CM_ SG_ 2013 VCLEFT_a489_vbatProtVoltage "Left body controller: a489 vbat prot voltage";
CM_ SG_ 2013 VCLEFT_a489_loadshedCommonBusVol "Left body controller: a489 loadshed common bus voltage";
CM_ SG_ 2013 VCLEFT_a489_loadshedCommonBusMon "Left body controller: a489 loadshed common bus monitor ratio";
CM_ SG_ 2013 VCLEFT_a493_12vSocketFrontEFuseC "Left body controller: a493 12v socket front e fuse current";
CM_ SG_ 2013 VCLEFT_a494_12vSocketRearEFuseCu "Left body controller: a494 12v socket rear e fuse current";
CM_ SG_ 2013 VCLEFT_a497_ecuUnprovisioned "Left body controller: a497 ecu unprovisioned";
CM_ SG_ 2013 VCLEFT_a500_channel "Left body controller: a500 channel";
CM_ SG_ 2013 VCLEFT_a500_mismatchedState "Left body controller: a500 mismatched state";
CM_ SG_ 2013 VCLEFT_a510_isRearwardEndstopUnc "Left body controller: a510 is rearward endstop uncalibrated";
CM_ SG_ 2013 VCLEFT_a510_isAbsPosSensorUncali "Left body controller: a510 is abs pos sensor uncalibrated";
CM_ SG_ 2013 VCLEFT_a510_seatState "Left body controller: a510 seat state";
CM_ SG_ 2013 VCLEFT_a510_motorType "Left body controller: a510 motor type";
CM_ SG_ 2013 VCLEFT_a510_absPosSensState "Left body controller: a510 abs pos sens state";
CM_ SG_ 2013 VCLEFT_a513_calibrated "Left body controller: a513 calibrated";
CM_ SG_ 2013 VCLEFT_a513_angle "Left body controller: a513 angle";
CM_ SG_ 2013 VCLEFT_a513_seatStatePrev "Left body controller: a513 seat state prev";
CM_ SG_ 2013 VCLEFT_a513_obstacleDetectReason "Left body controller: a513 obstacle detect reason";
CM_ SG_ 2013 VCLEFT_a513_accelLookbackTripDep "Left body controller: a513 accel lookback trip depth";
CM_ SG_ 2013 VCLEFT_a513_duty "Left body controller: a513 duty";
CM_ SG_ 2013 VCLEFT_a513_currentAbsFilt "Left body controller: a513 current abs filt";
CM_ SG_ 2013 VCLEFT_a513_motorType "Left body controller: a513 motor type";
CM_ SG_ 2013 VCLEFT_a513_absolutePosSensorFor "Left body controller: a513 absolute pos sensor forward";
CM_ SG_ 2013 VCLEFT_a513_cabinTemp "Left body controller: a513 cabin temp";
CM_ SG_ 2013 VCLEFT_a517_isRearwardEndstopUnc "Left body controller: a517 is rearward endstop uncalibrated";
CM_ SG_ 2013 VCLEFT_a517_isAbsPosSensorUncali "Left body controller: a517 is abs pos sensor uncalibrated";
CM_ SG_ 2013 VCLEFT_a518_seatState "Left body controller: a518 seat state";
CM_ SG_ 2013 VCLEFT_a520_epbConfig "Left body controller: a520 epb config";
CM_ SG_ 2013 VCLEFT_a520_gtwEpbConfig "Left body controller: a520 gtw epb config";
CM_ SG_ 2013 VCLEFT_a523_channel "Left body controller: a523 channel";
CM_ SG_ 2013 VCLEFT_a523_control2Byte1 "Left body controller: a523 control2 byte1";
CM_ SG_ 2013 VCLEFT_a523_control2Byte2 "Left body controller: a523 control2 byte2";
CM_ SG_ 2013 VCLEFT_a523_control2Byte3 "Left body controller: a523 control2 byte3";
CM_ SG_ 2013 VCLEFT_a523_control3Byte2 "Left body controller: a523 control3 byte2";
CM_ SG_ 2013 VCLEFT_a523_control3Byte3 "Left body controller: a523 control3 byte3";
CM_ SG_ 2013 VCLEFT_a525_GTW_twelveVBatteryTy "Left body controller: a525 GTW twelve v battery type";
CM_ SG_ 2013 VCLEFT_a525_newLVBatteryType "Left body controller: a525 new LV battery type";
CM_ SG_ 2013 VCLEFT_a525_initialLVBatteryType "Left body controller: a525 initial LV battery type";
CM_ SG_ 2013 VCLEFT_a525_serviceMode "Signal reported by Left body controller";
CM_ SG_ 2013 VCLEFT_a525_factoryGated "Left body controller: a525 factory gated";
CM_ SG_ 2013 VCLEFT_a525_frunkOpen "Left body controller: a525 frunk open";
CM_ SG_ 2013 VCLEFT_a536_trunkFoldFlatSwitchS "Left body controller: a536 trunk fold flat switch state";
CM_ SG_ 2013 VCLEFT_a536_trunkFoldFlatLeftSwi "Left body controller: a536 trunk fold flat left switch voltage";
CM_ SG_ 2013 VCLEFT_a545_GTW_twelveVBatteryTy "Left body controller: a545 GTW twelve v battery type";
CM_ SG_ 2013 VCLEFT_a545_newLVBatteryType "Left body controller: a545 new LV battery type";
CM_ SG_ 2013 VCLEFT_a545_serviceMode "Signal reported by Left body controller";
CM_ SG_ 2013 VCLEFT_a545_factoryGated "Left body controller: a545 factory gated";
CM_ SG_ 2013 VCLEFT_a545_frunkOpen "Left body controller: a545 frunk open";
CM_ SG_ 2013 VCLEFT_a551_restrictDoorReleaseS "Left body controller: a551 restrict door release signal front";
CM_ SG_ 2013 VCLEFT_a551_interiorReleaseReqCo "Left body controller: a551 interior release req count front";
CM_ SG_ 2013 VCLEFT_a551_lastRequestSourceFro "Left body controller: a551 last request source front";
CM_ SG_ 2013 VCLEFT_a551_restrictDoorRel_0001 "Left body controller: a551 restrict door release signal rear";
CM_ SG_ 2013 VCLEFT_a551_interiorRelease_0001 "Left body controller: a551 interior release req count rear";
CM_ SG_ 2013 VCLEFT_a551_lastRequestSourceRea "Left body controller: a551 last request source rear";
CM_ SG_ 2013 VCLEFT_a555_heaterPWMCommand "Left body controller: a555 heater PWM command";
CM_ SG_ 2013 VCLEFT_a555_ntcTemperature "Left body controller: a555 ntc temperature";
CM_ SG_ 2013 VCLEFT_a560_isRearwardEndstopUnc "Left body controller: a560 is rearward endstop uncalibrated";
CM_ SG_ 2013 VCLEFT_a560_isAbsPosSensorUncali "Left body controller: a560 is abs pos sensor uncalibrated";
CM_ SG_ 2013 VCLEFT_a560_seatState "Left body controller: a560 seat state";
CM_ SG_ 2013 VCLEFT_a560_motorType "Left body controller: a560 motor type";
CM_ SG_ 2013 VCLEFT_a560_absPosSensState "Left body controller: a560 abs pos sens state";
CM_ SG_ 2013 VCLEFT_a563_calibrated "Left body controller: a563 calibrated";
CM_ SG_ 2013 VCLEFT_a563_angle "Left body controller: a563 angle";
CM_ SG_ 2013 VCLEFT_a563_seatStatePrev "Left body controller: a563 seat state prev";
CM_ SG_ 2013 VCLEFT_a563_obstacleDetectReason "Left body controller: a563 obstacle detect reason";
CM_ SG_ 2013 VCLEFT_a563_accelLookbackTripDep "Left body controller: a563 accel lookback trip depth";
CM_ SG_ 2013 VCLEFT_a563_duty "Left body controller: a563 duty";
CM_ SG_ 2013 VCLEFT_a563_currentAbsFilt "Left body controller: a563 current abs filt";
CM_ SG_ 2013 VCLEFT_a563_motorType "Left body controller: a563 motor type";
CM_ SG_ 2013 VCLEFT_a563_absolutePosSensorFor "Left body controller: a563 absolute pos sensor forward";
CM_ SG_ 2013 VCLEFT_a563_cabinTemp "Left body controller: a563 cabin temp";
CM_ SG_ 2013 VCLEFT_a567_isRearwardEndstopUnc "Left body controller: a567 is rearward endstop uncalibrated";
CM_ SG_ 2013 VCLEFT_a567_isAbsPosSensorUncali "Left body controller: a567 is abs pos sensor uncalibrated";
CM_ SG_ 2013 VCLEFT_a568_seatState "Left body controller: a568 seat state";
CM_ SG_ 2013 VCLEFT_a570_seatHeatCurrent "Left body controller: a570 seat heat current";
CM_ SG_ 2013 VCLEFT_a570_seatHeatTmp "Left body controller: a570 seat heat tmp";
CM_ SG_ 2013 VCLEFT_a571_seatHeatCurrent "Left body controller: a571 seat heat current";
CM_ SG_ 2013 VCLEFT_a571_seatHeatTmp "Left body controller: a571 seat heat tmp";
CM_ SG_ 2013 VCLEFT_a572_seatHeatCurrent "Left body controller: a572 seat heat current";
CM_ SG_ 2013 VCLEFT_a572_seatHeatTmp "Left body controller: a572 seat heat tmp";
CM_ SG_ 2013 VCLEFT_a573_seatHeatCurrent "Left body controller: a573 seat heat current";
CM_ SG_ 2013 VCLEFT_a573_seatHeatTmp "Left body controller: a573 seat heat tmp";
CM_ SG_ 2013 VCLEFT_a577_outputFaulted "Left body controller: a577 output faulted";
CM_ SG_ 2013 VCLEFT_a577_currentSenseFaulted "Left body controller: a577 current sense faulted";
CM_ SG_ 2013 VCLEFT_a577_tempSenseFaulted "Left body controller: a577 temp sense faulted";
CM_ SG_ 2013 VCLEFT_a577_underCurrent "Left body controller: a577 under current";
CM_ SG_ 2013 VCLEFT_a577_overCurrent "Left body controller: a577 over current";
CM_ SG_ 2013 VCLEFT_a577_overTemperature "Left body controller: a577 over temperature";
CM_ SG_ 2013 VCLEFT_a578_openCircuitDashFL "Left body controller: a578 open circuit dash FL";
CM_ SG_ 2013 VCLEFT_a578_shortCircuitDashFL "Left body controller: a578 short circuit dash FL";
CM_ SG_ 2013 VCLEFT_a578_miaDashFL "Left body controller: a578 mia dash FL";
CM_ SG_ 2013 VCLEFT_a578_openCircuitDashFR "Left body controller: a578 open circuit dash FR";
CM_ SG_ 2013 VCLEFT_a578_shortCircuitDashFR "Left body controller: a578 short circuit dash FR";
CM_ SG_ 2013 VCLEFT_a578_miaDashFR "Left body controller: a578 mia dash FR";
CM_ SG_ 2013 VCLEFT_a578_openCircuitDoorFL "Left body controller: a578 open circuit door FL";
CM_ SG_ 2013 VCLEFT_a578_shortCircuitDoorFL "Left body controller: a578 short circuit door FL";
CM_ SG_ 2013 VCLEFT_a578_miaDoorFL "Left body controller: a578 mia door FL";
CM_ SG_ 2013 VCLEFT_a578_openCircuitDoorRL "Left body controller: a578 open circuit door RL";
CM_ SG_ 2013 VCLEFT_a578_shortCircuitDoorRL "Left body controller: a578 short circuit door RL";
CM_ SG_ 2013 VCLEFT_a578_miaDoorRL "Left body controller: a578 mia door RL";
CM_ SG_ 2013 VCLEFT_a579_gtwConfigType "Left body controller: a579 gtw config type";
CM_ SG_ 2013 VCLEFT_a579_installedHwid "Left body controller: a579 installed hwid";
CM_ SG_ 2013 VCLEFT_a580_gtwConfigType "Left body controller: a580 gtw config type";
CM_ SG_ 2013 VCLEFT_a580_installedHwid "Left body controller: a580 installed hwid";
CM_ SG_ 2013 VCLEFT_a581_outputFaulted "Left body controller: a581 output faulted";
CM_ SG_ 2013 VCLEFT_a581_currentSenseFaulted "Left body controller: a581 current sense faulted";
CM_ SG_ 2013 VCLEFT_a581_tempSenseFaulted "Left body controller: a581 temp sense faulted";
CM_ SG_ 2013 VCLEFT_a581_underCurrent "Left body controller: a581 under current";
CM_ SG_ 2013 VCLEFT_a581_overCurrent "Left body controller: a581 over current";
CM_ SG_ 2013 VCLEFT_a581_overTemperature "Left body controller: a581 over temperature";
CM_ SG_ 2013 VCLEFT_a582_outputCurrent "Left body controller: a582 output current";
CM_ SG_ 2013 VCLEFT_a585_ambientTemp "Left body controller: a585 ambient temp";
CM_ SG_ 2013 VCLEFT_a586_ambientTemp "Left body controller: a586 ambient temp";
CM_ SG_ 2013 VCLEFT_a587_VEH_seatStatus2 "Left body controller: a587 VEH seat status2";
CM_ SG_ 2013 VCLEFT_a587_VEH_switchStatus "Left body controller: a587 VEH switch status";
CM_ SG_ 2013 VCLEFT_a590_seatMotorCalibrated "Left body controller: a590 seat motor calibrated";
CM_ SG_ 2013 VCLEFT_a590_seatMotorCurrent "Left body controller: a590 seat motor current";
CM_ SG_ 2013 VCLEFT_a590_seatMotorState "Left body controller: a590 seat motor state";
CM_ SG_ 2013 VCLEFT_a590_seatSwitchBack "Left body controller: a590 seat switch back";
CM_ SG_ 2013 VCLEFT_a590_seatSwitchForward "Left body controller: a590 seat switch forward";
CM_ SG_ 2013 VCLEFT_a591_seatMotorCurrent "Left body controller: a591 seat motor current";
CM_ SG_ 2013 VCLEFT_a591_seatMotorPosReal "Left body controller: a591 seat motor pos real";
CM_ SG_ 2013 VCLEFT_a591_seatMotorState "Left body controller: a591 seat motor state";
CM_ SG_ 2013 VCLEFT_a591_seatSwitchBack "Left body controller: a591 seat switch back";
CM_ SG_ 2013 VCLEFT_a591_seatSwitchForward "Left body controller: a591 seat switch forward";
CM_ SG_ 2013 VCLEFT_a592_seatMotorCurrent "Left body controller: a592 seat motor current";
CM_ SG_ 2013 VCLEFT_a592_seatMotorPosReal "Left body controller: a592 seat motor pos real";
CM_ SG_ 2013 VCLEFT_a592_seatMotorState "Left body controller: a592 seat motor state";
CM_ SG_ 2013 VCLEFT_a592_seatSwitchBack "Left body controller: a592 seat switch back";
CM_ SG_ 2013 VCLEFT_a592_seatSwitchForward "Left body controller: a592 seat switch forward";
CM_ SG_ 2013 VCLEFT_a593_seatMotorCalibrated "Left body controller: a593 seat motor calibrated";
CM_ SG_ 2013 VCLEFT_a593_seatMotorCurrent "Left body controller: a593 seat motor current";
CM_ SG_ 2013 VCLEFT_a593_seatMotorPosReal "Left body controller: a593 seat motor pos real";
CM_ SG_ 2013 VCLEFT_a593_seatMotorState "Left body controller: a593 seat motor state";
CM_ SG_ 2013 VCLEFT_a593_seatSwitchBack "Left body controller: a593 seat switch back";
CM_ SG_ 2013 VCLEFT_a593_seatSwitchForward "Left body controller: a593 seat switch forward";
CM_ SG_ 2013 VCLEFT_a594_seatMotorCurrent "Left body controller: a594 seat motor current";
CM_ SG_ 2013 VCLEFT_a594_seatMotorDCurrent "Left body controller: a594 seat motor d current";
CM_ SG_ 2013 VCLEFT_a594_seatMotorPosReal "Left body controller: a594 seat motor pos real";
CM_ SG_ 2013 VCLEFT_a594_seatMotorState "Left body controller: a594 seat motor state";
CM_ SG_ 2013 VCLEFT_a595_seatMotorCurrent "Left body controller: a595 seat motor current";
CM_ SG_ 2013 VCLEFT_a595_seatMotorDCurrent "Left body controller: a595 seat motor d current";
CM_ SG_ 2013 VCLEFT_a595_seatMotorPosReal "Left body controller: a595 seat motor pos real";
CM_ SG_ 2013 VCLEFT_a595_seatMotorState "Left body controller: a595 seat motor state";
CM_ SG_ 2013 VCLEFT_a596_frontDoorLatchAjarSw "Left body controller: a596 front door latch ajar switch voltage";
CM_ SG_ 2013 VCLEFT_a597_rearDoorLatchAjarSwi "Left body controller: a597 rear door latch ajar switch voltage";
CM_ SG_ 2013 VCLEFT_a599_GTW_twelveVBatteryTy "Left body controller: a599 GTW twelve v battery type";
CM_ SG_ 2013 VCLEFT_a599_newLVBatteryType "Left body controller: a599 new LV battery type";
CM_ SG_ 2013 VCLEFT_a599_initialLVBatteryType "Left body controller: a599 initial LV battery type";
CM_ SG_ 2013 VCLEFT_a599_serviceMode "Signal reported by Left body controller";
CM_ SG_ 2013 VCLEFT_a599_factoryGated "Left body controller: a599 factory gated";
CM_ SG_ 2013 VCLEFT_a599_frunkOpen "Left body controller: a599 frunk open";
CM_ SG_ 2013 VCLEFT_a605_excessiveMacFailures "Left body controller: a605 excessive mac failures";
BA_DEF_ BO_ "GenMsgCycleTime" INT 0 3600000;
BA_DEF_ BO_ "GenMsgSendType" ENUM "Cyclic","NotUsed","NotUsed","NotUsed","NotUsed","NotUsed","NotUsed","IfActive","NoMsgSendType","NotUsed";
BA_DEF_ BO_ "VFrameFormat" ENUM "StandardCAN","ExtendedCAN","reserved","J1939PG","reserved","reserved","reserved","reserved","reserved","reserved","reserved","reserved","reserved","reserved","StandardCAN_FD","ExtendedCAN_FD";
BA_DEF_ BO_ "CANFD_BRS" ENUM "0","1";
BA_DEF_ SG_ "SystemSignalLongSymbol" STRING;
BA_DEF_ SG_ "Confidence" ENUM "layout-only","plausible","validated";
BA_DEF_DEF_ "GenMsgCycleTime" 0;
BA_DEF_DEF_ "GenMsgSendType" "NoMsgSendType";
BA_DEF_DEF_ "VFrameFormat" "StandardCAN";
BA_DEF_DEF_ "CANFD_BRS" "1";
BA_DEF_DEF_ "SystemSignalLongSymbol" "";
BA_DEF_DEF_ "Confidence" "layout-only";
BA_ "SystemSignalLongSymbol" SG_ 2013 VCLEFT_a120_PARTY_vehicleEstimat "VCLEFT_a120_PARTY_vehicleEstimates";
BA_ "SystemSignalLongSymbol" SG_ 2013 VCLEFT_a120_VEH_aggregatedAxleSp "VCLEFT_a120_VEH_aggregatedAxleSpeed";
BA_ "SystemSignalLongSymbol" SG_ 2013 VCLEFT_a120_PARTY_aggregatedAxle "VCLEFT_a120_PARTY_aggregatedAxleSpeed";
BA_ "SystemSignalLongSymbol" SG_ 2013 VCLEFT_a120_PARTY_stalklessInter "VCLEFT_a120_PARTY_stalklessInterfaces";
BA_ "SystemSignalLongSymbol" SG_ 2013 VCLEFT_a120_VEH_estimatedBrakeTe "VCLEFT_a120_VEH_estimatedBrakeTemp";
BA_ "SystemSignalLongSymbol" SG_ 2013 VCLEFT_a123_OBD_alcoholInterlock "VCLEFT_a123_OBD_alcoholInterlockRequest";
BA_ "SystemSignalLongSymbol" SG_ 2013 VCLEFT_a192_supplyVoltageIrratio "VCLEFT_a192_supplyVoltageIrrational";
BA_ "SystemSignalLongSymbol" SG_ 2013 VCLEFT_a192_motorPhaseCurrentIrr "VCLEFT_a192_motorPhaseCurrentIrrational";
BA_ "SystemSignalLongSymbol" SG_ 2013 VCLEFT_a194_configurationMismatc "VCLEFT_a194_configurationMismatch";
BA_ "SystemSignalLongSymbol" SG_ 2013 VCLEFT_a194_vcbldcMotorTypeUnkno "VCLEFT_a194_vcbldcMotorTypeUnknown";
BA_ "SystemSignalLongSymbol" SG_ 2013 VCLEFT_a194_nvramMotorTypeUnknow "VCLEFT_a194_nvramMotorTypeUnknown";
BA_ "SystemSignalLongSymbol" SG_ 2013 VCLEFT_a221_loadshedFromBattMoni "VCLEFT_a221_loadshedFromBattMonitor";
BA_ "SystemSignalLongSymbol" SG_ 2013 VCLEFT_a302_TMS320OverTempShutDw "VCLEFT_a302_TMS320OverTempShutDwn";
BA_ "SystemSignalLongSymbol" SG_ 2013 VCLEFT_a316_ambientTemperatureDe "VCLEFT_a316_ambientTemperatureDegC";
BA_ "SystemSignalLongSymbol" SG_ 2013 VCLEFT_a319_IBSTsOutputRodD_0001 "VCLEFT_a319_IBSTsOutputRodDriverQF";
BA_ "SystemSignalLongSymbol" SG_ 2013 VCLEFT_a352_liftgateVelocityNear "VCLEFT_a352_liftgateVelocityNearLatch";
BA_ "SystemSignalLongSymbol" SG_ 2013 VCLEFT_a352_liftgateClosingFaile "VCLEFT_a352_liftgateClosingFailedCount";
BA_ "SystemSignalLongSymbol" SG_ 2013 VCLEFT_a355_liftgateStoppingCond "VCLEFT_a355_liftgateStoppingCondition";
BA_ "SystemSignalLongSymbol" SG_ 2013 VCLEFT_a376_2RowSeatTrackActuato "VCLEFT_a376_2RowSeatTrackActuatorCurrent";
BA_ "SystemSignalLongSymbol" SG_ 2013 VCLEFT_a376_2RowSeatTrackAc_0001 "VCLEFT_a376_2RowSeatTrackActuatorDuty";
BA_ "SystemSignalLongSymbol" SG_ 2013 VCLEFT_a376_2RowSeatEasyEntrySta "VCLEFT_a376_2RowSeatEasyEntryState";
BA_ "SystemSignalLongSymbol" SG_ 2013 VCLEFT_a376_2RowSeatTrackPositio "VCLEFT_a376_2RowSeatTrackPositionSwitch";
BA_ "SystemSignalLongSymbol" SG_ 2013 VCLEFT_a395_leftSteeringWheelSwi "VCLEFT_a395_leftSteeringWheelSwitch";
BA_ "SystemSignalLongSymbol" SG_ 2013 VCLEFT_a395_rightSteeringWheelSw "VCLEFT_a395_rightSteeringWheelSwitch";
BA_ "SystemSignalLongSymbol" SG_ 2013 VCLEFT_a399_leftSteeringWheelSwi "VCLEFT_a399_leftSteeringWheelSwitch";
BA_ "SystemSignalLongSymbol" SG_ 2013 VCLEFT_a399_rightSteeringWheelSw "VCLEFT_a399_rightSteeringWheelSwitch";
BA_ "SystemSignalLongSymbol" SG_ 2013 VCLEFT_a399_leftNormalizedNoiseV "VCLEFT_a399_leftNormalizedNoiseValue";
BA_ "SystemSignalLongSymbol" SG_ 2013 VCLEFT_a399_rightNormalizedNoise "VCLEFT_a399_rightNormalizedNoiseValue";
BA_ "SystemSignalLongSymbol" SG_ 2013 VCLEFT_a403_leftSteeringWheelSwi "VCLEFT_a403_leftSteeringWheelSwitch";
BA_ "SystemSignalLongSymbol" SG_ 2013 VCLEFT_a403_rightSteeringWheelSw "VCLEFT_a403_rightSteeringWheelSwitch";
BA_ "SystemSignalLongSymbol" SG_ 2013 VCLEFT_a404_leftSteeringWheelSwi "VCLEFT_a404_leftSteeringWheelSwitch";
BA_ "SystemSignalLongSymbol" SG_ 2013 VCLEFT_a404_rightSteeringWheelSw "VCLEFT_a404_rightSteeringWheelSwitch";
BA_ "SystemSignalLongSymbol" SG_ 2013 VCLEFT_a405_leftSteeringWheelSwi "VCLEFT_a405_leftSteeringWheelSwitch";
BA_ "SystemSignalLongSymbol" SG_ 2013 VCLEFT_a405_rightSteeringWheelSw "VCLEFT_a405_rightSteeringWheelSwitch";
BA_ "SystemSignalLongSymbol" SG_ 2013 VCLEFT_a406_leftSteeringWheelSwi "VCLEFT_a406_leftSteeringWheelSwitch";
BA_ "SystemSignalLongSymbol" SG_ 2013 VCLEFT_a406_rightSteeringWheelSw "VCLEFT_a406_rightSteeringWheelSwitch";
BA_ "SystemSignalLongSymbol" SG_ 2013 VCLEFT_a407_leftSteeringWheelSwi "VCLEFT_a407_leftSteeringWheelSwitch";
BA_ "SystemSignalLongSymbol" SG_ 2013 VCLEFT_a407_rightSteeringWheelSw "VCLEFT_a407_rightSteeringWheelSwitch";
BA_ "SystemSignalLongSymbol" SG_ 2013 VCLEFT_a409_rightScrollWheelFaul "VCLEFT_a409_rightScrollWheelFault";
BA_ "SystemSignalLongSymbol" SG_ 2013 VCLEFT_a409_rightScrollWheelPrev "VCLEFT_a409_rightScrollWheelPrevious";
BA_ "SystemSignalLongSymbol" SG_ 2013 VCLEFT_a409_rightScrollWheelChal "VCLEFT_a409_rightScrollWheelChallenge";
BA_ "SystemSignalLongSymbol" SG_ 2013 VCLEFT_a410_rightScrollWheelFaul "VCLEFT_a410_rightScrollWheelFault";
BA_ "SystemSignalLongSymbol" SG_ 2013 VCLEFT_a411_rightScrollWheelFaul "VCLEFT_a411_rightScrollWheelFault";
BA_ "SystemSignalLongSymbol" SG_ 2013 VCLEFT_a413_loadUnattemptedOnFai "VCLEFT_a413_loadUnattemptedOnFailure";
BA_ "SystemSignalLongSymbol" SG_ 2013 VCLEFT_a413_uvLoadshedVsenseDigI "VCLEFT_a413_uvLoadshedVsenseDigIn";
BA_ "SystemSignalLongSymbol" SG_ 2013 VCLEFT_a414_rightHapticMotorFaul "VCLEFT_a414_rightHapticMotorFault";
BA_ "SystemSignalLongSymbol" SG_ 2013 VCLEFT_a415_leftVbatUndervoltage "VCLEFT_a415_leftVbatUndervoltageFault";
BA_ "SystemSignalLongSymbol" SG_ 2013 VCLEFT_a415_rightVbatUndervoltag "VCLEFT_a415_rightVbatUndervoltageFault";
BA_ "SystemSignalLongSymbol" SG_ 2013 VCLEFT_a415_leftVbatOvervoltageF "VCLEFT_a415_leftVbatOvervoltageFault";
BA_ "SystemSignalLongSymbol" SG_ 2013 VCLEFT_a415_rightVbatOvervoltage "VCLEFT_a415_rightVbatOvervoltageFault";
BA_ "SystemSignalLongSymbol" SG_ 2013 VCLEFT_a422_seat2RControllerStuc "VCLEFT_a422_seat2RControllerStuckOff";
BA_ "SystemSignalLongSymbol" SG_ 2013 VCLEFT_a422_auxSocketRearStuckOf "VCLEFT_a422_auxSocketRearStuckOff";
BA_ "SystemSignalLongSymbol" SG_ 2013 VCLEFT_a422_seat2RAllHeatersStuc "VCLEFT_a422_seat2RAllHeatersStuckOff";
BA_ "SystemSignalLongSymbol" SG_ 2013 VCLEFT_a422_trailerLightEcuStuck "VCLEFT_a422_trailerLightEcuStuckOff";
BA_ "SystemSignalLongSymbol" SG_ 2013 VCLEFT_a422_accessoryFeed3StuckO "VCLEFT_a422_accessoryFeed3StuckOff";
BA_ "SystemSignalLongSymbol" SG_ 2013 VCLEFT_a422_vbatProtFusedSeatStu "VCLEFT_a422_vbatProtFusedSeatStuckOff";
BA_ "SystemSignalLongSymbol" SG_ 2013 VCLEFT_a422_auxSocketFrontStuckO "VCLEFT_a422_auxSocketFrontStuckOff";
BA_ "SystemSignalLongSymbol" SG_ 2013 VCLEFT_a422_ambientRgbRightStuck "VCLEFT_a422_ambientRgbRightStuckOff";
BA_ "SystemSignalLongSymbol" SG_ 2013 VCLEFT_a422_ambientRgbMiddleStuc "VCLEFT_a422_ambientRgbMiddleStuckOff";
BA_ "SystemSignalLongSymbol" SG_ 2013 VCLEFT_a422_ambientRgbLeftStuckO "VCLEFT_a422_ambientRgbLeftStuckOff";
BA_ "SystemSignalLongSymbol" SG_ 2013 VCLEFT_a422_seat1rVentFanBackres "VCLEFT_a422_seat1rVentFanBackrestStuckOff";
BA_ "SystemSignalLongSymbol" SG_ 2013 VCLEFT_a422_seat1rVentFanCushion "VCLEFT_a422_seat1rVentFanCushionStuckOff";
BA_ "SystemSignalLongSymbol" SG_ 2013 VCLEFT_a422_trailerBrakeEcuStuck "VCLEFT_a422_trailerBrakeEcuStuckOff";
BA_ "SystemSignalLongSymbol" SG_ 2013 VCLEFT_a425_rightVisorLightStatu "VCLEFT_a425_rightVisorLightStatus";
BA_ "SystemSignalLongSymbol" SG_ 2013 VCLEFT_a430_leftRearDomeLightPow "VCLEFT_a430_leftRearDomeLightPowerSupplyStatus";
BA_ "SystemSignalLongSymbol" SG_ 2013 VCLEFT_a430_rightRearDomeLightPo "VCLEFT_a430_rightRearDomeLightPowerSupplyStatus";
BA_ "SystemSignalLongSymbol" SG_ 2013 VCLEFT_a466_hvac2RLeftAirwaveVer "VCLEFT_a466_hvac2RLeftAirwaveVerticalStall";
BA_ "SystemSignalLongSymbol" SG_ 2013 VCLEFT_a469_hvac2RLeftAirwaveLat "VCLEFT_a469_hvac2RLeftAirwaveLateralStall";
BA_ "SystemSignalLongSymbol" SG_ 2013 VCLEFT_a472_hvac2RRightAirwaveVe "VCLEFT_a472_hvac2RRightAirwaveVerticalStall";
BA_ "SystemSignalLongSymbol" SG_ 2013 VCLEFT_a475_hvac2RRightAirwaveLa "VCLEFT_a475_hvac2RRightAirwaveLateralStall";
BA_ "SystemSignalLongSymbol" SG_ 2013 VCLEFT_a480_deviceOvertemperatur "VCLEFT_a480_deviceOvertemperature";
BA_ "SystemSignalLongSymbol" SG_ 2013 VCLEFT_a482_underOrOverVoltageOr "VCLEFT_a482_underOrOverVoltageOrOverCurrent";
BA_ "SystemSignalLongSymbol" SG_ 2013 VCLEFT_a485_seat2RControllerUnat "VCLEFT_a485_seat2RControllerUnattemptedOn";
BA_ "SystemSignalLongSymbol" SG_ 2013 VCLEFT_a485_auxSocketRearUnattem "VCLEFT_a485_auxSocketRearUnattemptedOn";
BA_ "SystemSignalLongSymbol" SG_ 2013 VCLEFT_a485_seat2RAllHeatersUnat "VCLEFT_a485_seat2RAllHeatersUnattemptedOn";
BA_ "SystemSignalLongSymbol" SG_ 2013 VCLEFT_a485_trailerLightEcuUnatt "VCLEFT_a485_trailerLightEcuUnattemptedOn";
BA_ "SystemSignalLongSymbol" SG_ 2013 VCLEFT_a485_accessoryFeed3Unatte "VCLEFT_a485_accessoryFeed3UnattemptedOn";
BA_ "SystemSignalLongSymbol" SG_ 2013 VCLEFT_a485_vbatProtFusedSeatUna "VCLEFT_a485_vbatProtFusedSeatUnattemptedOn";
BA_ "SystemSignalLongSymbol" SG_ 2013 VCLEFT_a485_usbPortsUnattemptedO "VCLEFT_a485_usbPortsUnattemptedOn";
BA_ "SystemSignalLongSymbol" SG_ 2013 VCLEFT_a485_auxSocketFrontUnatte "VCLEFT_a485_auxSocketFrontUnattemptedOn";
BA_ "SystemSignalLongSymbol" SG_ 2013 VCLEFT_a485_lumbarEcuUnattempted "VCLEFT_a485_lumbarEcuUnattemptedOn";
BA_ "SystemSignalLongSymbol" SG_ 2013 VCLEFT_a485_ambientRgbRightUnatt "VCLEFT_a485_ambientRgbRightUnattemptedOn";
BA_ "SystemSignalLongSymbol" SG_ 2013 VCLEFT_a485_ambientRgbMiddleUnat "VCLEFT_a485_ambientRgbMiddleUnattemptedOn";
BA_ "SystemSignalLongSymbol" SG_ 2013 VCLEFT_a485_ambientRgbLeftUnatte "VCLEFT_a485_ambientRgbLeftUnattemptedOn";
BA_ "SystemSignalLongSymbol" SG_ 2013 VCLEFT_a485_door1rRgbUnattempted "VCLEFT_a485_door1rRgbUnattemptedOn";
BA_ "SystemSignalLongSymbol" SG_ 2013 VCLEFT_a485_door2rRgbUnattempted "VCLEFT_a485_door2rRgbUnattemptedOn";
BA_ "SystemSignalLongSymbol" SG_ 2013 VCLEFT_a485_seat1rVentFanBackres "VCLEFT_a485_seat1rVentFanBackrestUnattemptedOn";
BA_ "SystemSignalLongSymbol" SG_ 2013 VCLEFT_a485_seat1rVentFanCushion "VCLEFT_a485_seat1rVentFanCushionUnattemptedOn";
BA_ "SystemSignalLongSymbol" SG_ 2013 VCLEFT_a485_trailerBrakeEcuUnatt "VCLEFT_a485_trailerBrakeEcuUnattemptedOn";
BA_ "SystemSignalLongSymbol" SG_ 2013 VCLEFT_a485_trailerAuxUnattempte "VCLEFT_a485_trailerAuxUnattemptedOn";
BA_ "SystemSignalLongSymbol" SG_ 2013 VCLEFT_a485_vbatFusedUnattempted "VCLEFT_a485_vbatFusedUnattemptedOn";
BA_ "SystemSignalLongSymbol" SG_ 2013 VCLEFT_a489_seat2RControllerStuc "VCLEFT_a489_seat2RControllerStuckOn";
BA_ "SystemSignalLongSymbol" SG_ 2013 VCLEFT_a489_seat2RAllHeatersStuc "VCLEFT_a489_seat2RAllHeatersStuckOn";
BA_ "SystemSignalLongSymbol" SG_ 2013 VCLEFT_a489_trailerLightEcuStuck "VCLEFT_a489_trailerLightEcuStuckOn";
BA_ "SystemSignalLongSymbol" SG_ 2013 VCLEFT_a489_accessoryFeed3StuckO "VCLEFT_a489_accessoryFeed3StuckOn";
BA_ "SystemSignalLongSymbol" SG_ 2013 VCLEFT_a489_vbatProtFusedSeatStu "VCLEFT_a489_vbatProtFusedSeatStuckOn";
BA_ "SystemSignalLongSymbol" SG_ 2013 VCLEFT_a489_auxSocketFrontStuckO "VCLEFT_a489_auxSocketFrontStuckOn";
BA_ "SystemSignalLongSymbol" SG_ 2013 VCLEFT_a489_ambientRgbRightStuck "VCLEFT_a489_ambientRgbRightStuckOn";
BA_ "SystemSignalLongSymbol" SG_ 2013 VCLEFT_a489_ambientRgbMiddleStuc "VCLEFT_a489_ambientRgbMiddleStuckOn";
BA_ "SystemSignalLongSymbol" SG_ 2013 VCLEFT_a489_ambientRgbLeftStuckO "VCLEFT_a489_ambientRgbLeftStuckOn";
BA_ "SystemSignalLongSymbol" SG_ 2013 VCLEFT_a489_seat1rVentFanBackres "VCLEFT_a489_seat1rVentFanBackrestStuckOn";
BA_ "SystemSignalLongSymbol" SG_ 2013 VCLEFT_a489_seat1rVentFanCushion "VCLEFT_a489_seat1rVentFanCushionStuckOn";
BA_ "SystemSignalLongSymbol" SG_ 2013 VCLEFT_a489_trailerBrakeEcuStuck "VCLEFT_a489_trailerBrakeEcuStuckOn";
BA_ "SystemSignalLongSymbol" SG_ 2013 VCLEFT_a489_loadshedCommonBusVol "VCLEFT_a489_loadshedCommonBusVoltage";
BA_ "SystemSignalLongSymbol" SG_ 2013 VCLEFT_a489_loadshedCommonBusMon "VCLEFT_a489_loadshedCommonBusMonitorRatio";
BA_ "SystemSignalLongSymbol" SG_ 2013 VCLEFT_a493_12vSocketFrontEFuseC "VCLEFT_a493_12vSocketFrontEFuseCurrent";
BA_ "SystemSignalLongSymbol" SG_ 2013 VCLEFT_a494_12vSocketRearEFuseCu "VCLEFT_a494_12vSocketRearEFuseCurrent";
BA_ "SystemSignalLongSymbol" SG_ 2013 VCLEFT_a510_isRearwardEndstopUnc "VCLEFT_a510_isRearwardEndstopUncalibrated";
BA_ "SystemSignalLongSymbol" SG_ 2013 VCLEFT_a510_isAbsPosSensorUncali "VCLEFT_a510_isAbsPosSensorUncalibrated";
BA_ "SystemSignalLongSymbol" SG_ 2013 VCLEFT_a513_accelLookbackTripDep "VCLEFT_a513_accelLookbackTripDepth";
BA_ "SystemSignalLongSymbol" SG_ 2013 VCLEFT_a513_absolutePosSensorFor "VCLEFT_a513_absolutePosSensorForward";
BA_ "SystemSignalLongSymbol" SG_ 2013 VCLEFT_a517_isRearwardEndstopUnc "VCLEFT_a517_isRearwardEndstopUncalibrated";
BA_ "SystemSignalLongSymbol" SG_ 2013 VCLEFT_a517_isAbsPosSensorUncali "VCLEFT_a517_isAbsPosSensorUncalibrated";
BA_ "SystemSignalLongSymbol" SG_ 2013 VCLEFT_a525_GTW_twelveVBatteryTy "VCLEFT_a525_GTW_twelveVBatteryType";
BA_ "SystemSignalLongSymbol" SG_ 2013 VCLEFT_a536_trunkFoldFlatSwitchS "VCLEFT_a536_trunkFoldFlatSwitchState";
BA_ "SystemSignalLongSymbol" SG_ 2013 VCLEFT_a536_trunkFoldFlatLeftSwi "VCLEFT_a536_trunkFoldFlatLeftSwitchVoltage";
BA_ "SystemSignalLongSymbol" SG_ 2013 VCLEFT_a545_GTW_twelveVBatteryTy "VCLEFT_a545_GTW_twelveVBatteryType";
BA_ "SystemSignalLongSymbol" SG_ 2013 VCLEFT_a551_restrictDoorReleaseS "VCLEFT_a551_restrictDoorReleaseSignalFront";
BA_ "SystemSignalLongSymbol" SG_ 2013 VCLEFT_a551_interiorReleaseReqCo "VCLEFT_a551_interiorReleaseReqCountFront";
BA_ "SystemSignalLongSymbol" SG_ 2013 VCLEFT_a551_lastRequestSourceFro "VCLEFT_a551_lastRequestSourceFront";
BA_ "SystemSignalLongSymbol" SG_ 2013 VCLEFT_a551_restrictDoorRel_0001 "VCLEFT_a551_restrictDoorReleaseSignalRear";
BA_ "SystemSignalLongSymbol" SG_ 2013 VCLEFT_a551_interiorRelease_0001 "VCLEFT_a551_interiorReleaseReqCountRear";
BA_ "SystemSignalLongSymbol" SG_ 2013 VCLEFT_a551_lastRequestSourceRea "VCLEFT_a551_lastRequestSourceRear";
BA_ "SystemSignalLongSymbol" SG_ 2013 VCLEFT_a560_isRearwardEndstopUnc "VCLEFT_a560_isRearwardEndstopUncalibrated";
BA_ "SystemSignalLongSymbol" SG_ 2013 VCLEFT_a560_isAbsPosSensorUncali "VCLEFT_a560_isAbsPosSensorUncalibrated";
BA_ "SystemSignalLongSymbol" SG_ 2013 VCLEFT_a563_accelLookbackTripDep "VCLEFT_a563_accelLookbackTripDepth";
BA_ "SystemSignalLongSymbol" SG_ 2013 VCLEFT_a563_absolutePosSensorFor "VCLEFT_a563_absolutePosSensorForward";
BA_ "SystemSignalLongSymbol" SG_ 2013 VCLEFT_a567_isRearwardEndstopUnc "VCLEFT_a567_isRearwardEndstopUncalibrated";
BA_ "SystemSignalLongSymbol" SG_ 2013 VCLEFT_a567_isAbsPosSensorUncali "VCLEFT_a567_isAbsPosSensorUncalibrated";
BA_ "SystemSignalLongSymbol" SG_ 2013 VCLEFT_a596_frontDoorLatchAjarSw "VCLEFT_a596_frontDoorLatchAjarSwitchVoltage";
BA_ "SystemSignalLongSymbol" SG_ 2013 VCLEFT_a597_rearDoorLatchAjarSwi "VCLEFT_a597_rearDoorLatchAjarSwitchVoltage";
BA_ "SystemSignalLongSymbol" SG_ 2013 VCLEFT_a599_GTW_twelveVBatteryTy "VCLEFT_a599_GTW_twelveVBatteryType";
