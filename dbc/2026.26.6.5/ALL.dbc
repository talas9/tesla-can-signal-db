VERSION "dbc-export 1 2026.26.6.5"

NS_ :

BS_:

BU_: ADSP APB APP APS APSB BB BMS CC CMP CMPD CP DAS DI DIF DIR DPB EPAS3P EPAS3S EPASTP EPASTS EPBL EPBR ESP EVSE FC GTW HCML HCMR HVP IBST ICR IDB LS OCS1P PARK PCS PCS2 PM PMF PMR PNCD PTC RADC RCM RCM2 RCM3 RCU SCCM SCM SCS SDCR TAS TCU TCU2 TPMS TRCM UI UIS UMC USM V2G VC VCBATT VCBATT0 VCBATT1 VCBATT2 VCCC VCFRONT VCFRONT1 VCFRONT2 VCLEFT VCRIGHT VCSEAT2L VCSEAT2R VCSEC VEH

BO_ 1335 VCFRONT1_alertLog: 8 VCFRONT1
 SG_ VCFRONT1_alertID M : 0|10@1+ (1,0) [0|1023] "" Vector__XXX
 SG_ VCFRONT1_alertState : 15|1@1+ (1,0) [0|1] "" Vector__XXX
 SG_ VCFRONT1_a001_InternalWatchdog m1 : 16|1@1+ (1,0) [0|1] "" Vector__XXX
 SG_ VCFRONT1_a015_NVMMMemOverflow m15 : 16|1@1+ (1,0) [0|1] "" Vector__XXX
 SG_ VCFRONT1_a015_NVMMFilesystemErro m15 : 17|1@1+ (1,0) [0|1] "" Vector__XXX
 SG_ VCFRONT1_a015_NVMMRecordIDError m15 : 18|1@1+ (1,0) [0|1] "" Vector__XXX
 SG_ VCFRONT1_a059_voltageDrop m59 : 16|12@1+ (0.005443676,0) [0|22.29185322] "" Vector__XXX
 SG_ VCFRONT1_a059_resistanceEstimate m59 : 28|12@1+ (0.00244,0) [0|9.9918] "" Vector__XXX
 SG_ VCFRONT1_a059_current m59 : 40|12@1+ (0.05,0) [0|204.75] "" Vector__XXX
 SG_ VCFRONT1_a063_switchChannel m63 : 16|8@1+ (1,0) [0|255] "" Vector__XXX
 SG_ VCFRONT1_a063_switchType m63 : 24|8@1+ (1,0) [0|255] "" Vector__XXX
 SG_ VCFRONT1_a063_ADCVoltage m63 : 32|8@1+ (0.025,0) [0|6.375] "" Vector__XXX
 SG_ VCFRONT1_a063_disconnected m63 : 40|1@1+ (1,0) [0|1] "" Vector__XXX
 SG_ VCFRONT1_a063_indeterminate m63 : 41|1@1+ (1,0) [0|1] "" Vector__XXX
 SG_ VCFRONT1_a063_stuckActive m63 : 42|1@1+ (1,0) [0|1] "" Vector__XXX
 SG_ VCFRONT1_a063_faulted m63 : 43|1@1+ (1,0) [0|1] "" Vector__XXX
 SG_ VCFRONT1_a091_FRONTIPC_faultsAnd m91 : 16|1@1+ (1,0) [0|1] "" Vector__XXX
 SG_ VCFRONT1_a091_FRONTIPC_state m91 : 17|1@1+ (1,0) [0|1] "" Vector__XXX
 SG_ VCFRONT1_a096_FRONTIPC_status m96 : 16|1@1+ (1,0) [0|1] "" Vector__XXX
 SG_ VCFRONT1_a098_FRONTIPC_temperatu m98 : 16|1@1+ (1,0) [0|1] "" Vector__XXX
 SG_ VCFRONT1_a098_FRONTIPC_thermalCo m98 : 17|1@1+ (1,0) [0|1] "" Vector__XXX
 SG_ VCFRONT1_a106_BATTIPC_dcdcRailSt m106 : 16|1@1+ (1,0) [0|1] "" Vector__XXX
 SG_ VCFRONT1_a106_BATTIPC_dcdcStatus m106 : 17|1@1+ (1,0) [0|1] "" Vector__XXX
 SG_ VCFRONT1_a106_VEH_dcdcStatus m106 : 18|1@1+ (1,0) [0|1] "" Vector__XXX
 SG_ VCFRONT1_a106_VEH_thermalControl m106 : 19|1@1+ (1,0) [0|1] "" Vector__XXX
 SG_ VCFRONT1_a106_VEH_dcdcRailStatus m106 : 20|1@1+ (1,0) [0|1] "" Vector__XXX
 SG_ VCFRONT1_a106_CH_dcdcRailStatus m106 : 21|1@1+ (1,0) [0|1] "" Vector__XXX
 SG_ VCFRONT1_a106_CH_alertMatrix m106 : 22|1@1+ (1,0) [0|1] "" Vector__XXX
 SG_ VCFRONT1_a106_FRONTIPC_thermalCo m106 : 23|1@1+ (1,0) [0|1] "" Vector__XXX
 SG_ VCFRONT1_a106_FRONTIPC_dcdcRailS m106 : 24|1@1+ (1,0) [0|1] "" Vector__XXX
 SG_ VCFRONT1_a106_FRONTIPC_dcdcStatu m106 : 25|1@1+ (1,0) [0|1] "" Vector__XXX
 SG_ VCFRONT1_a108_FRONTIPC_status m108 : 16|1@1+ (1,0) [0|1] "" Vector__XXX
 SG_ VCFRONT1_a108_FRONTIPC_temperatu m108 : 17|1@1+ (1,0) [0|1] "" Vector__XXX
 SG_ VCFRONT1_a108_FRONTIPC_thermalCo m108 : 18|1@1+ (1,0) [0|1] "" Vector__XXX
 SG_ VCFRONT1_a108_FRONTIPC_motorStat m108 : 19|1@1+ (1,0) [0|1] "" Vector__XXX
 SG_ VCFRONT1_a120_BATTIPC_speed m120 : 16|1@1+ (1,0) [0|1] "" Vector__XXX
 SG_ VCFRONT1_a120_FRONTIPC_speed m120 : 17|1@1+ (1,0) [0|1] "" Vector__XXX
 SG_ VCFRONT1_a120_FRONTIPC_systemSta m120 : 18|1@1+ (1,0) [0|1] "" Vector__XXX
 SG_ VCFRONT1_a120_BATTIPC_systemStat m120 : 19|1@1+ (1,0) [0|1] "" Vector__XXX
 SG_ VCFRONT1_a120_FRONTIPC_systemPow m120 : 20|1@1+ (1,0) [0|1] "" Vector__XXX
 SG_ VCFRONT1_a120_FRONTIPC_autonomyH m120 : 21|1@1+ (1,0) [0|1] "" Vector__XXX
 SG_ VCFRONT1_a120_BATTIPC_chassisCon m120 : 22|1@1+ (1,0) [0|1] "" Vector__XXX
 SG_ VCFRONT1_a120_FRONTIPC_chassisCo m120 : 23|1@1+ (1,0) [0|1] "" Vector__XXX
 SG_ VCFRONT1_a120_FRONTIPC_odometerS m120 : 24|1@1+ (1,0) [0|1] "" Vector__XXX
 SG_ VCFRONT1_a124_FRONTIPC_status m124 : 16|1@1+ (1,0) [0|1] "" Vector__XXX
 SG_ VCFRONT1_a124_BATTIPC_status m124 : 17|1@1+ (1,0) [0|1] "" Vector__XXX
 SG_ VCFRONT1_a125_FRONTIPC_leftStalk m125 : 16|1@1+ (1,0) [0|1] "" Vector__XXX
 SG_ VCFRONT1_a125_FRONTIPC_steerAngl m125 : 17|1@1+ (1,0) [0|1] "" Vector__XXX
 SG_ VCFRONT1_a125_FRONTIPC_info m125 : 18|1@1+ (1,0) [0|1] "" Vector__XXX
 SG_ VCFRONT1_a126_FRONTIPC_sysStatus m126 : 16|1@1+ (1,0) [0|1] "" Vector__XXX
 SG_ VCFRONT1_a126_BATTIPC_sysStatus m126 : 17|1@1+ (1,0) [0|1] "" Vector__XXX
 SG_ VCFRONT1_a126_FRONTIPC_status m126 : 18|1@1+ (1,0) [0|1] "" Vector__XXX
 SG_ VCFRONT1_a126_BATTIPC_status m126 : 19|1@1+ (1,0) [0|1] "" Vector__XXX
 SG_ VCFRONT1_a127_iBoosterEFuseCurre m127 : 16|16@1+ (0.1,0) [0|6553.5] "" Vector__XXX
 SG_ VCFRONT1_a127_iBoosterEFuseVolta m127 : 32|16@1+ (0.1,0) [0|6553.5] "" Vector__XXX
 SG_ VCFRONT1_a127_iBoosterEFuseTemp m127 : 48|11@1+ (0.125,-40) [-40|215.875] "" Vector__XXX
 SG_ VCFRONT1_a128_vcrightEFuseCurren m128 : 16|16@1+ (0.1,0) [0|6553.5] "" Vector__XXX
 SG_ VCFRONT1_a128_vcrightEFuseVoltag m128 : 32|16@1+ (0.1,0) [0|6553.5] "" Vector__XXX
 SG_ VCFRONT1_a128_vcrightEFuseTemp m128 : 48|11@1+ (0.125,-40) [-40|215.875] "" Vector__XXX
 SG_ VCFRONT1_a128_vcrightEFuseRemain m128 : 59|4@1+ (1,0) [0|15] "" Vector__XXX
 SG_ VCFRONT1_a129_pcsEFuseCurrent m129 : 16|16@1+ (0.1,0) [0|6553.5] "" Vector__XXX
 SG_ VCFRONT1_a129_pcsEFuseVoltage m129 : 32|16@1+ (0.1,0) [0|6553.5] "" Vector__XXX
 SG_ VCFRONT1_a129_pcsEFuseTemp m129 : 48|11@1+ (0.125,-40) [-40|215.875] "" Vector__XXX
 SG_ VCFRONT1_a129_pcsEFuseRemainingR m129 : 59|4@1+ (1,0) [0|15] "" Vector__XXX
 SG_ VCFRONT1_a130_autopilot2EFuseCur m130 : 16|16@1+ (0.1,0) [0|6553.5] "" Vector__XXX
 SG_ VCFRONT1_a130_autopilot2EFuseVol m130 : 32|16@1+ (0.1,0) [0|6553.5] "" Vector__XXX
 SG_ VCFRONT1_a130_autopilot2EFuseTem m130 : 48|11@1+ (0.125,-40) [-40|215.875] "" Vector__XXX
 SG_ VCFRONT1_a130_autopilot2EFuseRem m130 : 59|4@1+ (1,0) [0|15] "" Vector__XXX
 SG_ VCFRONT1_a131_FRONTIPC_power m131 : 16|1@1+ (1,0) [0|1] "" Vector__XXX
 SG_ VCFRONT1_a131_BATTIPC_power m131 : 17|1@1+ (1,0) [0|1] "" Vector__XXX
 SG_ VCFRONT1_a132_epas2EFuseCurrent m132 : 16|16@1+ (0.1,0) [0|6553.5] "" Vector__XXX
 SG_ VCFRONT1_a132_epas2EFuseVoltage m132 : 32|16@1+ (0.1,0) [0|6553.5] "" Vector__XXX
 SG_ VCFRONT1_a132_epas2EFuseTemp m132 : 48|11@1+ (0.125,-40) [-40|215.875] "" Vector__XXX
 SG_ VCFRONT1_a133_BATTIPC_primaryAct m133 : 16|1@1+ (1,0) [0|1] "" Vector__XXX
 SG_ VCFRONT1_a133_FRONTIPC_secondary m133 : 17|1@1+ (1,0) [0|1] "" Vector__XXX
 SG_ VCFRONT1_a135_leftHeadlightEFuse m135 : 16|16@1+ (0.1,0) [0|6553.5] "" Vector__XXX
 SG_ VCFRONT1_a144_FRONTIPC_status m144 : 16|1@1+ (1,0) [0|1] "" Vector__XXX
 SG_ VCFRONT1_a144_BATTIPC_status m144 : 17|1@1+ (1,0) [0|1] "" Vector__XXX
 SG_ VCFRONT1_a164_lockoutVoltage m164 : 16|16@1+ (0.1,0) [0|6553.5] "" Vector__XXX
 SG_ VCFRONT1_a165_lockoutVoltage m165 : 16|16@1+ (0.1,0) [0|6553.5] "" Vector__XXX
 SG_ VCFRONT1_a177_mcuAudioEFuseCurre m177 : 16|10@1+ (0.1,0) [0|102.3] "" Vector__XXX
 SG_ VCFRONT1_a177_mcuAudioEFuseVolta m177 : 32|16@1+ (0.1,0) [0|6553.5] "" Vector__XXX
 SG_ VCFRONT1_a191_vehiclePowerState m191 : 16|2@1+ (1,0) [0|3] "" Vector__XXX
 SG_ VCFRONT1_a191_hvState m191 : 18|3@1+ (1,0) [0|7] "" Vector__XXX
 SG_ VCFRONT1_a191_busVoltage m191 : 24|8@1+ (0.08741903,0) [0|22.29185265] "" Vector__XXX
 SG_ VCFRONT1_a191_serviceMode m191 : 32|1@1+ (1,0) [0|1] "" Vector__XXX
 SG_ VCFRONT1_a191_frunkOpen m191 : 33|1@1+ (1,0) [0|1] "" Vector__XXX
 SG_ VCFRONT1_a191_exitDriveWarningTi m191 : 34|1@1+ (1,0) [0|1] "" Vector__XXX
 SG_ VCFRONT1_a191_NotEnoughPowerForS m191 : 35|1@1+ (1,0) [0|1] "" Vector__XXX
 SG_ VCFRONT1_a191_bmsState m191 : 36|4@1+ (1,0) [0|15] "" Vector__XXX
 SG_ VCFRONT1_a204_vbusVoltage m204 : 16|10@1+ (0.025,0) [0|25.575] "" Vector__XXX
 SG_ VCFRONT1_a204_BRailLocked m204 : 26|1@1+ (1,0) [0|1] "" Vector__XXX
 SG_ VCFRONT1_a204_uvLoadshedFaultInj m204 : 27|1@1+ (1,0) [0|1] "" Vector__XXX
 SG_ VCFRONT1_a204_pcsBridgeCurrent m204 : 32|16@1- (0.0625,0) [-2048|2047.9375] "" Vector__XXX
 SG_ VCFRONT1_a205_busVoltage m205 : 16|10@1+ (0.025,0) [0|25.575] "" Vector__XXX
 SG_ VCFRONT1_a205_BRailLocked m205 : 26|1@1+ (1,0) [0|1] "" Vector__XXX
 SG_ VCFRONT1_a205_ovLoadshedFaultInj m205 : 27|1@1+ (1,0) [0|1] "" Vector__XXX
 SG_ VCFRONT1_a205_pcsBridgeCurrent m205 : 32|16@1- (0.0625,0) [-2048|2047.9375] "" Vector__XXX
 SG_ VCFRONT1_a216_inDrive m216 : 16|1@1+ (1,0) [0|1] "" Vector__XXX
 SG_ VCFRONT1_a216_hvState m216 : 17|3@1+ (1,0) [0|7] "" Vector__XXX
 SG_ VCFRONT1_a216_vcrightFastBlowImm m216 : 20|1@1+ (1,0) [0|1] "" Vector__XXX
 SG_ VCFRONT1_a216_vcrightFastBlowDeb m216 : 21|1@1+ (1,0) [0|1] "" Vector__XXX
 SG_ VCFRONT1_a216_vcrightStaticImmin m216 : 22|1@1+ (1,0) [0|1] "" Vector__XXX
 SG_ VCFRONT1_a216_vcrightDynamicImmi m216 : 23|1@1+ (1,0) [0|1] "" Vector__XXX
 SG_ VCFRONT1_a220_DI_gear m220 : 16|3@1+ (1,0) [0|7] "" Vector__XXX
 SG_ VCFRONT1_a220_redundancyRequired m220 : 19|1@1+ (1,0) [0|1] "" Vector__XXX
 SG_ VCFRONT1_a220_vehicleSpeed m220 : 20|12@1+ (0.08,-40) [-40|287.6] "" Vector__XXX
 SG_ VCFRONT1_a220_lvHealthStatus m220 : 32|3@1+ (1,0) [0|7] "" Vector__XXX
 SG_ VCFRONT1_a220_factoryMode m220 : 35|1@1+ (1,0) [0|1] "" Vector__XXX
 SG_ VCFRONT1_a220_serviceMode m220 : 36|1@1+ (1,0) [0|1] "" Vector__XXX
 SG_ VCFRONT1_a220_unhealthyReason m220 : 40|5@1+ (1,0) [0|31] "" Vector__XXX
 SG_ VCFRONT1_a223_failedArmingSetup m223 : 16|1@1+ (1,0) [0|1] "" Vector__XXX
 SG_ VCFRONT1_a223_failedFaultInject m223 : 17|1@1+ (1,0) [0|1] "" Vector__XXX
 SG_ VCFRONT1_a223_overvoltageFaultAc m223 : 18|1@1+ (1,0) [0|1] "" Vector__XXX
 SG_ VCFRONT1_a223_sharedBridgeShutdo m223 : 19|1@1+ (1,0) [0|1] "" Vector__XXX
 SG_ VCFRONT1_a223_timedOut m223 : 20|1@1+ (1,0) [0|1] "" Vector__XXX
 SG_ VCFRONT1_a229_bridgeOpened m229 : 16|1@1+ (1,0) [0|1] "" Vector__XXX
 SG_ VCFRONT1_a229_pcsMIA m229 : 17|1@1+ (1,0) [0|1] "" Vector__XXX
 SG_ VCFRONT1_a229_pcsNotSupporting m229 : 18|1@1+ (1,0) [0|1] "" Vector__XXX
 SG_ VCFRONT1_a250_pcsOvShutdownFault m250 : 16|1@1+ (1,0) [0|1] "" Vector__XXX
 SG_ VCFRONT1_a250_pcsOvShutdownArmed m250 : 17|1@1+ (1,0) [0|1] "" Vector__XXX
 SG_ VCFRONT1_a250_battDomainHealthy m250 : 18|1@1+ (1,0) [0|1] "" Vector__XXX
 SG_ VCFRONT1_a250_busVoltage m250 : 19|10@1+ (0.025,0) [0|25.575] "" Vector__XXX
 SG_ VCFRONT1_a250_dcdcEnableLineVolt m250 : 29|9@1+ (0.05,0) [0|25.55] "" Vector__XXX
 SG_ VCFRONT1_a250_ovClampBusVoltage m250 : 38|10@1+ (0.025,0) [0|25.575] "" Vector__XXX
 SG_ VCFRONT1_a250_ovClampReferenceVo m250 : 48|7@1+ (0.025,0) [0|3.175] "" Vector__XXX
 SG_ VCFRONT1_a250_ovClampMonitorVolt m250 : 55|9@1+ (0.05,0) [0|25.55] "" Vector__XXX
 SG_ VCFRONT1_a251_rationalitySetupCh m251 : 16|2@1+ (1,0) [0|3] "" Vector__XXX
 SG_ VCFRONT1_a251_rationalitySetupFa m251 : 18|3@1+ (1,0) [0|7] "" Vector__XXX
 SG_ VCFRONT1_a251_clampLowSideCheckR m251 : 21|2@1+ (1,0) [0|3] "" Vector__XXX
 SG_ VCFRONT1_a251_clampLowSideFailur m251 : 24|3@1+ (1,0) [0|7] "" Vector__XXX
 SG_ VCFRONT1_a251_rationalityShutdow m251 : 27|2@1+ (1,0) [0|3] "" Vector__XXX
 SG_ VCFRONT1_a251_rationalitySh_0001 m251 : 29|3@1+ (1,0) [0|7] "" Vector__XXX
 SG_ VCFRONT1_a251_clampHighSideCheck m251 : 32|2@1+ (1,0) [0|3] "" Vector__XXX
 SG_ VCFRONT1_a251_clampHighSideFailu m251 : 34|3@1+ (1,0) [0|7] "" Vector__XXX
 SG_ VCFRONT1_a251_rationalityPcsShut m251 : 37|2@1+ (1,0) [0|3] "" Vector__XXX
 SG_ VCFRONT1_a251_rationalityPc_0001 m251 : 40|3@1+ (1,0) [0|7] "" Vector__XXX
 SG_ VCFRONT1_a251_testTimedOut m251 : 43|1@1+ (1,0) [0|1] "" Vector__XXX
 SG_ VCFRONT1_a252_stage m252 : 16|3@1+ (1,0) [0|7] "" Vector__XXX
 SG_ VCFRONT1_a252_incorrectPinConfig m252 : 19|1@1+ (1,0) [0|1] "" Vector__XXX
 SG_ VCFRONT1_a252_incorrectClampMoni m252 : 20|1@1+ (1,0) [0|1] "" Vector__XXX
 SG_ VCFRONT1_a252_incorrectClam_0001 m252 : 21|1@1+ (1,0) [0|1] "" Vector__XXX
 SG_ VCFRONT1_a252_incorrectClam_0002 m252 : 22|1@1+ (1,0) [0|1] "" Vector__XXX
 SG_ VCFRONT1_a252_incorrectPcsEnable m252 : 23|1@1+ (1,0) [0|1] "" Vector__XXX
 SG_ VCFRONT1_a252_incorrectPcsTripSt m252 : 24|1@1+ (1,0) [0|1] "" Vector__XXX
 SG_ VCFRONT1_a252_incorrectPcsSuppor m252 : 25|1@1+ (1,0) [0|1] "" Vector__XXX
 SG_ VCFRONT1_a252_incorrectPcsDcdcEn m252 : 26|1@1+ (1,0) [0|1] "" Vector__XXX
 SG_ VCFRONT1_a252_pcsOvShutdownFault m252 : 27|1@1+ (1,0) [0|1] "" Vector__XXX
 SG_ VCFRONT1_a252_pcsOvShutdownArmed m252 : 28|1@1+ (1,0) [0|1] "" Vector__XXX
 SG_ VCFRONT1_a252_pcsSupporting m252 : 29|1@1+ (1,0) [0|1] "" Vector__XXX
 SG_ VCFRONT1_a252_pcsDcdcEnableFeedb m252 : 30|1@1+ (1,0) [0|1] "" Vector__XXX
 SG_ VCFRONT1_a252_pcsOvClampArmed m252 : 31|1@1+ (1,0) [0|1] "" Vector__XXX
 SG_ VCFRONT1_a252_pcsOvSelfTestEnabl m252 : 32|1@1+ (1,0) [0|1] "" Vector__XXX
 SG_ VCFRONT1_a252_busVoltage m252 : 33|10@1+ (0.025,0) [0|25.575] "" Vector__XXX
 SG_ VCFRONT1_a252_dcdcEnableLineVolt m252 : 43|10@1+ (0.025,0) [0|25.575] "" Vector__XXX
 SG_ VCFRONT1_a252_ovClampMonitorChan m252 : 53|2@1+ (1,0) [0|3] "" Vector__XXX
 SG_ VCFRONT1_a252_ovClampMonitorVolt m252 : 55|9@1+ (0.05,0) [0|25.55] "" Vector__XXX
 SG_ VCFRONT1_a262_eFuseVoltage m262 : 16|16@1+ (0.1,0) [0|6553.5] "" Vector__XXX
 SG_ VCFRONT1_a262_vbatProtVoltage m262 : 32|16@1+ (0.1,0) [0|6553.5] "" Vector__XXX
 SG_ VCFRONT1_a263_eFuseVoltage m263 : 16|16@1+ (0.1,0) [0|6553.5] "" Vector__XXX
 SG_ VCFRONT1_a263_vbatProtVoltage m263 : 32|16@1+ (0.1,0) [0|6553.5] "" Vector__XXX
 SG_ VCFRONT1_a264_eFuseVoltage m264 : 16|16@1+ (0.1,0) [0|6553.5] "" Vector__XXX
 SG_ VCFRONT1_a264_vbatProtVoltage m264 : 32|16@1+ (0.1,0) [0|6553.5] "" Vector__XXX
 SG_ VCFRONT1_a266_eFuseVoltage m266 : 16|16@1+ (0.1,0) [0|6553.5] "" Vector__XXX
 SG_ VCFRONT1_a266_vbatProtVoltage m266 : 32|16@1+ (0.1,0) [0|6553.5] "" Vector__XXX
 SG_ VCFRONT1_a414_failureReason m414 : 16|6@1+ (1,0) [0|63] "" Vector__XXX
 SG_ VCFRONT1_a414_loadUnattemptedOnF m414 : 22|1@1+ (1,0) [0|1] "" Vector__XXX
 SG_ VCFRONT1_a414_deviceStuckOnFailu m414 : 23|1@1+ (1,0) [0|1] "" Vector__XXX
 SG_ VCFRONT1_a414_followerVCRightSel m414 : 24|1@1+ (1,0) [0|1] "" Vector__XXX
 SG_ VCFRONT1_a414_bridgeFailedToOpen m414 : 25|1@1+ (1,0) [0|1] "" Vector__XXX
 SG_ VCFRONT1_a414_uvLoadshedVsenseDi m414 : 26|1@1+ (1,0) [0|1] "" Vector__XXX
 SG_ VCFRONT1_a415_upstreamEFuseStuck m415 : 16|1@1+ (1,0) [0|1] "" Vector__XXX
 SG_ VCFRONT1_a475_channel m475 : 16|3@1+ (1,0) [0|7] "" Vector__XXX
 SG_ VCFRONT1_a475_reset m475 : 19|1@1+ (1,0) [0|1] "" Vector__XXX
 SG_ VCFRONT1_a475_spiError m475 : 20|1@1+ (1,0) [0|1] "" Vector__XXX
 SG_ VCFRONT1_a475_autoOn m475 : 21|1@1+ (1,0) [0|1] "" Vector__XXX
 SG_ VCFRONT1_a475_diagnosticBit m475 : 22|1@1+ (1,0) [0|1] "" Vector__XXX
 SG_ VCFRONT1_a475_deviceError m475 : 23|1@1+ (1,0) [0|1] "" Vector__XXX
 SG_ VCFRONT1_a475_unexpectedLock m475 : 24|1@1+ (1,0) [0|1] "" Vector__XXX
 SG_ VCFRONT1_a475_unexpectedFailSafe m475 : 25|1@1+ (1,0) [0|1] "" Vector__XXX
 SG_ VCFRONT1_a475_disableOutputFault m475 : 26|1@1+ (1,0) [0|1] "" Vector__XXX
 SG_ VCFRONT1_a475_vsUndervoltage m475 : 27|1@1+ (1,0) [0|1] "" Vector__XXX
 SG_ VCFRONT1_a475_hardShort m475 : 28|1@1+ (1,0) [0|1] "" Vector__XXX
 SG_ VCFRONT1_a475_prechargeFailure m475 : 29|1@1+ (1,0) [0|1] "" Vector__XXX
 SG_ VCFRONT1_a475_vdsMax m475 : 30|1@1+ (1,0) [0|1] "" Vector__XXX
 SG_ VCFRONT1_a475_bypassSaturation m475 : 31|1@1+ (1,0) [0|1] "" Vector__XXX
 SG_ VCFRONT1_a475_fuseLatch m475 : 32|1@1+ (1,0) [0|1] "" Vector__XXX
 SG_ VCFRONT1_a475_deviceOvertemperat m475 : 33|1@1+ (1,0) [0|1] "" Vector__XXX
 SG_ VCFRONT1_a475_ntcOvertemperature m475 : 34|1@1+ (1,0) [0|1] "" Vector__XXX
 SG_ VCFRONT1_a475_vgsLow m475 : 35|1@1+ (1,0) [0|1] "" Vector__XXX
 SG_ VCFRONT1_a475_chargePumpLow m475 : 36|1@1+ (1,0) [0|1] "" Vector__XXX
 SG_ VCFRONT1_a475_watchdog m475 : 37|1@1+ (1,0) [0|1] "" Vector__XXX
 SG_ VCFRONT1_a475_spiNotDone m475 : 38|1@1+ (1,0) [0|1] "" Vector__XXX
 SG_ VCFRONT1_a475_csUndervoltage m475 : 39|1@1+ (1,0) [0|1] "" Vector__XXX
 SG_ VCFRONT1_a475_configIncorrect m475 : 40|1@1+ (1,0) [0|1] "" Vector__XXX
 SG_ VCFRONT1_a475_bufferFull m475 : 41|1@1+ (1,0) [0|1] "" Vector__XXX
 SG_ VCFRONT1_a475_hitAlertRateLimit m475 : 42|1@1+ (1,0) [0|1] "" Vector__XXX
 SG_ VCFRONT1_a475_hwlo m475 : 43|1@1+ (1,0) [0|1] "" Vector__XXX
 SG_ VCFRONT1_a475_dinState m475 : 44|1@1+ (1,0) [0|1] "" Vector__XXX
 SG_ VCFRONT1_a475_enable m475 : 45|1@1+ (1,0) [0|1] "" Vector__XXX
 SG_ VCFRONT1_a480_channel m480 : 16|2@1+ (1,0) [0|3] "" Vector__XXX
 SG_ VCFRONT1_a480_reset m480 : 18|1@1+ (1,0) [0|1] "" Vector__XXX
 SG_ VCFRONT1_a480_spiError m480 : 19|1@1+ (1,0) [0|1] "" Vector__XXX
 SG_ VCFRONT1_a480_autoOn m480 : 20|1@1+ (1,0) [0|1] "" Vector__XXX
 SG_ VCFRONT1_a480_diagnosticBit m480 : 21|1@1+ (1,0) [0|1] "" Vector__XXX
 SG_ VCFRONT1_a480_deviceError m480 : 22|1@1+ (1,0) [0|1] "" Vector__XXX
 SG_ VCFRONT1_a480_overcurrent m480 : 23|1@1+ (1,0) [0|1] "" Vector__XXX
 SG_ VCFRONT1_a480_unexpectedLock m480 : 24|1@1+ (1,0) [0|1] "" Vector__XXX
 SG_ VCFRONT1_a480_disableOutputFault m480 : 25|1@1+ (1,0) [0|1] "" Vector__XXX
 SG_ VCFRONT1_a480_vsUndervoltage m480 : 26|1@1+ (1,0) [0|1] "" Vector__XXX
 SG_ VCFRONT1_a480_hardShort m480 : 27|1@1+ (1,0) [0|1] "" Vector__XXX
 SG_ VCFRONT1_a480_vdsMax m480 : 28|1@1+ (1,0) [0|1] "" Vector__XXX
 SG_ VCFRONT1_a480_bypassSaturation m480 : 29|1@1+ (1,0) [0|1] "" Vector__XXX
 SG_ VCFRONT1_a480_fuseLatch m480 : 30|1@1+ (1,0) [0|1] "" Vector__XXX
 SG_ VCFRONT1_a480_deviceOvertemperat m480 : 31|1@1+ (1,0) [0|1] "" Vector__XXX
 SG_ VCFRONT1_a480_ntcOvertemperature m480 : 32|1@1+ (1,0) [0|1] "" Vector__XXX
 SG_ VCFRONT1_a480_vgsLow m480 : 33|1@1+ (1,0) [0|1] "" Vector__XXX
 SG_ VCFRONT1_a480_chargePumpLow m480 : 34|1@1+ (1,0) [0|1] "" Vector__XXX
 SG_ VCFRONT1_a480_watchdog m480 : 35|1@1+ (1,0) [0|1] "" Vector__XXX
 SG_ VCFRONT1_a480_spiNotDone m480 : 36|1@1+ (1,0) [0|1] "" Vector__XXX
 SG_ VCFRONT1_a480_configIncorrect m480 : 37|1@1+ (1,0) [0|1] "" Vector__XXX
 SG_ VCFRONT1_a480_bufferFull m480 : 38|1@1+ (1,0) [0|1] "" Vector__XXX
 SG_ VCFRONT1_a480_hitAlertRateLimit m480 : 39|1@1+ (1,0) [0|1] "" Vector__XXX
 SG_ VCFRONT1_a480_hwlo m480 : 40|1@1+ (1,0) [0|1] "" Vector__XXX
 SG_ VCFRONT1_a480_enable m480 : 41|1@1+ (1,0) [0|1] "" Vector__XXX
 SG_ VCFRONT1_a482_lvBridgeEFuseCurre m482 : 16|16@1+ (0.1,0) [0|6553.5] "" Vector__XXX
 SG_ VCFRONT1_a482_lvBridgeEFuseVolta m482 : 32|16@1+ (0.1,0) [0|6553.5] "" Vector__XXX
 SG_ VCFRONT1_a482_lvBridgeEFuseTemp m482 : 48|11@1+ (0.125,-40) [-40|215.875] "" Vector__XXX
 SG_ VCFRONT1_a484_upstreamEFuseStuck m484 : 16|1@1+ (1,0) [0|1] "" Vector__XXX
 SG_ VCFRONT1_a484_upstreamEFuseVolta m484 : 17|6@1+ (1,0) [0|63] "" Vector__XXX
 SG_ VCFRONT1_a484_vbusVoltage m484 : 24|6@1+ (1,0) [0|63] "" Vector__XXX
 SG_ VCFRONT1_a484_upstreamEFuseRatio m484 : 32|7@1+ (1,0) [0|127] "" Vector__XXX
 SG_ VCFRONT1_a485_upstreamEfuseUnatt m485 : 16|1@1+ (1,0) [0|1] "" Vector__XXX
 SG_ VCFRONT1_a486_bridgeFailedArming m486 : 16|1@1+ (1,0) [0|1] "" Vector__XXX
 SG_ VCFRONT1_a486_bridgeFailedSyncCh m486 : 17|1@1+ (1,0) [0|1] "" Vector__XXX
 SG_ VCFRONT1_a486_localBridgeOutputO m486 : 18|1@1+ (1,0) [0|1] "" Vector__XXX
 SG_ VCFRONT1_a486_localBridgeSyncArm m486 : 19|1@1+ (1,0) [0|1] "" Vector__XXX
 SG_ VCFRONT1_a486_localBridgeDinStat m486 : 20|1@1+ (1,0) [0|1] "" Vector__XXX
 SG_ VCFRONT1_a486_remoteBridgeOutput m486 : 21|1@1+ (1,0) [0|1] "" Vector__XXX
 SG_ VCFRONT1_a486_remoteBridgeO_0001 m486 : 22|1@1+ (1,0) [0|1] "" Vector__XXX
 SG_ VCFRONT1_a486_remoteBridgeSyncAr m486 : 23|1@1+ (1,0) [0|1] "" Vector__XXX
 SG_ VCFRONT1_a486_remoteBridgeS_0001 m486 : 24|1@1+ (1,0) [0|1] "" Vector__XXX
 SG_ VCFRONT1_a486_remoteBridgeDinSta m486 : 25|1@1+ (1,0) [0|1] "" Vector__XXX
 SG_ VCFRONT1_a486_remoteBridgeD_0001 m486 : 26|1@1+ (1,0) [0|1] "" Vector__XXX
 SG_ VCFRONT1_a496_serviceMode m496 : 16|1@1+ (1,0) [0|1] "" Vector__XXX
 SG_ VCFRONT1_a496_frunkOpen m496 : 17|1@1+ (1,0) [0|1] "" Vector__XXX
 SG_ VCFRONT1_a496_NotEnoughPowerForS m496 : 18|1@1+ (1,0) [0|1] "" Vector__XXX
 SG_ VCFRONT1_a496_bmsState m496 : 19|4@1+ (1,0) [0|15] "" Vector__XXX
 SG_ VCFRONT1_a500_channel m500 : 16|8@1+ (1,0) [0|255] "" Vector__XXX
 SG_ VCFRONT1_a500_mismatchedState m500 : 24|3@1+ (1,0) [0|7] "" Vector__XXX
 SG_ VCFRONT1_a509_channel m509 : 16|3@1+ (1,0) [0|7] "" Vector__XXX
 SG_ VCFRONT1_a509_state m509 : 19|3@1+ (1,0) [0|7] "" Vector__XXX
 SG_ VCFRONT1_a509_expectedState m509 : 24|3@1+ (1,0) [0|7] "" Vector__XXX
 SG_ VCFRONT1_a509_hardwareLockout m509 : 27|1@1+ (1,0) [0|1] "" Vector__XXX
 SG_ VCFRONT1_a509_unlocksRemaining m509 : 32|8@1+ (1,0) [0|255] "" Vector__XXX
 SG_ VCFRONT1_a523_channel m523 : 16|8@1+ (1,0) [0|255] "" Vector__XXX
 SG_ VCFRONT1_a523_control2Byte1 m523 : 24|8@1+ (1,0) [0|255] "" Vector__XXX
 SG_ VCFRONT1_a523_control2Byte2 m523 : 32|8@1+ (1,0) [0|255] "" Vector__XXX
 SG_ VCFRONT1_a523_control2Byte3 m523 : 40|8@1+ (1,0) [0|255] "" Vector__XXX
 SG_ VCFRONT1_a523_control3Byte2 m523 : 48|8@1+ (1,0) [0|255] "" Vector__XXX
 SG_ VCFRONT1_a523_control3Byte3 m523 : 56|8@1+ (1,0) [0|255] "" Vector__XXX
 SG_ VCFRONT1_a574_frontDriveInverter m574 : 16|16@1+ (0.1,0) [0|6553.5] "" Vector__XXX
 SG_ VCFRONT1_a574_frontDriveInv_0001 m574 : 32|8@1+ (1,0) [0|255] "" Vector__XXX
 SG_ VCFRONT1_a596_vcrightCutoffEFuse m596 : 16|1@1+ (1,0) [0|1] "" Vector__XXX
 SG_ VCFRONT1_a596_vcrightCutoffCurve m596 : 17|3@1+ (1,0) [0|7] "" Vector__XXX
 SG_ VCFRONT1_a596_vcrightCutoffATerm m596 : 24|16@1+ (50,0) [0|3276750] "" Vector__XXX
 SG_ VCFRONT1_a596_vcrightCutoffBTerm m596 : 40|8@1- (1,-78) [-206|49] "" Vector__XXX
 SG_ VCFRONT1_a596_vcrightCutoffCTerm m596 : 48|16@1- (50,0) [-1638400|1638350] "" Vector__XXX
 SG_ VCFRONT1_a597_vcrightCutoffEFuse m597 : 16|1@1+ (1,0) [0|1] "" Vector__XXX
 SG_ VCFRONT1_a597_vcrightCutoffCurre m597 : 17|12@1+ (0.1,0) [0|409.5] "" Vector__XXX
 SG_ VCFRONT1_a597_vcrightCutoffTimin m597 : 32|16@1+ (1,0) [0|65535] "" Vector__XXX
 SG_ VCFRONT1_a597_vcrightCutoffMaxCo m597 : 48|5@1+ (1,0) [0|31] "" Vector__XXX

BO_ 833 VCFRONT1_alertMatrix: 8 VCFRONT1
 SG_ VCFRONT1_matrixIndex M : 0|4@1+ (1,0) [0|15] "" Vector__XXX
 SG_ VCFRONT1_a001_WatchdogReset m0 : 4|1@1+ (1,0) [0|1] "" Vector__XXX
 SG_ VCFRONT1_a002_PowerLossReset m0 : 5|1@1+ (1,0) [0|1] "" Vector__XXX
 SG_ VCFRONT1_a003_SWAssertion m0 : 6|1@1+ (1,0) [0|1] "" Vector__XXX
 SG_ VCFRONT1_a005_CANTXError m0 : 8|1@1+ (1,0) [0|1] "" Vector__XXX
 SG_ VCFRONT1_a006_CANTX_cyclicError m0 : 9|1@1+ (1,0) [0|1] "" Vector__XXX
 SG_ VCFRONT1_a012_CPUReset m0 : 15|1@1+ (1,0) [0|1] "" Vector__XXX
 SG_ VCFRONT1_a013_AlertManagerFault m0 : 16|1@1+ (1,0) [0|1] "" Vector__XXX
 SG_ VCFRONT1_a015_NVMMError m0 : 18|1@1+ (1,0) [0|1] "" Vector__XXX
 SG_ VCFRONT1_a016_NVMMRecordError m0 : 19|1@1+ (1,0) [0|1] "" Vector__XXX
 SG_ VCFRONT1_a017_NVMMStatusDbg m0 : 20|1@1+ (1,0) [0|1] "" Vector__XXX
 SG_ VCFRONT1_a018_HardFault m0 : 21|1@1+ (1,0) [0|1] "" Vector__XXX
 SG_ VCFRONT1_a019_BusFault m0 : 22|1@1+ (1,0) [0|1] "" Vector__XXX
 SG_ VCFRONT1_a021_TaskSchedulerError m0 : 24|1@1+ (1,0) [0|1] "" Vector__XXX
 SG_ VCFRONT1_a022_TaskInitError m0 : 25|1@1+ (1,0) [0|1] "" Vector__XXX
 SG_ VCFRONT1_a028_UsageFault m0 : 31|1@1+ (1,0) [0|1] "" Vector__XXX
 SG_ VCFRONT1_a029_CoreDump m0 : 32|1@1+ (1,0) [0|1] "" Vector__XXX
 SG_ VCFRONT1_a030_ECULogUploadReques m0 : 33|1@1+ (1,0) [0|1] "" Vector__XXX
 SG_ VCFRONT1_a031_UDSActive m0 : 34|1@1+ (1,0) [0|1] "" Vector__XXX
 SG_ VCFRONT1_a036_UnknownIrq m0 : 39|1@1+ (1,0) [0|1] "" Vector__XXX
 SG_ VCFRONT1_a037_MemManageFault m0 : 40|1@1+ (1,0) [0|1] "" Vector__XXX
 SG_ VCFRONT1_a038_ProtFaultInfo m0 : 41|1@1+ (1,0) [0|1] "" Vector__XXX
 SG_ VCFRONT1_a039_ProtFaultAddress m0 : 42|1@1+ (1,0) [0|1] "" Vector__XXX
 SG_ VCFRONT1_a040_Backtrace m0 : 43|1@1+ (1,0) [0|1] "" Vector__XXX
 SG_ VCFRONT1_a041_HighCPULoad m0 : 44|1@1+ (1,0) [0|1] "" Vector__XXX
 SG_ VCFRONT1_a042_HighStackUsage m0 : 45|1@1+ (1,0) [0|1] "" Vector__XXX
 SG_ VCFRONT1_a043_Task1msError m0 : 46|1@1+ (1,0) [0|1] "" Vector__XXX
 SG_ VCFRONT1_a044_Task10msError m0 : 47|1@1+ (1,0) [0|1] "" Vector__XXX
 SG_ VCFRONT1_a045_Task100msError m0 : 48|1@1+ (1,0) [0|1] "" Vector__XXX
 SG_ VCFRONT1_a046_Task1000msError m0 : 49|1@1+ (1,0) [0|1] "" Vector__XXX
 SG_ VCFRONT1_a058_inputRHighSyncDebu m0 : 61|1@1+ (1,0) [0|1] "" Vector__XXX
 SG_ VCFRONT1_a059_inputResistanceHig m0 : 62|1@1+ (1,0) [0|1] "" Vector__XXX
 SG_ VCFRONT1_a060_engineeringBuild m0 : 63|1@1+ (1,0) [0|1] "" Vector__XXX
 SG_ VCFRONT1_a061_XCPConnected m1 : 4|1@1+ (1,0) [0|1] "" Vector__XXX
 SG_ VCFRONT1_a062_XCPWasConnected m1 : 5|1@1+ (1,0) [0|1] "" Vector__XXX
 SG_ VCFRONT1_a063_SwitchFault m1 : 6|1@1+ (1,0) [0|1] "" Vector__XXX
 SG_ VCFRONT1_a064_busSleepReqTimeout m1 : 7|1@1+ (1,0) [0|1] "" Vector__XXX
 SG_ VCFRONT1_a077_VCBATT0_MIA m1 : 20|1@1+ (1,0) [0|1] "" Vector__XXX
 SG_ VCFRONT1_a078_VCBATT1_MIA m1 : 21|1@1+ (1,0) [0|1] "" Vector__XXX
 SG_ VCFRONT1_a079_VCBATT2_MIA m1 : 22|1@1+ (1,0) [0|1] "" Vector__XXX
 SG_ VCFRONT1_a080_VCFRONT0_MIA m1 : 23|1@1+ (1,0) [0|1] "" Vector__XXX
 SG_ VCFRONT1_a081_VCFRONT1_MIA m1 : 24|1@1+ (1,0) [0|1] "" Vector__XXX
 SG_ VCFRONT1_a082_VCFRONT2_MIA m1 : 25|1@1+ (1,0) [0|1] "" Vector__XXX
 SG_ VCFRONT1_a086_VCBATT_MIA m1 : 29|1@1+ (1,0) [0|1] "" Vector__XXX
 SG_ VCFRONT1_a090_APS_MIA m1 : 33|1@1+ (1,0) [0|1] "" Vector__XXX
 SG_ VCFRONT1_a091_CMPD_MIA m1 : 34|1@1+ (1,0) [0|1] "" Vector__XXX
 SG_ VCFRONT1_a096_OCS1P_MIA m1 : 39|1@1+ (1,0) [0|1] "" Vector__XXX
 SG_ VCFRONT1_a098_DIR_MIA m1 : 41|1@1+ (1,0) [0|1] "" Vector__XXX
 SG_ VCFRONT1_a100_CANbus_MIA m1 : 43|1@1+ (1,0) [0|1] "" Vector__XXX
 SG_ VCFRONT1_a103_CP_MIA m1 : 46|1@1+ (1,0) [0|1] "" Vector__XXX
 SG_ VCFRONT1_a104_DAS_MIA m1 : 47|1@1+ (1,0) [0|1] "" Vector__XXX
 SG_ VCFRONT1_a105_TAS_MIA m1 : 48|1@1+ (1,0) [0|1] "" Vector__XXX
 SG_ VCFRONT1_a106_PCS_MIA m1 : 49|1@1+ (1,0) [0|1] "" Vector__XXX
 SG_ VCFRONT1_a107_BMS_MIA m1 : 50|1@1+ (1,0) [0|1] "" Vector__XXX
 SG_ VCFRONT1_a108_DIF_MIA m1 : 51|1@1+ (1,0) [0|1] "" Vector__XXX
 SG_ VCFRONT1_a109_RCM_MIA m1 : 52|1@1+ (1,0) [0|1] "" Vector__XXX
 SG_ VCFRONT1_a110_GTW_MIA m1 : 53|1@1+ (1,0) [0|1] "" Vector__XXX
 SG_ VCFRONT1_a111_EPBR_MIA m1 : 54|1@1+ (1,0) [0|1] "" Vector__XXX
 SG_ VCFRONT1_a112_EPBL_MIA m1 : 55|1@1+ (1,0) [0|1] "" Vector__XXX
 SG_ VCFRONT1_a113_UI_MIA m1 : 56|1@1+ (1,0) [0|1] "" Vector__XXX
 SG_ VCFRONT1_a114_ESP_MIA m1 : 57|1@1+ (1,0) [0|1] "" Vector__XXX
 SG_ VCFRONT1_a115_VCSEC_MIA m1 : 58|1@1+ (1,0) [0|1] "" Vector__XXX
 SG_ VCFRONT1_a116_VCRIGHT_MIA m1 : 59|1@1+ (1,0) [0|1] "" Vector__XXX
 SG_ VCFRONT1_a117_VCLEFT_MIA m1 : 60|1@1+ (1,0) [0|1] "" Vector__XXX
 SG_ VCFRONT1_a118_VCFRONT_MIA m1 : 61|1@1+ (1,0) [0|1] "" Vector__XXX
 SG_ VCFRONT1_a119_SCCM_MIA m1 : 62|1@1+ (1,0) [0|1] "" Vector__XXX
 SG_ VCFRONT1_a120_DI_DRIVE_MIA m1 : 63|1@1+ (1,0) [0|1] "" Vector__XXX
 SG_ VCFRONT1_a122_ICR_MIA m2 : 5|1@1+ (1,0) [0|1] "" Vector__XXX
 SG_ VCFRONT1_a124_BB_MIA m2 : 7|1@1+ (1,0) [0|1] "" Vector__XXX
 SG_ VCFRONT1_a125_SCCM_MIA m2 : 8|1@1+ (1,0) [0|1] "" Vector__XXX
 SG_ VCFRONT1_a126_EPAS3P_MIA m2 : 9|1@1+ (1,0) [0|1] "" Vector__XXX
 SG_ VCFRONT1_a127_iBoosterEFuseTrip m2 : 10|1@1+ (1,0) [0|1] "" Vector__XXX
 SG_ VCFRONT1_a128_vcrightEFuseTrip m2 : 11|1@1+ (1,0) [0|1] "" Vector__XXX
 SG_ VCFRONT1_a129_pcsEFuseTrip m2 : 12|1@1+ (1,0) [0|1] "" Vector__XXX
 SG_ VCFRONT1_a130_autopilot2EFuseTri m2 : 13|1@1+ (1,0) [0|1] "" Vector__XXX
 SG_ VCFRONT1_a131_PCSCOMMON_MIA m2 : 14|1@1+ (1,0) [0|1] "" Vector__XXX
 SG_ VCFRONT1_a132_epas2EFuseTrip m2 : 15|1@1+ (1,0) [0|1] "" Vector__XXX
 SG_ VCFRONT1_a133_BRAKE_MIA m2 : 16|1@1+ (1,0) [0|1] "" Vector__XXX
 SG_ VCFRONT1_a134_hvContactorsEFuseT m2 : 17|1@1+ (1,0) [0|1] "" Vector__XXX
 SG_ VCFRONT1_a135_leftHeadlightEFuse m2 : 18|1@1+ (1,0) [0|1] "" Vector__XXX
 SG_ VCFRONT1_a144_EPAS3S_MIA m2 : 27|1@1+ (1,0) [0|1] "" Vector__XXX
 SG_ VCFRONT1_a164_eFuseLckoutMissing m2 : 47|1@1+ (1,0) [0|1] "" Vector__XXX
 SG_ VCFRONT1_a165_unxpctdEFuseLckout m2 : 48|1@1+ (1,0) [0|1] "" Vector__XXX
 SG_ VCFRONT1_a177_mcuAudioEFuseTrip m2 : 60|1@1+ (1,0) [0|1] "" Vector__XXX
 SG_ VCFRONT1_a188_sleepFailed m3 : 11|1@1+ (1,0) [0|1] "" Vector__XXX
 SG_ VCFRONT1_a191_exitDriveDomainDow m3 : 14|1@1+ (1,0) [0|1] "" Vector__XXX
 SG_ VCFRONT1_a204_undervoltageLoadsh m3 : 27|1@1+ (1,0) [0|1] "" Vector__XXX
 SG_ VCFRONT1_a205_overvoltageProtect m3 : 28|1@1+ (1,0) [0|1] "" Vector__XXX
 SG_ VCFRONT1_a214_openCircuitDetecte m3 : 37|1@1+ (1,0) [0|1] "" Vector__XXX
 SG_ VCFRONT1_a216_powerCutoffImminen m3 : 39|1@1+ (1,0) [0|1] "" Vector__XXX
 SG_ VCFRONT1_a220_LVUnhealthy m3 : 43|1@1+ (1,0) [0|1] "" Vector__XXX
 SG_ VCFRONT1_a223_bridgeOvervoltageS m3 : 46|1@1+ (1,0) [0|1] "" Vector__XXX
 SG_ VCFRONT1_a229_LVHealthCompromise m3 : 52|1@1+ (1,0) [0|1] "" Vector__XXX
 SG_ VCFRONT1_a230_autopilot2EFuseTri m3 : 53|1@1+ (1,0) [0|1] "" Vector__XXX
 SG_ VCFRONT1_a249_pcsOvClampTripped m4 : 12|1@1+ (1,0) [0|1] "" Vector__XXX
 SG_ VCFRONT1_a250_pcsOvShutdownTripp m4 : 13|1@1+ (1,0) [0|1] "" Vector__XXX
 SG_ VCFRONT1_a251_pcsOvShutdownSelfT m4 : 14|1@1+ (1,0) [0|1] "" Vector__XXX
 SG_ VCFRONT1_a252_pcsOvShutdownSelfT m4 : 15|1@1+ (1,0) [0|1] "" Vector__XXX
 SG_ VCFRONT1_a253_pcsOvShutdownHighS m4 : 16|1@1+ (1,0) [0|1] "" Vector__XXX
 SG_ VCFRONT1_a256_nxppca9539Fault m4 : 19|1@1+ (1,0) [0|1] "" Vector__XXX
 SG_ VCFRONT1_a262_vcrightVoltageMism m4 : 25|1@1+ (1,0) [0|1] "" Vector__XXX
 SG_ VCFRONT1_a263_pcsVoltageMismatch m4 : 26|1@1+ (1,0) [0|1] "" Vector__XXX
 SG_ VCFRONT1_a264_iBoosterVoltageMis m4 : 27|1@1+ (1,0) [0|1] "" Vector__XXX
 SG_ VCFRONT1_a266_EPAS2VoltageMismat m4 : 29|1@1+ (1,0) [0|1] "" Vector__XXX
 SG_ VCFRONT1_a414_undervoltageSelfTe m6 : 57|1@1+ (1,0) [0|1] "" Vector__XXX
 SG_ VCFRONT1_a415_undervoltageSelfTe m6 : 58|1@1+ (1,0) [0|1] "" Vector__XXX
 SG_ VCFRONT1_a423_rtosSleepFailed m7 : 6|1@1+ (1,0) [0|1] "" Vector__XXX
 SG_ VCFRONT1_a450_doorWakeToOpenDBG m7 : 33|1@1+ (1,0) [0|1] "" Vector__XXX
 SG_ VCFRONT1_a475_vnf1248Fault m7 : 58|1@1+ (1,0) [0|1] "" Vector__XXX
 SG_ VCFRONT1_a480_vnf1048Fault m7 : 63|1@1+ (1,0) [0|1] "" Vector__XXX
 SG_ VCFRONT1_a482_lvBridgeEFuseTrip m8 : 5|1@1+ (1,0) [0|1] "" Vector__XXX
 SG_ VCFRONT1_a483_vnf1048SelfTestFai m8 : 6|1@1+ (1,0) [0|1] "" Vector__XXX
 SG_ VCFRONT1_a484_undervoltageSelfTe m8 : 7|1@1+ (1,0) [0|1] "" Vector__XXX
 SG_ VCFRONT1_a485_uvSelfTestLoadUnat m8 : 8|1@1+ (1,0) [0|1] "" Vector__XXX
 SG_ VCFRONT1_a486_undervoltageSelfTe m8 : 9|1@1+ (1,0) [0|1] "" Vector__XXX
 SG_ VCFRONT1_a489_vnf1248SelfTestDeb m8 : 12|1@1+ (1,0) [0|1] "" Vector__XXX
 SG_ VCFRONT1_a490_vnf1248SelfTestFai m8 : 13|1@1+ (1,0) [0|1] "" Vector__XXX
 SG_ VCFRONT1_a491_vnf1248Configurati m8 : 14|1@1+ (1,0) [0|1] "" Vector__XXX
 SG_ VCFRONT1_a496_exitDriveWarningDo m8 : 19|1@1+ (1,0) [0|1] "" Vector__XXX
 SG_ VCFRONT1_a500_eFuseASICStateMism m8 : 23|1@1+ (1,0) [0|1] "" Vector__XXX
 SG_ VCFRONT1_a501_vnf1048Configurati m8 : 24|1@1+ (1,0) [0|1] "" Vector__XXX
 SG_ VCFRONT1_a509_eFuseASICManagerSt m8 : 32|1@1+ (1,0) [0|1] "" Vector__XXX
 SG_ VCFRONT1_a523_eFuseThresholdsInc m8 : 46|1@1+ (1,0) [0|1] "" Vector__XXX
 SG_ VCFRONT1_a574_frontDriveInverter m9 : 37|1@1+ (1,0) [0|1] "" Vector__XXX
 SG_ VCFRONT1_a575_frontDriveInverter m9 : 38|1@1+ (1,0) [0|1] "" Vector__XXX
 SG_ VCFRONT1_a578_vbusFusedLoadShedE m9 : 41|1@1+ (1,0) [0|1] "" Vector__XXX
 SG_ VCFRONT1_a581_harnessResistanceI m9 : 44|1@1+ (1,0) [0|1] "" Vector__XXX
 SG_ VCFRONT1_a590_vcrightPwrRational m9 : 53|1@1+ (1,0) [0|1] "" Vector__XXX
 SG_ VCFRONT1_a591_vcrightFastBlowDet m9 : 54|1@1+ (1,0) [0|1] "" Vector__XXX
 SG_ VCFRONT1_a596_vcrightCurvePowerC m9 : 59|1@1+ (1,0) [0|1] "" Vector__XXX
 SG_ VCFRONT1_a597_vcrightFastBlowPow m9 : 60|1@1+ (1,0) [0|1] "" Vector__XXX
 SG_ VCFRONT1_a617_APP_MIA m10 : 20|1@1+ (1,0) [0|1] "" Vector__XXX

BO_ 1027 VCFRONT1_eFuseDebugStatus: 8 VCFRONT1
 SG_ VCFRONT1_eFuseDebugStatusIndex M : 0|3@1+ (1,0) [0|7] "" Vector__XXX
 SG_ VCFRONT1_EPAS2EFuseState m0 : 3|3@1+ (1,0) [0|7] "" Vector__XXX
 SG_ VCFRONT1_EPAS2EFuseCurrent m0 : 8|12@1+ (0.05,0) [0|204.75] "A" Vector__XXX
 SG_ VCFRONT1_EPAS2EFuseOutput m0 : 20|1@1+ (1,0) [0|1] "" Vector__XXX
 SG_ VCFRONT1_EPAS2EFuseOutputDesired m0 : 21|1@1+ (1,0) [0|1] "" Vector__XXX
 SG_ VCFRONT1_EPAS2EFuseBypass m0 : 22|1@1+ (1,0) [0|1] "" Vector__XXX
 SG_ VCFRONT1_EPAS2EFuseBypassDesired m0 : 23|1@1+ (1,0) [0|1] "" Vector__XXX
 SG_ VCFRONT1_EPAS2EFuseVoltage m0 : 24|8@1+ (0.07,0) [0|17.85] "V" Vector__XXX
 SG_ VCFRONT1_EPAS2EFuseTemperature m0 : 32|8@1+ (1,-40) [-40|150] "degC" Vector__XXX
 SG_ VCFRONT1_EPAS2EFuseManagerState m0 : 40|4@1+ (1,0) [0|15] "" Vector__XXX
 SG_ VCFRONT1_EPAS2EFuseHardShortThre m0 : 44|4@1+ (1,0) [0|15] "" Vector__XXX
 SG_ VCFRONT1_EPAS2EFuseOCThreshold m0 : 48|5@1+ (1,0) [0|31] "" Vector__XXX
 SG_ VCFRONT1_EPAS2EFuseType m0 : 53|2@1+ (1,0) [0|3] "" Vector__XXX
 SG_ VCFRONT1_rightControllerEFuseSta m1 : 3|3@1+ (1,0) [0|7] "" Vector__XXX
 SG_ VCFRONT1_rightControllerEFuseCur m1 : 8|12@1+ (0.05,0) [0|204.75] "A" Vector__XXX
 SG_ VCFRONT1_rightControllerEFuseOut m1 : 20|1@1+ (1,0) [0|1] "" Vector__XXX
 SG_ VCFRONT1_rightControllerEFu_0002 m1 : 21|1@1+ (1,0) [0|1] "" Vector__XXX
 SG_ VCFRONT1_rightControllerEFuseByp m1 : 22|1@1+ (1,0) [0|1] "" Vector__XXX
 SG_ VCFRONT1_rightControllerEFu_0001 m1 : 23|1@1+ (1,0) [0|1] "" Vector__XXX
 SG_ VCFRONT1_rightControllerEFuseVol m1 : 24|8@1+ (0.07,0) [0|17.85] "V" Vector__XXX
 SG_ VCFRONT1_rightControllerEFuseTem m1 : 32|8@1+ (1,-40) [-40|150] "degC" Vector__XXX
 SG_ VCFRONT1_rightControllerEFuseMan m1 : 40|4@1+ (1,0) [0|15] "" Vector__XXX
 SG_ VCFRONT1_rightControllerEFuseHar m1 : 44|4@1+ (1,0) [0|15] "" Vector__XXX
 SG_ VCFRONT1_rightControllerEFuseOCT m1 : 48|5@1+ (1,0) [0|31] "" Vector__XXX
 SG_ VCFRONT1_rightControllerEFuseTyp m1 : 53|2@1+ (1,0) [0|3] "" Vector__XXX
 SG_ VCFRONT1_autopilot2EFuseState m3 : 3|3@1+ (1,0) [0|7] "" Vector__XXX
 SG_ VCFRONT1_autopilot2EFuseCurrent m3 : 8|12@1+ (0.05,0) [0|204.75] "A" Vector__XXX
 SG_ VCFRONT1_autopilot2EFuseOutput m3 : 20|1@1+ (1,0) [0|1] "" Vector__XXX
 SG_ VCFRONT1_autopilot2EFuseOutputDe m3 : 21|1@1+ (1,0) [0|1] "" Vector__XXX
 SG_ VCFRONT1_autopilot2EFuseBypass m3 : 22|1@1+ (1,0) [0|1] "" Vector__XXX
 SG_ VCFRONT1_autopilot2EFuseBypassDe m3 : 23|1@1+ (1,0) [0|1] "" Vector__XXX
 SG_ VCFRONT1_autopilot2EFuseVoltage m3 : 24|8@1+ (0.07,0) [0|17.85] "V" Vector__XXX
 SG_ VCFRONT1_autopilot2EFuseTemperat m3 : 32|8@1+ (1,-40) [-40|150] "degC" Vector__XXX
 SG_ VCFRONT1_autopilot2EFuseManagerS m3 : 40|4@1+ (1,0) [0|15] "" Vector__XXX
 SG_ VCFRONT1_autopilot2EFuseHardShor m3 : 44|4@1+ (1,0) [0|15] "" Vector__XXX
 SG_ VCFRONT1_autopilot2EFuseOCThresh m3 : 48|5@1+ (1,0) [0|31] "" Vector__XXX
 SG_ VCFRONT1_autopilot2EFuseType m3 : 53|2@1+ (1,0) [0|3] "" Vector__XXX

BO_ 1351 VCFRONT2_alertLog: 8 VCFRONT2
 SG_ VCFRONT2_alertID M : 0|10@1+ (1,0) [0|1023] "" Vector__XXX
 SG_ VCFRONT2_alertState : 15|1@1+ (1,0) [0|1] "" Vector__XXX
 SG_ VCFRONT2_a001_InternalWatchdog m1 : 16|1@1+ (1,0) [0|1] "" Vector__XXX
 SG_ VCFRONT2_a015_NVMMMemOverflow m15 : 16|1@1+ (1,0) [0|1] "" Vector__XXX
 SG_ VCFRONT2_a015_NVMMFilesystemErro m15 : 17|1@1+ (1,0) [0|1] "" Vector__XXX
 SG_ VCFRONT2_a015_NVMMRecordIDError m15 : 18|1@1+ (1,0) [0|1] "" Vector__XXX
 SG_ VCFRONT2_a059_voltageDrop m59 : 16|12@1+ (0.005443676,0) [0|22.29185322] "" Vector__XXX
 SG_ VCFRONT2_a059_resistanceEstimate m59 : 28|12@1+ (0.00244,0) [0|9.9918] "" Vector__XXX
 SG_ VCFRONT2_a059_current m59 : 40|12@1+ (0.05,0) [0|204.75] "" Vector__XXX
 SG_ VCFRONT2_a063_switchChannel m63 : 16|8@1+ (1,0) [0|255] "" Vector__XXX
 SG_ VCFRONT2_a063_switchType m63 : 24|8@1+ (1,0) [0|255] "" Vector__XXX
 SG_ VCFRONT2_a063_ADCVoltage m63 : 32|8@1+ (0.025,0) [0|6.375] "" Vector__XXX
 SG_ VCFRONT2_a063_disconnected m63 : 40|1@1+ (1,0) [0|1] "" Vector__XXX
 SG_ VCFRONT2_a063_indeterminate m63 : 41|1@1+ (1,0) [0|1] "" Vector__XXX
 SG_ VCFRONT2_a063_stuckActive m63 : 42|1@1+ (1,0) [0|1] "" Vector__XXX
 SG_ VCFRONT2_a063_faulted m63 : 43|1@1+ (1,0) [0|1] "" Vector__XXX
 SG_ VCFRONT2_a091_FRONTIPC_faultsAnd m91 : 16|1@1+ (1,0) [0|1] "" Vector__XXX
 SG_ VCFRONT2_a091_FRONTIPC_state m91 : 17|1@1+ (1,0) [0|1] "" Vector__XXX
 SG_ VCFRONT2_a096_FRONTIPC_status m96 : 16|1@1+ (1,0) [0|1] "" Vector__XXX
 SG_ VCFRONT2_a098_FRONTIPC_temperatu m98 : 16|1@1+ (1,0) [0|1] "" Vector__XXX
 SG_ VCFRONT2_a098_FRONTIPC_thermalCo m98 : 17|1@1+ (1,0) [0|1] "" Vector__XXX
 SG_ VCFRONT2_a106_BATTIPC_dcdcRailSt m106 : 16|1@1+ (1,0) [0|1] "" Vector__XXX
 SG_ VCFRONT2_a106_BATTIPC_dcdcStatus m106 : 17|1@1+ (1,0) [0|1] "" Vector__XXX
 SG_ VCFRONT2_a106_VEH_dcdcStatus m106 : 18|1@1+ (1,0) [0|1] "" Vector__XXX
 SG_ VCFRONT2_a106_VEH_thermalControl m106 : 19|1@1+ (1,0) [0|1] "" Vector__XXX
 SG_ VCFRONT2_a106_VEH_dcdcRailStatus m106 : 20|1@1+ (1,0) [0|1] "" Vector__XXX
 SG_ VCFRONT2_a106_CH_dcdcRailStatus m106 : 21|1@1+ (1,0) [0|1] "" Vector__XXX
 SG_ VCFRONT2_a106_CH_alertMatrix m106 : 22|1@1+ (1,0) [0|1] "" Vector__XXX
 SG_ VCFRONT2_a106_FRONTIPC_thermalCo m106 : 23|1@1+ (1,0) [0|1] "" Vector__XXX
 SG_ VCFRONT2_a106_FRONTIPC_dcdcRailS m106 : 24|1@1+ (1,0) [0|1] "" Vector__XXX
 SG_ VCFRONT2_a106_FRONTIPC_dcdcStatu m106 : 25|1@1+ (1,0) [0|1] "" Vector__XXX
 SG_ VCFRONT2_a108_FRONTIPC_status m108 : 16|1@1+ (1,0) [0|1] "" Vector__XXX
 SG_ VCFRONT2_a108_FRONTIPC_temperatu m108 : 17|1@1+ (1,0) [0|1] "" Vector__XXX
 SG_ VCFRONT2_a108_FRONTIPC_thermalCo m108 : 18|1@1+ (1,0) [0|1] "" Vector__XXX
 SG_ VCFRONT2_a108_FRONTIPC_motorStat m108 : 19|1@1+ (1,0) [0|1] "" Vector__XXX
 SG_ VCFRONT2_a120_BATTIPC_speed m120 : 16|1@1+ (1,0) [0|1] "" Vector__XXX
 SG_ VCFRONT2_a120_FRONTIPC_speed m120 : 17|1@1+ (1,0) [0|1] "" Vector__XXX
 SG_ VCFRONT2_a120_FRONTIPC_systemSta m120 : 18|1@1+ (1,0) [0|1] "" Vector__XXX
 SG_ VCFRONT2_a120_BATTIPC_systemStat m120 : 19|1@1+ (1,0) [0|1] "" Vector__XXX
 SG_ VCFRONT2_a120_FRONTIPC_systemPow m120 : 20|1@1+ (1,0) [0|1] "" Vector__XXX
 SG_ VCFRONT2_a120_FRONTIPC_autonomyH m120 : 21|1@1+ (1,0) [0|1] "" Vector__XXX
 SG_ VCFRONT2_a120_BATTIPC_chassisCon m120 : 22|1@1+ (1,0) [0|1] "" Vector__XXX
 SG_ VCFRONT2_a120_FRONTIPC_chassisCo m120 : 23|1@1+ (1,0) [0|1] "" Vector__XXX
 SG_ VCFRONT2_a120_FRONTIPC_odometerS m120 : 24|1@1+ (1,0) [0|1] "" Vector__XXX
 SG_ VCFRONT2_a124_FRONTIPC_status m124 : 16|1@1+ (1,0) [0|1] "" Vector__XXX
 SG_ VCFRONT2_a124_BATTIPC_status m124 : 17|1@1+ (1,0) [0|1] "" Vector__XXX
 SG_ VCFRONT2_a125_FRONTIPC_leftStalk m125 : 16|1@1+ (1,0) [0|1] "" Vector__XXX
 SG_ VCFRONT2_a125_FRONTIPC_steerAngl m125 : 17|1@1+ (1,0) [0|1] "" Vector__XXX
 SG_ VCFRONT2_a125_FRONTIPC_info m125 : 18|1@1+ (1,0) [0|1] "" Vector__XXX
 SG_ VCFRONT2_a126_FRONTIPC_sysStatus m126 : 16|1@1+ (1,0) [0|1] "" Vector__XXX
 SG_ VCFRONT2_a126_BATTIPC_sysStatus m126 : 17|1@1+ (1,0) [0|1] "" Vector__XXX
 SG_ VCFRONT2_a126_FRONTIPC_status m126 : 18|1@1+ (1,0) [0|1] "" Vector__XXX
 SG_ VCFRONT2_a126_BATTIPC_status m126 : 19|1@1+ (1,0) [0|1] "" Vector__XXX
 SG_ VCFRONT2_a131_FRONTIPC_power m131 : 16|1@1+ (1,0) [0|1] "" Vector__XXX
 SG_ VCFRONT2_a131_BATTIPC_power m131 : 17|1@1+ (1,0) [0|1] "" Vector__XXX
 SG_ VCFRONT2_a133_BATTIPC_primaryAct m133 : 16|1@1+ (1,0) [0|1] "" Vector__XXX
 SG_ VCFRONT2_a133_FRONTIPC_secondary m133 : 17|1@1+ (1,0) [0|1] "" Vector__XXX
 SG_ VCFRONT2_a142_driverState m142 : 16|4@1+ (1,0) [0|15] "" Vector__XXX
 SG_ VCFRONT2_a142_driverThermWarn m142 : 20|1@1+ (1,0) [0|1] "" Vector__XXX
 SG_ VCFRONT2_a142_driverThermShutdow m142 : 21|1@1+ (1,0) [0|1] "" Vector__XXX
 SG_ VCFRONT2_a142_undervoltage m142 : 22|1@1+ (1,0) [0|1] "" Vector__XXX
 SG_ VCFRONT2_a142_chargePumpUndervol m142 : 23|1@1+ (1,0) [0|1] "" Vector__XXX
 SG_ VCFRONT2_a142_isCoilOpenX m142 : 24|1@1+ (1,0) [0|1] "" Vector__XXX
 SG_ VCFRONT2_a142_isCoilOpenY m142 : 25|1@1+ (1,0) [0|1] "" Vector__XXX
 SG_ VCFRONT2_a142_isCoilShortXPGnd m142 : 26|1@1+ (1,0) [0|1] "" Vector__XXX
 SG_ VCFRONT2_a142_isCoilShortXPVbb m142 : 27|1@1+ (1,0) [0|1] "" Vector__XXX
 SG_ VCFRONT2_a142_isCoilShortXNGnd m142 : 28|1@1+ (1,0) [0|1] "" Vector__XXX
 SG_ VCFRONT2_a142_isCoilShortXNVbb m142 : 29|1@1+ (1,0) [0|1] "" Vector__XXX
 SG_ VCFRONT2_a142_isCoilShortYPGnd m142 : 30|1@1+ (1,0) [0|1] "" Vector__XXX
 SG_ VCFRONT2_a142_isCoilShortYPVbb m142 : 31|1@1+ (1,0) [0|1] "" Vector__XXX
 SG_ VCFRONT2_a142_isCoilShortYNGnd m142 : 32|1@1+ (1,0) [0|1] "" Vector__XXX
 SG_ VCFRONT2_a142_isCoilShortYNVbb m142 : 33|1@1+ (1,0) [0|1] "" Vector__XXX
 SG_ VCFRONT2_a142_driverHasCommError m142 : 34|1@1+ (1,0) [0|1] "" Vector__XXX
 SG_ VCFRONT2_a144_FRONTIPC_status m144 : 16|1@1+ (1,0) [0|1] "" Vector__XXX
 SG_ VCFRONT2_a144_BATTIPC_status m144 : 17|1@1+ (1,0) [0|1] "" Vector__XXX
 SG_ VCFRONT2_a150_RPMActual m150 : 16|10@1+ (10,0) [0|10230] "" Vector__XXX
 SG_ VCFRONT2_a150_RPMTarget m150 : 26|10@1+ (10,0) [0|10230] "" Vector__XXX
 SG_ VCFRONT2_a159_stall m159 : 16|1@1+ (1,0) [0|1] "" Vector__XXX
 SG_ VCFRONT2_a159_angleActual m159 : 17|10@1+ (0.25,-70) [-70|185.75] "" Vector__XXX
 SG_ VCFRONT2_a159_angleTarget m159 : 27|10@1+ (0.25,-10) [-10|245.75] "" Vector__XXX
 SG_ VCFRONT2_a171_VCFRONT m171 : 16|1@1+ (1,0) [0|1] "" Vector__XXX
 SG_ VCFRONT2_a171_VCRIGHT m171 : 17|1@1+ (1,0) [0|1] "" Vector__XXX
 SG_ VCFRONT2_a171_VCLEFT m171 : 18|1@1+ (1,0) [0|1] "" Vector__XXX
 SG_ VCFRONT2_a171_VCBATT m171 : 19|1@1+ (1,0) [0|1] "" Vector__XXX
 SG_ VCFRONT2_a171_BMS m171 : 20|1@1+ (1,0) [0|1] "" Vector__XXX
 SG_ VCFRONT2_a171_HVP m171 : 21|1@1+ (1,0) [0|1] "" Vector__XXX
 SG_ VCFRONT2_a171_GTW m171 : 22|1@1+ (1,0) [0|1] "" Vector__XXX
 SG_ VCFRONT2_a171_CP m171 : 23|1@1+ (1,0) [0|1] "" Vector__XXX
 SG_ VCFRONT2_a171_PCS m171 : 24|1@1+ (1,0) [0|1] "" Vector__XXX
 SG_ VCFRONT2_a171_PCSCPU2 m171 : 25|1@1+ (1,0) [0|1] "" Vector__XXX
 SG_ VCFRONT2_a171_DI m171 : 26|1@1+ (1,0) [0|1] "" Vector__XXX
 SG_ VCFRONT2_a171_DIS m171 : 27|1@1+ (1,0) [0|1] "" Vector__XXX
 SG_ VCFRONT2_a171_PM m171 : 28|1@1+ (1,0) [0|1] "" Vector__XXX
 SG_ VCFRONT2_a171_PMS m171 : 29|1@1+ (1,0) [0|1] "" Vector__XXX
 SG_ VCFRONT2_a171_EPBR m171 : 30|1@1+ (1,0) [0|1] "" Vector__XXX
 SG_ VCFRONT2_a171_EPBL m171 : 31|1@1+ (1,0) [0|1] "" Vector__XXX
 SG_ VCFRONT2_a171_IBST m171 : 32|1@1+ (1,0) [0|1] "" Vector__XXX
 SG_ VCFRONT2_a171_IBSTCAL m171 : 33|1@1+ (1,0) [0|1] "" Vector__XXX
 SG_ VCFRONT2_a171_ESP m171 : 34|1@1+ (1,0) [0|1] "" Vector__XXX
 SG_ VCFRONT2_a171_ESPCAL m171 : 35|1@1+ (1,0) [0|1] "" Vector__XXX
 SG_ VCFRONT2_a171_OPC m171 : 36|1@1+ (1,0) [0|1] "" Vector__XXX
 SG_ VCFRONT2_a171_OPCS m171 : 37|1@1+ (1,0) [0|1] "" Vector__XXX
 SG_ VCFRONT2_a171_SCCM m171 : 38|1@1+ (1,0) [0|1] "" Vector__XXX
 SG_ VCFRONT2_a171_LVBMS m171 : 39|1@1+ (1,0) [0|1] "" Vector__XXX
 SG_ VCFRONT2_a171_IDB m171 : 40|1@1+ (1,0) [0|1] "" Vector__XXX
 SG_ VCFRONT2_a171_IDB1 m171 : 41|1@1+ (1,0) [0|1] "" Vector__XXX
 SG_ VCFRONT2_a171_IDBCAL m171 : 42|1@1+ (1,0) [0|1] "" Vector__XXX
 SG_ VCFRONT2_a171_RCU m171 : 43|1@1+ (1,0) [0|1] "" Vector__XXX
 SG_ VCFRONT2_a171_RCUCAL m171 : 44|1@1+ (1,0) [0|1] "" Vector__XXX
 SG_ VCFRONT2_a171_DPB m171 : 45|1@1+ (1,0) [0|1] "" Vector__XXX
 SG_ VCFRONT2_a171_DPBCAL m171 : 46|1@1+ (1,0) [0|1] "" Vector__XXX
 SG_ VCFRONT2_a171_serviceMode m171 : 47|1@1+ (1,0) [0|1] "" Vector__XXX
 SG_ VCFRONT2_a172_ECUMismatchBits m172 : 16|47@1+ (1,0) [0|140737488355327] "" Vector__XXX
 SG_ VCFRONT2_a172_serviceMode m172 : 63|1@1+ (1,0) [0|1] "" Vector__XXX
 SG_ VCFRONT2_a173_ECUMismatchBits m173 : 16|47@1+ (1,0) [0|140737488355327] "" Vector__XXX
 SG_ VCFRONT2_a173_serviceMode m173 : 63|1@1+ (1,0) [0|1] "" Vector__XXX
 SG_ VCFRONT2_a176_vehicleState m176 : 16|5@1+ (1,0) [0|31] "" Vector__XXX
 SG_ VCFRONT2_a186_noDriveChgCableCon m186 : 16|1@1+ (1,0) [0|1] "" Vector__XXX
 SG_ VCFRONT2_a187_vehBusRetryCount m187 : 16|9@1+ (1,0) [0|511] "" Vector__XXX
 SG_ VCFRONT2_a187_partyBusRetryCount m187 : 25|9@1+ (1,0) [0|511] "" Vector__XXX
 SG_ VCFRONT2_a187_hvsBusRetryCount m187 : 34|9@1+ (1,0) [0|511] "" Vector__XXX
 SG_ VCFRONT2_a187_ethBusRetryCount m187 : 43|9@1+ (1,0) [0|511] "" Vector__XXX
 SG_ VCFRONT2_a187_chBusRetryCount m187 : 52|9@1+ (1,0) [0|511] "" Vector__XXX
 SG_ VCFRONT2_a195_LVVoltage m195 : 16|12@1+ (0.005443676,0) [0|22.29185322] "" Vector__XXX
 SG_ VCFRONT2_a195_serviceMode m195 : 28|1@1+ (1,0) [0|1] "" Vector__XXX
 SG_ VCFRONT2_a195_frunkOpen m195 : 29|1@1+ (1,0) [0|1] "" Vector__XXX
 SG_ VCFRONT2_a210_valveUnderTravel m210 : 16|1@1+ (1,0) [0|1] "" Vector__XXX
 SG_ VCFRONT2_a210_valveOverTravel m210 : 17|1@1+ (1,0) [0|1] "" Vector__XXX
 SG_ VCFRONT2_a210_valveNoTravel m210 : 18|1@1+ (1,0) [0|1] "" Vector__XXX
 SG_ VCFRONT2_a214_motorFaulted m214 : 16|1@1+ (1,0) [0|1] "" Vector__XXX
 SG_ VCFRONT2_a214_motorLocked m214 : 17|1@1+ (1,0) [0|1] "" Vector__XXX
 SG_ VCFRONT2_a214_ecuReset m214 : 18|1@1+ (1,0) [0|1] "" Vector__XXX
 SG_ VCFRONT2_a214_fetTempIrrational m214 : 19|1@1+ (1,0) [0|1] "" Vector__XXX
 SG_ VCFRONT2_a214_motorControlError m214 : 20|1@1+ (1,0) [0|1] "" Vector__XXX
 SG_ VCFRONT2_a214_underVoltage m214 : 21|1@1+ (1,0) [0|1] "" Vector__XXX
 SG_ VCFRONT2_a214_overVoltage m214 : 22|1@1+ (1,0) [0|1] "" Vector__XXX
 SG_ VCFRONT2_a214_hardwareOvercurren m214 : 23|1@1+ (1,0) [0|1] "" Vector__XXX
 SG_ VCFRONT2_a214_motorOpenPhase m214 : 24|1@1+ (1,0) [0|1] "" Vector__XXX
 SG_ VCFRONT2_a214_motorSoftOpenPhase m214 : 25|1@1+ (1,0) [0|1] "" Vector__XXX
 SG_ VCFRONT2_a214_motorOvertemp m214 : 26|1@1+ (1,0) [0|1] "" Vector__XXX
 SG_ VCFRONT2_a214_dcOvercurrent m214 : 27|1@1+ (1,0) [0|1] "" Vector__XXX
 SG_ VCFRONT2_a214_motorStalled m214 : 28|1@1+ (1,0) [0|1] "" Vector__XXX
 SG_ VCFRONT2_a214_selfTestFailed m214 : 29|1@1+ (1,0) [0|1] "" Vector__XXX
 SG_ VCFRONT2_a214_selfTestResult m214 : 32|3@1+ (1,0) [0|7] "" Vector__XXX
 SG_ VCFRONT2_a214_linChecksumError m214 : 35|1@1+ (1,0) [0|1] "" Vector__XXX
 SG_ VCFRONT2_a214_linFramingError m214 : 36|1@1+ (1,0) [0|1] "" Vector__XXX
 SG_ VCFRONT2_a214_phaseShorted m214 : 37|1@1+ (1,0) [0|1] "" Vector__XXX
 SG_ VCFRONT2_a214_busVoltageIrration m214 : 38|1@1+ (1,0) [0|1] "" Vector__XXX
 SG_ VCFRONT2_a214_dcCurrentIrrationa m214 : 39|1@1+ (1,0) [0|1] "" Vector__XXX
 SG_ VCFRONT2_a214_motorSpeedIrration m214 : 40|1@1+ (1,0) [0|1] "" Vector__XXX
 SG_ VCFRONT2_a214_supplyVoltageIrrat m214 : 41|1@1+ (1,0) [0|1] "" Vector__XXX
 SG_ VCFRONT2_a214_motorPhaseCurrentI m214 : 42|1@1+ (1,0) [0|1] "" Vector__XXX
 SG_ VCFRONT2_a214_chipOvertemp m214 : 43|1@1+ (1,0) [0|1] "" Vector__XXX
 SG_ VCFRONT2_a214_motorSpeedTooHigh m214 : 44|1@1+ (1,0) [0|1] "" Vector__XXX
 SG_ VCFRONT2_a214_phaseOvercurrent m214 : 45|1@1+ (1,0) [0|1] "" Vector__XXX
 SG_ VCFRONT2_a214_vddaOvercurrent m214 : 46|1@1+ (1,0) [0|1] "" Vector__XXX
 SG_ VCFRONT2_a214_busVoltageUnhealth m214 : 47|1@1+ (1,0) [0|1] "" Vector__XXX
 SG_ VCFRONT2_a214_hsVdsOvervoltage m214 : 48|1@1+ (1,0) [0|1] "" Vector__XXX
 SG_ VCFRONT2_a214_hsVdsOvervoltageMa m214 : 49|3@1+ (1,0) [0|7] "" Vector__XXX
 SG_ VCFRONT2_a214_lsVdsOvervoltage m214 : 52|1@1+ (1,0) [0|1] "" Vector__XXX
 SG_ VCFRONT2_a214_lsVdsOvervoltageMa m214 : 53|3@1+ (1,0) [0|7] "" Vector__XXX
 SG_ VCFRONT2_a214_payloadBitsNotSet m214 : 56|1@1+ (1,0) [0|1] "" Vector__XXX
 SG_ VCFRONT2_a217_motorFaulted m217 : 16|1@1+ (1,0) [0|1] "" Vector__XXX
 SG_ VCFRONT2_a217_motorLocked m217 : 17|1@1+ (1,0) [0|1] "" Vector__XXX
 SG_ VCFRONT2_a217_ecuReset m217 : 18|1@1+ (1,0) [0|1] "" Vector__XXX
 SG_ VCFRONT2_a217_fetTempIrrational m217 : 19|1@1+ (1,0) [0|1] "" Vector__XXX
 SG_ VCFRONT2_a217_motorControlError m217 : 20|1@1+ (1,0) [0|1] "" Vector__XXX
 SG_ VCFRONT2_a217_underVoltage m217 : 21|1@1+ (1,0) [0|1] "" Vector__XXX
 SG_ VCFRONT2_a217_overVoltage m217 : 22|1@1+ (1,0) [0|1] "" Vector__XXX
 SG_ VCFRONT2_a217_hardwareOvercurren m217 : 23|1@1+ (1,0) [0|1] "" Vector__XXX
 SG_ VCFRONT2_a217_motorOpenPhase m217 : 24|1@1+ (1,0) [0|1] "" Vector__XXX
 SG_ VCFRONT2_a217_motorSoftOpenPhase m217 : 25|1@1+ (1,0) [0|1] "" Vector__XXX
 SG_ VCFRONT2_a217_motorOvertemp m217 : 26|1@1+ (1,0) [0|1] "" Vector__XXX
 SG_ VCFRONT2_a217_dcOvercurrent m217 : 27|1@1+ (1,0) [0|1] "" Vector__XXX
 SG_ VCFRONT2_a217_motorStalled m217 : 28|1@1+ (1,0) [0|1] "" Vector__XXX
 SG_ VCFRONT2_a217_selfTestFailed m217 : 29|1@1+ (1,0) [0|1] "" Vector__XXX
 SG_ VCFRONT2_a217_selfTestResult m217 : 32|3@1+ (1,0) [0|7] "" Vector__XXX
 SG_ VCFRONT2_a217_linChecksumError m217 : 35|1@1+ (1,0) [0|1] "" Vector__XXX
 SG_ VCFRONT2_a217_linFramingError m217 : 36|1@1+ (1,0) [0|1] "" Vector__XXX
 SG_ VCFRONT2_a217_phaseShorted m217 : 37|1@1+ (1,0) [0|1] "" Vector__XXX
 SG_ VCFRONT2_a217_busVoltageIrration m217 : 38|1@1+ (1,0) [0|1] "" Vector__XXX
 SG_ VCFRONT2_a217_dcCurrentIrrationa m217 : 39|1@1+ (1,0) [0|1] "" Vector__XXX
 SG_ VCFRONT2_a217_motorSpeedIrration m217 : 40|1@1+ (1,0) [0|1] "" Vector__XXX
 SG_ VCFRONT2_a217_supplyVoltageIrrat m217 : 41|1@1+ (1,0) [0|1] "" Vector__XXX
 SG_ VCFRONT2_a217_motorPhaseCurrentI m217 : 42|1@1+ (1,0) [0|1] "" Vector__XXX
 SG_ VCFRONT2_a217_chipOvertemp m217 : 43|1@1+ (1,0) [0|1] "" Vector__XXX
 SG_ VCFRONT2_a217_motorSpeedTooHigh m217 : 44|1@1+ (1,0) [0|1] "" Vector__XXX
 SG_ VCFRONT2_a217_phaseOvercurrent m217 : 45|1@1+ (1,0) [0|1] "" Vector__XXX
 SG_ VCFRONT2_a217_vddaOvercurrent m217 : 46|1@1+ (1,0) [0|1] "" Vector__XXX
 SG_ VCFRONT2_a217_busVoltageUnhealth m217 : 47|1@1+ (1,0) [0|1] "" Vector__XXX
 SG_ VCFRONT2_a217_hsVdsOvervoltage m217 : 48|1@1+ (1,0) [0|1] "" Vector__XXX
 SG_ VCFRONT2_a217_hsVdsOvervoltageMa m217 : 49|3@1+ (1,0) [0|7] "" Vector__XXX
 SG_ VCFRONT2_a217_lsVdsOvervoltage m217 : 52|1@1+ (1,0) [0|1] "" Vector__XXX
 SG_ VCFRONT2_a217_lsVdsOvervoltageMa m217 : 53|3@1+ (1,0) [0|7] "" Vector__XXX
 SG_ VCFRONT2_a217_payloadBitsNotSet m217 : 56|1@1+ (1,0) [0|1] "" Vector__XXX
 SG_ VCFRONT2_a235_ptSensorTemp m235 : 16|11@1+ (0.125,-40) [-40|215.875] "" Vector__XXX
 SG_ VCFRONT2_a236_batSensorTemp m236 : 16|11@1+ (0.125,-40) [-40|215.875] "" Vector__XXX
 SG_ VCFRONT2_a247_solenoidISense m247 : 16|8@1- (0.01,0) [-1.28|1.27] "" Vector__XXX
 SG_ VCFRONT2_a249_tempCoolantBatInle m249 : 16|10@1+ (0.125,-40) [-40|87.875] "" Vector__XXX
 SG_ VCFRONT2_a249_tempCoolantPTInlet m249 : 26|11@1+ (0.125,-40) [-40|215.875] "" Vector__XXX
 SG_ VCFRONT2_a254_RPMActual m254 : 16|10@1+ (10,0) [0|10230] "" Vector__XXX
 SG_ VCFRONT2_a254_RPMTarget m254 : 26|10@1+ (10,0) [0|10230] "" Vector__XXX
 SG_ VCFRONT2_a283_thmlFanDisabled m283 : 16|1@1+ (1,0) [0|1] "" Vector__XXX
 SG_ VCFRONT2_a283_thmlFanLimited m283 : 17|1@1+ (1,0) [0|1] "" Vector__XXX
 SG_ VCFRONT2_a283_thmlFanDemand m283 : 24|7@1+ (1,0) [0|127] "" Vector__XXX
 SG_ VCFRONT2_a283_thmlFanDemandLimit m283 : 32|7@1+ (1,0) [0|127] "" Vector__XXX
 SG_ VCFRONT2_a283_thmlFanPhaseI m283 : 40|7@1+ (0.25,5) [5|36.75] "" Vector__XXX
 SG_ VCFRONT2_a283_thmlFanPhaseILimit m283 : 48|7@1+ (0.25,5) [5|36.75] "" Vector__XXX
 SG_ VCFRONT2_a284_driverState m284 : 16|4@1+ (1,0) [0|15] "" Vector__XXX
 SG_ VCFRONT2_a284_driverThermWarn m284 : 20|1@1+ (1,0) [0|1] "" Vector__XXX
 SG_ VCFRONT2_a284_driverThermShutdow m284 : 21|1@1+ (1,0) [0|1] "" Vector__XXX
 SG_ VCFRONT2_a284_undervoltage m284 : 22|1@1+ (1,0) [0|1] "" Vector__XXX
 SG_ VCFRONT2_a284_chargePumpUndervol m284 : 23|1@1+ (1,0) [0|1] "" Vector__XXX
 SG_ VCFRONT2_a284_isCoilOpenX m284 : 24|1@1+ (1,0) [0|1] "" Vector__XXX
 SG_ VCFRONT2_a284_isCoilOpenY m284 : 25|1@1+ (1,0) [0|1] "" Vector__XXX
 SG_ VCFRONT2_a284_isCoilShortXPGnd m284 : 26|1@1+ (1,0) [0|1] "" Vector__XXX
 SG_ VCFRONT2_a284_isCoilShortXPVbb m284 : 27|1@1+ (1,0) [0|1] "" Vector__XXX
 SG_ VCFRONT2_a284_isCoilShortXNGnd m284 : 28|1@1+ (1,0) [0|1] "" Vector__XXX
 SG_ VCFRONT2_a284_isCoilShortXNVbb m284 : 29|1@1+ (1,0) [0|1] "" Vector__XXX
 SG_ VCFRONT2_a284_isCoilShortYPGnd m284 : 30|1@1+ (1,0) [0|1] "" Vector__XXX
 SG_ VCFRONT2_a284_isCoilShortYPVbb m284 : 31|1@1+ (1,0) [0|1] "" Vector__XXX
 SG_ VCFRONT2_a284_isCoilShortYNGnd m284 : 32|1@1+ (1,0) [0|1] "" Vector__XXX
 SG_ VCFRONT2_a284_isCoilShortYNVbb m284 : 33|1@1+ (1,0) [0|1] "" Vector__XXX
 SG_ VCFRONT2_a284_driverHasCommError m284 : 34|1@1+ (1,0) [0|1] "" Vector__XXX
 SG_ VCFRONT2_a285_driverState m285 : 16|4@1+ (1,0) [0|15] "" Vector__XXX
 SG_ VCFRONT2_a285_driverThermWarn m285 : 20|1@1+ (1,0) [0|1] "" Vector__XXX
 SG_ VCFRONT2_a285_driverThermShutdow m285 : 21|1@1+ (1,0) [0|1] "" Vector__XXX
 SG_ VCFRONT2_a285_undervoltage m285 : 22|1@1+ (1,0) [0|1] "" Vector__XXX
 SG_ VCFRONT2_a285_chargePumpUndervol m285 : 23|1@1+ (1,0) [0|1] "" Vector__XXX
 SG_ VCFRONT2_a285_isCoilOpenX m285 : 24|1@1+ (1,0) [0|1] "" Vector__XXX
 SG_ VCFRONT2_a285_isCoilOpenY m285 : 25|1@1+ (1,0) [0|1] "" Vector__XXX
 SG_ VCFRONT2_a285_isCoilShortXPGnd m285 : 26|1@1+ (1,0) [0|1] "" Vector__XXX
 SG_ VCFRONT2_a285_isCoilShortXPVbb m285 : 27|1@1+ (1,0) [0|1] "" Vector__XXX
 SG_ VCFRONT2_a285_isCoilShortXNGnd m285 : 28|1@1+ (1,0) [0|1] "" Vector__XXX
 SG_ VCFRONT2_a285_isCoilShortXNVbb m285 : 29|1@1+ (1,0) [0|1] "" Vector__XXX
 SG_ VCFRONT2_a285_isCoilShortYPGnd m285 : 30|1@1+ (1,0) [0|1] "" Vector__XXX
 SG_ VCFRONT2_a285_isCoilShortYPVbb m285 : 31|1@1+ (1,0) [0|1] "" Vector__XXX
 SG_ VCFRONT2_a285_isCoilShortYNGnd m285 : 32|1@1+ (1,0) [0|1] "" Vector__XXX
 SG_ VCFRONT2_a285_isCoilShortYNVbb m285 : 33|1@1+ (1,0) [0|1] "" Vector__XXX
 SG_ VCFRONT2_a285_driverHasCommError m285 : 34|1@1+ (1,0) [0|1] "" Vector__XXX
 SG_ VCFRONT2_a286_driverState m286 : 16|4@1+ (1,0) [0|15] "" Vector__XXX
 SG_ VCFRONT2_a286_driverThermWarn m286 : 20|1@1+ (1,0) [0|1] "" Vector__XXX
 SG_ VCFRONT2_a286_driverThermShutdow m286 : 21|1@1+ (1,0) [0|1] "" Vector__XXX
 SG_ VCFRONT2_a286_undervoltage m286 : 22|1@1+ (1,0) [0|1] "" Vector__XXX
 SG_ VCFRONT2_a286_chargePumpUndervol m286 : 23|1@1+ (1,0) [0|1] "" Vector__XXX
 SG_ VCFRONT2_a286_isCoilOpenX m286 : 24|1@1+ (1,0) [0|1] "" Vector__XXX
 SG_ VCFRONT2_a286_isCoilOpenY m286 : 25|1@1+ (1,0) [0|1] "" Vector__XXX
 SG_ VCFRONT2_a286_isCoilShortXPGnd m286 : 26|1@1+ (1,0) [0|1] "" Vector__XXX
 SG_ VCFRONT2_a286_isCoilShortXPVbb m286 : 27|1@1+ (1,0) [0|1] "" Vector__XXX
 SG_ VCFRONT2_a286_isCoilShortXNGnd m286 : 28|1@1+ (1,0) [0|1] "" Vector__XXX
 SG_ VCFRONT2_a286_isCoilShortXNVbb m286 : 29|1@1+ (1,0) [0|1] "" Vector__XXX
 SG_ VCFRONT2_a286_isCoilShortYPGnd m286 : 30|1@1+ (1,0) [0|1] "" Vector__XXX
 SG_ VCFRONT2_a286_isCoilShortYPVbb m286 : 31|1@1+ (1,0) [0|1] "" Vector__XXX
 SG_ VCFRONT2_a286_isCoilShortYNGnd m286 : 32|1@1+ (1,0) [0|1] "" Vector__XXX
 SG_ VCFRONT2_a286_isCoilShortYNVbb m286 : 33|1@1+ (1,0) [0|1] "" Vector__XXX
 SG_ VCFRONT2_a286_driverHasCommError m286 : 34|1@1+ (1,0) [0|1] "" Vector__XXX
 SG_ VCFRONT2_a287_driverState m287 : 16|4@1+ (1,0) [0|15] "" Vector__XXX
 SG_ VCFRONT2_a287_driverThermWarn m287 : 20|1@1+ (1,0) [0|1] "" Vector__XXX
 SG_ VCFRONT2_a287_driverThermShutdow m287 : 21|1@1+ (1,0) [0|1] "" Vector__XXX
 SG_ VCFRONT2_a287_undervoltage m287 : 22|1@1+ (1,0) [0|1] "" Vector__XXX
 SG_ VCFRONT2_a287_chargePumpUndervol m287 : 23|1@1+ (1,0) [0|1] "" Vector__XXX
 SG_ VCFRONT2_a287_isCoilOpenX m287 : 24|1@1+ (1,0) [0|1] "" Vector__XXX
 SG_ VCFRONT2_a287_isCoilOpenY m287 : 25|1@1+ (1,0) [0|1] "" Vector__XXX
 SG_ VCFRONT2_a287_isCoilShortXPGnd m287 : 26|1@1+ (1,0) [0|1] "" Vector__XXX
 SG_ VCFRONT2_a287_isCoilShortXPVbb m287 : 27|1@1+ (1,0) [0|1] "" Vector__XXX
 SG_ VCFRONT2_a287_isCoilShortXNGnd m287 : 28|1@1+ (1,0) [0|1] "" Vector__XXX
 SG_ VCFRONT2_a287_isCoilShortXNVbb m287 : 29|1@1+ (1,0) [0|1] "" Vector__XXX
 SG_ VCFRONT2_a287_isCoilShortYPGnd m287 : 30|1@1+ (1,0) [0|1] "" Vector__XXX
 SG_ VCFRONT2_a287_isCoilShortYPVbb m287 : 31|1@1+ (1,0) [0|1] "" Vector__XXX
 SG_ VCFRONT2_a287_isCoilShortYNGnd m287 : 32|1@1+ (1,0) [0|1] "" Vector__XXX
 SG_ VCFRONT2_a287_isCoilShortYNVbb m287 : 33|1@1+ (1,0) [0|1] "" Vector__XXX
 SG_ VCFRONT2_a287_driverHasCommError m287 : 34|1@1+ (1,0) [0|1] "" Vector__XXX
 SG_ VCFRONT2_a288_driverState m288 : 16|4@1+ (1,0) [0|15] "" Vector__XXX
 SG_ VCFRONT2_a288_driverThermWarn m288 : 20|1@1+ (1,0) [0|1] "" Vector__XXX
 SG_ VCFRONT2_a288_driverThermShutdow m288 : 21|1@1+ (1,0) [0|1] "" Vector__XXX
 SG_ VCFRONT2_a288_undervoltage m288 : 22|1@1+ (1,0) [0|1] "" Vector__XXX
 SG_ VCFRONT2_a288_chargePumpUndervol m288 : 23|1@1+ (1,0) [0|1] "" Vector__XXX
 SG_ VCFRONT2_a288_isCoilOpenX m288 : 24|1@1+ (1,0) [0|1] "" Vector__XXX
 SG_ VCFRONT2_a288_isCoilOpenY m288 : 25|1@1+ (1,0) [0|1] "" Vector__XXX
 SG_ VCFRONT2_a288_isCoilShortXPGnd m288 : 26|1@1+ (1,0) [0|1] "" Vector__XXX
 SG_ VCFRONT2_a288_isCoilShortXPVbb m288 : 27|1@1+ (1,0) [0|1] "" Vector__XXX
 SG_ VCFRONT2_a288_isCoilShortXNGnd m288 : 28|1@1+ (1,0) [0|1] "" Vector__XXX
 SG_ VCFRONT2_a288_isCoilShortXNVbb m288 : 29|1@1+ (1,0) [0|1] "" Vector__XXX
 SG_ VCFRONT2_a288_isCoilShortYPGnd m288 : 30|1@1+ (1,0) [0|1] "" Vector__XXX
 SG_ VCFRONT2_a288_isCoilShortYPVbb m288 : 31|1@1+ (1,0) [0|1] "" Vector__XXX
 SG_ VCFRONT2_a288_isCoilShortYNGnd m288 : 32|1@1+ (1,0) [0|1] "" Vector__XXX
 SG_ VCFRONT2_a288_isCoilShortYNVbb m288 : 33|1@1+ (1,0) [0|1] "" Vector__XXX
 SG_ VCFRONT2_a288_driverHasCommError m288 : 34|1@1+ (1,0) [0|1] "" Vector__XXX
 SG_ VCFRONT2_a289_driverState m289 : 16|4@1+ (1,0) [0|15] "" Vector__XXX
 SG_ VCFRONT2_a289_driverThermWarn m289 : 20|1@1+ (1,0) [0|1] "" Vector__XXX
 SG_ VCFRONT2_a289_driverThermShutdow m289 : 21|1@1+ (1,0) [0|1] "" Vector__XXX
 SG_ VCFRONT2_a289_undervoltage m289 : 22|1@1+ (1,0) [0|1] "" Vector__XXX
 SG_ VCFRONT2_a289_chargePumpUndervol m289 : 23|1@1+ (1,0) [0|1] "" Vector__XXX
 SG_ VCFRONT2_a289_isCoilOpenX m289 : 24|1@1+ (1,0) [0|1] "" Vector__XXX
 SG_ VCFRONT2_a289_isCoilOpenY m289 : 25|1@1+ (1,0) [0|1] "" Vector__XXX
 SG_ VCFRONT2_a289_isCoilShortXPGnd m289 : 26|1@1+ (1,0) [0|1] "" Vector__XXX
 SG_ VCFRONT2_a289_isCoilShortXPVbb m289 : 27|1@1+ (1,0) [0|1] "" Vector__XXX
 SG_ VCFRONT2_a289_isCoilShortXNGnd m289 : 28|1@1+ (1,0) [0|1] "" Vector__XXX
 SG_ VCFRONT2_a289_isCoilShortXNVbb m289 : 29|1@1+ (1,0) [0|1] "" Vector__XXX
 SG_ VCFRONT2_a289_isCoilShortYPGnd m289 : 30|1@1+ (1,0) [0|1] "" Vector__XXX
 SG_ VCFRONT2_a289_isCoilShortYPVbb m289 : 31|1@1+ (1,0) [0|1] "" Vector__XXX
 SG_ VCFRONT2_a289_isCoilShortYNGnd m289 : 32|1@1+ (1,0) [0|1] "" Vector__XXX
 SG_ VCFRONT2_a289_isCoilShortYNVbb m289 : 33|1@1+ (1,0) [0|1] "" Vector__XXX
 SG_ VCFRONT2_a289_driverHasCommError m289 : 34|1@1+ (1,0) [0|1] "" Vector__XXX
 SG_ VCFRONT2_a302_LINFrameStatus m302 : 16|3@1+ (1,0) [0|7] "" Vector__XXX
 SG_ VCFRONT2_a355_fluidNotFilled m355 : 16|1@1+ (1,0) [0|1] "" Vector__XXX
 SG_ VCFRONT2_a355_systemNotCommissio m355 : 17|1@1+ (1,0) [0|1] "" Vector__XXX
 SG_ VCFRONT2_a355_serviceLockout m355 : 18|1@1+ (1,0) [0|1] "" Vector__XXX
 SG_ VCFRONT2_a355_factoryGated m355 : 19|1@1+ (1,0) [0|1] "" Vector__XXX
 SG_ VCFRONT2_a356_fluidNotFilled m356 : 16|1@1+ (1,0) [0|1] "" Vector__XXX
 SG_ VCFRONT2_a356_systemNotCommissio m356 : 17|1@1+ (1,0) [0|1] "" Vector__XXX
 SG_ VCFRONT2_a356_serviceLockout m356 : 18|1@1+ (1,0) [0|1] "" Vector__XXX
 SG_ VCFRONT2_a356_factoryGated m356 : 19|1@1+ (1,0) [0|1] "" Vector__XXX
 SG_ VCFRONT2_a356_refCommissionStatu m356 : 20|1@1+ (1,0) [0|1] "" Vector__XXX
 SG_ VCFRONT2_a360_vehicleLoadShedAct m360 : 16|1@1+ (1,0) [0|1] "" Vector__XXX
 SG_ VCFRONT2_a360_notEnoughPowerForS m360 : 17|1@1+ (1,0) [0|1] "" Vector__XXX
 SG_ VCFRONT2_a367_bmsSoc m367 : 16|8@1+ (0.5,0) [0|127.5] "" Vector__XXX
 SG_ VCFRONT2_a368_bmsRequestRemoved m368 : 16|1@1+ (1,0) [0|1] "" Vector__XXX
 SG_ VCFRONT2_a368_enteringState m368 : 17|3@1+ (1,0) [0|7] "" Vector__XXX
 SG_ VCFRONT2_a368_exitingState m368 : 20|3@1+ (1,0) [0|7] "" Vector__XXX
 SG_ VCFRONT2_a368_bmsSoc m368 : 24|8@1+ (0.5,0) [0|127.5] "" Vector__XXX
 SG_ VCFRONT2_a368_systemFaulted m368 : 32|1@1+ (1,0) [0|1] "" Vector__XXX
 SG_ VCFRONT2_a368_coolantTempSensors m368 : 33|1@1+ (1,0) [0|1] "" Vector__XXX
 SG_ VCFRONT2_a368_coolantValveFaulte m368 : 34|1@1+ (1,0) [0|1] "" Vector__XXX
 SG_ VCFRONT2_a368_louverFaulted m368 : 35|1@1+ (1,0) [0|1] "" Vector__XXX
 SG_ VCFRONT2_a368_fansFaulted m368 : 36|1@1+ (1,0) [0|1] "" Vector__XXX
 SG_ VCFRONT2_a368_coolantNotFilled m368 : 37|1@1+ (1,0) [0|1] "" Vector__XXX
 SG_ VCFRONT2_a368_coolantPumpsFaulte m368 : 38|1@1+ (1,0) [0|1] "" Vector__XXX
 SG_ VCFRONT2_a368_preconditionsNotMe m368 : 39|1@1+ (1,0) [0|1] "" Vector__XXX
 SG_ VCFRONT2_a368_belowSocMin m368 : 40|1@1+ (1,0) [0|1] "" Vector__XXX
 SG_ VCFRONT2_a369_powerGenerationLim m369 : 16|1@1+ (1,0) [0|1] "" Vector__XXX
 SG_ VCFRONT2_a369_heatRejectionLimit m369 : 17|1@1+ (1,0) [0|1] "" Vector__XXX
 SG_ VCFRONT2_a369_bmsSoc m369 : 24|8@1+ (0.5,0) [0|127.5] "" Vector__XXX
 SG_ VCFRONT2_a369_wasteHeatPower m369 : 32|7@1+ (100,0) [0|12700] "" Vector__XXX
 SG_ VCFRONT2_a374_lccInletSolenoidIS m374 : 16|8@1- (0.01,0) [-1.28|1.27] "" Vector__XXX
 SG_ VCFRONT2_a377_wiperStuckOutOfPar m377 : 16|1@1+ (1,0) [0|1] "" Vector__XXX
 SG_ VCFRONT2_a377_wiperStuckInPark m377 : 17|1@1+ (1,0) [0|1] "" Vector__XXX
 SG_ VCFRONT2_a397_discharge m397 : 16|1@1+ (1,0) [0|1] "" Vector__XXX
 SG_ VCFRONT2_a397_suction m397 : 17|1@1+ (1,0) [0|1] "" Vector__XXX
 SG_ VCFRONT2_a397_liquid m397 : 18|1@1+ (1,0) [0|1] "" Vector__XXX
 SG_ VCFRONT2_a397_offsetError m397 : 19|10@1- (0.2,0) [-102.4|102.2] "" Vector__XXX
 SG_ VCFRONT2_a397_runTimeOffSetDetec m397 : 29|1@1+ (1,0) [0|1] "" Vector__XXX
 SG_ VCFRONT2_a409_brushlessMotorConf m409 : 16|1@1+ (1,0) [0|1] "" Vector__XXX
 SG_ VCFRONT2_a446_compFaultRefrigera m446 : 16|1@1+ (1,0) [0|1] "" Vector__XXX
 SG_ VCFRONT2_a446_compFaultTdHigh m446 : 17|1@1+ (1,0) [0|1] "" Vector__XXX
 SG_ VCFRONT2_a446_compFaultPdLow m446 : 18|1@1+ (1,0) [0|1] "" Vector__XXX
 SG_ VCFRONT2_a446_compFaultPdHigh m446 : 19|1@1+ (1,0) [0|1] "" Vector__XXX
 SG_ VCFRONT2_a446_compFaultPsLow m446 : 20|1@1+ (1,0) [0|1] "" Vector__XXX
 SG_ VCFRONT2_a446_compStandbyLowAmbi m446 : 21|1@1+ (1,0) [0|1] "" Vector__XXX
 SG_ VCFRONT2_a446_compStandbyLowDisc m446 : 22|1@1+ (1,0) [0|1] "" Vector__XXX
 SG_ VCFRONT2_a446_compStandbyHVNotRe m446 : 23|1@1+ (1,0) [0|1] "" Vector__XXX
 SG_ VCFRONT2_a446_compStandbyCommuni m446 : 24|1@1+ (1,0) [0|1] "" Vector__XXX
 SG_ VCFRONT2_a446_compStandbySelfNot m446 : 25|1@1+ (1,0) [0|1] "" Vector__XXX
 SG_ VCFRONT2_a446_compStandbyRefrigN m446 : 26|1@1+ (1,0) [0|1] "" Vector__XXX
 SG_ VCFRONT2_a446_compStandbyCoastDo m446 : 27|1@1+ (1,0) [0|1] "" Vector__XXX
 SG_ VCFRONT2_a446_compStandbyMultipl m446 : 28|1@1+ (1,0) [0|1] "" Vector__XXX
 SG_ VCFRONT2_a446_compStandbyShowroo m446 : 29|1@1+ (1,0) [0|1] "" Vector__XXX
 SG_ VCFRONT2_a446_compStandbyMu_0001 m446 : 30|1@1+ (1,0) [0|1] "" Vector__XXX
 SG_ VCFRONT2_a446_hpCabinLoadType m446 : 31|2@1+ (1,0) [0|3] "" Vector__XXX
 SG_ VCFRONT2_a446_hpBatteryLoadType m446 : 33|2@1+ (1,0) [0|3] "" Vector__XXX
 SG_ VCFRONT2_a446_usingModeledPs m446 : 35|1@1+ (1,0) [0|1] "" Vector__XXX
 SG_ VCFRONT2_a446_usingModeledPd m446 : 36|1@1+ (1,0) [0|1] "" Vector__XXX
 SG_ VCFRONT2_a446_usingModeledPl m446 : 37|1@1+ (1,0) [0|1] "" Vector__XXX
 SG_ VCFRONT2_a446_usingModeledTs m446 : 38|1@1+ (1,0) [0|1] "" Vector__XXX
 SG_ VCFRONT2_a446_usingModeledTd m446 : 39|1@1+ (1,0) [0|1] "" Vector__XXX
 SG_ VCFRONT2_a446_usingModeledTl m446 : 40|1@1+ (1,0) [0|1] "" Vector__XXX
 SG_ VCFRONT2_a446_sensorHasOffsetTd m446 : 41|1@1+ (1,0) [0|1] "" Vector__XXX
 SG_ VCFRONT2_a446_sensorHasOffsetPd m446 : 42|1@1+ (1,0) [0|1] "" Vector__XXX
 SG_ VCFRONT2_a446_sensorDroopPd m446 : 43|1@1+ (1,0) [0|1] "" Vector__XXX
 SG_ VCFRONT2_a446_sensorHasOffsetTl m446 : 44|1@1+ (1,0) [0|1] "" Vector__XXX
 SG_ VCFRONT2_a446_sensorIntermi_0002 m446 : 45|1@1+ (1,0) [0|1] "" Vector__XXX
 SG_ VCFRONT2_a446_sensorIntermittent m446 : 46|1@1+ (1,0) [0|1] "" Vector__XXX
 SG_ VCFRONT2_a446_sensorIntermi_0001 m446 : 47|1@1+ (1,0) [0|1] "" Vector__XXX
 SG_ VCFRONT2_a446_sensorIntermi_0005 m446 : 48|1@1+ (1,0) [0|1] "" Vector__XXX
 SG_ VCFRONT2_a446_sensorIntermi_0003 m446 : 49|1@1+ (1,0) [0|1] "" Vector__XXX
 SG_ VCFRONT2_a446_sensorIntermi_0004 m446 : 50|1@1+ (1,0) [0|1] "" Vector__XXX
 SG_ VCFRONT2_a446_highSuctionSuperhe m446 : 51|1@1+ (1,0) [0|1] "" Vector__XXX
 SG_ VCFRONT2_a446_evapLowPsCutout m446 : 52|1@1+ (1,0) [0|1] "" Vector__XXX
 SG_ VCFRONT2_a446_batteryOverTemp m446 : 53|1@1+ (1,0) [0|1] "" Vector__XXX
 SG_ VCFRONT2_a446_hvacSystemFault m446 : 54|1@1+ (1,0) [0|1] "" Vector__XXX
 SG_ VCFRONT2_a446_coolantSysLockedOu m446 : 55|1@1+ (1,0) [0|1] "" Vector__XXX
 SG_ VCFRONT2_a446_refSysLockedOut m446 : 56|1@1+ (1,0) [0|1] "" Vector__XXX
 SG_ VCFRONT2_a446_chillerEXVNotReady m446 : 57|1@1+ (1,0) [0|1] "" Vector__XXX
 SG_ VCFRONT2_a446_CCLEXVNotReady m446 : 58|1@1+ (1,0) [0|1] "" Vector__XXX
 SG_ VCFRONT2_a446_CCREXVNotReady m446 : 59|1@1+ (1,0) [0|1] "" Vector__XXX
 SG_ VCFRONT2_a446_LCCEXVNotReady m446 : 60|1@1+ (1,0) [0|1] "" Vector__XXX
 SG_ VCFRONT2_a446_evapEXVNotReady m446 : 61|1@1+ (1,0) [0|1] "" Vector__XXX
 SG_ VCFRONT2_a446_recircEXVNotReady m446 : 62|1@1+ (1,0) [0|1] "" Vector__XXX
 SG_ VCFRONT2_a446_checkA447Alert m446 : 63|1@1+ (1,0) [0|1] "" Vector__XXX
 SG_ VCFRONT2_a447_caseHVACUnavailabl m447 : 16|1@1+ (1,0) [0|1] "" Vector__XXX
 SG_ VCFRONT2_a447_heatPumpHVACUnavai m447 : 17|1@1+ (1,0) [0|1] "" Vector__XXX
 SG_ VCFRONT2_a447_activeLouverCompro m447 : 18|1@1+ (1,0) [0|1] "" Vector__XXX
 SG_ VCFRONT2_a447_coolantValveCompro m447 : 19|1@1+ (1,0) [0|1] "" Vector__XXX
 SG_ VCFRONT2_a447_ambientSourcingCom m447 : 20|1@1+ (1,0) [0|1] "" Vector__XXX
 SG_ VCFRONT2_a447_scavengeLoopCompro m447 : 21|1@1+ (1,0) [0|1] "" Vector__XXX
 SG_ VCFRONT2_a447_coolantSystemCompr m447 : 22|1@1+ (1,0) [0|1] "" Vector__XXX
 SG_ VCFRONT2_a447_hvBattActiveDischg m447 : 23|1@1+ (1,0) [0|1] "" Vector__XXX
 SG_ VCFRONT2_a447_hvBatteryDischargi m447 : 24|1@1+ (1,0) [0|1] "" Vector__XXX
 SG_ VCFRONT2_a447_lccSolenoidComprom m447 : 25|1@1+ (1,0) [0|1] "" Vector__XXX
 SG_ VCFRONT2_a447_refrigerantSystemC m447 : 26|1@1+ (1,0) [0|1] "" Vector__XXX
 SG_ VCFRONT2_a447_powertrainThermalF m447 : 27|1@1+ (1,0) [0|1] "" Vector__XXX
 SG_ VCFRONT2_a447_refrigDischargePre m447 : 28|1@1+ (1,0) [0|1] "" Vector__XXX
 SG_ VCFRONT2_a447_refrigeDischargeTe m447 : 29|1@1+ (1,0) [0|1] "" Vector__XXX
 SG_ VCFRONT2_a447_refrigSuctionPress m447 : 30|1@1+ (1,0) [0|1] "" Vector__XXX
 SG_ VCFRONT2_a447_refrigSuctionTempC m447 : 31|1@1+ (1,0) [0|1] "" Vector__XXX
 SG_ VCFRONT2_a447_refrigLiquidPressC m447 : 32|1@1+ (1,0) [0|1] "" Vector__XXX
 SG_ VCFRONT2_a447_refrigLiquidTempCo m447 : 33|1@1+ (1,0) [0|1] "" Vector__XXX
 SG_ VCFRONT2_a459_coolantFillActive m459 : 16|1@1+ (1,0) [0|1] "" Vector__XXX
 SG_ VCFRONT2_a459_refrigerantFillAct m459 : 17|1@1+ (1,0) [0|1] "" Vector__XXX
 SG_ VCFRONT2_a464_flowIndex m464 : 16|8@1+ (1,0) [0|255] "" Vector__XXX
 SG_ VCFRONT2_a464_flowIndexFiltered m464 : 24|8@1+ (1,0) [0|255] "" Vector__XXX
 SG_ VCFRONT2_a464_subcool m464 : 32|7@1+ (0.4,-10) [-10|40.8] "" Vector__XXX
 SG_ VCFRONT2_a464_subcoolFiltered m464 : 40|7@1+ (0.4,-10) [-10|40.8] "" Vector__XXX
 SG_ VCFRONT2_a465_flowIndex m465 : 16|8@1+ (1,0) [0|255] "" Vector__XXX
 SG_ VCFRONT2_a465_flowIndexFiltered m465 : 24|8@1+ (1,0) [0|255] "" Vector__XXX
 SG_ VCFRONT2_a465_subcool m465 : 32|7@1+ (0.4,-10) [-10|40.8] "" Vector__XXX
 SG_ VCFRONT2_a465_subcoolFiltered m465 : 40|7@1+ (0.4,-10) [-10|40.8] "" Vector__XXX
 SG_ VCFRONT2_a465_flaggedAtSteadySta m465 : 47|1@1+ (1,0) [0|1] "" Vector__XXX
 SG_ VCFRONT2_a465_flaggedAtUnsteadyS m465 : 48|1@1+ (1,0) [0|1] "" Vector__XXX
 SG_ VCFRONT2_a466_flowIndex m466 : 16|8@1+ (1,0) [0|255] "" Vector__XXX
 SG_ VCFRONT2_a466_flowIndexFiltered m466 : 24|8@1+ (1,0) [0|255] "" Vector__XXX
 SG_ VCFRONT2_a466_subcool m466 : 32|7@1+ (0.4,-10) [-10|40.8] "" Vector__XXX
 SG_ VCFRONT2_a466_subcoolFiltered m466 : 40|7@1+ (0.4,-10) [-10|40.8] "" Vector__XXX
 SG_ VCFRONT2_a467_powerIndexFiltered m467 : 16|7@1+ (1,0) [0|127] "" Vector__XXX
 SG_ VCFRONT2_a470_pressureLiquid m470 : 16|8@1+ (0.2,0) [0|51] "" Vector__XXX
 SG_ VCFRONT2_a470_pressureDischarge m470 : 24|8@1+ (0.2,0) [0|51] "" Vector__XXX
 SG_ VCFRONT2_a490_coolantPumpType m490 : 16|3@1+ (1,0) [0|7] "" Vector__XXX
 SG_ VCFRONT2_a511_PCSEFuseCurrent m511 : 16|16@1- (0.1,0) [-3276.8|3276.7] "" Vector__XXX
 SG_ VCFRONT2_a511_DCDCMaxOutputCurre m511 : 32|16@1- (0.1,0) [-3276.8|3276.7] "" Vector__XXX
 SG_ VCFRONT2_a511_hvState m511 : 48|3@1+ (1,0) [0|7] "" Vector__XXX
 SG_ VCFRONT2_a511_DCDCOutputIsLimite m511 : 51|1@1+ (1,0) [0|1] "" Vector__XXX
 SG_ VCFRONT2_a511_PCSSignalsAreValid m511 : 52|1@1+ (1,0) [0|1] "" Vector__XXX
 SG_ VCFRONT2_a511_factoryGated m511 : 53|1@1+ (1,0) [0|1] "" Vector__XXX
 SG_ VCFRONT2_a511_vehicleIsUpdating m511 : 54|1@1+ (1,0) [0|1] "" Vector__XXX
 SG_ VCFRONT2_a511_serviceMode m511 : 55|1@1+ (1,0) [0|1] "" Vector__XXX
 SG_ VCFRONT2_a511_frunkOpen m511 : 56|1@1+ (1,0) [0|1] "" Vector__XXX
 SG_ VCFRONT2_a531_powerIndexFiltered m531 : 16|7@1+ (1,0) [0|127] "" Vector__XXX
 SG_ VCFRONT2_a560_highSHCOP1 m560 : 16|1@1+ (1,0) [0|1] "" Vector__XXX
 SG_ VCFRONT2_a560_highSHBattConditio m560 : 17|1@1+ (1,0) [0|1] "" Vector__XXX
 SG_ VCFRONT2_a560_highSHCabinReheatC m560 : 18|1@1+ (1,0) [0|1] "" Vector__XXX
 SG_ VCFRONT2_a560_highSHCabinReheatH m560 : 19|1@1+ (1,0) [0|1] "" Vector__XXX
 SG_ VCFRONT2_a560_highSHCabinCooling m560 : 20|1@1+ (1,0) [0|1] "" Vector__XXX
 SG_ VCFRONT2_a560_highSHCabinHeating m560 : 21|1@1+ (1,0) [0|1] "" Vector__XXX
 SG_ VCFRONT2_a560_highSHCatchAll m560 : 22|1@1+ (1,0) [0|1] "" Vector__XXX
 SG_ VCFRONT2_a615_FRONTIPC_switchSta m615 : 16|1@1+ (1,0) [0|1] "" Vector__XXX
 SG_ VCFRONT2_a616_FRONTIPC_switchSta m616 : 16|1@1+ (1,0) [0|1] "" Vector__XXX
 SG_ VCFRONT2_a667_hcmRegionAndSide m667 : 16|3@1+ (1,0) [0|7] "" Vector__XXX
 SG_ VCFRONT2_a667_country m667 : 24|16@1+ (1,0) [0|65535] "" Vector__XXX
 SG_ VCFRONT2_a667_homologationRegion m667 : 40|2@1+ (1,0) [0|3] "" Vector__XXX
 SG_ VCFRONT2_a667_isRightHandDrive m667 : 42|1@1+ (1,0) [0|1] "" Vector__XXX
 SG_ VCFRONT2_a697_isGlobalHeadlamps m697 : 16|1@1+ (1,0) [0|1] "" Vector__XXX
 SG_ VCFRONT2_a697_isVirtualPitchSens m697 : 17|1@1+ (1,0) [0|1] "" Vector__XXX
 SG_ VCFRONT2_a697_calibratedVertical m697 : 18|10@1+ (1,0) [0|1023] "" Vector__XXX
 SG_ VCFRONT2_a697_calibratedHorizont m697 : 28|10@1+ (1,0) [0|1023] "" Vector__XXX

CM_ BO_ 1335 "VCFRONT1 ECU message: alert log";
CM_ SG_ 1335 VCFRONT1_alertID "VCFRONT1 ECU: alert ID";
CM_ SG_ 1335 VCFRONT1_alertState "VCFRONT1 ECU: alert state";
CM_ SG_ 1335 VCFRONT1_a001_InternalWatchdog "VCFRONT1 ECU: a001 internal watchdog";
CM_ SG_ 1335 VCFRONT1_a015_NVMMMemOverflow "VCFRONT1 ECU: a015 NVMM mem overflow";
CM_ SG_ 1335 VCFRONT1_a015_NVMMFilesystemErro "VCFRONT1 ECU: a015 NVMM filesystem error";
CM_ SG_ 1335 VCFRONT1_a015_NVMMRecordIDError "VCFRONT1 ECU: a015 NVMM record ID error";
CM_ SG_ 1335 VCFRONT1_a059_voltageDrop "VCFRONT1 ECU: a059 voltage drop";
CM_ SG_ 1335 VCFRONT1_a059_resistanceEstimate "VCFRONT1 ECU: a059 resistance estimate";
CM_ SG_ 1335 VCFRONT1_a059_current "VCFRONT1 ECU: a059 current";
CM_ SG_ 1335 VCFRONT1_a063_switchChannel "VCFRONT1 ECU: a063 switch channel";
CM_ SG_ 1335 VCFRONT1_a063_switchType "VCFRONT1 ECU: a063 switch type";
CM_ SG_ 1335 VCFRONT1_a063_ADCVoltage "VCFRONT1 ECU: a063 ADC voltage";
CM_ SG_ 1335 VCFRONT1_a063_disconnected "VCFRONT1 ECU: a063 disconnected";
CM_ SG_ 1335 VCFRONT1_a063_indeterminate "VCFRONT1 ECU: a063 indeterminate";
CM_ SG_ 1335 VCFRONT1_a063_stuckActive "VCFRONT1 ECU: a063 stuck active";
CM_ SG_ 1335 VCFRONT1_a063_faulted "VCFRONT1 ECU: a063 faulted";
CM_ SG_ 1335 VCFRONT1_a091_FRONTIPC_faultsAnd "VCFRONT1 ECU: a091 FRONTIPC faults and extras";
CM_ SG_ 1335 VCFRONT1_a091_FRONTIPC_state "VCFRONT1 ECU: a091 FRONTIPC state";
CM_ SG_ 1335 VCFRONT1_a096_FRONTIPC_status "VCFRONT1 ECU: a096 FRONTIPC status";
CM_ SG_ 1335 VCFRONT1_a098_FRONTIPC_temperatu "VCFRONT1 ECU: a098 FRONTIPC temperature";
CM_ SG_ 1335 VCFRONT1_a098_FRONTIPC_thermalCo "VCFRONT1 ECU: a098 FRONTIPC thermal control";
CM_ SG_ 1335 VCFRONT1_a106_BATTIPC_dcdcRailSt "VCFRONT1 ECU: a106 BATTIPC dcdc rail status";
CM_ SG_ 1335 VCFRONT1_a106_BATTIPC_dcdcStatus "VCFRONT1 ECU: a106 BATTIPC dcdc status";
CM_ SG_ 1335 VCFRONT1_a106_VEH_dcdcStatus "VCFRONT1 ECU: a106 VEH dcdc status";
CM_ SG_ 1335 VCFRONT1_a106_VEH_thermalControl "VCFRONT1 ECU: a106 VEH thermal control";
CM_ SG_ 1335 VCFRONT1_a106_VEH_dcdcRailStatus "VCFRONT1 ECU: a106 VEH dcdc rail status";
CM_ SG_ 1335 VCFRONT1_a106_CH_dcdcRailStatus "VCFRONT1 ECU: a106 CH dcdc rail status";
CM_ SG_ 1335 VCFRONT1_a106_CH_alertMatrix "VCFRONT1 ECU: a106 CH alert matrix";
CM_ SG_ 1335 VCFRONT1_a106_FRONTIPC_thermalCo "VCFRONT1 ECU: a106 FRONTIPC thermal control";
CM_ SG_ 1335 VCFRONT1_a106_FRONTIPC_dcdcRailS "VCFRONT1 ECU: a106 FRONTIPC dcdc rail status";
CM_ SG_ 1335 VCFRONT1_a106_FRONTIPC_dcdcStatu "VCFRONT1 ECU: a106 FRONTIPC dcdc status";
CM_ SG_ 1335 VCFRONT1_a108_FRONTIPC_status "VCFRONT1 ECU: a108 FRONTIPC status";
CM_ SG_ 1335 VCFRONT1_a108_FRONTIPC_temperatu "VCFRONT1 ECU: a108 FRONTIPC temperature";
CM_ SG_ 1335 VCFRONT1_a108_FRONTIPC_thermalCo "VCFRONT1 ECU: a108 FRONTIPC thermal control";
CM_ SG_ 1335 VCFRONT1_a108_FRONTIPC_motorStat "VCFRONT1 ECU: a108 FRONTIPC motor status";
CM_ SG_ 1335 VCFRONT1_a120_BATTIPC_speed "VCFRONT1 ECU: a120 BATTIPC speed";
CM_ SG_ 1335 VCFRONT1_a120_FRONTIPC_speed "VCFRONT1 ECU: a120 FRONTIPC speed";
CM_ SG_ 1335 VCFRONT1_a120_FRONTIPC_systemSta "VCFRONT1 ECU: a120 FRONTIPC system status";
CM_ SG_ 1335 VCFRONT1_a120_BATTIPC_systemStat "VCFRONT1 ECU: a120 BATTIPC system status";
CM_ SG_ 1335 VCFRONT1_a120_FRONTIPC_systemPow "VCFRONT1 ECU: a120 FRONTIPC system power";
CM_ SG_ 1335 VCFRONT1_a120_FRONTIPC_autonomyH "VCFRONT1 ECU: a120 FRONTIPC autonomy health";
CM_ SG_ 1335 VCFRONT1_a120_BATTIPC_chassisCon "VCFRONT1 ECU: a120 BATTIPC chassis control2";
CM_ SG_ 1335 VCFRONT1_a120_FRONTIPC_chassisCo "VCFRONT1 ECU: a120 FRONTIPC chassis control2";
CM_ SG_ 1335 VCFRONT1_a120_FRONTIPC_odometerS "VCFRONT1 ECU: a120 FRONTIPC odometer status";
CM_ SG_ 1335 VCFRONT1_a124_FRONTIPC_status "VCFRONT1 ECU: a124 FRONTIPC status";
CM_ SG_ 1335 VCFRONT1_a124_BATTIPC_status "VCFRONT1 ECU: a124 BATTIPC status";
CM_ SG_ 1335 VCFRONT1_a125_FRONTIPC_leftStalk "VCFRONT1 ECU: a125 FRONTIPC left stalk";
CM_ SG_ 1335 VCFRONT1_a125_FRONTIPC_steerAngl "VCFRONT1 ECU: a125 FRONTIPC steer angle";
CM_ SG_ 1335 VCFRONT1_a125_FRONTIPC_info "VCFRONT1 ECU: a125 FRONTIPC info";
CM_ SG_ 1335 VCFRONT1_a126_FRONTIPC_sysStatus "VCFRONT1 ECU: a126 FRONTIPC sys status";
CM_ SG_ 1335 VCFRONT1_a126_BATTIPC_sysStatus "VCFRONT1 ECU: a126 BATTIPC sys status";
CM_ SG_ 1335 VCFRONT1_a126_FRONTIPC_status "VCFRONT1 ECU: a126 FRONTIPC status";
CM_ SG_ 1335 VCFRONT1_a126_BATTIPC_status "VCFRONT1 ECU: a126 BATTIPC status";
CM_ SG_ 1335 VCFRONT1_a127_iBoosterEFuseCurre "VCFRONT1 ECU: a127 i booster e fuse current";
CM_ SG_ 1335 VCFRONT1_a127_iBoosterEFuseVolta "VCFRONT1 ECU: a127 i booster e fuse voltage";
CM_ SG_ 1335 VCFRONT1_a127_iBoosterEFuseTemp "VCFRONT1 ECU: a127 i booster e fuse temp";
CM_ SG_ 1335 VCFRONT1_a128_vcrightEFuseCurren "VCFRONT1 ECU: a128 vcright e fuse current";
CM_ SG_ 1335 VCFRONT1_a128_vcrightEFuseVoltag "VCFRONT1 ECU: a128 vcright e fuse voltage";
CM_ SG_ 1335 VCFRONT1_a128_vcrightEFuseTemp "VCFRONT1 ECU: a128 vcright e fuse temp";
CM_ SG_ 1335 VCFRONT1_a128_vcrightEFuseRemain "VCFRONT1 ECU: a128 vcright e fuse remaining retries";
CM_ SG_ 1335 VCFRONT1_a129_pcsEFuseCurrent "VCFRONT1 ECU: a129 pcs e fuse current";
CM_ SG_ 1335 VCFRONT1_a129_pcsEFuseVoltage "VCFRONT1 ECU: a129 pcs e fuse voltage";
CM_ SG_ 1335 VCFRONT1_a129_pcsEFuseTemp "VCFRONT1 ECU: a129 pcs e fuse temp";
CM_ SG_ 1335 VCFRONT1_a129_pcsEFuseRemainingR "VCFRONT1 ECU: a129 pcs e fuse remaining retries";
CM_ SG_ 1335 VCFRONT1_a130_autopilot2EFuseCur "VCFRONT1 ECU: a130 autopilot2 e fuse current";
CM_ SG_ 1335 VCFRONT1_a130_autopilot2EFuseVol "VCFRONT1 ECU: a130 autopilot2 e fuse voltage";
CM_ SG_ 1335 VCFRONT1_a130_autopilot2EFuseTem "VCFRONT1 ECU: a130 autopilot2 e fuse temp";
CM_ SG_ 1335 VCFRONT1_a130_autopilot2EFuseRem "VCFRONT1 ECU: a130 autopilot2 e fuse remaining retries";
CM_ SG_ 1335 VCFRONT1_a131_FRONTIPC_power "VCFRONT1 ECU: a131 FRONTIPC power";
CM_ SG_ 1335 VCFRONT1_a131_BATTIPC_power "VCFRONT1 ECU: a131 BATTIPC power";
CM_ SG_ 1335 VCFRONT1_a132_epas2EFuseCurrent "VCFRONT1 ECU: a132 epas2 e fuse current";
CM_ SG_ 1335 VCFRONT1_a132_epas2EFuseVoltage "VCFRONT1 ECU: a132 epas2 e fuse voltage";
CM_ SG_ 1335 VCFRONT1_a132_epas2EFuseTemp "VCFRONT1 ECU: a132 epas2 e fuse temp";
CM_ SG_ 1335 VCFRONT1_a133_BATTIPC_primaryAct "VCFRONT1 ECU: a133 BATTIPC primary actuator";
CM_ SG_ 1335 VCFRONT1_a133_FRONTIPC_secondary "VCFRONT1 ECU: a133 FRONTIPC secondary actuator";
CM_ SG_ 1335 VCFRONT1_a135_leftHeadlightEFuse "VCFRONT1 ECU: a135 left headlight e fuse current";
CM_ SG_ 1335 VCFRONT1_a144_FRONTIPC_status "VCFRONT1 ECU: a144 FRONTIPC status";
CM_ SG_ 1335 VCFRONT1_a144_BATTIPC_status "VCFRONT1 ECU: a144 BATTIPC status";
CM_ SG_ 1335 VCFRONT1_a164_lockoutVoltage "VCFRONT1 ECU: a164 lockout voltage";
CM_ SG_ 1335 VCFRONT1_a165_lockoutVoltage "VCFRONT1 ECU: a165 lockout voltage";
CM_ SG_ 1335 VCFRONT1_a177_mcuAudioEFuseCurre "VCFRONT1 ECU: a177 mcu audio e fuse current";
CM_ SG_ 1335 VCFRONT1_a177_mcuAudioEFuseVolta "VCFRONT1 ECU: a177 mcu audio e fuse voltage";
CM_ SG_ 1335 VCFRONT1_a191_vehiclePowerState "VCFRONT1 ECU: a191 vehicle power state";
CM_ SG_ 1335 VCFRONT1_a191_hvState "VCFRONT1 ECU: a191 hv state";
CM_ SG_ 1335 VCFRONT1_a191_busVoltage "VCFRONT1 ECU: a191 bus voltage";
CM_ SG_ 1335 VCFRONT1_a191_serviceMode "Signal reported by VCFRONT1 ECU";
CM_ SG_ 1335 VCFRONT1_a191_frunkOpen "VCFRONT1 ECU: a191 frunk open";
CM_ SG_ 1335 VCFRONT1_a191_exitDriveWarningTi "VCFRONT1 ECU: a191 exit drive warning timer expired";
CM_ SG_ 1335 VCFRONT1_a191_NotEnoughPowerForS "VCFRONT1 ECU: a191 not enough power for support";
CM_ SG_ 1335 VCFRONT1_a191_bmsState "VCFRONT1 ECU: a191 bms state";
CM_ SG_ 1335 VCFRONT1_a204_vbusVoltage "VCFRONT1 ECU: a204 vbus voltage";
CM_ SG_ 1335 VCFRONT1_a204_BRailLocked "VCFRONT1 ECU: a204 b rail locked";
CM_ SG_ 1335 VCFRONT1_a204_uvLoadshedFaultInj "VCFRONT1 ECU: a204 uv loadshed fault inject";
CM_ SG_ 1335 VCFRONT1_a204_pcsBridgeCurrent "VCFRONT1 ECU: a204 pcs bridge current";
CM_ SG_ 1335 VCFRONT1_a205_busVoltage "VCFRONT1 ECU: a205 bus voltage";
CM_ SG_ 1335 VCFRONT1_a205_BRailLocked "VCFRONT1 ECU: a205 b rail locked";
CM_ SG_ 1335 VCFRONT1_a205_ovLoadshedFaultInj "VCFRONT1 ECU: a205 ov loadshed fault inject";
CM_ SG_ 1335 VCFRONT1_a205_pcsBridgeCurrent "VCFRONT1 ECU: a205 pcs bridge current";
CM_ SG_ 1335 VCFRONT1_a216_inDrive "VCFRONT1 ECU: a216 in drive";
CM_ SG_ 1335 VCFRONT1_a216_hvState "VCFRONT1 ECU: a216 hv state";
CM_ SG_ 1335 VCFRONT1_a216_vcrightFastBlowImm "VCFRONT1 ECU: a216 vcright fast blow imminent";
CM_ SG_ 1335 VCFRONT1_a216_vcrightFastBlowDeb "VCFRONT1 ECU: a216 vcright fast blow debounce imminent";
CM_ SG_ 1335 VCFRONT1_a216_vcrightStaticImmin "VCFRONT1 ECU: a216 vcright static imminent";
CM_ SG_ 1335 VCFRONT1_a216_vcrightDynamicImmi "VCFRONT1 ECU: a216 vcright dynamic imminent";
CM_ SG_ 1335 VCFRONT1_a220_DI_gear "VCFRONT1 ECU: a220 DI gear";
CM_ SG_ 1335 VCFRONT1_a220_redundancyRequired "VCFRONT1 ECU: a220 redundancy required";
CM_ SG_ 1335 VCFRONT1_a220_vehicleSpeed "VCFRONT1 ECU: a220 vehicle speed";
CM_ SG_ 1335 VCFRONT1_a220_lvHealthStatus "VCFRONT1 ECU: a220 lv health status";
CM_ SG_ 1335 VCFRONT1_a220_factoryMode "VCFRONT1 ECU: a220 factory mode";
CM_ SG_ 1335 VCFRONT1_a220_serviceMode "Signal reported by VCFRONT1 ECU";
CM_ SG_ 1335 VCFRONT1_a220_unhealthyReason "VCFRONT1 ECU: a220 unhealthy reason";
CM_ SG_ 1335 VCFRONT1_a223_failedArmingSetup "VCFRONT1 ECU: a223 failed arming setup";
CM_ SG_ 1335 VCFRONT1_a223_failedFaultInject "VCFRONT1 ECU: a223 failed fault inject";
CM_ SG_ 1335 VCFRONT1_a223_overvoltageFaultAc "VCFRONT1 ECU: a223 overvoltage fault active";
CM_ SG_ 1335 VCFRONT1_a223_sharedBridgeShutdo "VCFRONT1 ECU: a223 shared bridge shutdown active";
CM_ SG_ 1335 VCFRONT1_a223_timedOut "VCFRONT1 ECU: a223 timed out";
CM_ SG_ 1335 VCFRONT1_a229_bridgeOpened "VCFRONT1 ECU: a229 bridge opened";
CM_ SG_ 1335 VCFRONT1_a229_pcsMIA "VCFRONT1 ECU: a229 pcs MIA";
CM_ SG_ 1335 VCFRONT1_a229_pcsNotSupporting "VCFRONT1 ECU: a229 pcs not supporting";
CM_ SG_ 1335 VCFRONT1_a250_pcsOvShutdownFault "VCFRONT1 ECU: a250 pcs ov shutdown fault pin active";
CM_ SG_ 1335 VCFRONT1_a250_pcsOvShutdownArmed "VCFRONT1 ECU: a250 pcs ov shutdown armed";
CM_ SG_ 1335 VCFRONT1_a250_battDomainHealthy "VCFRONT1 ECU: a250 batt domain healthy";
CM_ SG_ 1335 VCFRONT1_a250_busVoltage "VCFRONT1 ECU: a250 bus voltage";
CM_ SG_ 1335 VCFRONT1_a250_dcdcEnableLineVolt "VCFRONT1 ECU: a250 dcdc enable line voltage";
CM_ SG_ 1335 VCFRONT1_a250_ovClampBusVoltage "VCFRONT1 ECU: a250 ov clamp bus voltage";
CM_ SG_ 1335 VCFRONT1_a250_ovClampReferenceVo "VCFRONT1 ECU: a250 ov clamp reference voltage";
CM_ SG_ 1335 VCFRONT1_a250_ovClampMonitorVolt "VCFRONT1 ECU: a250 ov clamp monitor voltage1";
CM_ SG_ 1335 VCFRONT1_a251_rationalitySetupCh "VCFRONT1 ECU: a251 rationality setup check result";
CM_ SG_ 1335 VCFRONT1_a251_rationalitySetupFa "VCFRONT1 ECU: a251 rationality setup failure reason";
CM_ SG_ 1335 VCFRONT1_a251_clampLowSideCheckR "VCFRONT1 ECU: a251 clamp low side check result";
CM_ SG_ 1335 VCFRONT1_a251_clampLowSideFailur "VCFRONT1 ECU: a251 clamp low side failure reason";
CM_ SG_ 1335 VCFRONT1_a251_rationalityShutdow "VCFRONT1 ECU: a251 rationality shutdown armed check result";
CM_ SG_ 1335 VCFRONT1_a251_rationalitySh_0001 "VCFRONT1 ECU: a251 rationality shutdown armed failure reason";
CM_ SG_ 1335 VCFRONT1_a251_clampHighSideCheck "VCFRONT1 ECU: a251 clamp high side check result";
CM_ SG_ 1335 VCFRONT1_a251_clampHighSideFailu "VCFRONT1 ECU: a251 clamp high side failure reason";
CM_ SG_ 1335 VCFRONT1_a251_rationalityPcsShut "VCFRONT1 ECU: a251 rationality pcs shutdown check result";
CM_ SG_ 1335 VCFRONT1_a251_rationalityPc_0001 "VCFRONT1 ECU: a251 rationality pcs shutdown failure reason";
CM_ SG_ 1335 VCFRONT1_a251_testTimedOut "VCFRONT1 ECU: a251 test timed out";
CM_ SG_ 1335 VCFRONT1_a252_stage "VCFRONT1 ECU: a252 stage";
CM_ SG_ 1335 VCFRONT1_a252_incorrectPinConfig "VCFRONT1 ECU: a252 incorrect pin configuration";
CM_ SG_ 1335 VCFRONT1_a252_incorrectClampMoni "VCFRONT1 ECU: a252 incorrect clamp monitor1 voltage";
CM_ SG_ 1335 VCFRONT1_a252_incorrectClam_0001 "VCFRONT1 ECU: a252 incorrect clamp monitor2 voltage";
CM_ SG_ 1335 VCFRONT1_a252_incorrectClam_0002 "VCFRONT1 ECU: a252 incorrect clamp monitor3 voltage";
CM_ SG_ 1335 VCFRONT1_a252_incorrectPcsEnable "VCFRONT1 ECU: a252 incorrect pcs enable line voltage";
CM_ SG_ 1335 VCFRONT1_a252_incorrectPcsTripSt "VCFRONT1 ECU: a252 incorrect pcs trip state";
CM_ SG_ 1335 VCFRONT1_a252_incorrectPcsSuppor "VCFRONT1 ECU: a252 incorrect pcs support status";
CM_ SG_ 1335 VCFRONT1_a252_incorrectPcsDcdcEn "VCFRONT1 ECU: a252 incorrect pcs dcdc enable feedback";
CM_ SG_ 1335 VCFRONT1_a252_pcsOvShutdownFault "VCFRONT1 ECU: a252 pcs ov shutdown fault pin active";
CM_ SG_ 1335 VCFRONT1_a252_pcsOvShutdownArmed "VCFRONT1 ECU: a252 pcs ov shutdown armed";
CM_ SG_ 1335 VCFRONT1_a252_pcsSupporting "VCFRONT1 ECU: a252 pcs supporting";
CM_ SG_ 1335 VCFRONT1_a252_pcsDcdcEnableFeedb "VCFRONT1 ECU: a252 pcs dcdc enable feedback";
CM_ SG_ 1335 VCFRONT1_a252_pcsOvClampArmed "VCFRONT1 ECU: a252 pcs ov clamp armed";
CM_ SG_ 1335 VCFRONT1_a252_pcsOvSelfTestEnabl "VCFRONT1 ECU: a252 pcs ov self test enabled";
CM_ SG_ 1335 VCFRONT1_a252_busVoltage "VCFRONT1 ECU: a252 bus voltage";
CM_ SG_ 1335 VCFRONT1_a252_dcdcEnableLineVolt "VCFRONT1 ECU: a252 dcdc enable line voltage";
CM_ SG_ 1335 VCFRONT1_a252_ovClampMonitorChan "VCFRONT1 ECU: a252 ov clamp monitor channel";
CM_ SG_ 1335 VCFRONT1_a252_ovClampMonitorVolt "VCFRONT1 ECU: a252 ov clamp monitor voltage";
CM_ SG_ 1335 VCFRONT1_a262_eFuseVoltage "VCFRONT1 ECU: a262 e fuse voltage";
CM_ SG_ 1335 VCFRONT1_a262_vbatProtVoltage "VCFRONT1 ECU: a262 vbat prot voltage";
CM_ SG_ 1335 VCFRONT1_a263_eFuseVoltage "VCFRONT1 ECU: a263 e fuse voltage";
CM_ SG_ 1335 VCFRONT1_a263_vbatProtVoltage "VCFRONT1 ECU: a263 vbat prot voltage";
CM_ SG_ 1335 VCFRONT1_a264_eFuseVoltage "VCFRONT1 ECU: a264 e fuse voltage";
CM_ SG_ 1335 VCFRONT1_a264_vbatProtVoltage "VCFRONT1 ECU: a264 vbat prot voltage";
CM_ SG_ 1335 VCFRONT1_a266_eFuseVoltage "VCFRONT1 ECU: a266 e fuse voltage";
CM_ SG_ 1335 VCFRONT1_a266_vbatProtVoltage "VCFRONT1 ECU: a266 vbat prot voltage";
CM_ SG_ 1335 VCFRONT1_a414_failureReason "VCFRONT1 ECU: a414 failure reason";
CM_ SG_ 1335 VCFRONT1_a414_loadUnattemptedOnF "VCFRONT1 ECU: a414 load unattempted on failure";
CM_ SG_ 1335 VCFRONT1_a414_deviceStuckOnFailu "VCFRONT1 ECU: a414 device stuck on failure";
CM_ SG_ 1335 VCFRONT1_a414_followerVCRightSel "VCFRONT1 ECU: a414 follower VC right self test failure";
CM_ SG_ 1335 VCFRONT1_a414_bridgeFailedToOpen "VCFRONT1 ECU: a414 bridge failed to open";
CM_ SG_ 1335 VCFRONT1_a414_uvLoadshedVsenseDi "VCFRONT1 ECU: a414 uv loadshed vsense dig in";
CM_ SG_ 1335 VCFRONT1_a415_upstreamEFuseStuck "VCFRONT1 ECU: a415 upstream e fuse stuck off";
CM_ SG_ 1335 VCFRONT1_a475_channel "VCFRONT1 ECU: a475 channel";
CM_ SG_ 1335 VCFRONT1_a475_reset "VCFRONT1 ECU: a475 reset";
CM_ SG_ 1335 VCFRONT1_a475_spiError "VCFRONT1 ECU: a475 spi error";
CM_ SG_ 1335 VCFRONT1_a475_autoOn "VCFRONT1 ECU: a475 auto on";
CM_ SG_ 1335 VCFRONT1_a475_diagnosticBit "VCFRONT1 ECU: a475 diagnostic bit";
CM_ SG_ 1335 VCFRONT1_a475_deviceError "VCFRONT1 ECU: a475 device error";
CM_ SG_ 1335 VCFRONT1_a475_unexpectedLock "VCFRONT1 ECU: a475 unexpected lock";
CM_ SG_ 1335 VCFRONT1_a475_unexpectedFailSafe "VCFRONT1 ECU: a475 unexpected fail safe";
CM_ SG_ 1335 VCFRONT1_a475_disableOutputFault "VCFRONT1 ECU: a475 disable output fault";
CM_ SG_ 1335 VCFRONT1_a475_vsUndervoltage "VCFRONT1 ECU: a475 vs undervoltage";
CM_ SG_ 1335 VCFRONT1_a475_hardShort "VCFRONT1 ECU: a475 hard short";
CM_ SG_ 1335 VCFRONT1_a475_prechargeFailure "VCFRONT1 ECU: a475 precharge failure";
CM_ SG_ 1335 VCFRONT1_a475_vdsMax "VCFRONT1 ECU: a475 vds max";
CM_ SG_ 1335 VCFRONT1_a475_bypassSaturation "VCFRONT1 ECU: a475 bypass saturation";
CM_ SG_ 1335 VCFRONT1_a475_fuseLatch "VCFRONT1 ECU: a475 fuse latch";
CM_ SG_ 1335 VCFRONT1_a475_deviceOvertemperat "VCFRONT1 ECU: a475 device overtemperature";
CM_ SG_ 1335 VCFRONT1_a475_ntcOvertemperature "VCFRONT1 ECU: a475 ntc overtemperature";
CM_ SG_ 1335 VCFRONT1_a475_vgsLow "VCFRONT1 ECU: a475 vgs low";
CM_ SG_ 1335 VCFRONT1_a475_chargePumpLow "VCFRONT1 ECU: a475 charge pump low";
CM_ SG_ 1335 VCFRONT1_a475_watchdog "VCFRONT1 ECU: a475 watchdog";
CM_ SG_ 1335 VCFRONT1_a475_spiNotDone "VCFRONT1 ECU: a475 spi not done";
CM_ SG_ 1335 VCFRONT1_a475_csUndervoltage "VCFRONT1 ECU: a475 cs undervoltage";
CM_ SG_ 1335 VCFRONT1_a475_configIncorrect "VCFRONT1 ECU: a475 config incorrect";
CM_ SG_ 1335 VCFRONT1_a475_bufferFull "VCFRONT1 ECU: a475 buffer full";
CM_ SG_ 1335 VCFRONT1_a475_hitAlertRateLimit "VCFRONT1 ECU: a475 hit alert rate limit";
CM_ SG_ 1335 VCFRONT1_a475_hwlo "VCFRONT1 ECU: a475 hwlo";
CM_ SG_ 1335 VCFRONT1_a475_dinState "VCFRONT1 ECU: a475 din state";
CM_ SG_ 1335 VCFRONT1_a475_enable "VCFRONT1 ECU: a475 enable";
CM_ SG_ 1335 VCFRONT1_a480_channel "VCFRONT1 ECU: a480 channel";
CM_ SG_ 1335 VCFRONT1_a480_reset "VCFRONT1 ECU: a480 reset";
CM_ SG_ 1335 VCFRONT1_a480_spiError "VCFRONT1 ECU: a480 spi error";
CM_ SG_ 1335 VCFRONT1_a480_autoOn "VCFRONT1 ECU: a480 auto on";
CM_ SG_ 1335 VCFRONT1_a480_diagnosticBit "VCFRONT1 ECU: a480 diagnostic bit";
CM_ SG_ 1335 VCFRONT1_a480_deviceError "VCFRONT1 ECU: a480 device error";
CM_ SG_ 1335 VCFRONT1_a480_overcurrent "VCFRONT1 ECU: a480 overcurrent";
CM_ SG_ 1335 VCFRONT1_a480_unexpectedLock "VCFRONT1 ECU: a480 unexpected lock";
CM_ SG_ 1335 VCFRONT1_a480_disableOutputFault "VCFRONT1 ECU: a480 disable output fault";
CM_ SG_ 1335 VCFRONT1_a480_vsUndervoltage "VCFRONT1 ECU: a480 vs undervoltage";
CM_ SG_ 1335 VCFRONT1_a480_hardShort "VCFRONT1 ECU: a480 hard short";
CM_ SG_ 1335 VCFRONT1_a480_vdsMax "VCFRONT1 ECU: a480 vds max";
CM_ SG_ 1335 VCFRONT1_a480_bypassSaturation "VCFRONT1 ECU: a480 bypass saturation";
CM_ SG_ 1335 VCFRONT1_a480_fuseLatch "VCFRONT1 ECU: a480 fuse latch";
CM_ SG_ 1335 VCFRONT1_a480_deviceOvertemperat "VCFRONT1 ECU: a480 device overtemperature";
CM_ SG_ 1335 VCFRONT1_a480_ntcOvertemperature "VCFRONT1 ECU: a480 ntc overtemperature";
CM_ SG_ 1335 VCFRONT1_a480_vgsLow "VCFRONT1 ECU: a480 vgs low";
CM_ SG_ 1335 VCFRONT1_a480_chargePumpLow "VCFRONT1 ECU: a480 charge pump low";
CM_ SG_ 1335 VCFRONT1_a480_watchdog "VCFRONT1 ECU: a480 watchdog";
CM_ SG_ 1335 VCFRONT1_a480_spiNotDone "VCFRONT1 ECU: a480 spi not done";
CM_ SG_ 1335 VCFRONT1_a480_configIncorrect "VCFRONT1 ECU: a480 config incorrect";
CM_ SG_ 1335 VCFRONT1_a480_bufferFull "VCFRONT1 ECU: a480 buffer full";
CM_ SG_ 1335 VCFRONT1_a480_hitAlertRateLimit "VCFRONT1 ECU: a480 hit alert rate limit";
CM_ SG_ 1335 VCFRONT1_a480_hwlo "VCFRONT1 ECU: a480 hwlo";
CM_ SG_ 1335 VCFRONT1_a480_enable "VCFRONT1 ECU: a480 enable";
CM_ SG_ 1335 VCFRONT1_a482_lvBridgeEFuseCurre "VCFRONT1 ECU: a482 lv bridge e fuse current";
CM_ SG_ 1335 VCFRONT1_a482_lvBridgeEFuseVolta "VCFRONT1 ECU: a482 lv bridge e fuse voltage";
CM_ SG_ 1335 VCFRONT1_a482_lvBridgeEFuseTemp "VCFRONT1 ECU: a482 lv bridge e fuse temp";
CM_ SG_ 1335 VCFRONT1_a484_upstreamEFuseStuck "VCFRONT1 ECU: a484 upstream e fuse stuck on";
CM_ SG_ 1335 VCFRONT1_a484_upstreamEFuseVolta "VCFRONT1 ECU: a484 upstream e fuse voltage";
CM_ SG_ 1335 VCFRONT1_a484_vbusVoltage "VCFRONT1 ECU: a484 vbus voltage";
CM_ SG_ 1335 VCFRONT1_a484_upstreamEFuseRatio "VCFRONT1 ECU: a484 upstream e fuse ratio";
CM_ SG_ 1335 VCFRONT1_a485_upstreamEfuseUnatt "VCFRONT1 ECU: a485 upstream efuse unattempted on";
CM_ SG_ 1335 VCFRONT1_a486_bridgeFailedArming "VCFRONT1 ECU: a486 bridge failed arming setup";
CM_ SG_ 1335 VCFRONT1_a486_bridgeFailedSyncCh "VCFRONT1 ECU: a486 bridge failed sync check";
CM_ SG_ 1335 VCFRONT1_a486_localBridgeOutputO "VCFRONT1 ECU: a486 local bridge output on";
CM_ SG_ 1335 VCFRONT1_a486_localBridgeSyncArm "VCFRONT1 ECU: a486 local bridge sync armed";
CM_ SG_ 1335 VCFRONT1_a486_localBridgeDinStat "VCFRONT1 ECU: a486 local bridge din state";
CM_ SG_ 1335 VCFRONT1_a486_remoteBridgeOutput "VCFRONT1 ECU: a486 remote bridge output on";
CM_ SG_ 1335 VCFRONT1_a486_remoteBridgeO_0001 "VCFRONT1 ECU: a486 remote bridge output on valid";
CM_ SG_ 1335 VCFRONT1_a486_remoteBridgeSyncAr "VCFRONT1 ECU: a486 remote bridge sync armed";
CM_ SG_ 1335 VCFRONT1_a486_remoteBridgeS_0001 "VCFRONT1 ECU: a486 remote bridge sync armed valid";
CM_ SG_ 1335 VCFRONT1_a486_remoteBridgeDinSta "VCFRONT1 ECU: a486 remote bridge din state";
CM_ SG_ 1335 VCFRONT1_a486_remoteBridgeD_0001 "VCFRONT1 ECU: a486 remote bridge din state valid";
CM_ SG_ 1335 VCFRONT1_a496_serviceMode "Signal reported by VCFRONT1 ECU";
CM_ SG_ 1335 VCFRONT1_a496_frunkOpen "VCFRONT1 ECU: a496 frunk open";
CM_ SG_ 1335 VCFRONT1_a496_NotEnoughPowerForS "VCFRONT1 ECU: a496 not enough power for support";
CM_ SG_ 1335 VCFRONT1_a496_bmsState "VCFRONT1 ECU: a496 bms state";
CM_ SG_ 1335 VCFRONT1_a500_channel "VCFRONT1 ECU: a500 channel";
CM_ SG_ 1335 VCFRONT1_a500_mismatchedState "VCFRONT1 ECU: a500 mismatched state";
CM_ SG_ 1335 VCFRONT1_a509_channel "VCFRONT1 ECU: a509 channel";
CM_ SG_ 1335 VCFRONT1_a509_state "VCFRONT1 ECU: a509 state";
CM_ SG_ 1335 VCFRONT1_a509_expectedState "VCFRONT1 ECU: a509 expected state";
CM_ SG_ 1335 VCFRONT1_a509_hardwareLockout "VCFRONT1 ECU: a509 hardware lockout";
CM_ SG_ 1335 VCFRONT1_a509_unlocksRemaining "VCFRONT1 ECU: a509 unlocks remaining";
CM_ SG_ 1335 VCFRONT1_a523_channel "VCFRONT1 ECU: a523 channel";
CM_ SG_ 1335 VCFRONT1_a523_control2Byte1 "VCFRONT1 ECU: a523 control2 byte1";
CM_ SG_ 1335 VCFRONT1_a523_control2Byte2 "VCFRONT1 ECU: a523 control2 byte2";
CM_ SG_ 1335 VCFRONT1_a523_control2Byte3 "VCFRONT1 ECU: a523 control2 byte3";
CM_ SG_ 1335 VCFRONT1_a523_control3Byte2 "VCFRONT1 ECU: a523 control3 byte2";
CM_ SG_ 1335 VCFRONT1_a523_control3Byte3 "VCFRONT1 ECU: a523 control3 byte3";
CM_ SG_ 1335 VCFRONT1_a574_frontDriveInverter "VCFRONT1 ECU: a574 front drive inverter current";
CM_ SG_ 1335 VCFRONT1_a574_frontDriveInv_0001 "VCFRONT1 ECU: a574 front drive inverter remaining retries";
CM_ SG_ 1335 VCFRONT1_a596_vcrightCutoffEFuse "VCFRONT1 ECU: a596 vcright cutoff e fuse curve type";
CM_ SG_ 1335 VCFRONT1_a596_vcrightCutoffCurve "VCFRONT1 ECU: a596 vcright cutoff curve offset channel";
CM_ SG_ 1335 VCFRONT1_a596_vcrightCutoffATerm "VCFRONT1 ECU: a596 vcright cutoff a term";
CM_ SG_ 1335 VCFRONT1_a596_vcrightCutoffBTerm "VCFRONT1 ECU: a596 vcright cutoff b term";
CM_ SG_ 1335 VCFRONT1_a596_vcrightCutoffCTerm "VCFRONT1 ECU: a596 vcright cutoff c term";
CM_ SG_ 1335 VCFRONT1_a597_vcrightCutoffEFuse "VCFRONT1 ECU: a597 vcright cutoff e fuse fast blow type";
CM_ SG_ 1335 VCFRONT1_a597_vcrightCutoffCurre "VCFRONT1 ECU: a597 vcright cutoff current threshold";
CM_ SG_ 1335 VCFRONT1_a597_vcrightCutoffTimin "VCFRONT1 ECU: a597 vcright cutoff timing threshold ms";
CM_ SG_ 1335 VCFRONT1_a597_vcrightCutoffMaxCo "VCFRONT1 ECU: a597 vcright cutoff max count";
CM_ BO_ 833 "VCFRONT1 ECU message: alert matrix";
CM_ SG_ 833 VCFRONT1_matrixIndex "VCFRONT1 ECU: matrix index";
CM_ SG_ 833 VCFRONT1_a001_WatchdogReset "VCFRONT1 ECU: a001 watchdog reset";
CM_ SG_ 833 VCFRONT1_a002_PowerLossReset "VCFRONT1 ECU: a002 power loss reset";
CM_ SG_ 833 VCFRONT1_a003_SWAssertion "VCFRONT1 ECU: a003 SW assertion";
CM_ SG_ 833 VCFRONT1_a005_CANTXError "VCFRONT1 ECU: a005 CANTX error";
CM_ SG_ 833 VCFRONT1_a006_CANTX_cyclicError "VCFRONT1 ECU: a006 CANTX cyclic error";
CM_ SG_ 833 VCFRONT1_a012_CPUReset "VCFRONT1 ECU: a012 CPU reset";
CM_ SG_ 833 VCFRONT1_a013_AlertManagerFault "VCFRONT1 ECU: a013 alert manager fault";
CM_ SG_ 833 VCFRONT1_a015_NVMMError "VCFRONT1 ECU: a015 NVMM error";
CM_ SG_ 833 VCFRONT1_a016_NVMMRecordError "VCFRONT1 ECU: a016 NVMM record error";
CM_ SG_ 833 VCFRONT1_a017_NVMMStatusDbg "VCFRONT1 ECU: a017 NVMM status dbg";
CM_ SG_ 833 VCFRONT1_a018_HardFault "VCFRONT1 ECU: a018 hard fault";
CM_ SG_ 833 VCFRONT1_a019_BusFault "VCFRONT1 ECU: a019 bus fault";
CM_ SG_ 833 VCFRONT1_a021_TaskSchedulerError "VCFRONT1 ECU: a021 task scheduler error";
CM_ SG_ 833 VCFRONT1_a022_TaskInitError "VCFRONT1 ECU: a022 task init error";
CM_ SG_ 833 VCFRONT1_a028_UsageFault "VCFRONT1 ECU: a028 usage fault";
CM_ SG_ 833 VCFRONT1_a029_CoreDump "VCFRONT1 ECU: a029 core dump";
CM_ SG_ 833 VCFRONT1_a030_ECULogUploadReques "VCFRONT1 ECU: a030 ECU log upload request";
CM_ SG_ 833 VCFRONT1_a031_UDSActive "VCFRONT1 ECU: a031 UDS active";
CM_ SG_ 833 VCFRONT1_a036_UnknownIrq "VCFRONT1 ECU: a036 unknown irq";
CM_ SG_ 833 VCFRONT1_a037_MemManageFault "VCFRONT1 ECU: a037 mem manage fault";
CM_ SG_ 833 VCFRONT1_a038_ProtFaultInfo "VCFRONT1 ECU: a038 prot fault info";
CM_ SG_ 833 VCFRONT1_a039_ProtFaultAddress "VCFRONT1 ECU: a039 prot fault address";
CM_ SG_ 833 VCFRONT1_a040_Backtrace "VCFRONT1 ECU: a040 backtrace";
CM_ SG_ 833 VCFRONT1_a041_HighCPULoad "VCFRONT1 ECU: a041 high CPU load";
CM_ SG_ 833 VCFRONT1_a042_HighStackUsage "VCFRONT1 ECU: a042 high stack usage";
CM_ SG_ 833 VCFRONT1_a043_Task1msError "VCFRONT1 ECU: a043 task1ms error";
CM_ SG_ 833 VCFRONT1_a044_Task10msError "VCFRONT1 ECU: a044 task10ms error";
CM_ SG_ 833 VCFRONT1_a045_Task100msError "VCFRONT1 ECU: a045 task100ms error";
CM_ SG_ 833 VCFRONT1_a046_Task1000msError "VCFRONT1 ECU: a046 task1000ms error";
CM_ SG_ 833 VCFRONT1_a058_inputRHighSyncDebu "VCFRONT1 ECU: a058 input r high sync debug";
CM_ SG_ 833 VCFRONT1_a059_inputResistanceHig "VCFRONT1 ECU: a059 input resistance high";
CM_ SG_ 833 VCFRONT1_a060_engineeringBuild "VCFRONT1 ECU: a060 engineering build";
CM_ SG_ 833 VCFRONT1_a061_XCPConnected "VCFRONT1 ECU: a061 XCP connected";
CM_ SG_ 833 VCFRONT1_a062_XCPWasConnected "VCFRONT1 ECU: a062 XCP was connected";
CM_ SG_ 833 VCFRONT1_a063_SwitchFault "VCFRONT1 ECU: a063 switch fault";
CM_ SG_ 833 VCFRONT1_a064_busSleepReqTimeout "VCFRONT1 ECU: a064 bus sleep req timeout";
CM_ SG_ 833 VCFRONT1_a077_VCBATT0_MIA "VCFRONT1 ECU: a077 VCBATT0 MIA";
CM_ SG_ 833 VCFRONT1_a078_VCBATT1_MIA "VCFRONT1 ECU: a078 VCBATT1 MIA";
CM_ SG_ 833 VCFRONT1_a079_VCBATT2_MIA "VCFRONT1 ECU: a079 VCBATT2 MIA";
CM_ SG_ 833 VCFRONT1_a080_VCFRONT0_MIA "VCFRONT1 ECU: a080 VCFRONT0 MIA";
CM_ SG_ 833 VCFRONT1_a081_VCFRONT1_MIA "VCFRONT1 ECU: a081 VCFRONT1 MIA";
CM_ SG_ 833 VCFRONT1_a082_VCFRONT2_MIA "VCFRONT1 ECU: a082 VCFRONT2 MIA";
CM_ SG_ 833 VCFRONT1_a086_VCBATT_MIA "VCFRONT1 ECU: a086 VCBATT MIA";
CM_ SG_ 833 VCFRONT1_a090_APS_MIA "VCFRONT1 ECU: a090 APS MIA";
CM_ SG_ 833 VCFRONT1_a091_CMPD_MIA "VCFRONT1 ECU: a091 CMPD MIA";
CM_ SG_ 833 VCFRONT1_a096_OCS1P_MIA "VCFRONT1 ECU: a096 OCS1 p MIA";
CM_ SG_ 833 VCFRONT1_a098_DIR_MIA "VCFRONT1 ECU: a098 DIR MIA";
CM_ SG_ 833 VCFRONT1_a100_CANbus_MIA "VCFRONT1 ECU: a100 CA nbus MIA";
CM_ SG_ 833 VCFRONT1_a103_CP_MIA "VCFRONT1 ECU: a103 CP MIA";
CM_ SG_ 833 VCFRONT1_a104_DAS_MIA "VCFRONT1 ECU: a104 DAS MIA";
CM_ SG_ 833 VCFRONT1_a105_TAS_MIA "VCFRONT1 ECU: a105 TAS MIA";
CM_ SG_ 833 VCFRONT1_a106_PCS_MIA "VCFRONT1 ECU: a106 PCS MIA";
CM_ SG_ 833 VCFRONT1_a107_BMS_MIA "VCFRONT1 ECU: a107 BMS MIA";
CM_ SG_ 833 VCFRONT1_a108_DIF_MIA "VCFRONT1 ECU: a108 DIF MIA";
CM_ SG_ 833 VCFRONT1_a109_RCM_MIA "VCFRONT1 ECU: a109 RCM MIA";
CM_ SG_ 833 VCFRONT1_a110_GTW_MIA "VCFRONT1 ECU: a110 GTW MIA";
CM_ SG_ 833 VCFRONT1_a111_EPBR_MIA "VCFRONT1 ECU: a111 EPBR MIA";
CM_ SG_ 833 VCFRONT1_a112_EPBL_MIA "VCFRONT1 ECU: a112 EPBL MIA";
CM_ SG_ 833 VCFRONT1_a113_UI_MIA "VCFRONT1 ECU: a113 UI MIA";
CM_ SG_ 833 VCFRONT1_a114_ESP_MIA "VCFRONT1 ECU: a114 ESP MIA";
CM_ SG_ 833 VCFRONT1_a115_VCSEC_MIA "VCFRONT1 ECU: a115 VCSEC MIA";
CM_ SG_ 833 VCFRONT1_a116_VCRIGHT_MIA "VCFRONT1 ECU: a116 VCRIGHT MIA";
CM_ SG_ 833 VCFRONT1_a117_VCLEFT_MIA "VCFRONT1 ECU: a117 VCLEFT MIA";
CM_ SG_ 833 VCFRONT1_a118_VCFRONT_MIA "VCFRONT1 ECU: a118 VCFRONT MIA";
CM_ SG_ 833 VCFRONT1_a119_SCCM_MIA "VCFRONT1 ECU: a119 SCCM MIA";
CM_ SG_ 833 VCFRONT1_a120_DI_DRIVE_MIA "VCFRONT1 ECU: a120 DI DRIVE MIA";
CM_ SG_ 833 VCFRONT1_a122_ICR_MIA "VCFRONT1 ECU: a122 ICR MIA";
CM_ SG_ 833 VCFRONT1_a124_BB_MIA "VCFRONT1 ECU: a124 BB MIA";
CM_ SG_ 833 VCFRONT1_a125_SCCM_MIA "VCFRONT1 ECU: a125 SCCM MIA";
CM_ SG_ 833 VCFRONT1_a126_EPAS3P_MIA "VCFRONT1 ECU: a126 EPAS3 p MIA";
CM_ SG_ 833 VCFRONT1_a127_iBoosterEFuseTrip "VCFRONT1 ECU: a127 i booster e fuse trip";
CM_ SG_ 833 VCFRONT1_a128_vcrightEFuseTrip "VCFRONT1 ECU: a128 vcright e fuse trip";
CM_ SG_ 833 VCFRONT1_a129_pcsEFuseTrip "VCFRONT1 ECU: a129 pcs e fuse trip";
CM_ SG_ 833 VCFRONT1_a130_autopilot2EFuseTri "VCFRONT1 ECU: a130 autopilot2 e fuse trip";
CM_ SG_ 833 VCFRONT1_a131_PCSCOMMON_MIA "VCFRONT1 ECU: a131 PCSCOMMON MIA";
CM_ SG_ 833 VCFRONT1_a132_epas2EFuseTrip "VCFRONT1 ECU: a132 epas2 e fuse trip";
CM_ SG_ 833 VCFRONT1_a133_BRAKE_MIA "VCFRONT1 ECU: a133 BRAKE MIA";
CM_ SG_ 833 VCFRONT1_a134_hvContactorsEFuseT "VCFRONT1 ECU: a134 hv contactors e fuse trip";
CM_ SG_ 833 VCFRONT1_a135_leftHeadlightEFuse "VCFRONT1 ECU: a135 left headlight e fuse trip";
CM_ SG_ 833 VCFRONT1_a144_EPAS3S_MIA "VCFRONT1 ECU: a144 EPAS3 s MIA";
CM_ SG_ 833 VCFRONT1_a164_eFuseLckoutMissing "VCFRONT1 ECU: a164 e fuse lckout missing";
CM_ SG_ 833 VCFRONT1_a165_unxpctdEFuseLckout "VCFRONT1 ECU: a165 unxpctd e fuse lckout";
CM_ SG_ 833 VCFRONT1_a177_mcuAudioEFuseTrip "VCFRONT1 ECU: a177 mcu audio e fuse trip";
CM_ SG_ 833 VCFRONT1_a188_sleepFailed "VCFRONT1 ECU: a188 sleep failed";
CM_ SG_ 833 VCFRONT1_a191_exitDriveDomainDow "VCFRONT1 ECU: a191 exit drive domain down";
CM_ SG_ 833 VCFRONT1_a204_undervoltageLoadsh "VCFRONT1 ECU: a204 undervoltage loadshed triggered";
CM_ SG_ 833 VCFRONT1_a205_overvoltageProtect "VCFRONT1 ECU: a205 overvoltage protection triggered";
CM_ SG_ 833 VCFRONT1_a214_openCircuitDetecte "VCFRONT1 ECU: a214 open circuit detected";
CM_ SG_ 833 VCFRONT1_a216_powerCutoffImminen "VCFRONT1 ECU: a216 power cutoff imminent";
CM_ SG_ 833 VCFRONT1_a220_LVUnhealthy "VCFRONT1 ECU: a220 LV unhealthy";
CM_ SG_ 833 VCFRONT1_a223_bridgeOvervoltageS "VCFRONT1 ECU: a223 bridge overvoltage self test failure";
CM_ SG_ 833 VCFRONT1_a229_LVHealthCompromise "VCFRONT1 ECU: a229 LV health compromised";
CM_ SG_ 833 VCFRONT1_a230_autopilot2EFuseTri "VCFRONT1 ECU: a230 autopilot2 e fuse trip during OTA";
CM_ SG_ 833 VCFRONT1_a249_pcsOvClampTripped "VCFRONT1 ECU: a249 pcs ov clamp tripped";
CM_ SG_ 833 VCFRONT1_a250_pcsOvShutdownTripp "VCFRONT1 ECU: a250 pcs ov shutdown tripped";
CM_ SG_ 833 VCFRONT1_a251_pcsOvShutdownSelfT "VCFRONT1 ECU: a251 pcs ov shutdown self test failure";
CM_ SG_ 833 VCFRONT1_a252_pcsOvShutdownSelfT "VCFRONT1 ECU: a252 pcs ov shutdown self test stage failure";
CM_ SG_ 833 VCFRONT1_a253_pcsOvShutdownHighS "VCFRONT1 ECU: a253 pcs ov shutdown high side self test debug";
CM_ SG_ 833 VCFRONT1_a256_nxppca9539Fault "VCFRONT1 ECU: a256 nxppca9539 fault";
CM_ SG_ 833 VCFRONT1_a262_vcrightVoltageMism "VCFRONT1 ECU: a262 vcright voltage mismatch";
CM_ SG_ 833 VCFRONT1_a263_pcsVoltageMismatch "VCFRONT1 ECU: a263 pcs voltage mismatch";
CM_ SG_ 833 VCFRONT1_a264_iBoosterVoltageMis "VCFRONT1 ECU: a264 i booster voltage mismatch";
CM_ SG_ 833 VCFRONT1_a266_EPAS2VoltageMismat "VCFRONT1 ECU: a266 EPAS2 voltage mismatch";
CM_ SG_ 833 VCFRONT1_a414_undervoltageSelfTe "VCFRONT1 ECU: a414 undervoltage self test failure";
CM_ SG_ 833 VCFRONT1_a415_undervoltageSelfTe "VCFRONT1 ECU: a415 undervoltage self test stuck off";
CM_ SG_ 833 VCFRONT1_a423_rtosSleepFailed "VCFRONT1 ECU: a423 rtos sleep failed";
CM_ SG_ 833 VCFRONT1_a450_doorWakeToOpenDBG "VCFRONT1 ECU: a450 door wake to open DBG";
CM_ SG_ 833 VCFRONT1_a475_vnf1248Fault "VCFRONT1 ECU: a475 vnf1248 fault";
CM_ SG_ 833 VCFRONT1_a480_vnf1048Fault "VCFRONT1 ECU: a480 vnf1048 fault";
CM_ SG_ 833 VCFRONT1_a482_lvBridgeEFuseTrip "VCFRONT1 ECU: a482 lv bridge e fuse trip";
CM_ SG_ 833 VCFRONT1_a483_vnf1048SelfTestFai "VCFRONT1 ECU: a483 vnf1048 self test failure";
CM_ SG_ 833 VCFRONT1_a484_undervoltageSelfTe "VCFRONT1 ECU: a484 undervoltage self test stuck on";
CM_ SG_ 833 VCFRONT1_a485_uvSelfTestLoadUnat "VCFRONT1 ECU: a485 uv self test load unattempted on dbg";
CM_ SG_ 833 VCFRONT1_a486_undervoltageSelfTe "VCFRONT1 ECU: a486 undervoltage self test bridge sync failure";
CM_ SG_ 833 VCFRONT1_a489_vnf1248SelfTestDeb "VCFRONT1 ECU: a489 vnf1248 self test debug";
CM_ SG_ 833 VCFRONT1_a490_vnf1248SelfTestFai "VCFRONT1 ECU: a490 vnf1248 self test failure";
CM_ SG_ 833 VCFRONT1_a491_vnf1248Configurati "VCFRONT1 ECU: a491 vnf1248 configuration mismatch";
CM_ SG_ 833 VCFRONT1_a496_exitDriveWarningDo "VCFRONT1 ECU: a496 exit drive warning domain down";
CM_ SG_ 833 VCFRONT1_a500_eFuseASICStateMism "VCFRONT1 ECU: a500 e fuse ASIC state mismatch";
CM_ SG_ 833 VCFRONT1_a501_vnf1048Configurati "VCFRONT1 ECU: a501 vnf1048 configuration mismatch";
CM_ SG_ 833 VCFRONT1_a509_eFuseASICManagerSt "VCFRONT1 ECU: a509 e fuse ASIC manager state mismatch";
CM_ SG_ 833 VCFRONT1_a523_eFuseThresholdsInc "VCFRONT1 ECU: a523 e fuse thresholds incorrect";
CM_ SG_ 833 VCFRONT1_a574_frontDriveInverter "VCFRONT1 ECU: a574 front drive inverter e fuse trip";
CM_ SG_ 833 VCFRONT1_a575_frontDriveInverter "VCFRONT1 ECU: a575 front drive inverter e fuse trip DBG";
CM_ SG_ 833 VCFRONT1_a578_vbusFusedLoadShedE "VCFRONT1 ECU: a578 vbus fused load shed e fuse trip";
CM_ SG_ 833 VCFRONT1_a581_harnessResistanceI "VCFRONT1 ECU: a581 harness resistance info";
CM_ SG_ 833 VCFRONT1_a590_vcrightPwrRational "VCFRONT1 ECU: a590 vcright pwr rationality curve";
CM_ SG_ 833 VCFRONT1_a591_vcrightFastBlowDet "VCFRONT1 ECU: a591 vcright fast blow detection";
CM_ SG_ 833 VCFRONT1_a596_vcrightCurvePowerC "VCFRONT1 ECU: a596 vcright curve power cutoff";
CM_ SG_ 833 VCFRONT1_a597_vcrightFastBlowPow "VCFRONT1 ECU: a597 vcright fast blow power cutoff";
CM_ SG_ 833 VCFRONT1_a617_APP_MIA "VCFRONT1 ECU: a617 APP MIA";
CM_ BO_ 1027 "VCFRONT1 ECU message: e fuse debug status";
CM_ SG_ 1027 VCFRONT1_eFuseDebugStatusIndex "VCFRONT1 ECU: e fuse debug status index";
CM_ SG_ 1027 VCFRONT1_EPAS2EFuseState "VCFRONT1 ECU: EPAS2 e fuse state";
CM_ SG_ 1027 VCFRONT1_EPAS2EFuseCurrent "VCFRONT1 ECU: EPAS2 e fuse current";
CM_ SG_ 1027 VCFRONT1_EPAS2EFuseOutput "VCFRONT1 ECU: EPAS2 e fuse output";
CM_ SG_ 1027 VCFRONT1_EPAS2EFuseOutputDesired "VCFRONT1 ECU: EPAS2 e fuse output desired";
CM_ SG_ 1027 VCFRONT1_EPAS2EFuseBypass "VCFRONT1 ECU: EPAS2 e fuse bypass";
CM_ SG_ 1027 VCFRONT1_EPAS2EFuseBypassDesired "VCFRONT1 ECU: EPAS2 e fuse bypass desired";
CM_ SG_ 1027 VCFRONT1_EPAS2EFuseVoltage "VCFRONT1 ECU: EPAS2 e fuse voltage";
CM_ SG_ 1027 VCFRONT1_EPAS2EFuseTemperature "VCFRONT1 ECU: EPAS2 e fuse temperature";
CM_ SG_ 1027 VCFRONT1_EPAS2EFuseManagerState "VCFRONT1 ECU: EPAS2 e fuse manager state";
CM_ SG_ 1027 VCFRONT1_EPAS2EFuseHardShortThre "VCFRONT1 ECU: EPAS2 e fuse hard short threshold";
CM_ SG_ 1027 VCFRONT1_EPAS2EFuseOCThreshold "VCFRONT1 ECU: EPAS2 e fuse OC threshold";
CM_ SG_ 1027 VCFRONT1_EPAS2EFuseType "Reports the type of the EPAS2 eFuse.";
CM_ SG_ 1027 VCFRONT1_rightControllerEFuseSta "VCFRONT1 ECU: right controller e fuse state";
CM_ SG_ 1027 VCFRONT1_rightControllerEFuseCur "VCFRONT1 ECU: right controller e fuse current";
CM_ SG_ 1027 VCFRONT1_rightControllerEFuseOut "VCFRONT1 ECU: right controller e fuse output";
CM_ SG_ 1027 VCFRONT1_rightControllerEFu_0002 "VCFRONT1 ECU: right controller e fuse output desired";
CM_ SG_ 1027 VCFRONT1_rightControllerEFuseByp "VCFRONT1 ECU: right controller e fuse bypass";
CM_ SG_ 1027 VCFRONT1_rightControllerEFu_0001 "VCFRONT1 ECU: right controller e fuse bypass desired";
CM_ SG_ 1027 VCFRONT1_rightControllerEFuseVol "VCFRONT1 ECU: right controller e fuse voltage";
CM_ SG_ 1027 VCFRONT1_rightControllerEFuseTem "VCFRONT1 ECU: right controller e fuse temperature";
CM_ SG_ 1027 VCFRONT1_rightControllerEFuseMan "VCFRONT1 ECU: right controller e fuse manager state";
CM_ SG_ 1027 VCFRONT1_rightControllerEFuseHar "VCFRONT1 ECU: right controller e fuse hard short threshold";
CM_ SG_ 1027 VCFRONT1_rightControllerEFuseOCT "VCFRONT1 ECU: right controller e fuse OC threshold";
CM_ SG_ 1027 VCFRONT1_rightControllerEFuseTyp "Reports the type of the right controller eFuse.";
CM_ SG_ 1027 VCFRONT1_autopilot2EFuseState "VCFRONT1 ECU: autopilot2 e fuse state";
CM_ SG_ 1027 VCFRONT1_autopilot2EFuseCurrent "VCFRONT1 ECU: autopilot2 e fuse current";
CM_ SG_ 1027 VCFRONT1_autopilot2EFuseOutput "VCFRONT1 ECU: autopilot2 e fuse output";
CM_ SG_ 1027 VCFRONT1_autopilot2EFuseOutputDe "VCFRONT1 ECU: autopilot2 e fuse output desired";
CM_ SG_ 1027 VCFRONT1_autopilot2EFuseBypass "VCFRONT1 ECU: autopilot2 e fuse bypass";
CM_ SG_ 1027 VCFRONT1_autopilot2EFuseBypassDe "VCFRONT1 ECU: autopilot2 e fuse bypass desired";
CM_ SG_ 1027 VCFRONT1_autopilot2EFuseVoltage "VCFRONT1 ECU: autopilot2 e fuse voltage";
CM_ SG_ 1027 VCFRONT1_autopilot2EFuseTemperat "VCFRONT1 ECU: autopilot2 e fuse temperature";
CM_ SG_ 1027 VCFRONT1_autopilot2EFuseManagerS "VCFRONT1 ECU: autopilot2 e fuse manager state";
CM_ SG_ 1027 VCFRONT1_autopilot2EFuseHardShor "VCFRONT1 ECU: autopilot2 e fuse hard short threshold";
CM_ SG_ 1027 VCFRONT1_autopilot2EFuseOCThresh "VCFRONT1 ECU: autopilot2 e fuse OC threshold";
CM_ SG_ 1027 VCFRONT1_autopilot2EFuseType "Reports the type of the autopilot2 eFuse.";
CM_ BO_ 1351 "VCFRONT2 ECU message: alert log";
CM_ SG_ 1351 VCFRONT2_alertID "VCFRONT2 ECU: alert ID";
CM_ SG_ 1351 VCFRONT2_alertState "VCFRONT2 ECU: alert state";
CM_ SG_ 1351 VCFRONT2_a001_InternalWatchdog "VCFRONT2 ECU: a001 internal watchdog";
CM_ SG_ 1351 VCFRONT2_a015_NVMMMemOverflow "VCFRONT2 ECU: a015 NVMM mem overflow";
CM_ SG_ 1351 VCFRONT2_a015_NVMMFilesystemErro "VCFRONT2 ECU: a015 NVMM filesystem error";
CM_ SG_ 1351 VCFRONT2_a015_NVMMRecordIDError "VCFRONT2 ECU: a015 NVMM record ID error";
CM_ SG_ 1351 VCFRONT2_a059_voltageDrop "VCFRONT2 ECU: a059 voltage drop";
CM_ SG_ 1351 VCFRONT2_a059_resistanceEstimate "VCFRONT2 ECU: a059 resistance estimate";
CM_ SG_ 1351 VCFRONT2_a059_current "VCFRONT2 ECU: a059 current";
CM_ SG_ 1351 VCFRONT2_a063_switchChannel "VCFRONT2 ECU: a063 switch channel";
CM_ SG_ 1351 VCFRONT2_a063_switchType "VCFRONT2 ECU: a063 switch type";
CM_ SG_ 1351 VCFRONT2_a063_ADCVoltage "VCFRONT2 ECU: a063 ADC voltage";
CM_ SG_ 1351 VCFRONT2_a063_disconnected "VCFRONT2 ECU: a063 disconnected";
CM_ SG_ 1351 VCFRONT2_a063_indeterminate "VCFRONT2 ECU: a063 indeterminate";
CM_ SG_ 1351 VCFRONT2_a063_stuckActive "VCFRONT2 ECU: a063 stuck active";
CM_ SG_ 1351 VCFRONT2_a063_faulted "VCFRONT2 ECU: a063 faulted";
CM_ SG_ 1351 VCFRONT2_a091_FRONTIPC_faultsAnd "VCFRONT2 ECU: a091 FRONTIPC faults and extras";
CM_ SG_ 1351 VCFRONT2_a091_FRONTIPC_state "VCFRONT2 ECU: a091 FRONTIPC state";
CM_ SG_ 1351 VCFRONT2_a096_FRONTIPC_status "VCFRONT2 ECU: a096 FRONTIPC status";
CM_ SG_ 1351 VCFRONT2_a098_FRONTIPC_temperatu "VCFRONT2 ECU: a098 FRONTIPC temperature";
CM_ SG_ 1351 VCFRONT2_a098_FRONTIPC_thermalCo "VCFRONT2 ECU: a098 FRONTIPC thermal control";
CM_ SG_ 1351 VCFRONT2_a106_BATTIPC_dcdcRailSt "VCFRONT2 ECU: a106 BATTIPC dcdc rail status";
CM_ SG_ 1351 VCFRONT2_a106_BATTIPC_dcdcStatus "VCFRONT2 ECU: a106 BATTIPC dcdc status";
CM_ SG_ 1351 VCFRONT2_a106_VEH_dcdcStatus "VCFRONT2 ECU: a106 VEH dcdc status";
CM_ SG_ 1351 VCFRONT2_a106_VEH_thermalControl "VCFRONT2 ECU: a106 VEH thermal control";
CM_ SG_ 1351 VCFRONT2_a106_VEH_dcdcRailStatus "VCFRONT2 ECU: a106 VEH dcdc rail status";
CM_ SG_ 1351 VCFRONT2_a106_CH_dcdcRailStatus "VCFRONT2 ECU: a106 CH dcdc rail status";
CM_ SG_ 1351 VCFRONT2_a106_CH_alertMatrix "VCFRONT2 ECU: a106 CH alert matrix";
CM_ SG_ 1351 VCFRONT2_a106_FRONTIPC_thermalCo "VCFRONT2 ECU: a106 FRONTIPC thermal control";
CM_ SG_ 1351 VCFRONT2_a106_FRONTIPC_dcdcRailS "VCFRONT2 ECU: a106 FRONTIPC dcdc rail status";
CM_ SG_ 1351 VCFRONT2_a106_FRONTIPC_dcdcStatu "VCFRONT2 ECU: a106 FRONTIPC dcdc status";
CM_ SG_ 1351 VCFRONT2_a108_FRONTIPC_status "VCFRONT2 ECU: a108 FRONTIPC status";
CM_ SG_ 1351 VCFRONT2_a108_FRONTIPC_temperatu "VCFRONT2 ECU: a108 FRONTIPC temperature";
CM_ SG_ 1351 VCFRONT2_a108_FRONTIPC_thermalCo "VCFRONT2 ECU: a108 FRONTIPC thermal control";
CM_ SG_ 1351 VCFRONT2_a108_FRONTIPC_motorStat "VCFRONT2 ECU: a108 FRONTIPC motor status";
CM_ SG_ 1351 VCFRONT2_a120_BATTIPC_speed "VCFRONT2 ECU: a120 BATTIPC speed";
CM_ SG_ 1351 VCFRONT2_a120_FRONTIPC_speed "VCFRONT2 ECU: a120 FRONTIPC speed";
CM_ SG_ 1351 VCFRONT2_a120_FRONTIPC_systemSta "VCFRONT2 ECU: a120 FRONTIPC system status";
CM_ SG_ 1351 VCFRONT2_a120_BATTIPC_systemStat "VCFRONT2 ECU: a120 BATTIPC system status";
CM_ SG_ 1351 VCFRONT2_a120_FRONTIPC_systemPow "VCFRONT2 ECU: a120 FRONTIPC system power";
CM_ SG_ 1351 VCFRONT2_a120_FRONTIPC_autonomyH "VCFRONT2 ECU: a120 FRONTIPC autonomy health";
CM_ SG_ 1351 VCFRONT2_a120_BATTIPC_chassisCon "VCFRONT2 ECU: a120 BATTIPC chassis control2";
CM_ SG_ 1351 VCFRONT2_a120_FRONTIPC_chassisCo "VCFRONT2 ECU: a120 FRONTIPC chassis control2";
CM_ SG_ 1351 VCFRONT2_a120_FRONTIPC_odometerS "VCFRONT2 ECU: a120 FRONTIPC odometer status";
CM_ SG_ 1351 VCFRONT2_a124_FRONTIPC_status "VCFRONT2 ECU: a124 FRONTIPC status";
CM_ SG_ 1351 VCFRONT2_a124_BATTIPC_status "VCFRONT2 ECU: a124 BATTIPC status";
CM_ SG_ 1351 VCFRONT2_a125_FRONTIPC_leftStalk "VCFRONT2 ECU: a125 FRONTIPC left stalk";
CM_ SG_ 1351 VCFRONT2_a125_FRONTIPC_steerAngl "VCFRONT2 ECU: a125 FRONTIPC steer angle";
CM_ SG_ 1351 VCFRONT2_a125_FRONTIPC_info "VCFRONT2 ECU: a125 FRONTIPC info";
CM_ SG_ 1351 VCFRONT2_a126_FRONTIPC_sysStatus "VCFRONT2 ECU: a126 FRONTIPC sys status";
CM_ SG_ 1351 VCFRONT2_a126_BATTIPC_sysStatus "VCFRONT2 ECU: a126 BATTIPC sys status";
CM_ SG_ 1351 VCFRONT2_a126_FRONTIPC_status "VCFRONT2 ECU: a126 FRONTIPC status";
CM_ SG_ 1351 VCFRONT2_a126_BATTIPC_status "VCFRONT2 ECU: a126 BATTIPC status";
CM_ SG_ 1351 VCFRONT2_a131_FRONTIPC_power "VCFRONT2 ECU: a131 FRONTIPC power";
CM_ SG_ 1351 VCFRONT2_a131_BATTIPC_power "VCFRONT2 ECU: a131 BATTIPC power";
CM_ SG_ 1351 VCFRONT2_a133_BATTIPC_primaryAct "VCFRONT2 ECU: a133 BATTIPC primary actuator";
CM_ SG_ 1351 VCFRONT2_a133_FRONTIPC_secondary "VCFRONT2 ECU: a133 FRONTIPC secondary actuator";
CM_ SG_ 1351 VCFRONT2_a142_driverState "VCFRONT2 ECU: a142 driver state";
CM_ SG_ 1351 VCFRONT2_a142_driverThermWarn "VCFRONT2 ECU: a142 driver therm warn";
CM_ SG_ 1351 VCFRONT2_a142_driverThermShutdow "VCFRONT2 ECU: a142 driver therm shutdown";
CM_ SG_ 1351 VCFRONT2_a142_undervoltage "VCFRONT2 ECU: a142 undervoltage";
CM_ SG_ 1351 VCFRONT2_a142_chargePumpUndervol "VCFRONT2 ECU: a142 charge pump undervoltage";
CM_ SG_ 1351 VCFRONT2_a142_isCoilOpenX "VCFRONT2 ECU: a142 is coil open x";
CM_ SG_ 1351 VCFRONT2_a142_isCoilOpenY "VCFRONT2 ECU: a142 is coil open y";
CM_ SG_ 1351 VCFRONT2_a142_isCoilShortXPGnd "VCFRONT2 ECU: a142 is coil short XP gnd";
CM_ SG_ 1351 VCFRONT2_a142_isCoilShortXPVbb "VCFRONT2 ECU: a142 is coil short XP vbb";
CM_ SG_ 1351 VCFRONT2_a142_isCoilShortXNGnd "VCFRONT2 ECU: a142 is coil short XN gnd";
CM_ SG_ 1351 VCFRONT2_a142_isCoilShortXNVbb "VCFRONT2 ECU: a142 is coil short XN vbb";
CM_ SG_ 1351 VCFRONT2_a142_isCoilShortYPGnd "VCFRONT2 ECU: a142 is coil short YP gnd";
CM_ SG_ 1351 VCFRONT2_a142_isCoilShortYPVbb "VCFRONT2 ECU: a142 is coil short YP vbb";
CM_ SG_ 1351 VCFRONT2_a142_isCoilShortYNGnd "VCFRONT2 ECU: a142 is coil short YN gnd";
CM_ SG_ 1351 VCFRONT2_a142_isCoilShortYNVbb "VCFRONT2 ECU: a142 is coil short YN vbb";
CM_ SG_ 1351 VCFRONT2_a142_driverHasCommError "VCFRONT2 ECU: a142 driver has comm error";
CM_ SG_ 1351 VCFRONT2_a144_FRONTIPC_status "VCFRONT2 ECU: a144 FRONTIPC status";
CM_ SG_ 1351 VCFRONT2_a144_BATTIPC_status "VCFRONT2 ECU: a144 BATTIPC status";
CM_ SG_ 1351 VCFRONT2_a150_RPMActual "VCFRONT2 ECU: a150 RPM actual";
CM_ SG_ 1351 VCFRONT2_a150_RPMTarget "VCFRONT2 ECU: a150 RPM target";
CM_ SG_ 1351 VCFRONT2_a159_stall "VCFRONT2 ECU: a159 stall";
CM_ SG_ 1351 VCFRONT2_a159_angleActual "VCFRONT2 ECU: a159 angle actual";
CM_ SG_ 1351 VCFRONT2_a159_angleTarget "VCFRONT2 ECU: a159 angle target";
CM_ SG_ 1351 VCFRONT2_a171_VCFRONT "VCFRONT2 ECU: a171 VCFRONT";
CM_ SG_ 1351 VCFRONT2_a171_VCRIGHT "VCFRONT2 ECU: a171 VCRIGHT";
CM_ SG_ 1351 VCFRONT2_a171_VCLEFT "VCFRONT2 ECU: a171 VCLEFT";
CM_ SG_ 1351 VCFRONT2_a171_VCBATT "VCFRONT2 ECU: a171 VCBATT";
CM_ SG_ 1351 VCFRONT2_a171_BMS "VCFRONT2 ECU: a171 BMS";
CM_ SG_ 1351 VCFRONT2_a171_HVP "VCFRONT2 ECU: a171 HVP";
CM_ SG_ 1351 VCFRONT2_a171_GTW "VCFRONT2 ECU: a171 GTW";
CM_ SG_ 1351 VCFRONT2_a171_CP "VCFRONT2 ECU: a171 CP";
CM_ SG_ 1351 VCFRONT2_a171_PCS "VCFRONT2 ECU: a171 PCS";
CM_ SG_ 1351 VCFRONT2_a171_PCSCPU2 "VCFRONT2 ECU: a171 PCSCPU2";
CM_ SG_ 1351 VCFRONT2_a171_DI "VCFRONT2 ECU: a171 DI";
CM_ SG_ 1351 VCFRONT2_a171_DIS "VCFRONT2 ECU: a171 DIS";
CM_ SG_ 1351 VCFRONT2_a171_PM "VCFRONT2 ECU: a171 PM";
CM_ SG_ 1351 VCFRONT2_a171_PMS "VCFRONT2 ECU: a171 PMS";
CM_ SG_ 1351 VCFRONT2_a171_EPBR "VCFRONT2 ECU: a171 EPBR";
CM_ SG_ 1351 VCFRONT2_a171_EPBL "VCFRONT2 ECU: a171 EPBL";
CM_ SG_ 1351 VCFRONT2_a171_IBST "VCFRONT2 ECU: a171 IBST";
CM_ SG_ 1351 VCFRONT2_a171_IBSTCAL "VCFRONT2 ECU: a171 IBSTCAL";
CM_ SG_ 1351 VCFRONT2_a171_ESP "VCFRONT2 ECU: a171 ESP";
CM_ SG_ 1351 VCFRONT2_a171_ESPCAL "VCFRONT2 ECU: a171 ESPCAL";
CM_ SG_ 1351 VCFRONT2_a171_OPC "VCFRONT2 ECU: a171 OPC";
CM_ SG_ 1351 VCFRONT2_a171_OPCS "VCFRONT2 ECU: a171 OPCS";
CM_ SG_ 1351 VCFRONT2_a171_SCCM "VCFRONT2 ECU: a171 SCCM";
CM_ SG_ 1351 VCFRONT2_a171_LVBMS "VCFRONT2 ECU: a171 LVBMS";
CM_ SG_ 1351 VCFRONT2_a171_IDB "VCFRONT2 ECU: a171 IDB";
CM_ SG_ 1351 VCFRONT2_a171_IDB1 "VCFRONT2 ECU: a171 IDB1";
CM_ SG_ 1351 VCFRONT2_a171_IDBCAL "VCFRONT2 ECU: a171 IDBCAL";
CM_ SG_ 1351 VCFRONT2_a171_RCU "VCFRONT2 ECU: a171 RCU";
CM_ SG_ 1351 VCFRONT2_a171_RCUCAL "VCFRONT2 ECU: a171 RCUCAL";
CM_ SG_ 1351 VCFRONT2_a171_DPB "VCFRONT2 ECU: a171 DPB";
CM_ SG_ 1351 VCFRONT2_a171_DPBCAL "VCFRONT2 ECU: a171 DPBCAL";
CM_ SG_ 1351 VCFRONT2_a171_serviceMode "Signal reported by VCFRONT2 ECU";
CM_ SG_ 1351 VCFRONT2_a172_ECUMismatchBits "VCFRONT2 ECU: a172 ECU mismatch bits";
CM_ SG_ 1351 VCFRONT2_a172_serviceMode "Signal reported by VCFRONT2 ECU";
CM_ SG_ 1351 VCFRONT2_a173_ECUMismatchBits "VCFRONT2 ECU: a173 ECU mismatch bits";
CM_ SG_ 1351 VCFRONT2_a173_serviceMode "Signal reported by VCFRONT2 ECU";
CM_ SG_ 1351 VCFRONT2_a176_vehicleState "VCFRONT2 ECU: a176 vehicle state";
CM_ SG_ 1351 VCFRONT2_a186_noDriveChgCableCon "VCFRONT2 ECU: a186 no drive chg cable con x";
CM_ SG_ 1351 VCFRONT2_a187_vehBusRetryCount "VCFRONT2 ECU: a187 veh bus retry count";
CM_ SG_ 1351 VCFRONT2_a187_partyBusRetryCount "VCFRONT2 ECU: a187 party bus retry count";
CM_ SG_ 1351 VCFRONT2_a187_hvsBusRetryCount "VCFRONT2 ECU: a187 hvs bus retry count";
CM_ SG_ 1351 VCFRONT2_a187_ethBusRetryCount "VCFRONT2 ECU: a187 eth bus retry count";
CM_ SG_ 1351 VCFRONT2_a187_chBusRetryCount "VCFRONT2 ECU: a187 ch bus retry count";
CM_ SG_ 1351 VCFRONT2_a195_LVVoltage "VCFRONT2 ECU: a195 LV voltage";
CM_ SG_ 1351 VCFRONT2_a195_serviceMode "Signal reported by VCFRONT2 ECU";
CM_ SG_ 1351 VCFRONT2_a195_frunkOpen "VCFRONT2 ECU: a195 frunk open";
CM_ SG_ 1351 VCFRONT2_a210_valveUnderTravel "VCFRONT2 ECU: a210 valve under travel";
CM_ SG_ 1351 VCFRONT2_a210_valveOverTravel "VCFRONT2 ECU: a210 valve over travel";
CM_ SG_ 1351 VCFRONT2_a210_valveNoTravel "VCFRONT2 ECU: a210 valve no travel";
CM_ SG_ 1351 VCFRONT2_a214_motorFaulted "VCFRONT2 ECU: a214 motor faulted";
CM_ SG_ 1351 VCFRONT2_a214_motorLocked "VCFRONT2 ECU: a214 motor locked";
CM_ SG_ 1351 VCFRONT2_a214_ecuReset "VCFRONT2 ECU: a214 ecu reset";
CM_ SG_ 1351 VCFRONT2_a214_fetTempIrrational "VCFRONT2 ECU: a214 fet temp irrational";
CM_ SG_ 1351 VCFRONT2_a214_motorControlError "VCFRONT2 ECU: a214 motor control error";
CM_ SG_ 1351 VCFRONT2_a214_underVoltage "VCFRONT2 ECU: a214 under voltage";
CM_ SG_ 1351 VCFRONT2_a214_overVoltage "VCFRONT2 ECU: a214 over voltage";
CM_ SG_ 1351 VCFRONT2_a214_hardwareOvercurren "VCFRONT2 ECU: a214 hardware overcurrent";
CM_ SG_ 1351 VCFRONT2_a214_motorOpenPhase "VCFRONT2 ECU: a214 motor open phase";
CM_ SG_ 1351 VCFRONT2_a214_motorSoftOpenPhase "VCFRONT2 ECU: a214 motor soft open phase";
CM_ SG_ 1351 VCFRONT2_a214_motorOvertemp "VCFRONT2 ECU: a214 motor overtemp";
CM_ SG_ 1351 VCFRONT2_a214_dcOvercurrent "VCFRONT2 ECU: a214 dc overcurrent";
CM_ SG_ 1351 VCFRONT2_a214_motorStalled "VCFRONT2 ECU: a214 motor stalled";
CM_ SG_ 1351 VCFRONT2_a214_selfTestFailed "VCFRONT2 ECU: a214 self test failed";
CM_ SG_ 1351 VCFRONT2_a214_selfTestResult "VCFRONT2 ECU: a214 self test result";
CM_ SG_ 1351 VCFRONT2_a214_linChecksumError "VCFRONT2 ECU: a214 lin checksum error";
CM_ SG_ 1351 VCFRONT2_a214_linFramingError "VCFRONT2 ECU: a214 lin framing error";
CM_ SG_ 1351 VCFRONT2_a214_phaseShorted "VCFRONT2 ECU: a214 phase shorted";
CM_ SG_ 1351 VCFRONT2_a214_busVoltageIrration "VCFRONT2 ECU: a214 bus voltage irrational";
CM_ SG_ 1351 VCFRONT2_a214_dcCurrentIrrationa "VCFRONT2 ECU: a214 dc current irrational";
CM_ SG_ 1351 VCFRONT2_a214_motorSpeedIrration "VCFRONT2 ECU: a214 motor speed irrational";
CM_ SG_ 1351 VCFRONT2_a214_supplyVoltageIrrat "VCFRONT2 ECU: a214 supply voltage irrational";
CM_ SG_ 1351 VCFRONT2_a214_motorPhaseCurrentI "VCFRONT2 ECU: a214 motor phase current irrational";
CM_ SG_ 1351 VCFRONT2_a214_chipOvertemp "VCFRONT2 ECU: a214 chip overtemp";
CM_ SG_ 1351 VCFRONT2_a214_motorSpeedTooHigh "VCFRONT2 ECU: a214 motor speed too high";
CM_ SG_ 1351 VCFRONT2_a214_phaseOvercurrent "VCFRONT2 ECU: a214 phase overcurrent";
CM_ SG_ 1351 VCFRONT2_a214_vddaOvercurrent "VCFRONT2 ECU: a214 vdda overcurrent";
CM_ SG_ 1351 VCFRONT2_a214_busVoltageUnhealth "VCFRONT2 ECU: a214 bus voltage unhealthy";
CM_ SG_ 1351 VCFRONT2_a214_hsVdsOvervoltage "VCFRONT2 ECU: a214 hs vds overvoltage";
CM_ SG_ 1351 VCFRONT2_a214_hsVdsOvervoltageMa "VCFRONT2 ECU: a214 hs vds overvoltage mask";
CM_ SG_ 1351 VCFRONT2_a214_lsVdsOvervoltage "VCFRONT2 ECU: a214 ls vds overvoltage";
CM_ SG_ 1351 VCFRONT2_a214_lsVdsOvervoltageMa "VCFRONT2 ECU: a214 ls vds overvoltage mask";
CM_ SG_ 1351 VCFRONT2_a214_payloadBitsNotSet "VCFRONT2 ECU: a214 payload bits not set";
CM_ SG_ 1351 VCFRONT2_a217_motorFaulted "VCFRONT2 ECU: a217 motor faulted";
CM_ SG_ 1351 VCFRONT2_a217_motorLocked "VCFRONT2 ECU: a217 motor locked";
CM_ SG_ 1351 VCFRONT2_a217_ecuReset "VCFRONT2 ECU: a217 ecu reset";
CM_ SG_ 1351 VCFRONT2_a217_fetTempIrrational "VCFRONT2 ECU: a217 fet temp irrational";
CM_ SG_ 1351 VCFRONT2_a217_motorControlError "VCFRONT2 ECU: a217 motor control error";
CM_ SG_ 1351 VCFRONT2_a217_underVoltage "VCFRONT2 ECU: a217 under voltage";
CM_ SG_ 1351 VCFRONT2_a217_overVoltage "VCFRONT2 ECU: a217 over voltage";
CM_ SG_ 1351 VCFRONT2_a217_hardwareOvercurren "VCFRONT2 ECU: a217 hardware overcurrent";
CM_ SG_ 1351 VCFRONT2_a217_motorOpenPhase "VCFRONT2 ECU: a217 motor open phase";
CM_ SG_ 1351 VCFRONT2_a217_motorSoftOpenPhase "VCFRONT2 ECU: a217 motor soft open phase";
CM_ SG_ 1351 VCFRONT2_a217_motorOvertemp "VCFRONT2 ECU: a217 motor overtemp";
CM_ SG_ 1351 VCFRONT2_a217_dcOvercurrent "VCFRONT2 ECU: a217 dc overcurrent";
CM_ SG_ 1351 VCFRONT2_a217_motorStalled "VCFRONT2 ECU: a217 motor stalled";
CM_ SG_ 1351 VCFRONT2_a217_selfTestFailed "VCFRONT2 ECU: a217 self test failed";
CM_ SG_ 1351 VCFRONT2_a217_selfTestResult "VCFRONT2 ECU: a217 self test result";
CM_ SG_ 1351 VCFRONT2_a217_linChecksumError "VCFRONT2 ECU: a217 lin checksum error";
CM_ SG_ 1351 VCFRONT2_a217_linFramingError "VCFRONT2 ECU: a217 lin framing error";
CM_ SG_ 1351 VCFRONT2_a217_phaseShorted "VCFRONT2 ECU: a217 phase shorted";
CM_ SG_ 1351 VCFRONT2_a217_busVoltageIrration "VCFRONT2 ECU: a217 bus voltage irrational";
CM_ SG_ 1351 VCFRONT2_a217_dcCurrentIrrationa "VCFRONT2 ECU: a217 dc current irrational";
CM_ SG_ 1351 VCFRONT2_a217_motorSpeedIrration "VCFRONT2 ECU: a217 motor speed irrational";
CM_ SG_ 1351 VCFRONT2_a217_supplyVoltageIrrat "VCFRONT2 ECU: a217 supply voltage irrational";
CM_ SG_ 1351 VCFRONT2_a217_motorPhaseCurrentI "VCFRONT2 ECU: a217 motor phase current irrational";
CM_ SG_ 1351 VCFRONT2_a217_chipOvertemp "VCFRONT2 ECU: a217 chip overtemp";
CM_ SG_ 1351 VCFRONT2_a217_motorSpeedTooHigh "VCFRONT2 ECU: a217 motor speed too high";
CM_ SG_ 1351 VCFRONT2_a217_phaseOvercurrent "VCFRONT2 ECU: a217 phase overcurrent";
CM_ SG_ 1351 VCFRONT2_a217_vddaOvercurrent "VCFRONT2 ECU: a217 vdda overcurrent";
CM_ SG_ 1351 VCFRONT2_a217_busVoltageUnhealth "VCFRONT2 ECU: a217 bus voltage unhealthy";
CM_ SG_ 1351 VCFRONT2_a217_hsVdsOvervoltage "VCFRONT2 ECU: a217 hs vds overvoltage";
CM_ SG_ 1351 VCFRONT2_a217_hsVdsOvervoltageMa "VCFRONT2 ECU: a217 hs vds overvoltage mask";
CM_ SG_ 1351 VCFRONT2_a217_lsVdsOvervoltage "VCFRONT2 ECU: a217 ls vds overvoltage";
CM_ SG_ 1351 VCFRONT2_a217_lsVdsOvervoltageMa "VCFRONT2 ECU: a217 ls vds overvoltage mask";
CM_ SG_ 1351 VCFRONT2_a217_payloadBitsNotSet "VCFRONT2 ECU: a217 payload bits not set";
CM_ SG_ 1351 VCFRONT2_a235_ptSensorTemp "VCFRONT2 ECU: a235 pt sensor temp";
CM_ SG_ 1351 VCFRONT2_a236_batSensorTemp "VCFRONT2 ECU: a236 bat sensor temp";
CM_ SG_ 1351 VCFRONT2_a247_solenoidISense "VCFRONT2 ECU: a247 solenoid i sense";
CM_ SG_ 1351 VCFRONT2_a249_tempCoolantBatInle "VCFRONT2 ECU: a249 temp coolant bat inlet";
CM_ SG_ 1351 VCFRONT2_a249_tempCoolantPTInlet "VCFRONT2 ECU: a249 temp coolant PT inlet";
CM_ SG_ 1351 VCFRONT2_a254_RPMActual "VCFRONT2 ECU: a254 RPM actual";
CM_ SG_ 1351 VCFRONT2_a254_RPMTarget "VCFRONT2 ECU: a254 RPM target";
CM_ SG_ 1351 VCFRONT2_a283_thmlFanDisabled "VCFRONT2 ECU: a283 thml fan disabled";
CM_ SG_ 1351 VCFRONT2_a283_thmlFanLimited "VCFRONT2 ECU: a283 thml fan limited";
CM_ SG_ 1351 VCFRONT2_a283_thmlFanDemand "VCFRONT2 ECU: a283 thml fan demand";
CM_ SG_ 1351 VCFRONT2_a283_thmlFanDemandLimit "VCFRONT2 ECU: a283 thml fan demand limit";
CM_ SG_ 1351 VCFRONT2_a283_thmlFanPhaseI "VCFRONT2 ECU: a283 thml fan phase i";
CM_ SG_ 1351 VCFRONT2_a283_thmlFanPhaseILimit "VCFRONT2 ECU: a283 thml fan phase i limit";
CM_ SG_ 1351 VCFRONT2_a284_driverState "VCFRONT2 ECU: a284 driver state";
CM_ SG_ 1351 VCFRONT2_a284_driverThermWarn "VCFRONT2 ECU: a284 driver therm warn";
CM_ SG_ 1351 VCFRONT2_a284_driverThermShutdow "VCFRONT2 ECU: a284 driver therm shutdown";
CM_ SG_ 1351 VCFRONT2_a284_undervoltage "VCFRONT2 ECU: a284 undervoltage";
CM_ SG_ 1351 VCFRONT2_a284_chargePumpUndervol "VCFRONT2 ECU: a284 charge pump undervoltage";
CM_ SG_ 1351 VCFRONT2_a284_isCoilOpenX "VCFRONT2 ECU: a284 is coil open x";
CM_ SG_ 1351 VCFRONT2_a284_isCoilOpenY "VCFRONT2 ECU: a284 is coil open y";
CM_ SG_ 1351 VCFRONT2_a284_isCoilShortXPGnd "VCFRONT2 ECU: a284 is coil short XP gnd";
CM_ SG_ 1351 VCFRONT2_a284_isCoilShortXPVbb "VCFRONT2 ECU: a284 is coil short XP vbb";
CM_ SG_ 1351 VCFRONT2_a284_isCoilShortXNGnd "VCFRONT2 ECU: a284 is coil short XN gnd";
CM_ SG_ 1351 VCFRONT2_a284_isCoilShortXNVbb "VCFRONT2 ECU: a284 is coil short XN vbb";
CM_ SG_ 1351 VCFRONT2_a284_isCoilShortYPGnd "VCFRONT2 ECU: a284 is coil short YP gnd";
CM_ SG_ 1351 VCFRONT2_a284_isCoilShortYPVbb "VCFRONT2 ECU: a284 is coil short YP vbb";
CM_ SG_ 1351 VCFRONT2_a284_isCoilShortYNGnd "VCFRONT2 ECU: a284 is coil short YN gnd";
CM_ SG_ 1351 VCFRONT2_a284_isCoilShortYNVbb "VCFRONT2 ECU: a284 is coil short YN vbb";
CM_ SG_ 1351 VCFRONT2_a284_driverHasCommError "VCFRONT2 ECU: a284 driver has comm error";
CM_ SG_ 1351 VCFRONT2_a285_driverState "VCFRONT2 ECU: a285 driver state";
CM_ SG_ 1351 VCFRONT2_a285_driverThermWarn "VCFRONT2 ECU: a285 driver therm warn";
CM_ SG_ 1351 VCFRONT2_a285_driverThermShutdow "VCFRONT2 ECU: a285 driver therm shutdown";
CM_ SG_ 1351 VCFRONT2_a285_undervoltage "VCFRONT2 ECU: a285 undervoltage";
CM_ SG_ 1351 VCFRONT2_a285_chargePumpUndervol "VCFRONT2 ECU: a285 charge pump undervoltage";
CM_ SG_ 1351 VCFRONT2_a285_isCoilOpenX "VCFRONT2 ECU: a285 is coil open x";
CM_ SG_ 1351 VCFRONT2_a285_isCoilOpenY "VCFRONT2 ECU: a285 is coil open y";
CM_ SG_ 1351 VCFRONT2_a285_isCoilShortXPGnd "VCFRONT2 ECU: a285 is coil short XP gnd";
CM_ SG_ 1351 VCFRONT2_a285_isCoilShortXPVbb "VCFRONT2 ECU: a285 is coil short XP vbb";
CM_ SG_ 1351 VCFRONT2_a285_isCoilShortXNGnd "VCFRONT2 ECU: a285 is coil short XN gnd";
CM_ SG_ 1351 VCFRONT2_a285_isCoilShortXNVbb "VCFRONT2 ECU: a285 is coil short XN vbb";
CM_ SG_ 1351 VCFRONT2_a285_isCoilShortYPGnd "VCFRONT2 ECU: a285 is coil short YP gnd";
CM_ SG_ 1351 VCFRONT2_a285_isCoilShortYPVbb "VCFRONT2 ECU: a285 is coil short YP vbb";
CM_ SG_ 1351 VCFRONT2_a285_isCoilShortYNGnd "VCFRONT2 ECU: a285 is coil short YN gnd";
CM_ SG_ 1351 VCFRONT2_a285_isCoilShortYNVbb "VCFRONT2 ECU: a285 is coil short YN vbb";
CM_ SG_ 1351 VCFRONT2_a285_driverHasCommError "VCFRONT2 ECU: a285 driver has comm error";
CM_ SG_ 1351 VCFRONT2_a286_driverState "VCFRONT2 ECU: a286 driver state";
CM_ SG_ 1351 VCFRONT2_a286_driverThermWarn "VCFRONT2 ECU: a286 driver therm warn";
CM_ SG_ 1351 VCFRONT2_a286_driverThermShutdow "VCFRONT2 ECU: a286 driver therm shutdown";
CM_ SG_ 1351 VCFRONT2_a286_undervoltage "VCFRONT2 ECU: a286 undervoltage";
CM_ SG_ 1351 VCFRONT2_a286_chargePumpUndervol "VCFRONT2 ECU: a286 charge pump undervoltage";
CM_ SG_ 1351 VCFRONT2_a286_isCoilOpenX "VCFRONT2 ECU: a286 is coil open x";
CM_ SG_ 1351 VCFRONT2_a286_isCoilOpenY "VCFRONT2 ECU: a286 is coil open y";
CM_ SG_ 1351 VCFRONT2_a286_isCoilShortXPGnd "VCFRONT2 ECU: a286 is coil short XP gnd";
CM_ SG_ 1351 VCFRONT2_a286_isCoilShortXPVbb "VCFRONT2 ECU: a286 is coil short XP vbb";
CM_ SG_ 1351 VCFRONT2_a286_isCoilShortXNGnd "VCFRONT2 ECU: a286 is coil short XN gnd";
CM_ SG_ 1351 VCFRONT2_a286_isCoilShortXNVbb "VCFRONT2 ECU: a286 is coil short XN vbb";
CM_ SG_ 1351 VCFRONT2_a286_isCoilShortYPGnd "VCFRONT2 ECU: a286 is coil short YP gnd";
CM_ SG_ 1351 VCFRONT2_a286_isCoilShortYPVbb "VCFRONT2 ECU: a286 is coil short YP vbb";
CM_ SG_ 1351 VCFRONT2_a286_isCoilShortYNGnd "VCFRONT2 ECU: a286 is coil short YN gnd";
CM_ SG_ 1351 VCFRONT2_a286_isCoilShortYNVbb "VCFRONT2 ECU: a286 is coil short YN vbb";
CM_ SG_ 1351 VCFRONT2_a286_driverHasCommError "VCFRONT2 ECU: a286 driver has comm error";
CM_ SG_ 1351 VCFRONT2_a287_driverState "VCFRONT2 ECU: a287 driver state";
CM_ SG_ 1351 VCFRONT2_a287_driverThermWarn "VCFRONT2 ECU: a287 driver therm warn";
CM_ SG_ 1351 VCFRONT2_a287_driverThermShutdow "VCFRONT2 ECU: a287 driver therm shutdown";
CM_ SG_ 1351 VCFRONT2_a287_undervoltage "VCFRONT2 ECU: a287 undervoltage";
CM_ SG_ 1351 VCFRONT2_a287_chargePumpUndervol "VCFRONT2 ECU: a287 charge pump undervoltage";
CM_ SG_ 1351 VCFRONT2_a287_isCoilOpenX "VCFRONT2 ECU: a287 is coil open x";
CM_ SG_ 1351 VCFRONT2_a287_isCoilOpenY "VCFRONT2 ECU: a287 is coil open y";
CM_ SG_ 1351 VCFRONT2_a287_isCoilShortXPGnd "VCFRONT2 ECU: a287 is coil short XP gnd";
CM_ SG_ 1351 VCFRONT2_a287_isCoilShortXPVbb "VCFRONT2 ECU: a287 is coil short XP vbb";
CM_ SG_ 1351 VCFRONT2_a287_isCoilShortXNGnd "VCFRONT2 ECU: a287 is coil short XN gnd";
CM_ SG_ 1351 VCFRONT2_a287_isCoilShortXNVbb "VCFRONT2 ECU: a287 is coil short XN vbb";
CM_ SG_ 1351 VCFRONT2_a287_isCoilShortYPGnd "VCFRONT2 ECU: a287 is coil short YP gnd";
CM_ SG_ 1351 VCFRONT2_a287_isCoilShortYPVbb "VCFRONT2 ECU: a287 is coil short YP vbb";
CM_ SG_ 1351 VCFRONT2_a287_isCoilShortYNGnd "VCFRONT2 ECU: a287 is coil short YN gnd";
CM_ SG_ 1351 VCFRONT2_a287_isCoilShortYNVbb "VCFRONT2 ECU: a287 is coil short YN vbb";
CM_ SG_ 1351 VCFRONT2_a287_driverHasCommError "VCFRONT2 ECU: a287 driver has comm error";
CM_ SG_ 1351 VCFRONT2_a288_driverState "VCFRONT2 ECU: a288 driver state";
CM_ SG_ 1351 VCFRONT2_a288_driverThermWarn "VCFRONT2 ECU: a288 driver therm warn";
CM_ SG_ 1351 VCFRONT2_a288_driverThermShutdow "VCFRONT2 ECU: a288 driver therm shutdown";
CM_ SG_ 1351 VCFRONT2_a288_undervoltage "VCFRONT2 ECU: a288 undervoltage";
CM_ SG_ 1351 VCFRONT2_a288_chargePumpUndervol "VCFRONT2 ECU: a288 charge pump undervoltage";
CM_ SG_ 1351 VCFRONT2_a288_isCoilOpenX "VCFRONT2 ECU: a288 is coil open x";
CM_ SG_ 1351 VCFRONT2_a288_isCoilOpenY "VCFRONT2 ECU: a288 is coil open y";
CM_ SG_ 1351 VCFRONT2_a288_isCoilShortXPGnd "VCFRONT2 ECU: a288 is coil short XP gnd";
CM_ SG_ 1351 VCFRONT2_a288_isCoilShortXPVbb "VCFRONT2 ECU: a288 is coil short XP vbb";
CM_ SG_ 1351 VCFRONT2_a288_isCoilShortXNGnd "VCFRONT2 ECU: a288 is coil short XN gnd";
CM_ SG_ 1351 VCFRONT2_a288_isCoilShortXNVbb "VCFRONT2 ECU: a288 is coil short XN vbb";
CM_ SG_ 1351 VCFRONT2_a288_isCoilShortYPGnd "VCFRONT2 ECU: a288 is coil short YP gnd";
CM_ SG_ 1351 VCFRONT2_a288_isCoilShortYPVbb "VCFRONT2 ECU: a288 is coil short YP vbb";
CM_ SG_ 1351 VCFRONT2_a288_isCoilShortYNGnd "VCFRONT2 ECU: a288 is coil short YN gnd";
CM_ SG_ 1351 VCFRONT2_a288_isCoilShortYNVbb "VCFRONT2 ECU: a288 is coil short YN vbb";
CM_ SG_ 1351 VCFRONT2_a288_driverHasCommError "VCFRONT2 ECU: a288 driver has comm error";
CM_ SG_ 1351 VCFRONT2_a289_driverState "VCFRONT2 ECU: a289 driver state";
CM_ SG_ 1351 VCFRONT2_a289_driverThermWarn "VCFRONT2 ECU: a289 driver therm warn";
CM_ SG_ 1351 VCFRONT2_a289_driverThermShutdow "VCFRONT2 ECU: a289 driver therm shutdown";
CM_ SG_ 1351 VCFRONT2_a289_undervoltage "VCFRONT2 ECU: a289 undervoltage";
CM_ SG_ 1351 VCFRONT2_a289_chargePumpUndervol "VCFRONT2 ECU: a289 charge pump undervoltage";
CM_ SG_ 1351 VCFRONT2_a289_isCoilOpenX "VCFRONT2 ECU: a289 is coil open x";
CM_ SG_ 1351 VCFRONT2_a289_isCoilOpenY "VCFRONT2 ECU: a289 is coil open y";
CM_ SG_ 1351 VCFRONT2_a289_isCoilShortXPGnd "VCFRONT2 ECU: a289 is coil short XP gnd";
CM_ SG_ 1351 VCFRONT2_a289_isCoilShortXPVbb "VCFRONT2 ECU: a289 is coil short XP vbb";
CM_ SG_ 1351 VCFRONT2_a289_isCoilShortXNGnd "VCFRONT2 ECU: a289 is coil short XN gnd";
CM_ SG_ 1351 VCFRONT2_a289_isCoilShortXNVbb "VCFRONT2 ECU: a289 is coil short XN vbb";
CM_ SG_ 1351 VCFRONT2_a289_isCoilShortYPGnd "VCFRONT2 ECU: a289 is coil short YP gnd";
CM_ SG_ 1351 VCFRONT2_a289_isCoilShortYPVbb "VCFRONT2 ECU: a289 is coil short YP vbb";
CM_ SG_ 1351 VCFRONT2_a289_isCoilShortYNGnd "VCFRONT2 ECU: a289 is coil short YN gnd";
CM_ SG_ 1351 VCFRONT2_a289_isCoilShortYNVbb "VCFRONT2 ECU: a289 is coil short YN vbb";
CM_ SG_ 1351 VCFRONT2_a289_driverHasCommError "VCFRONT2 ECU: a289 driver has comm error";
CM_ SG_ 1351 VCFRONT2_a302_LINFrameStatus "VCFRONT2 ECU: a302 LIN frame status";
CM_ SG_ 1351 VCFRONT2_a355_fluidNotFilled "VCFRONT2 ECU: a355 fluid not filled";
CM_ SG_ 1351 VCFRONT2_a355_systemNotCommissio "VCFRONT2 ECU: a355 system not commissioned";
CM_ SG_ 1351 VCFRONT2_a355_serviceLockout "VCFRONT2 ECU: a355 service lockout";
CM_ SG_ 1351 VCFRONT2_a355_factoryGated "VCFRONT2 ECU: a355 factory gated";
CM_ SG_ 1351 VCFRONT2_a356_fluidNotFilled "VCFRONT2 ECU: a356 fluid not filled";
CM_ SG_ 1351 VCFRONT2_a356_systemNotCommissio "VCFRONT2 ECU: a356 system not commissioned";
CM_ SG_ 1351 VCFRONT2_a356_serviceLockout "VCFRONT2 ECU: a356 service lockout";
CM_ SG_ 1351 VCFRONT2_a356_factoryGated "VCFRONT2 ECU: a356 factory gated";
CM_ SG_ 1351 VCFRONT2_a356_refCommissionStatu "VCFRONT2 ECU: a356 ref commission status";
CM_ SG_ 1351 VCFRONT2_a360_vehicleLoadShedAct "VCFRONT2 ECU: a360 vehicle load shed active";
CM_ SG_ 1351 VCFRONT2_a360_notEnoughPowerForS "VCFRONT2 ECU: a360 not enough power for support";
CM_ SG_ 1351 VCFRONT2_a367_bmsSoc "VCFRONT2 ECU: a367 bms soc";
CM_ SG_ 1351 VCFRONT2_a368_bmsRequestRemoved "VCFRONT2 ECU: a368 bms request removed";
CM_ SG_ 1351 VCFRONT2_a368_enteringState "VCFRONT2 ECU: a368 entering state";
CM_ SG_ 1351 VCFRONT2_a368_exitingState "VCFRONT2 ECU: a368 exiting state";
CM_ SG_ 1351 VCFRONT2_a368_bmsSoc "VCFRONT2 ECU: a368 bms soc";
CM_ SG_ 1351 VCFRONT2_a368_systemFaulted "VCFRONT2 ECU: a368 system faulted";
CM_ SG_ 1351 VCFRONT2_a368_coolantTempSensors "VCFRONT2 ECU: a368 coolant temp sensors faulted";
CM_ SG_ 1351 VCFRONT2_a368_coolantValveFaulte "VCFRONT2 ECU: a368 coolant valve faulted";
CM_ SG_ 1351 VCFRONT2_a368_louverFaulted "VCFRONT2 ECU: a368 louver faulted";
CM_ SG_ 1351 VCFRONT2_a368_fansFaulted "VCFRONT2 ECU: a368 fans faulted";
CM_ SG_ 1351 VCFRONT2_a368_coolantNotFilled "VCFRONT2 ECU: a368 coolant not filled";
CM_ SG_ 1351 VCFRONT2_a368_coolantPumpsFaulte "VCFRONT2 ECU: a368 coolant pumps faulted";
CM_ SG_ 1351 VCFRONT2_a368_preconditionsNotMe "VCFRONT2 ECU: a368 preconditions not met";
CM_ SG_ 1351 VCFRONT2_a368_belowSocMin "VCFRONT2 ECU: a368 below soc min";
CM_ SG_ 1351 VCFRONT2_a369_powerGenerationLim "VCFRONT2 ECU: a369 power generation limited";
CM_ SG_ 1351 VCFRONT2_a369_heatRejectionLimit "VCFRONT2 ECU: a369 heat rejection limited";
CM_ SG_ 1351 VCFRONT2_a369_bmsSoc "VCFRONT2 ECU: a369 bms soc";
CM_ SG_ 1351 VCFRONT2_a369_wasteHeatPower "VCFRONT2 ECU: a369 waste heat power";
CM_ SG_ 1351 VCFRONT2_a374_lccInletSolenoidIS "VCFRONT2 ECU: a374 lcc inlet solenoid i sense";
CM_ SG_ 1351 VCFRONT2_a377_wiperStuckOutOfPar "VCFRONT2 ECU: a377 wiper stuck out of park";
CM_ SG_ 1351 VCFRONT2_a377_wiperStuckInPark "VCFRONT2 ECU: a377 wiper stuck in park";
CM_ SG_ 1351 VCFRONT2_a397_discharge "VCFRONT2 ECU: a397 discharge";
CM_ SG_ 1351 VCFRONT2_a397_suction "VCFRONT2 ECU: a397 suction";
CM_ SG_ 1351 VCFRONT2_a397_liquid "VCFRONT2 ECU: a397 liquid";
CM_ SG_ 1351 VCFRONT2_a397_offsetError "VCFRONT2 ECU: a397 offset error";
CM_ SG_ 1351 VCFRONT2_a397_runTimeOffSetDetec "VCFRONT2 ECU: a397 run time off set detected";
CM_ SG_ 1351 VCFRONT2_a409_brushlessMotorConf "VCFRONT2 ECU: a409 brushless motor configuration invalid";
CM_ SG_ 1351 VCFRONT2_a446_compFaultRefrigera "VCFRONT2 ECU: a446 comp fault refrigerant";
CM_ SG_ 1351 VCFRONT2_a446_compFaultTdHigh "VCFRONT2 ECU: a446 comp fault td high";
CM_ SG_ 1351 VCFRONT2_a446_compFaultPdLow "VCFRONT2 ECU: a446 comp fault pd low";
CM_ SG_ 1351 VCFRONT2_a446_compFaultPdHigh "VCFRONT2 ECU: a446 comp fault pd high";
CM_ SG_ 1351 VCFRONT2_a446_compFaultPsLow "VCFRONT2 ECU: a446 comp fault ps low";
CM_ SG_ 1351 VCFRONT2_a446_compStandbyLowAmbi "VCFRONT2 ECU: a446 comp standby low ambient";
CM_ SG_ 1351 VCFRONT2_a446_compStandbyLowDisc "VCFRONT2 ECU: a446 comp standby low disch press";
CM_ SG_ 1351 VCFRONT2_a446_compStandbyHVNotRe "VCFRONT2 ECU: a446 comp standby HV not ready";
CM_ SG_ 1351 VCFRONT2_a446_compStandbyCommuni "VCFRONT2 ECU: a446 comp standby communication";
CM_ SG_ 1351 VCFRONT2_a446_compStandbySelfNot "VCFRONT2 ECU: a446 comp standby self not ready";
CM_ SG_ 1351 VCFRONT2_a446_compStandbyRefrigN "VCFRONT2 ECU: a446 comp standby refrig not ok";
CM_ SG_ 1351 VCFRONT2_a446_compStandbyCoastDo "VCFRONT2 ECU: a446 comp standby coast down mode";
CM_ SG_ 1351 VCFRONT2_a446_compStandbyMultipl "VCFRONT2 ECU: a446 comp standby multiple pd cutouts";
CM_ SG_ 1351 VCFRONT2_a446_compStandbyShowroo "VCFRONT2 ECU: a446 comp standby showroom mode";
CM_ SG_ 1351 VCFRONT2_a446_compStandbyMu_0001 "VCFRONT2 ECU: a446 comp standby multiple td cutouts";
CM_ SG_ 1351 VCFRONT2_a446_hpCabinLoadType "VCFRONT2 ECU: a446 hp cabin load type";
CM_ SG_ 1351 VCFRONT2_a446_hpBatteryLoadType "VCFRONT2 ECU: a446 hp battery load type";
CM_ SG_ 1351 VCFRONT2_a446_usingModeledPs "VCFRONT2 ECU: a446 using modeled ps";
CM_ SG_ 1351 VCFRONT2_a446_usingModeledPd "VCFRONT2 ECU: a446 using modeled pd";
CM_ SG_ 1351 VCFRONT2_a446_usingModeledPl "VCFRONT2 ECU: a446 using modeled pl";
CM_ SG_ 1351 VCFRONT2_a446_usingModeledTs "VCFRONT2 ECU: a446 using modeled ts";
CM_ SG_ 1351 VCFRONT2_a446_usingModeledTd "VCFRONT2 ECU: a446 using modeled td";
CM_ SG_ 1351 VCFRONT2_a446_usingModeledTl "VCFRONT2 ECU: a446 using modeled tl";
CM_ SG_ 1351 VCFRONT2_a446_sensorHasOffsetTd "VCFRONT2 ECU: a446 sensor has offset td";
CM_ SG_ 1351 VCFRONT2_a446_sensorHasOffsetPd "VCFRONT2 ECU: a446 sensor has offset pd";
CM_ SG_ 1351 VCFRONT2_a446_sensorDroopPd "VCFRONT2 ECU: a446 sensor droop pd";
CM_ SG_ 1351 VCFRONT2_a446_sensorHasOffsetTl "VCFRONT2 ECU: a446 sensor has offset tl";
CM_ SG_ 1351 VCFRONT2_a446_sensorIntermi_0002 "VCFRONT2 ECU: a446 sensor intermittent ps";
CM_ SG_ 1351 VCFRONT2_a446_sensorIntermittent "VCFRONT2 ECU: a446 sensor intermittent pd";
CM_ SG_ 1351 VCFRONT2_a446_sensorIntermi_0001 "VCFRONT2 ECU: a446 sensor intermittent pl";
CM_ SG_ 1351 VCFRONT2_a446_sensorIntermi_0005 "VCFRONT2 ECU: a446 sensor intermittent ts";
CM_ SG_ 1351 VCFRONT2_a446_sensorIntermi_0003 "VCFRONT2 ECU: a446 sensor intermittent td";
CM_ SG_ 1351 VCFRONT2_a446_sensorIntermi_0004 "VCFRONT2 ECU: a446 sensor intermittent tl";
CM_ SG_ 1351 VCFRONT2_a446_highSuctionSuperhe "VCFRONT2 ECU: a446 high suction superheat";
CM_ SG_ 1351 VCFRONT2_a446_evapLowPsCutout "VCFRONT2 ECU: a446 evap low ps cutout";
CM_ SG_ 1351 VCFRONT2_a446_batteryOverTemp "VCFRONT2 ECU: a446 battery over temp";
CM_ SG_ 1351 VCFRONT2_a446_hvacSystemFault "VCFRONT2 ECU: a446 hvac system fault";
CM_ SG_ 1351 VCFRONT2_a446_coolantSysLockedOu "VCFRONT2 ECU: a446 coolant sys locked out";
CM_ SG_ 1351 VCFRONT2_a446_refSysLockedOut "VCFRONT2 ECU: a446 ref sys locked out";
CM_ SG_ 1351 VCFRONT2_a446_chillerEXVNotReady "VCFRONT2 ECU: a446 chiller EXV not ready";
CM_ SG_ 1351 VCFRONT2_a446_CCLEXVNotReady "VCFRONT2 ECU: a446 CCLEXV not ready";
CM_ SG_ 1351 VCFRONT2_a446_CCREXVNotReady "VCFRONT2 ECU: a446 CCREXV not ready";
CM_ SG_ 1351 VCFRONT2_a446_LCCEXVNotReady "VCFRONT2 ECU: a446 LCCEXV not ready";
CM_ SG_ 1351 VCFRONT2_a446_evapEXVNotReady "VCFRONT2 ECU: a446 evap EXV not ready";
CM_ SG_ 1351 VCFRONT2_a446_recircEXVNotReady "VCFRONT2 ECU: a446 recirc EXV not ready";
CM_ SG_ 1351 VCFRONT2_a446_checkA447Alert "VCFRONT2 ECU: a446 check A447 alert";
CM_ SG_ 1351 VCFRONT2_a447_caseHVACUnavailabl "VCFRONT2 ECU: a447 case HVAC unavailable";
CM_ SG_ 1351 VCFRONT2_a447_heatPumpHVACUnavai "VCFRONT2 ECU: a447 heat pump HVAC unavailable";
CM_ SG_ 1351 VCFRONT2_a447_activeLouverCompro "VCFRONT2 ECU: a447 active louver compromised";
CM_ SG_ 1351 VCFRONT2_a447_coolantValveCompro "VCFRONT2 ECU: a447 coolant valve compromised";
CM_ SG_ 1351 VCFRONT2_a447_ambientSourcingCom "VCFRONT2 ECU: a447 ambient sourcing compromised";
CM_ SG_ 1351 VCFRONT2_a447_scavengeLoopCompro "VCFRONT2 ECU: a447 scavenge loop compromised";
CM_ SG_ 1351 VCFRONT2_a447_coolantSystemCompr "VCFRONT2 ECU: a447 coolant system compromised";
CM_ SG_ 1351 VCFRONT2_a447_hvBattActiveDischg "VCFRONT2 ECU: a447 hv batt active dischg compromised";
CM_ SG_ 1351 VCFRONT2_a447_hvBatteryDischargi "VCFRONT2 ECU: a447 hv battery discharging compromised";
CM_ SG_ 1351 VCFRONT2_a447_lccSolenoidComprom "VCFRONT2 ECU: a447 lcc solenoid compromised";
CM_ SG_ 1351 VCFRONT2_a447_refrigerantSystemC "VCFRONT2 ECU: a447 refrigerant system compromised";
CM_ SG_ 1351 VCFRONT2_a447_powertrainThermalF "VCFRONT2 ECU: a447 powertrain thermal fans compromised";
CM_ SG_ 1351 VCFRONT2_a447_refrigDischargePre "VCFRONT2 ECU: a447 refrig discharge press compromised";
CM_ SG_ 1351 VCFRONT2_a447_refrigeDischargeTe "VCFRONT2 ECU: a447 refrige discharge temp compromised";
CM_ SG_ 1351 VCFRONT2_a447_refrigSuctionPress "VCFRONT2 ECU: a447 refrig suction press compromised";
CM_ SG_ 1351 VCFRONT2_a447_refrigSuctionTempC "VCFRONT2 ECU: a447 refrig suction temp compromised";
CM_ SG_ 1351 VCFRONT2_a447_refrigLiquidPressC "VCFRONT2 ECU: a447 refrig liquid press compromised";
CM_ SG_ 1351 VCFRONT2_a447_refrigLiquidTempCo "VCFRONT2 ECU: a447 refrig liquid temp compromised";
CM_ SG_ 1351 VCFRONT2_a459_coolantFillActive "VCFRONT2 ECU: a459 coolant fill active";
CM_ SG_ 1351 VCFRONT2_a459_refrigerantFillAct "VCFRONT2 ECU: a459 refrigerant fill active";
CM_ SG_ 1351 VCFRONT2_a464_flowIndex "VCFRONT2 ECU: a464 flow index";
CM_ SG_ 1351 VCFRONT2_a464_flowIndexFiltered "VCFRONT2 ECU: a464 flow index filtered";
CM_ SG_ 1351 VCFRONT2_a464_subcool "VCFRONT2 ECU: a464 subcool";
CM_ SG_ 1351 VCFRONT2_a464_subcoolFiltered "VCFRONT2 ECU: a464 subcool filtered";
CM_ SG_ 1351 VCFRONT2_a465_flowIndex "VCFRONT2 ECU: a465 flow index";
CM_ SG_ 1351 VCFRONT2_a465_flowIndexFiltered "VCFRONT2 ECU: a465 flow index filtered";
CM_ SG_ 1351 VCFRONT2_a465_subcool "VCFRONT2 ECU: a465 subcool";
CM_ SG_ 1351 VCFRONT2_a465_subcoolFiltered "VCFRONT2 ECU: a465 subcool filtered";
CM_ SG_ 1351 VCFRONT2_a465_flaggedAtSteadySta "VCFRONT2 ECU: a465 flagged at steady state";
CM_ SG_ 1351 VCFRONT2_a465_flaggedAtUnsteadyS "VCFRONT2 ECU: a465 flagged at unsteady state";
CM_ SG_ 1351 VCFRONT2_a466_flowIndex "VCFRONT2 ECU: a466 flow index";
CM_ SG_ 1351 VCFRONT2_a466_flowIndexFiltered "VCFRONT2 ECU: a466 flow index filtered";
CM_ SG_ 1351 VCFRONT2_a466_subcool "VCFRONT2 ECU: a466 subcool";
CM_ SG_ 1351 VCFRONT2_a466_subcoolFiltered "VCFRONT2 ECU: a466 subcool filtered";
CM_ SG_ 1351 VCFRONT2_a467_powerIndexFiltered "VCFRONT2 ECU: a467 power index filtered";
CM_ SG_ 1351 VCFRONT2_a470_pressureLiquid "VCFRONT2 ECU: a470 pressure liquid";
CM_ SG_ 1351 VCFRONT2_a470_pressureDischarge "VCFRONT2 ECU: a470 pressure discharge";
CM_ SG_ 1351 VCFRONT2_a490_coolantPumpType "VCFRONT2 ECU: a490 coolant pump type";
CM_ SG_ 1351 VCFRONT2_a511_PCSEFuseCurrent "VCFRONT2 ECU: a511 PCSE fuse current";
CM_ SG_ 1351 VCFRONT2_a511_DCDCMaxOutputCurre "VCFRONT2 ECU: a511 DCDC max output current allowed";
CM_ SG_ 1351 VCFRONT2_a511_hvState "VCFRONT2 ECU: a511 hv state";
CM_ SG_ 1351 VCFRONT2_a511_DCDCOutputIsLimite "VCFRONT2 ECU: a511 DCDC output is limited";
CM_ SG_ 1351 VCFRONT2_a511_PCSSignalsAreValid "VCFRONT2 ECU: a511 PCS signals are valid";
CM_ SG_ 1351 VCFRONT2_a511_factoryGated "VCFRONT2 ECU: a511 factory gated";
CM_ SG_ 1351 VCFRONT2_a511_vehicleIsUpdating "VCFRONT2 ECU: a511 vehicle is updating";
CM_ SG_ 1351 VCFRONT2_a511_serviceMode "Signal reported by VCFRONT2 ECU";
CM_ SG_ 1351 VCFRONT2_a511_frunkOpen "VCFRONT2 ECU: a511 frunk open";
CM_ SG_ 1351 VCFRONT2_a531_powerIndexFiltered "VCFRONT2 ECU: a531 power index filtered";
CM_ SG_ 1351 VCFRONT2_a560_highSHCOP1 "VCFRONT2 ECU: a560 high SHCOP1";
CM_ SG_ 1351 VCFRONT2_a560_highSHBattConditio "VCFRONT2 ECU: a560 high SH batt conditioning";
CM_ SG_ 1351 VCFRONT2_a560_highSHCabinReheatC "VCFRONT2 ECU: a560 high SH cabin reheat CD";
CM_ SG_ 1351 VCFRONT2_a560_highSHCabinReheatH "VCFRONT2 ECU: a560 high SH cabin reheat HD";
CM_ SG_ 1351 VCFRONT2_a560_highSHCabinCooling "VCFRONT2 ECU: a560 high SH cabin cooling";
CM_ SG_ 1351 VCFRONT2_a560_highSHCabinHeating "VCFRONT2 ECU: a560 high SH cabin heating";
CM_ SG_ 1351 VCFRONT2_a560_highSHCatchAll "VCFRONT2 ECU: a560 high SH catch all";
CM_ SG_ 1351 VCFRONT2_a615_FRONTIPC_switchSta "VCFRONT2 ECU: a615 FRONTIPC switch status";
CM_ SG_ 1351 VCFRONT2_a616_FRONTIPC_switchSta "VCFRONT2 ECU: a616 FRONTIPC switch status";
CM_ SG_ 1351 VCFRONT2_a667_hcmRegionAndSide "VCFRONT2 ECU: a667 hcm region and side";
CM_ SG_ 1351 VCFRONT2_a667_country "VCFRONT2 ECU: a667 country";
CM_ SG_ 1351 VCFRONT2_a667_homologationRegion "VCFRONT2 ECU: a667 homologation region override";
CM_ SG_ 1351 VCFRONT2_a667_isRightHandDrive "VCFRONT2 ECU: a667 is right hand drive";
CM_ SG_ 1351 VCFRONT2_a697_isGlobalHeadlamps "VCFRONT2 ECU: a697 is global headlamps";
CM_ SG_ 1351 VCFRONT2_a697_isVirtualPitchSens "VCFRONT2 ECU: a697 is virtual pitch sensor";
CM_ SG_ 1351 VCFRONT2_a697_calibratedVertical "VCFRONT2 ECU: a697 calibrated vertical position HCML";
CM_ SG_ 1351 VCFRONT2_a697_calibratedHorizont "VCFRONT2 ECU: a697 calibrated horizontal position HCML";
BA_DEF_ BO_ "GenMsgCycleTime" INT 0 3600000;
BA_DEF_ BO_ "GenMsgSendType" ENUM "Cyclic","NotUsed","NotUsed","NotUsed","NotUsed","NotUsed","NotUsed","IfActive","NoMsgSendType","NotUsed";
BA_DEF_ BO_ "VFrameFormat" ENUM "StandardCAN","ExtendedCAN","reserved","J1939PG","reserved","reserved","reserved","reserved","reserved","reserved","reserved","reserved","reserved","reserved","StandardCAN_FD","ExtendedCAN_FD";
BA_DEF_ BO_ "CANFD_BRS" ENUM "0","1";
BA_DEF_ SG_ "SystemSignalLongSymbol" STRING;
BA_DEF_ SG_ "Confidence" ENUM "layout-only","plausible","validated";
BA_DEF_DEF_ "GenMsgCycleTime" 0;
BA_DEF_DEF_ "GenMsgSendType" "NoMsgSendType";
BA_DEF_DEF_ "VFrameFormat" "StandardCAN";
BA_DEF_DEF_ "CANFD_BRS" "1";
BA_DEF_DEF_ "SystemSignalLongSymbol" "";
BA_DEF_DEF_ "Confidence" "layout-only";
BA_ "SystemSignalLongSymbol" SG_ 1335 VCFRONT1_a015_NVMMFilesystemErro "VCFRONT1_a015_NVMMFilesystemError";
BA_ "SystemSignalLongSymbol" SG_ 1335 VCFRONT1_a091_FRONTIPC_faultsAnd "VCFRONT1_a091_FRONTIPC_faultsAndExtras";
BA_ "SystemSignalLongSymbol" SG_ 1335 VCFRONT1_a098_FRONTIPC_temperatu "VCFRONT1_a098_FRONTIPC_temperature";
BA_ "SystemSignalLongSymbol" SG_ 1335 VCFRONT1_a098_FRONTIPC_thermalCo "VCFRONT1_a098_FRONTIPC_thermalControl";
BA_ "SystemSignalLongSymbol" SG_ 1335 VCFRONT1_a106_BATTIPC_dcdcRailSt "VCFRONT1_a106_BATTIPC_dcdcRailStatus";
BA_ "SystemSignalLongSymbol" SG_ 1335 VCFRONT1_a106_FRONTIPC_thermalCo "VCFRONT1_a106_FRONTIPC_thermalControl";
BA_ "SystemSignalLongSymbol" SG_ 1335 VCFRONT1_a106_FRONTIPC_dcdcRailS "VCFRONT1_a106_FRONTIPC_dcdcRailStatus";
BA_ "SystemSignalLongSymbol" SG_ 1335 VCFRONT1_a106_FRONTIPC_dcdcStatu "VCFRONT1_a106_FRONTIPC_dcdcStatus";
BA_ "SystemSignalLongSymbol" SG_ 1335 VCFRONT1_a108_FRONTIPC_temperatu "VCFRONT1_a108_FRONTIPC_temperature";
BA_ "SystemSignalLongSymbol" SG_ 1335 VCFRONT1_a108_FRONTIPC_thermalCo "VCFRONT1_a108_FRONTIPC_thermalControl";
BA_ "SystemSignalLongSymbol" SG_ 1335 VCFRONT1_a108_FRONTIPC_motorStat "VCFRONT1_a108_FRONTIPC_motorStatus";
BA_ "SystemSignalLongSymbol" SG_ 1335 VCFRONT1_a120_FRONTIPC_systemSta "VCFRONT1_a120_FRONTIPC_systemStatus";
BA_ "SystemSignalLongSymbol" SG_ 1335 VCFRONT1_a120_BATTIPC_systemStat "VCFRONT1_a120_BATTIPC_systemStatus";
BA_ "SystemSignalLongSymbol" SG_ 1335 VCFRONT1_a120_FRONTIPC_systemPow "VCFRONT1_a120_FRONTIPC_systemPower";
BA_ "SystemSignalLongSymbol" SG_ 1335 VCFRONT1_a120_FRONTIPC_autonomyH "VCFRONT1_a120_FRONTIPC_autonomyHealth";
BA_ "SystemSignalLongSymbol" SG_ 1335 VCFRONT1_a120_BATTIPC_chassisCon "VCFRONT1_a120_BATTIPC_chassisControl2";
BA_ "SystemSignalLongSymbol" SG_ 1335 VCFRONT1_a120_FRONTIPC_chassisCo "VCFRONT1_a120_FRONTIPC_chassisControl2";
BA_ "SystemSignalLongSymbol" SG_ 1335 VCFRONT1_a120_FRONTIPC_odometerS "VCFRONT1_a120_FRONTIPC_odometerStatus";
BA_ "SystemSignalLongSymbol" SG_ 1335 VCFRONT1_a125_FRONTIPC_steerAngl "VCFRONT1_a125_FRONTIPC_steerAngle";
BA_ "SystemSignalLongSymbol" SG_ 1335 VCFRONT1_a127_iBoosterEFuseCurre "VCFRONT1_a127_iBoosterEFuseCurrent";
BA_ "SystemSignalLongSymbol" SG_ 1335 VCFRONT1_a127_iBoosterEFuseVolta "VCFRONT1_a127_iBoosterEFuseVoltage";
BA_ "SystemSignalLongSymbol" SG_ 1335 VCFRONT1_a128_vcrightEFuseCurren "VCFRONT1_a128_vcrightEFuseCurrent";
BA_ "SystemSignalLongSymbol" SG_ 1335 VCFRONT1_a128_vcrightEFuseVoltag "VCFRONT1_a128_vcrightEFuseVoltage";
BA_ "SystemSignalLongSymbol" SG_ 1335 VCFRONT1_a128_vcrightEFuseRemain "VCFRONT1_a128_vcrightEFuseRemainingRetries";
BA_ "SystemSignalLongSymbol" SG_ 1335 VCFRONT1_a129_pcsEFuseRemainingR "VCFRONT1_a129_pcsEFuseRemainingRetries";
BA_ "SystemSignalLongSymbol" SG_ 1335 VCFRONT1_a130_autopilot2EFuseCur "VCFRONT1_a130_autopilot2EFuseCurrent";
BA_ "SystemSignalLongSymbol" SG_ 1335 VCFRONT1_a130_autopilot2EFuseVol "VCFRONT1_a130_autopilot2EFuseVoltage";
BA_ "SystemSignalLongSymbol" SG_ 1335 VCFRONT1_a130_autopilot2EFuseTem "VCFRONT1_a130_autopilot2EFuseTemp";
BA_ "SystemSignalLongSymbol" SG_ 1335 VCFRONT1_a130_autopilot2EFuseRem "VCFRONT1_a130_autopilot2EFuseRemainingRetries";
BA_ "SystemSignalLongSymbol" SG_ 1335 VCFRONT1_a133_BATTIPC_primaryAct "VCFRONT1_a133_BATTIPC_primaryActuator";
BA_ "SystemSignalLongSymbol" SG_ 1335 VCFRONT1_a133_FRONTIPC_secondary "VCFRONT1_a133_FRONTIPC_secondaryActuator";
BA_ "SystemSignalLongSymbol" SG_ 1335 VCFRONT1_a135_leftHeadlightEFuse "VCFRONT1_a135_leftHeadlightEFuseCurrent";
BA_ "SystemSignalLongSymbol" SG_ 1335 VCFRONT1_a177_mcuAudioEFuseCurre "VCFRONT1_a177_mcuAudioEFuseCurrent";
BA_ "SystemSignalLongSymbol" SG_ 1335 VCFRONT1_a177_mcuAudioEFuseVolta "VCFRONT1_a177_mcuAudioEFuseVoltage";
BA_ "SystemSignalLongSymbol" SG_ 1335 VCFRONT1_a191_exitDriveWarningTi "VCFRONT1_a191_exitDriveWarningTimerExpired";
BA_ "SystemSignalLongSymbol" SG_ 1335 VCFRONT1_a191_NotEnoughPowerForS "VCFRONT1_a191_NotEnoughPowerForSupport";
BA_ "SystemSignalLongSymbol" SG_ 1335 VCFRONT1_a204_uvLoadshedFaultInj "VCFRONT1_a204_uvLoadshedFaultInject";
BA_ "SystemSignalLongSymbol" SG_ 1335 VCFRONT1_a205_ovLoadshedFaultInj "VCFRONT1_a205_ovLoadshedFaultInject";
BA_ "SystemSignalLongSymbol" SG_ 1335 VCFRONT1_a216_vcrightFastBlowImm "VCFRONT1_a216_vcrightFastBlowImminent";
BA_ "SystemSignalLongSymbol" SG_ 1335 VCFRONT1_a216_vcrightFastBlowDeb "VCFRONT1_a216_vcrightFastBlowDebounceImminent";
BA_ "SystemSignalLongSymbol" SG_ 1335 VCFRONT1_a216_vcrightStaticImmin "VCFRONT1_a216_vcrightStaticImminent";
BA_ "SystemSignalLongSymbol" SG_ 1335 VCFRONT1_a216_vcrightDynamicImmi "VCFRONT1_a216_vcrightDynamicImminent";
BA_ "SystemSignalLongSymbol" SG_ 1335 VCFRONT1_a223_overvoltageFaultAc "VCFRONT1_a223_overvoltageFaultActive";
BA_ "SystemSignalLongSymbol" SG_ 1335 VCFRONT1_a223_sharedBridgeShutdo "VCFRONT1_a223_sharedBridgeShutdownActive";
BA_ "SystemSignalLongSymbol" SG_ 1335 VCFRONT1_a250_pcsOvShutdownFault "VCFRONT1_a250_pcsOvShutdownFaultPinActive";
BA_ "SystemSignalLongSymbol" SG_ 1335 VCFRONT1_a250_dcdcEnableLineVolt "VCFRONT1_a250_dcdcEnableLineVoltage";
BA_ "SystemSignalLongSymbol" SG_ 1335 VCFRONT1_a250_ovClampReferenceVo "VCFRONT1_a250_ovClampReferenceVoltage";
BA_ "SystemSignalLongSymbol" SG_ 1335 VCFRONT1_a250_ovClampMonitorVolt "VCFRONT1_a250_ovClampMonitorVoltage1";
BA_ "SystemSignalLongSymbol" SG_ 1335 VCFRONT1_a251_rationalitySetupCh "VCFRONT1_a251_rationalitySetupCheckResult";
BA_ "SystemSignalLongSymbol" SG_ 1335 VCFRONT1_a251_rationalitySetupFa "VCFRONT1_a251_rationalitySetupFailureReason";
BA_ "SystemSignalLongSymbol" SG_ 1335 VCFRONT1_a251_clampLowSideCheckR "VCFRONT1_a251_clampLowSideCheckResult";
BA_ "SystemSignalLongSymbol" SG_ 1335 VCFRONT1_a251_clampLowSideFailur "VCFRONT1_a251_clampLowSideFailureReason";
BA_ "SystemSignalLongSymbol" SG_ 1335 VCFRONT1_a251_rationalityShutdow "VCFRONT1_a251_rationalityShutdownArmedCheckResult";
BA_ "SystemSignalLongSymbol" SG_ 1335 VCFRONT1_a251_rationalitySh_0001 "VCFRONT1_a251_rationalityShutdownArmedFailureReason";
BA_ "SystemSignalLongSymbol" SG_ 1335 VCFRONT1_a251_clampHighSideCheck "VCFRONT1_a251_clampHighSideCheckResult";
BA_ "SystemSignalLongSymbol" SG_ 1335 VCFRONT1_a251_clampHighSideFailu "VCFRONT1_a251_clampHighSideFailureReason";
BA_ "SystemSignalLongSymbol" SG_ 1335 VCFRONT1_a251_rationalityPcsShut "VCFRONT1_a251_rationalityPcsShutdownCheckResult";
BA_ "SystemSignalLongSymbol" SG_ 1335 VCFRONT1_a251_rationalityPc_0001 "VCFRONT1_a251_rationalityPcsShutdownFailureReason";
BA_ "SystemSignalLongSymbol" SG_ 1335 VCFRONT1_a252_incorrectPinConfig "VCFRONT1_a252_incorrectPinConfiguration";
BA_ "SystemSignalLongSymbol" SG_ 1335 VCFRONT1_a252_incorrectClampMoni "VCFRONT1_a252_incorrectClampMonitor1Voltage";
BA_ "SystemSignalLongSymbol" SG_ 1335 VCFRONT1_a252_incorrectClam_0001 "VCFRONT1_a252_incorrectClampMonitor2Voltage";
BA_ "SystemSignalLongSymbol" SG_ 1335 VCFRONT1_a252_incorrectClam_0002 "VCFRONT1_a252_incorrectClampMonitor3Voltage";
BA_ "SystemSignalLongSymbol" SG_ 1335 VCFRONT1_a252_incorrectPcsEnable "VCFRONT1_a252_incorrectPcsEnableLineVoltage";
BA_ "SystemSignalLongSymbol" SG_ 1335 VCFRONT1_a252_incorrectPcsTripSt "VCFRONT1_a252_incorrectPcsTripState";
BA_ "SystemSignalLongSymbol" SG_ 1335 VCFRONT1_a252_incorrectPcsSuppor "VCFRONT1_a252_incorrectPcsSupportStatus";
BA_ "SystemSignalLongSymbol" SG_ 1335 VCFRONT1_a252_incorrectPcsDcdcEn "VCFRONT1_a252_incorrectPcsDcdcEnableFeedback";
BA_ "SystemSignalLongSymbol" SG_ 1335 VCFRONT1_a252_pcsOvShutdownFault "VCFRONT1_a252_pcsOvShutdownFaultPinActive";
BA_ "SystemSignalLongSymbol" SG_ 1335 VCFRONT1_a252_pcsDcdcEnableFeedb "VCFRONT1_a252_pcsDcdcEnableFeedback";
BA_ "SystemSignalLongSymbol" SG_ 1335 VCFRONT1_a252_pcsOvSelfTestEnabl "VCFRONT1_a252_pcsOvSelfTestEnabled";
BA_ "SystemSignalLongSymbol" SG_ 1335 VCFRONT1_a252_dcdcEnableLineVolt "VCFRONT1_a252_dcdcEnableLineVoltage";
BA_ "SystemSignalLongSymbol" SG_ 1335 VCFRONT1_a252_ovClampMonitorChan "VCFRONT1_a252_ovClampMonitorChannel";
BA_ "SystemSignalLongSymbol" SG_ 1335 VCFRONT1_a252_ovClampMonitorVolt "VCFRONT1_a252_ovClampMonitorVoltage";
BA_ "SystemSignalLongSymbol" SG_ 1335 VCFRONT1_a414_loadUnattemptedOnF "VCFRONT1_a414_loadUnattemptedOnFailure";
BA_ "SystemSignalLongSymbol" SG_ 1335 VCFRONT1_a414_deviceStuckOnFailu "VCFRONT1_a414_deviceStuckOnFailure";
BA_ "SystemSignalLongSymbol" SG_ 1335 VCFRONT1_a414_followerVCRightSel "VCFRONT1_a414_followerVCRightSelfTestFailure";
BA_ "SystemSignalLongSymbol" SG_ 1335 VCFRONT1_a414_uvLoadshedVsenseDi "VCFRONT1_a414_uvLoadshedVsenseDigIn";
BA_ "SystemSignalLongSymbol" SG_ 1335 VCFRONT1_a415_upstreamEFuseStuck "VCFRONT1_a415_upstreamEFuseStuckOff";
BA_ "SystemSignalLongSymbol" SG_ 1335 VCFRONT1_a475_deviceOvertemperat "VCFRONT1_a475_deviceOvertemperature";
BA_ "SystemSignalLongSymbol" SG_ 1335 VCFRONT1_a480_deviceOvertemperat "VCFRONT1_a480_deviceOvertemperature";
BA_ "SystemSignalLongSymbol" SG_ 1335 VCFRONT1_a482_lvBridgeEFuseCurre "VCFRONT1_a482_lvBridgeEFuseCurrent";
BA_ "SystemSignalLongSymbol" SG_ 1335 VCFRONT1_a482_lvBridgeEFuseVolta "VCFRONT1_a482_lvBridgeEFuseVoltage";
BA_ "SystemSignalLongSymbol" SG_ 1335 VCFRONT1_a484_upstreamEFuseStuck "VCFRONT1_a484_upstreamEFuseStuckOn";
BA_ "SystemSignalLongSymbol" SG_ 1335 VCFRONT1_a484_upstreamEFuseVolta "VCFRONT1_a484_upstreamEFuseVoltage";
BA_ "SystemSignalLongSymbol" SG_ 1335 VCFRONT1_a485_upstreamEfuseUnatt "VCFRONT1_a485_upstreamEfuseUnattemptedOn";
BA_ "SystemSignalLongSymbol" SG_ 1335 VCFRONT1_a486_bridgeFailedArming "VCFRONT1_a486_bridgeFailedArmingSetup";
BA_ "SystemSignalLongSymbol" SG_ 1335 VCFRONT1_a486_bridgeFailedSyncCh "VCFRONT1_a486_bridgeFailedSyncCheck";
BA_ "SystemSignalLongSymbol" SG_ 1335 VCFRONT1_a486_localBridgeOutputO "VCFRONT1_a486_localBridgeOutputOn";
BA_ "SystemSignalLongSymbol" SG_ 1335 VCFRONT1_a486_localBridgeSyncArm "VCFRONT1_a486_localBridgeSyncArmed";
BA_ "SystemSignalLongSymbol" SG_ 1335 VCFRONT1_a486_localBridgeDinStat "VCFRONT1_a486_localBridgeDinState";
BA_ "SystemSignalLongSymbol" SG_ 1335 VCFRONT1_a486_remoteBridgeOutput "VCFRONT1_a486_remoteBridgeOutputOn";
BA_ "SystemSignalLongSymbol" SG_ 1335 VCFRONT1_a486_remoteBridgeO_0001 "VCFRONT1_a486_remoteBridgeOutputOnValid";
BA_ "SystemSignalLongSymbol" SG_ 1335 VCFRONT1_a486_remoteBridgeSyncAr "VCFRONT1_a486_remoteBridgeSyncArmed";
BA_ "SystemSignalLongSymbol" SG_ 1335 VCFRONT1_a486_remoteBridgeS_0001 "VCFRONT1_a486_remoteBridgeSyncArmedValid";
BA_ "SystemSignalLongSymbol" SG_ 1335 VCFRONT1_a486_remoteBridgeDinSta "VCFRONT1_a486_remoteBridgeDinState";
BA_ "SystemSignalLongSymbol" SG_ 1335 VCFRONT1_a486_remoteBridgeD_0001 "VCFRONT1_a486_remoteBridgeDinStateValid";
BA_ "SystemSignalLongSymbol" SG_ 1335 VCFRONT1_a496_NotEnoughPowerForS "VCFRONT1_a496_NotEnoughPowerForSupport";
BA_ "SystemSignalLongSymbol" SG_ 1335 VCFRONT1_a574_frontDriveInverter "VCFRONT1_a574_frontDriveInverterCurrent";
BA_ "SystemSignalLongSymbol" SG_ 1335 VCFRONT1_a574_frontDriveInv_0001 "VCFRONT1_a574_frontDriveInverterRemainingRetries";
BA_ "SystemSignalLongSymbol" SG_ 1335 VCFRONT1_a596_vcrightCutoffEFuse "VCFRONT1_a596_vcrightCutoffEFuseCurveType";
BA_ "SystemSignalLongSymbol" SG_ 1335 VCFRONT1_a596_vcrightCutoffCurve "VCFRONT1_a596_vcrightCutoffCurveOffsetChannel";
BA_ "SystemSignalLongSymbol" SG_ 1335 VCFRONT1_a597_vcrightCutoffEFuse "VCFRONT1_a597_vcrightCutoffEFuseFastBlowType";
BA_ "SystemSignalLongSymbol" SG_ 1335 VCFRONT1_a597_vcrightCutoffCurre "VCFRONT1_a597_vcrightCutoffCurrentThreshold";
BA_ "SystemSignalLongSymbol" SG_ 1335 VCFRONT1_a597_vcrightCutoffTimin "VCFRONT1_a597_vcrightCutoffTimingThresholdMs";
BA_ "SystemSignalLongSymbol" SG_ 1335 VCFRONT1_a597_vcrightCutoffMaxCo "VCFRONT1_a597_vcrightCutoffMaxCount";
BA_ "SystemSignalLongSymbol" SG_ 833 VCFRONT1_a030_ECULogUploadReques "VCFRONT1_a030_ECULogUploadRequest";
BA_ "SystemSignalLongSymbol" SG_ 833 VCFRONT1_a058_inputRHighSyncDebu "VCFRONT1_a058_inputRHighSyncDebug";
BA_ "SystemSignalLongSymbol" SG_ 833 VCFRONT1_a059_inputResistanceHig "VCFRONT1_a059_inputResistanceHigh";
BA_ "SystemSignalLongSymbol" SG_ 833 VCFRONT1_a130_autopilot2EFuseTri "VCFRONT1_a130_autopilot2EFuseTrip";
BA_ "SystemSignalLongSymbol" SG_ 833 VCFRONT1_a134_hvContactorsEFuseT "VCFRONT1_a134_hvContactorsEFuseTrip";
BA_ "SystemSignalLongSymbol" SG_ 833 VCFRONT1_a135_leftHeadlightEFuse "VCFRONT1_a135_leftHeadlightEFuseTrip";
BA_ "SystemSignalLongSymbol" SG_ 833 VCFRONT1_a191_exitDriveDomainDow "VCFRONT1_a191_exitDriveDomainDown";
BA_ "SystemSignalLongSymbol" SG_ 833 VCFRONT1_a204_undervoltageLoadsh "VCFRONT1_a204_undervoltageLoadshedTriggered";
BA_ "SystemSignalLongSymbol" SG_ 833 VCFRONT1_a205_overvoltageProtect "VCFRONT1_a205_overvoltageProtectionTriggered";
BA_ "SystemSignalLongSymbol" SG_ 833 VCFRONT1_a214_openCircuitDetecte "VCFRONT1_a214_openCircuitDetected";
BA_ "SystemSignalLongSymbol" SG_ 833 VCFRONT1_a216_powerCutoffImminen "VCFRONT1_a216_powerCutoffImminent";
BA_ "SystemSignalLongSymbol" SG_ 833 VCFRONT1_a223_bridgeOvervoltageS "VCFRONT1_a223_bridgeOvervoltageSelfTestFailure";
BA_ "SystemSignalLongSymbol" SG_ 833 VCFRONT1_a229_LVHealthCompromise "VCFRONT1_a229_LVHealthCompromised";
BA_ "SystemSignalLongSymbol" SG_ 833 VCFRONT1_a230_autopilot2EFuseTri "VCFRONT1_a230_autopilot2EFuseTripDuringOTA";
BA_ "SystemSignalLongSymbol" SG_ 833 VCFRONT1_a250_pcsOvShutdownTripp "VCFRONT1_a250_pcsOvShutdownTripped";
BA_ "SystemSignalLongSymbol" SG_ 833 VCFRONT1_a251_pcsOvShutdownSelfT "VCFRONT1_a251_pcsOvShutdownSelfTestFailure";
BA_ "SystemSignalLongSymbol" SG_ 833 VCFRONT1_a252_pcsOvShutdownSelfT "VCFRONT1_a252_pcsOvShutdownSelfTestStageFailure";
BA_ "SystemSignalLongSymbol" SG_ 833 VCFRONT1_a253_pcsOvShutdownHighS "VCFRONT1_a253_pcsOvShutdownHighSideSelfTestDebug";
BA_ "SystemSignalLongSymbol" SG_ 833 VCFRONT1_a262_vcrightVoltageMism "VCFRONT1_a262_vcrightVoltageMismatch";
BA_ "SystemSignalLongSymbol" SG_ 833 VCFRONT1_a264_iBoosterVoltageMis "VCFRONT1_a264_iBoosterVoltageMismatch";
BA_ "SystemSignalLongSymbol" SG_ 833 VCFRONT1_a266_EPAS2VoltageMismat "VCFRONT1_a266_EPAS2VoltageMismatch";
BA_ "SystemSignalLongSymbol" SG_ 833 VCFRONT1_a414_undervoltageSelfTe "VCFRONT1_a414_undervoltageSelfTestFailure";
BA_ "SystemSignalLongSymbol" SG_ 833 VCFRONT1_a415_undervoltageSelfTe "VCFRONT1_a415_undervoltageSelfTestStuckOff";
BA_ "SystemSignalLongSymbol" SG_ 833 VCFRONT1_a483_vnf1048SelfTestFai "VCFRONT1_a483_vnf1048SelfTestFailure";
BA_ "SystemSignalLongSymbol" SG_ 833 VCFRONT1_a484_undervoltageSelfTe "VCFRONT1_a484_undervoltageSelfTestStuckOn";
BA_ "SystemSignalLongSymbol" SG_ 833 VCFRONT1_a485_uvSelfTestLoadUnat "VCFRONT1_a485_uvSelfTestLoadUnattemptedOnDbg";
BA_ "SystemSignalLongSymbol" SG_ 833 VCFRONT1_a486_undervoltageSelfTe "VCFRONT1_a486_undervoltageSelfTestBridgeSyncFailure";
BA_ "SystemSignalLongSymbol" SG_ 833 VCFRONT1_a489_vnf1248SelfTestDeb "VCFRONT1_a489_vnf1248SelfTestDebug";
BA_ "SystemSignalLongSymbol" SG_ 833 VCFRONT1_a490_vnf1248SelfTestFai "VCFRONT1_a490_vnf1248SelfTestFailure";
BA_ "SystemSignalLongSymbol" SG_ 833 VCFRONT1_a491_vnf1248Configurati "VCFRONT1_a491_vnf1248ConfigurationMismatch";
BA_ "SystemSignalLongSymbol" SG_ 833 VCFRONT1_a496_exitDriveWarningDo "VCFRONT1_a496_exitDriveWarningDomainDown";
BA_ "SystemSignalLongSymbol" SG_ 833 VCFRONT1_a500_eFuseASICStateMism "VCFRONT1_a500_eFuseASICStateMismatch";
BA_ "SystemSignalLongSymbol" SG_ 833 VCFRONT1_a501_vnf1048Configurati "VCFRONT1_a501_vnf1048ConfigurationMismatch";
BA_ "SystemSignalLongSymbol" SG_ 833 VCFRONT1_a509_eFuseASICManagerSt "VCFRONT1_a509_eFuseASICManagerStateMismatch";
BA_ "SystemSignalLongSymbol" SG_ 833 VCFRONT1_a523_eFuseThresholdsInc "VCFRONT1_a523_eFuseThresholdsIncorrect";
BA_ "SystemSignalLongSymbol" SG_ 833 VCFRONT1_a574_frontDriveInverter "VCFRONT1_a574_frontDriveInverterEFuseTrip";
BA_ "SystemSignalLongSymbol" SG_ 833 VCFRONT1_a575_frontDriveInverter "VCFRONT1_a575_frontDriveInverterEFuseTripDBG";
BA_ "SystemSignalLongSymbol" SG_ 833 VCFRONT1_a578_vbusFusedLoadShedE "VCFRONT1_a578_vbusFusedLoadShedEFuseTrip";
BA_ "SystemSignalLongSymbol" SG_ 833 VCFRONT1_a581_harnessResistanceI "VCFRONT1_a581_harnessResistanceInfo";
BA_ "SystemSignalLongSymbol" SG_ 833 VCFRONT1_a590_vcrightPwrRational "VCFRONT1_a590_vcrightPwrRationalityCurve";
BA_ "SystemSignalLongSymbol" SG_ 833 VCFRONT1_a591_vcrightFastBlowDet "VCFRONT1_a591_vcrightFastBlowDetection";
BA_ "SystemSignalLongSymbol" SG_ 833 VCFRONT1_a596_vcrightCurvePowerC "VCFRONT1_a596_vcrightCurvePowerCutoff";
BA_ "SystemSignalLongSymbol" SG_ 833 VCFRONT1_a597_vcrightFastBlowPow "VCFRONT1_a597_vcrightFastBlowPowerCutoff";
BA_ "Confidence" SG_ 1027 VCFRONT1_EPAS2EFuseState 1;
BA_ "Confidence" SG_ 1027 VCFRONT1_EPAS2EFuseCurrent 1;
BA_ "Confidence" SG_ 1027 VCFRONT1_EPAS2EFuseVoltage 1;
BA_ "Confidence" SG_ 1027 VCFRONT1_EPAS2EFuseTemperature 1;
BA_ "Confidence" SG_ 1027 VCFRONT1_EPAS2EFuseManagerState 1;
BA_ "Confidence" SG_ 1027 VCFRONT1_EPAS2EFuseHardShortThre 1;
BA_ "SystemSignalLongSymbol" SG_ 1027 VCFRONT1_EPAS2EFuseHardShortThre "VCFRONT1_EPAS2EFuseHardShortThreshold";
BA_ "Confidence" SG_ 1027 VCFRONT1_EPAS2EFuseOCThreshold 1;
BA_ "Confidence" SG_ 1027 VCFRONT1_EPAS2EFuseType 1;
BA_ "Confidence" SG_ 1027 VCFRONT1_rightControllerEFuseSta 1;
BA_ "SystemSignalLongSymbol" SG_ 1027 VCFRONT1_rightControllerEFuseSta "VCFRONT1_rightControllerEFuseState";
BA_ "Confidence" SG_ 1027 VCFRONT1_rightControllerEFuseCur 1;
BA_ "SystemSignalLongSymbol" SG_ 1027 VCFRONT1_rightControllerEFuseCur "VCFRONT1_rightControllerEFuseCurrent";
BA_ "SystemSignalLongSymbol" SG_ 1027 VCFRONT1_rightControllerEFuseOut "VCFRONT1_rightControllerEFuseOutput";
BA_ "SystemSignalLongSymbol" SG_ 1027 VCFRONT1_rightControllerEFu_0002 "VCFRONT1_rightControllerEFuseOutputDesired";
BA_ "SystemSignalLongSymbol" SG_ 1027 VCFRONT1_rightControllerEFuseByp "VCFRONT1_rightControllerEFuseBypass";
BA_ "SystemSignalLongSymbol" SG_ 1027 VCFRONT1_rightControllerEFu_0001 "VCFRONT1_rightControllerEFuseBypassDesired";
BA_ "Confidence" SG_ 1027 VCFRONT1_rightControllerEFuseVol 1;
BA_ "SystemSignalLongSymbol" SG_ 1027 VCFRONT1_rightControllerEFuseVol "VCFRONT1_rightControllerEFuseVoltage";
BA_ "Confidence" SG_ 1027 VCFRONT1_rightControllerEFuseTem 1;
BA_ "SystemSignalLongSymbol" SG_ 1027 VCFRONT1_rightControllerEFuseTem "VCFRONT1_rightControllerEFuseTemperature";
BA_ "Confidence" SG_ 1027 VCFRONT1_rightControllerEFuseMan 1;
BA_ "SystemSignalLongSymbol" SG_ 1027 VCFRONT1_rightControllerEFuseMan "VCFRONT1_rightControllerEFuseManagerState";
BA_ "Confidence" SG_ 1027 VCFRONT1_rightControllerEFuseHar 1;
BA_ "SystemSignalLongSymbol" SG_ 1027 VCFRONT1_rightControllerEFuseHar "VCFRONT1_rightControllerEFuseHardShortThreshold";
BA_ "Confidence" SG_ 1027 VCFRONT1_rightControllerEFuseOCT 1;
BA_ "SystemSignalLongSymbol" SG_ 1027 VCFRONT1_rightControllerEFuseOCT "VCFRONT1_rightControllerEFuseOCThreshold";
BA_ "Confidence" SG_ 1027 VCFRONT1_rightControllerEFuseTyp 1;
BA_ "SystemSignalLongSymbol" SG_ 1027 VCFRONT1_rightControllerEFuseTyp "VCFRONT1_rightControllerEFuseType";
BA_ "Confidence" SG_ 1027 VCFRONT1_autopilot2EFuseState 1;
BA_ "Confidence" SG_ 1027 VCFRONT1_autopilot2EFuseCurrent 1;
BA_ "SystemSignalLongSymbol" SG_ 1027 VCFRONT1_autopilot2EFuseOutputDe "VCFRONT1_autopilot2EFuseOutputDesired";
BA_ "SystemSignalLongSymbol" SG_ 1027 VCFRONT1_autopilot2EFuseBypassDe "VCFRONT1_autopilot2EFuseBypassDesired";
BA_ "Confidence" SG_ 1027 VCFRONT1_autopilot2EFuseVoltage 1;
BA_ "Confidence" SG_ 1027 VCFRONT1_autopilot2EFuseTemperat 1;
BA_ "SystemSignalLongSymbol" SG_ 1027 VCFRONT1_autopilot2EFuseTemperat "VCFRONT1_autopilot2EFuseTemperature";
BA_ "Confidence" SG_ 1027 VCFRONT1_autopilot2EFuseManagerS 1;
BA_ "SystemSignalLongSymbol" SG_ 1027 VCFRONT1_autopilot2EFuseManagerS "VCFRONT1_autopilot2EFuseManagerState";
BA_ "Confidence" SG_ 1027 VCFRONT1_autopilot2EFuseHardShor 1;
BA_ "SystemSignalLongSymbol" SG_ 1027 VCFRONT1_autopilot2EFuseHardShor "VCFRONT1_autopilot2EFuseHardShortThreshold";
BA_ "Confidence" SG_ 1027 VCFRONT1_autopilot2EFuseOCThresh 1;
BA_ "SystemSignalLongSymbol" SG_ 1027 VCFRONT1_autopilot2EFuseOCThresh "VCFRONT1_autopilot2EFuseOCThreshold";
BA_ "Confidence" SG_ 1027 VCFRONT1_autopilot2EFuseType 1;
BA_ "SystemSignalLongSymbol" SG_ 1351 VCFRONT2_a015_NVMMFilesystemErro "VCFRONT2_a015_NVMMFilesystemError";
BA_ "SystemSignalLongSymbol" SG_ 1351 VCFRONT2_a091_FRONTIPC_faultsAnd "VCFRONT2_a091_FRONTIPC_faultsAndExtras";
BA_ "SystemSignalLongSymbol" SG_ 1351 VCFRONT2_a098_FRONTIPC_temperatu "VCFRONT2_a098_FRONTIPC_temperature";
BA_ "SystemSignalLongSymbol" SG_ 1351 VCFRONT2_a098_FRONTIPC_thermalCo "VCFRONT2_a098_FRONTIPC_thermalControl";
BA_ "SystemSignalLongSymbol" SG_ 1351 VCFRONT2_a106_BATTIPC_dcdcRailSt "VCFRONT2_a106_BATTIPC_dcdcRailStatus";
BA_ "SystemSignalLongSymbol" SG_ 1351 VCFRONT2_a106_FRONTIPC_thermalCo "VCFRONT2_a106_FRONTIPC_thermalControl";
BA_ "SystemSignalLongSymbol" SG_ 1351 VCFRONT2_a106_FRONTIPC_dcdcRailS "VCFRONT2_a106_FRONTIPC_dcdcRailStatus";
BA_ "SystemSignalLongSymbol" SG_ 1351 VCFRONT2_a106_FRONTIPC_dcdcStatu "VCFRONT2_a106_FRONTIPC_dcdcStatus";
BA_ "SystemSignalLongSymbol" SG_ 1351 VCFRONT2_a108_FRONTIPC_temperatu "VCFRONT2_a108_FRONTIPC_temperature";
BA_ "SystemSignalLongSymbol" SG_ 1351 VCFRONT2_a108_FRONTIPC_thermalCo "VCFRONT2_a108_FRONTIPC_thermalControl";
BA_ "SystemSignalLongSymbol" SG_ 1351 VCFRONT2_a108_FRONTIPC_motorStat "VCFRONT2_a108_FRONTIPC_motorStatus";
BA_ "SystemSignalLongSymbol" SG_ 1351 VCFRONT2_a120_FRONTIPC_systemSta "VCFRONT2_a120_FRONTIPC_systemStatus";
BA_ "SystemSignalLongSymbol" SG_ 1351 VCFRONT2_a120_BATTIPC_systemStat "VCFRONT2_a120_BATTIPC_systemStatus";
BA_ "SystemSignalLongSymbol" SG_ 1351 VCFRONT2_a120_FRONTIPC_systemPow "VCFRONT2_a120_FRONTIPC_systemPower";
BA_ "SystemSignalLongSymbol" SG_ 1351 VCFRONT2_a120_FRONTIPC_autonomyH "VCFRONT2_a120_FRONTIPC_autonomyHealth";
BA_ "SystemSignalLongSymbol" SG_ 1351 VCFRONT2_a120_BATTIPC_chassisCon "VCFRONT2_a120_BATTIPC_chassisControl2";
BA_ "SystemSignalLongSymbol" SG_ 1351 VCFRONT2_a120_FRONTIPC_chassisCo "VCFRONT2_a120_FRONTIPC_chassisControl2";
BA_ "SystemSignalLongSymbol" SG_ 1351 VCFRONT2_a120_FRONTIPC_odometerS "VCFRONT2_a120_FRONTIPC_odometerStatus";
BA_ "SystemSignalLongSymbol" SG_ 1351 VCFRONT2_a125_FRONTIPC_steerAngl "VCFRONT2_a125_FRONTIPC_steerAngle";
BA_ "SystemSignalLongSymbol" SG_ 1351 VCFRONT2_a133_BATTIPC_primaryAct "VCFRONT2_a133_BATTIPC_primaryActuator";
BA_ "SystemSignalLongSymbol" SG_ 1351 VCFRONT2_a133_FRONTIPC_secondary "VCFRONT2_a133_FRONTIPC_secondaryActuator";
BA_ "SystemSignalLongSymbol" SG_ 1351 VCFRONT2_a142_driverThermShutdow "VCFRONT2_a142_driverThermShutdown";
BA_ "SystemSignalLongSymbol" SG_ 1351 VCFRONT2_a142_chargePumpUndervol "VCFRONT2_a142_chargePumpUndervoltage";
BA_ "SystemSignalLongSymbol" SG_ 1351 VCFRONT2_a186_noDriveChgCableCon "VCFRONT2_a186_noDriveChgCableConX";
BA_ "SystemSignalLongSymbol" SG_ 1351 VCFRONT2_a214_hardwareOvercurren "VCFRONT2_a214_hardwareOvercurrent";
BA_ "SystemSignalLongSymbol" SG_ 1351 VCFRONT2_a214_busVoltageIrration "VCFRONT2_a214_busVoltageIrrational";
BA_ "SystemSignalLongSymbol" SG_ 1351 VCFRONT2_a214_dcCurrentIrrationa "VCFRONT2_a214_dcCurrentIrrational";
BA_ "SystemSignalLongSymbol" SG_ 1351 VCFRONT2_a214_motorSpeedIrration "VCFRONT2_a214_motorSpeedIrrational";
BA_ "SystemSignalLongSymbol" SG_ 1351 VCFRONT2_a214_supplyVoltageIrrat "VCFRONT2_a214_supplyVoltageIrrational";
BA_ "SystemSignalLongSymbol" SG_ 1351 VCFRONT2_a214_motorPhaseCurrentI "VCFRONT2_a214_motorPhaseCurrentIrrational";
BA_ "SystemSignalLongSymbol" SG_ 1351 VCFRONT2_a214_busVoltageUnhealth "VCFRONT2_a214_busVoltageUnhealthy";
BA_ "SystemSignalLongSymbol" SG_ 1351 VCFRONT2_a214_hsVdsOvervoltageMa "VCFRONT2_a214_hsVdsOvervoltageMask";
BA_ "SystemSignalLongSymbol" SG_ 1351 VCFRONT2_a214_lsVdsOvervoltageMa "VCFRONT2_a214_lsVdsOvervoltageMask";
BA_ "SystemSignalLongSymbol" SG_ 1351 VCFRONT2_a217_hardwareOvercurren "VCFRONT2_a217_hardwareOvercurrent";
BA_ "SystemSignalLongSymbol" SG_ 1351 VCFRONT2_a217_busVoltageIrration "VCFRONT2_a217_busVoltageIrrational";
BA_ "SystemSignalLongSymbol" SG_ 1351 VCFRONT2_a217_dcCurrentIrrationa "VCFRONT2_a217_dcCurrentIrrational";
BA_ "SystemSignalLongSymbol" SG_ 1351 VCFRONT2_a217_motorSpeedIrration "VCFRONT2_a217_motorSpeedIrrational";
BA_ "SystemSignalLongSymbol" SG_ 1351 VCFRONT2_a217_supplyVoltageIrrat "VCFRONT2_a217_supplyVoltageIrrational";
BA_ "SystemSignalLongSymbol" SG_ 1351 VCFRONT2_a217_motorPhaseCurrentI "VCFRONT2_a217_motorPhaseCurrentIrrational";
BA_ "SystemSignalLongSymbol" SG_ 1351 VCFRONT2_a217_busVoltageUnhealth "VCFRONT2_a217_busVoltageUnhealthy";
BA_ "SystemSignalLongSymbol" SG_ 1351 VCFRONT2_a217_hsVdsOvervoltageMa "VCFRONT2_a217_hsVdsOvervoltageMask";
BA_ "SystemSignalLongSymbol" SG_ 1351 VCFRONT2_a217_lsVdsOvervoltageMa "VCFRONT2_a217_lsVdsOvervoltageMask";
BA_ "SystemSignalLongSymbol" SG_ 1351 VCFRONT2_a249_tempCoolantBatInle "VCFRONT2_a249_tempCoolantBatInlet";
BA_ "SystemSignalLongSymbol" SG_ 1351 VCFRONT2_a284_driverThermShutdow "VCFRONT2_a284_driverThermShutdown";
BA_ "SystemSignalLongSymbol" SG_ 1351 VCFRONT2_a284_chargePumpUndervol "VCFRONT2_a284_chargePumpUndervoltage";
BA_ "SystemSignalLongSymbol" SG_ 1351 VCFRONT2_a285_driverThermShutdow "VCFRONT2_a285_driverThermShutdown";
BA_ "SystemSignalLongSymbol" SG_ 1351 VCFRONT2_a285_chargePumpUndervol "VCFRONT2_a285_chargePumpUndervoltage";
BA_ "SystemSignalLongSymbol" SG_ 1351 VCFRONT2_a286_driverThermShutdow "VCFRONT2_a286_driverThermShutdown";
BA_ "SystemSignalLongSymbol" SG_ 1351 VCFRONT2_a286_chargePumpUndervol "VCFRONT2_a286_chargePumpUndervoltage";
BA_ "SystemSignalLongSymbol" SG_ 1351 VCFRONT2_a287_driverThermShutdow "VCFRONT2_a287_driverThermShutdown";
BA_ "SystemSignalLongSymbol" SG_ 1351 VCFRONT2_a287_chargePumpUndervol "VCFRONT2_a287_chargePumpUndervoltage";
BA_ "SystemSignalLongSymbol" SG_ 1351 VCFRONT2_a288_driverThermShutdow "VCFRONT2_a288_driverThermShutdown";
BA_ "SystemSignalLongSymbol" SG_ 1351 VCFRONT2_a288_chargePumpUndervol "VCFRONT2_a288_chargePumpUndervoltage";
BA_ "SystemSignalLongSymbol" SG_ 1351 VCFRONT2_a289_driverThermShutdow "VCFRONT2_a289_driverThermShutdown";
BA_ "SystemSignalLongSymbol" SG_ 1351 VCFRONT2_a289_chargePumpUndervol "VCFRONT2_a289_chargePumpUndervoltage";
BA_ "SystemSignalLongSymbol" SG_ 1351 VCFRONT2_a355_systemNotCommissio "VCFRONT2_a355_systemNotCommissioned";
BA_ "SystemSignalLongSymbol" SG_ 1351 VCFRONT2_a356_systemNotCommissio "VCFRONT2_a356_systemNotCommissioned";
BA_ "SystemSignalLongSymbol" SG_ 1351 VCFRONT2_a356_refCommissionStatu "VCFRONT2_a356_refCommissionStatus";
BA_ "SystemSignalLongSymbol" SG_ 1351 VCFRONT2_a360_vehicleLoadShedAct "VCFRONT2_a360_vehicleLoadShedActive";
BA_ "SystemSignalLongSymbol" SG_ 1351 VCFRONT2_a360_notEnoughPowerForS "VCFRONT2_a360_notEnoughPowerForSupport";
BA_ "SystemSignalLongSymbol" SG_ 1351 VCFRONT2_a368_coolantTempSensors "VCFRONT2_a368_coolantTempSensorsFaulted";
BA_ "SystemSignalLongSymbol" SG_ 1351 VCFRONT2_a368_coolantValveFaulte "VCFRONT2_a368_coolantValveFaulted";
BA_ "SystemSignalLongSymbol" SG_ 1351 VCFRONT2_a368_coolantPumpsFaulte "VCFRONT2_a368_coolantPumpsFaulted";
BA_ "SystemSignalLongSymbol" SG_ 1351 VCFRONT2_a368_preconditionsNotMe "VCFRONT2_a368_preconditionsNotMet";
BA_ "SystemSignalLongSymbol" SG_ 1351 VCFRONT2_a369_powerGenerationLim "VCFRONT2_a369_powerGenerationLimited";
BA_ "SystemSignalLongSymbol" SG_ 1351 VCFRONT2_a369_heatRejectionLimit "VCFRONT2_a369_heatRejectionLimited";
BA_ "SystemSignalLongSymbol" SG_ 1351 VCFRONT2_a374_lccInletSolenoidIS "VCFRONT2_a374_lccInletSolenoidISense";
BA_ "SystemSignalLongSymbol" SG_ 1351 VCFRONT2_a377_wiperStuckOutOfPar "VCFRONT2_a377_wiperStuckOutOfPark";
BA_ "SystemSignalLongSymbol" SG_ 1351 VCFRONT2_a397_runTimeOffSetDetec "VCFRONT2_a397_runTimeOffSetDetected";
BA_ "SystemSignalLongSymbol" SG_ 1351 VCFRONT2_a409_brushlessMotorConf "VCFRONT2_a409_brushlessMotorConfigurationInvalid";
BA_ "SystemSignalLongSymbol" SG_ 1351 VCFRONT2_a446_compFaultRefrigera "VCFRONT2_a446_compFaultRefrigerant";
BA_ "SystemSignalLongSymbol" SG_ 1351 VCFRONT2_a446_compStandbyLowAmbi "VCFRONT2_a446_compStandbyLowAmbient";
BA_ "SystemSignalLongSymbol" SG_ 1351 VCFRONT2_a446_compStandbyLowDisc "VCFRONT2_a446_compStandbyLowDischPress";
BA_ "SystemSignalLongSymbol" SG_ 1351 VCFRONT2_a446_compStandbyHVNotRe "VCFRONT2_a446_compStandbyHVNotReady";
BA_ "SystemSignalLongSymbol" SG_ 1351 VCFRONT2_a446_compStandbyCommuni "VCFRONT2_a446_compStandbyCommunication";
BA_ "SystemSignalLongSymbol" SG_ 1351 VCFRONT2_a446_compStandbySelfNot "VCFRONT2_a446_compStandbySelfNotReady";
BA_ "SystemSignalLongSymbol" SG_ 1351 VCFRONT2_a446_compStandbyRefrigN "VCFRONT2_a446_compStandbyRefrigNotOk";
BA_ "SystemSignalLongSymbol" SG_ 1351 VCFRONT2_a446_compStandbyCoastDo "VCFRONT2_a446_compStandbyCoastDownMode";
BA_ "SystemSignalLongSymbol" SG_ 1351 VCFRONT2_a446_compStandbyMultipl "VCFRONT2_a446_compStandbyMultiplePdCutouts";
BA_ "SystemSignalLongSymbol" SG_ 1351 VCFRONT2_a446_compStandbyShowroo "VCFRONT2_a446_compStandbyShowroomMode";
BA_ "SystemSignalLongSymbol" SG_ 1351 VCFRONT2_a446_compStandbyMu_0001 "VCFRONT2_a446_compStandbyMultipleTdCutouts";
BA_ "SystemSignalLongSymbol" SG_ 1351 VCFRONT2_a446_sensorIntermi_0002 "VCFRONT2_a446_sensorIntermittentPs";
BA_ "SystemSignalLongSymbol" SG_ 1351 VCFRONT2_a446_sensorIntermittent "VCFRONT2_a446_sensorIntermittentPd";
BA_ "SystemSignalLongSymbol" SG_ 1351 VCFRONT2_a446_sensorIntermi_0001 "VCFRONT2_a446_sensorIntermittentPl";
BA_ "SystemSignalLongSymbol" SG_ 1351 VCFRONT2_a446_sensorIntermi_0005 "VCFRONT2_a446_sensorIntermittentTs";
BA_ "SystemSignalLongSymbol" SG_ 1351 VCFRONT2_a446_sensorIntermi_0003 "VCFRONT2_a446_sensorIntermittentTd";
BA_ "SystemSignalLongSymbol" SG_ 1351 VCFRONT2_a446_sensorIntermi_0004 "VCFRONT2_a446_sensorIntermittentTl";
BA_ "SystemSignalLongSymbol" SG_ 1351 VCFRONT2_a446_highSuctionSuperhe "VCFRONT2_a446_highSuctionSuperheat";
BA_ "SystemSignalLongSymbol" SG_ 1351 VCFRONT2_a446_coolantSysLockedOu "VCFRONT2_a446_coolantSysLockedOut";
BA_ "SystemSignalLongSymbol" SG_ 1351 VCFRONT2_a447_caseHVACUnavailabl "VCFRONT2_a447_caseHVACUnavailable";
BA_ "SystemSignalLongSymbol" SG_ 1351 VCFRONT2_a447_heatPumpHVACUnavai "VCFRONT2_a447_heatPumpHVACUnavailable";
BA_ "SystemSignalLongSymbol" SG_ 1351 VCFRONT2_a447_activeLouverCompro "VCFRONT2_a447_activeLouverCompromised";
BA_ "SystemSignalLongSymbol" SG_ 1351 VCFRONT2_a447_coolantValveCompro "VCFRONT2_a447_coolantValveCompromised";
BA_ "SystemSignalLongSymbol" SG_ 1351 VCFRONT2_a447_ambientSourcingCom "VCFRONT2_a447_ambientSourcingCompromised";
BA_ "SystemSignalLongSymbol" SG_ 1351 VCFRONT2_a447_scavengeLoopCompro "VCFRONT2_a447_scavengeLoopCompromised";
BA_ "SystemSignalLongSymbol" SG_ 1351 VCFRONT2_a447_coolantSystemCompr "VCFRONT2_a447_coolantSystemCompromised";
BA_ "SystemSignalLongSymbol" SG_ 1351 VCFRONT2_a447_hvBattActiveDischg "VCFRONT2_a447_hvBattActiveDischgCompromised";
BA_ "SystemSignalLongSymbol" SG_ 1351 VCFRONT2_a447_hvBatteryDischargi "VCFRONT2_a447_hvBatteryDischargingCompromised";
BA_ "SystemSignalLongSymbol" SG_ 1351 VCFRONT2_a447_lccSolenoidComprom "VCFRONT2_a447_lccSolenoidCompromised";
BA_ "SystemSignalLongSymbol" SG_ 1351 VCFRONT2_a447_refrigerantSystemC "VCFRONT2_a447_refrigerantSystemCompromised";
BA_ "SystemSignalLongSymbol" SG_ 1351 VCFRONT2_a447_powertrainThermalF "VCFRONT2_a447_powertrainThermalFansCompromised";
BA_ "SystemSignalLongSymbol" SG_ 1351 VCFRONT2_a447_refrigDischargePre "VCFRONT2_a447_refrigDischargePressCompromised";
BA_ "SystemSignalLongSymbol" SG_ 1351 VCFRONT2_a447_refrigeDischargeTe "VCFRONT2_a447_refrigeDischargeTempCompromised";
BA_ "SystemSignalLongSymbol" SG_ 1351 VCFRONT2_a447_refrigSuctionPress "VCFRONT2_a447_refrigSuctionPressCompromised";
BA_ "SystemSignalLongSymbol" SG_ 1351 VCFRONT2_a447_refrigSuctionTempC "VCFRONT2_a447_refrigSuctionTempCompromised";
BA_ "SystemSignalLongSymbol" SG_ 1351 VCFRONT2_a447_refrigLiquidPressC "VCFRONT2_a447_refrigLiquidPressCompromised";
BA_ "SystemSignalLongSymbol" SG_ 1351 VCFRONT2_a447_refrigLiquidTempCo "VCFRONT2_a447_refrigLiquidTempCompromised";
BA_ "SystemSignalLongSymbol" SG_ 1351 VCFRONT2_a459_refrigerantFillAct "VCFRONT2_a459_refrigerantFillActive";
BA_ "SystemSignalLongSymbol" SG_ 1351 VCFRONT2_a465_flaggedAtSteadySta "VCFRONT2_a465_flaggedAtSteadyState";
BA_ "SystemSignalLongSymbol" SG_ 1351 VCFRONT2_a465_flaggedAtUnsteadyS "VCFRONT2_a465_flaggedAtUnsteadyState";
BA_ "SystemSignalLongSymbol" SG_ 1351 VCFRONT2_a511_DCDCMaxOutputCurre "VCFRONT2_a511_DCDCMaxOutputCurrentAllowed";
BA_ "SystemSignalLongSymbol" SG_ 1351 VCFRONT2_a511_DCDCOutputIsLimite "VCFRONT2_a511_DCDCOutputIsLimited";
BA_ "SystemSignalLongSymbol" SG_ 1351 VCFRONT2_a560_highSHBattConditio "VCFRONT2_a560_highSHBattConditioning";
BA_ "SystemSignalLongSymbol" SG_ 1351 VCFRONT2_a560_highSHCabinReheatC "VCFRONT2_a560_highSHCabinReheatCD";
BA_ "SystemSignalLongSymbol" SG_ 1351 VCFRONT2_a560_highSHCabinReheatH "VCFRONT2_a560_highSHCabinReheatHD";
BA_ "SystemSignalLongSymbol" SG_ 1351 VCFRONT2_a615_FRONTIPC_switchSta "VCFRONT2_a615_FRONTIPC_switchStatus";
BA_ "SystemSignalLongSymbol" SG_ 1351 VCFRONT2_a616_FRONTIPC_switchSta "VCFRONT2_a616_FRONTIPC_switchStatus";
BA_ "SystemSignalLongSymbol" SG_ 1351 VCFRONT2_a667_homologationRegion "VCFRONT2_a667_homologationRegionOverride";
BA_ "SystemSignalLongSymbol" SG_ 1351 VCFRONT2_a697_isVirtualPitchSens "VCFRONT2_a697_isVirtualPitchSensor";
BA_ "SystemSignalLongSymbol" SG_ 1351 VCFRONT2_a697_calibratedVertical "VCFRONT2_a697_calibratedVerticalPositionHCML";
BA_ "SystemSignalLongSymbol" SG_ 1351 VCFRONT2_a697_calibratedHorizont "VCFRONT2_a697_calibratedHorizontalPositionHCML";
VAL_ 1027 VCFRONT1_EPAS2EFuseState 7 "SELF_TEST" 6 "SELF_TEST_PREP" 5 "FAILSAFE" 4 "LOCKED" 3 "UNLOCKED" 2 "CONFIGURATION" 1 "WAKEUP" 0 "STANDBY" ;
VAL_ 1027 VCFRONT1_EPAS2EFuseManagerState 8 "LOCKOUT" 7 "IDLE" 6 "UNLOCKING" 5 "LOCKED_ON_BOOT" 4 "LOCKING" 3 "STANDBY" 2 "WAKEUP" 1 "OFF" 0 "RESETTING" ;
VAL_ 1027 VCFRONT1_EPAS2EFuseHardShortThre 15 "160_MV" 14 "139_3_MV" 13 "121_3_MV" 12 "105_6_MV" 11 "91_9_MV" 10 "80_MV" 9 "69_6_MV" 8 "60_6_MV" 7 "52_8_MV" 6 "45_9_MV" 5 "40_MV" 4 "34_8_MV" 3 "30_3_MV" 2 "26_4_MV" 1 "23_MV" 0 "20_MV" ;
VAL_ 1027 VCFRONT1_EPAS2EFuseOCThreshold 31 "89_3_MV" 30 "78_8_MV" 29 "69_5_MV" 28 "61_3_MV" 27 "54_MV" 26 "50_6_MV" 25 "47_5_MV" 24 "44_5_MV" 23 "41_7_MV" 22 "39_1_MV" 21 "36_6_MV" 20 "34_3_MV" 19 "32_2_MV" 18 "30_1_MV" 17 "28_2_MV" 16 "26_5_MV" 15 "24_8_MV" 14 "23_3_MV" 13 "21_8_MV" 12 "20_4_MV" 11 "19_1_MV" 10 "17_9_MV" 9 "16_8_MV" 8 "15_8_MV" 7 "14_8_MV" 6 "13_8_MV" 5 "13_MV" 4 "11_8_MV" 3 "10_4_MV" 2 "8_7_MV" 1 "7_2_MV" 0 "6_MV" ;
VAL_ 1027 VCFRONT1_EPAS2EFuseType 2 "VNF1248" 1 "VNF1048" 0 "UNKNOWN" ;
VAL_ 1027 VCFRONT1_rightControllerEFuseSta 7 "SELF_TEST" 6 "SELF_TEST_PREP" 5 "FAILSAFE" 4 "LOCKED" 3 "UNLOCKED" 2 "CONFIGURATION" 1 "WAKEUP" 0 "STANDBY" ;
VAL_ 1027 VCFRONT1_rightControllerEFuseMan 8 "LOCKOUT" 7 "IDLE" 6 "UNLOCKING" 5 "LOCKED_ON_BOOT" 4 "LOCKING" 3 "STANDBY" 2 "WAKEUP" 1 "OFF" 0 "RESETTING" ;
VAL_ 1027 VCFRONT1_rightControllerEFuseHar 15 "160_MV" 14 "139_3_MV" 13 "121_3_MV" 12 "105_6_MV" 11 "91_9_MV" 10 "80_MV" 9 "69_6_MV" 8 "60_6_MV" 7 "52_8_MV" 6 "45_9_MV" 5 "40_MV" 4 "34_8_MV" 3 "30_3_MV" 2 "26_4_MV" 1 "23_MV" 0 "20_MV" ;
VAL_ 1027 VCFRONT1_rightControllerEFuseOCT 31 "89_3_MV" 30 "78_8_MV" 29 "69_5_MV" 28 "61_3_MV" 27 "54_MV" 26 "50_6_MV" 25 "47_5_MV" 24 "44_5_MV" 23 "41_7_MV" 22 "39_1_MV" 21 "36_6_MV" 20 "34_3_MV" 19 "32_2_MV" 18 "30_1_MV" 17 "28_2_MV" 16 "26_5_MV" 15 "24_8_MV" 14 "23_3_MV" 13 "21_8_MV" 12 "20_4_MV" 11 "19_1_MV" 10 "17_9_MV" 9 "16_8_MV" 8 "15_8_MV" 7 "14_8_MV" 6 "13_8_MV" 5 "13_MV" 4 "11_8_MV" 3 "10_4_MV" 2 "8_7_MV" 1 "7_2_MV" 0 "6_MV" ;
VAL_ 1027 VCFRONT1_rightControllerEFuseTyp 2 "VNF1248" 1 "VNF1048" 0 "UNKNOWN" ;
VAL_ 1027 VCFRONT1_autopilot2EFuseState 7 "SELF_TEST" 6 "SELF_TEST_PREP" 5 "FAILSAFE" 4 "LOCKED" 3 "UNLOCKED" 2 "CONFIGURATION" 1 "WAKEUP" 0 "STANDBY" ;
VAL_ 1027 VCFRONT1_autopilot2EFuseManagerS 8 "LOCKOUT" 7 "IDLE" 6 "UNLOCKING" 5 "LOCKED_ON_BOOT" 4 "LOCKING" 3 "STANDBY" 2 "WAKEUP" 1 "OFF" 0 "RESETTING" ;
VAL_ 1027 VCFRONT1_autopilot2EFuseHardShor 15 "160_MV" 14 "139_3_MV" 13 "121_3_MV" 12 "105_6_MV" 11 "91_9_MV" 10 "80_MV" 9 "69_6_MV" 8 "60_6_MV" 7 "52_8_MV" 6 "45_9_MV" 5 "40_MV" 4 "34_8_MV" 3 "30_3_MV" 2 "26_4_MV" 1 "23_MV" 0 "20_MV" ;
VAL_ 1027 VCFRONT1_autopilot2EFuseOCThresh 31 "89_3_MV" 30 "78_8_MV" 29 "69_5_MV" 28 "61_3_MV" 27 "54_MV" 26 "50_6_MV" 25 "47_5_MV" 24 "44_5_MV" 23 "41_7_MV" 22 "39_1_MV" 21 "36_6_MV" 20 "34_3_MV" 19 "32_2_MV" 18 "30_1_MV" 17 "28_2_MV" 16 "26_5_MV" 15 "24_8_MV" 14 "23_3_MV" 13 "21_8_MV" 12 "20_4_MV" 11 "19_1_MV" 10 "17_9_MV" 9 "16_8_MV" 8 "15_8_MV" 7 "14_8_MV" 6 "13_8_MV" 5 "13_MV" 4 "11_8_MV" 3 "10_4_MV" 2 "8_7_MV" 1 "7_2_MV" 0 "6_MV" ;
VAL_ 1027 VCFRONT1_autopilot2EFuseType 2 "VNF1248" 1 "VNF1048" 0 "UNKNOWN" ;
