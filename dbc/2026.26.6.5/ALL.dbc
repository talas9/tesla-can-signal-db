VERSION "dbc-export 1 2026.26.6.5"

NS_ :

BS_:

BU_: ADSP APB APP APS APSB BB BMS CC CMP CMPD CP DAS DI DIF DIR DPB EPAS3P EPAS3S EPASTP EPASTS EPBL EPBR ESP EVSE FC GTW HCML HCMR HVP IBST ICR IDB LS OCS1P PARK PCS PCS2 PM PMF PMR PNCD PTC RADC RCM RCM2 RCM3 RCU SCCM SCM SCS SDCR TAS TCU TCU2 TPMS TRCM UI UIS UMC USM V2G VC VCBATT VCBATT0 VCBATT1 VCBATT2 VCCC VCFRONT VCFRONT1 VCFRONT2 VCLEFT VCRIGHT VCSEAT2L VCSEAT2R VCSEC VEH

BO_ 1339 VCBATT1_alertLog: 8 VCBATT1
 SG_ VCBATT1_alertID M : 0|10@1+ (1,0) [0|1023] "" Vector__XXX
 SG_ VCBATT1_alertState : 15|1@1+ (1,0) [0|1] "" Vector__XXX
 SG_ VCBATT1_a001_InternalWatchdog m1 : 16|1@1+ (1,0) [0|1] "" Vector__XXX
 SG_ VCBATT1_a015_NVMMMemOverflow m15 : 16|1@1+ (1,0) [0|1] "" Vector__XXX
 SG_ VCBATT1_a015_NVMMFilesystemError m15 : 17|1@1+ (1,0) [0|1] "" Vector__XXX
 SG_ VCBATT1_a015_NVMMRecordIDError m15 : 18|1@1+ (1,0) [0|1] "" Vector__XXX
 SG_ VCBATT1_a059_voltageDrop m59 : 16|12@1+ (0.005443676,0) [0|22.29185322] "" Vector__XXX
 SG_ VCBATT1_a059_resistanceEstimate m59 : 28|12@1+ (0.00244,0) [0|9.9918] "" Vector__XXX
 SG_ VCBATT1_a059_current m59 : 40|12@1+ (0.05,0) [0|204.75] "" Vector__XXX
 SG_ VCBATT1_a063_switchChannel m63 : 16|8@1+ (1,0) [0|255] "" Vector__XXX
 SG_ VCBATT1_a063_switchType m63 : 24|8@1+ (1,0) [0|255] "" Vector__XXX
 SG_ VCBATT1_a063_ADCVoltage m63 : 32|8@1+ (0.025,0) [0|6.375] "" Vector__XXX
 SG_ VCBATT1_a063_disconnected m63 : 40|1@1+ (1,0) [0|1] "" Vector__XXX
 SG_ VCBATT1_a063_indeterminate m63 : 41|1@1+ (1,0) [0|1] "" Vector__XXX
 SG_ VCBATT1_a063_stuckActive m63 : 42|1@1+ (1,0) [0|1] "" Vector__XXX
 SG_ VCBATT1_a063_faulted m63 : 43|1@1+ (1,0) [0|1] "" Vector__XXX
 SG_ VCBATT1_a091_FRONTIPC_faultsAndE m91 : 16|1@1+ (1,0) [0|1] "" Vector__XXX
 SG_ VCBATT1_a091_FRONTIPC_state m91 : 17|1@1+ (1,0) [0|1] "" Vector__XXX
 SG_ VCBATT1_a096_FRONTIPC_status m96 : 16|1@1+ (1,0) [0|1] "" Vector__XXX
 SG_ VCBATT1_a098_FRONTIPC_temperatur m98 : 16|1@1+ (1,0) [0|1] "" Vector__XXX
 SG_ VCBATT1_a098_FRONTIPC_thermalCon m98 : 17|1@1+ (1,0) [0|1] "" Vector__XXX
 SG_ VCBATT1_a106_BATTIPC_dcdcRailSta m106 : 16|1@1+ (1,0) [0|1] "" Vector__XXX
 SG_ VCBATT1_a106_BATTIPC_dcdcStatus m106 : 17|1@1+ (1,0) [0|1] "" Vector__XXX
 SG_ VCBATT1_a106_VEH_dcdcStatus m106 : 18|1@1+ (1,0) [0|1] "" Vector__XXX
 SG_ VCBATT1_a106_VEH_thermalControl m106 : 19|1@1+ (1,0) [0|1] "" Vector__XXX
 SG_ VCBATT1_a106_VEH_dcdcRailStatus m106 : 20|1@1+ (1,0) [0|1] "" Vector__XXX
 SG_ VCBATT1_a106_CH_dcdcRailStatus m106 : 21|1@1+ (1,0) [0|1] "" Vector__XXX
 SG_ VCBATT1_a106_CH_alertMatrix m106 : 22|1@1+ (1,0) [0|1] "" Vector__XXX
 SG_ VCBATT1_a106_FRONTIPC_thermalCon m106 : 23|1@1+ (1,0) [0|1] "" Vector__XXX
 SG_ VCBATT1_a106_FRONTIPC_dcdcRailSt m106 : 24|1@1+ (1,0) [0|1] "" Vector__XXX
 SG_ VCBATT1_a106_FRONTIPC_dcdcStatus m106 : 25|1@1+ (1,0) [0|1] "" Vector__XXX
 SG_ VCBATT1_a108_FRONTIPC_status m108 : 16|1@1+ (1,0) [0|1] "" Vector__XXX
 SG_ VCBATT1_a108_FRONTIPC_temperatur m108 : 17|1@1+ (1,0) [0|1] "" Vector__XXX
 SG_ VCBATT1_a108_FRONTIPC_thermalCon m108 : 18|1@1+ (1,0) [0|1] "" Vector__XXX
 SG_ VCBATT1_a108_FRONTIPC_motorStatu m108 : 19|1@1+ (1,0) [0|1] "" Vector__XXX
 SG_ VCBATT1_a120_BATTIPC_speed m120 : 16|1@1+ (1,0) [0|1] "" Vector__XXX
 SG_ VCBATT1_a120_FRONTIPC_speed m120 : 17|1@1+ (1,0) [0|1] "" Vector__XXX
 SG_ VCBATT1_a120_FRONTIPC_systemStat m120 : 18|1@1+ (1,0) [0|1] "" Vector__XXX
 SG_ VCBATT1_a120_BATTIPC_systemStatu m120 : 19|1@1+ (1,0) [0|1] "" Vector__XXX
 SG_ VCBATT1_a120_FRONTIPC_systemPowe m120 : 20|1@1+ (1,0) [0|1] "" Vector__XXX
 SG_ VCBATT1_a120_FRONTIPC_autonomyHe m120 : 21|1@1+ (1,0) [0|1] "" Vector__XXX
 SG_ VCBATT1_a120_BATTIPC_chassisCont m120 : 22|1@1+ (1,0) [0|1] "" Vector__XXX
 SG_ VCBATT1_a120_FRONTIPC_chassisCon m120 : 23|1@1+ (1,0) [0|1] "" Vector__XXX
 SG_ VCBATT1_a120_FRONTIPC_odometerSt m120 : 24|1@1+ (1,0) [0|1] "" Vector__XXX
 SG_ VCBATT1_a124_FRONTIPC_status m124 : 16|1@1+ (1,0) [0|1] "" Vector__XXX
 SG_ VCBATT1_a124_BATTIPC_status m124 : 17|1@1+ (1,0) [0|1] "" Vector__XXX
 SG_ VCBATT1_a125_FRONTIPC_leftStalk m125 : 16|1@1+ (1,0) [0|1] "" Vector__XXX
 SG_ VCBATT1_a125_FRONTIPC_steerAngle m125 : 17|1@1+ (1,0) [0|1] "" Vector__XXX
 SG_ VCBATT1_a125_FRONTIPC_info m125 : 18|1@1+ (1,0) [0|1] "" Vector__XXX
 SG_ VCBATT1_a126_FRONTIPC_sysStatus m126 : 16|1@1+ (1,0) [0|1] "" Vector__XXX
 SG_ VCBATT1_a126_BATTIPC_sysStatus m126 : 17|1@1+ (1,0) [0|1] "" Vector__XXX
 SG_ VCBATT1_a126_FRONTIPC_status m126 : 18|1@1+ (1,0) [0|1] "" Vector__XXX
 SG_ VCBATT1_a126_BATTIPC_status m126 : 19|1@1+ (1,0) [0|1] "" Vector__XXX
 SG_ VCBATT1_a127_vcleftEFuseCurrent m127 : 16|16@1+ (0.1,0) [0|6553.5] "" Vector__XXX
 SG_ VCBATT1_a127_vcleftEFuseVoltage m127 : 32|16@1+ (0.1,0) [0|6553.5] "" Vector__XXX
 SG_ VCBATT1_a127_vcleftEFuseTemp m127 : 48|11@1+ (0.125,-40) [-40|215.875] "" Vector__XXX
 SG_ VCBATT1_a127_vcleftEFuseRemainin m127 : 59|4@1+ (1,0) [0|15] "" Vector__XXX
 SG_ VCBATT1_a129_epas1EFuseCurrent m129 : 16|16@1+ (0.1,0) [0|6553.5] "" Vector__XXX
 SG_ VCBATT1_a129_epas1EFuseVoltage m129 : 32|16@1+ (0.1,0) [0|6553.5] "" Vector__XXX
 SG_ VCBATT1_a129_epas1EFuseTemp m129 : 48|11@1+ (0.125,-40) [-40|215.875] "" Vector__XXX
 SG_ VCBATT1_a130_autopilot1EFuseCurr m130 : 16|16@1+ (0.1,0) [0|6553.5] "" Vector__XXX
 SG_ VCBATT1_a130_autopilot1EFuseVolt m130 : 32|16@1+ (0.1,0) [0|6553.5] "" Vector__XXX
 SG_ VCBATT1_a130_autopilot1EFuseTemp m130 : 48|11@1+ (0.125,-40) [-40|215.875] "" Vector__XXX
 SG_ VCBATT1_a130_autopilot1EFuseRema m130 : 59|4@1+ (1,0) [0|15] "" Vector__XXX
 SG_ VCBATT1_a131_FRONTIPC_power m131 : 16|1@1+ (1,0) [0|1] "" Vector__XXX
 SG_ VCBATT1_a131_BATTIPC_power m131 : 17|1@1+ (1,0) [0|1] "" Vector__XXX
 SG_ VCBATT1_a132_iBoosterCurrent m132 : 16|16@1+ (0.1,0) [0|6553.5] "" Vector__XXX
 SG_ VCBATT1_a132_iBoosterVoltage m132 : 32|16@1+ (0.1,0) [0|6553.5] "" Vector__XXX
 SG_ VCBATT1_a132_iBoosterEFuseTemp m132 : 48|11@1+ (0.125,-40) [-40|215.875] "" Vector__XXX
 SG_ VCBATT1_a133_BATTIPC_primaryActu m133 : 16|1@1+ (1,0) [0|1] "" Vector__XXX
 SG_ VCBATT1_a133_FRONTIPC_secondaryA m133 : 17|1@1+ (1,0) [0|1] "" Vector__XXX
 SG_ VCBATT1_a144_FRONTIPC_status m144 : 16|1@1+ (1,0) [0|1] "" Vector__XXX
 SG_ VCBATT1_a144_BATTIPC_status m144 : 17|1@1+ (1,0) [0|1] "" Vector__XXX
 SG_ VCBATT1_a164_lockoutVoltage m164 : 16|16@1+ (0.1,0) [0|6553.5] "" Vector__XXX
 SG_ VCBATT1_a165_lockoutVoltage m165 : 16|16@1+ (0.1,0) [0|6553.5] "" Vector__XXX
 SG_ VCBATT1_a180_vehiclePowerState m180 : 16|2@1+ (1,0) [0|3] "" Vector__XXX
 SG_ VCBATT1_a180_hvState m180 : 18|3@1+ (1,0) [0|7] "" Vector__XXX
 SG_ VCBATT1_a180_bmsState m180 : 24|4@1+ (1,0) [0|15] "" Vector__XXX
 SG_ VCBATT1_a180_notEnoughPowerForSu m180 : 28|1@1+ (1,0) [0|1] "" Vector__XXX
 SG_ VCBATT1_a180_pcsEFuseStable m180 : 29|1@1+ (1,0) [0|1] "" Vector__XXX
 SG_ VCBATT1_a180_vcrightEFuseStable m180 : 30|1@1+ (1,0) [0|1] "" Vector__XXX
 SG_ VCBATT1_a180_contactorEFuseStabl m180 : 31|1@1+ (1,0) [0|1] "" Vector__XXX
 SG_ VCBATT1_a180_hvcEFuseStable m180 : 32|1@1+ (1,0) [0|1] "" Vector__XXX
 SG_ VCBATT1_a180_replaceLVBattery m180 : 33|1@1+ (1,0) [0|1] "" Vector__XXX
 SG_ VCBATT1_a180_BMS_MIA m180 : 34|1@1+ (1,0) [0|1] "" Vector__XXX
 SG_ VCBATT1_a180_PCS_MIA m180 : 35|1@1+ (1,0) [0|1] "" Vector__XXX
 SG_ VCBATT1_a180_HVBlockingMismatch m180 : 36|1@1+ (1,0) [0|1] "" Vector__XXX
 SG_ VCBATT1_a180_serviceMode m180 : 37|1@1+ (1,0) [0|1] "" Vector__XXX
 SG_ VCBATT1_a180_transportMode m180 : 38|1@1+ (1,0) [0|1] "" Vector__XXX
 SG_ VCBATT1_a180_frunkOpen m180 : 39|1@1+ (1,0) [0|1] "" Vector__XXX
 SG_ VCBATT1_a180_dcdcLVSupportStatus m180 : 40|2@1+ (1,0) [0|3] "" Vector__XXX
 SG_ VCBATT1_a180_IBSVoltage m180 : 48|8@1+ (0.08741903,0) [0|22.29185265] "" Vector__XXX
 SG_ VCBATT1_a180_targetPCSVoltage m180 : 56|8@1+ (0.1,0) [0|25.5] "" Vector__XXX
 SG_ VCBATT1_a182_deadLV m182 : 16|1@1+ (1,0) [0|1] "" Vector__XXX
 SG_ VCBATT1_a182_voltageDrop m182 : 17|1@1+ (1,0) [0|1] "" Vector__XXX
 SG_ VCBATT1_a182_overcharge m182 : 18|1@1+ (1,0) [0|1] "" Vector__XXX
 SG_ VCBATT1_a182_LVFloorReached m182 : 19|1@1+ (1,0) [0|1] "" Vector__XXX
 SG_ VCBATT1_a182_shortedCell m182 : 20|1@1+ (1,0) [0|1] "" Vector__XXX
 SG_ VCBATT1_a182_postPORExcessiveAh m182 : 21|1@1+ (1,0) [0|1] "" Vector__XXX
 SG_ VCBATT1_a182_resistanceEstimatio m182 : 22|1@1+ (1,0) [0|1] "" Vector__XXX
 SG_ VCBATT1_a182_dcrMilliOhmsAboveTh m182 : 23|1@1+ (1,0) [0|1] "" Vector__XXX
 SG_ VCBATT1_a182_prechargeLVLoadRedu m182 : 24|1@1+ (1,0) [0|1] "" Vector__XXX
 SG_ VCBATT1_a182_factoryMode m182 : 25|1@1+ (1,0) [0|1] "" Vector__XXX
 SG_ VCBATT1_a182_serviceMode m182 : 26|1@1+ (1,0) [0|1] "" Vector__XXX
 SG_ VCBATT1_a182_transportMode m182 : 27|1@1+ (1,0) [0|1] "" Vector__XXX
 SG_ VCBATT1_a182_frunkOpen m182 : 28|1@1+ (1,0) [0|1] "" Vector__XXX
 SG_ VCBATT1_a182_packOverDischarged m182 : 29|1@1+ (1,0) [0|1] "" Vector__XXX
 SG_ VCBATT1_a182_cellImbalance m182 : 30|1@1+ (1,0) [0|1] "" Vector__XXX
 SG_ VCBATT1_a182_instantPrechargeDCR m182 : 31|1@1+ (1,0) [0|1] "" Vector__XXX
 SG_ VCBATT1_a182_ambientTemp m182 : 32|7@1+ (1,-40) [-40|87] "" Vector__XXX
 SG_ VCBATT1_a182_dischargedAmpHours m182 : 39|8@1+ (60,0) [0|15300] "" Vector__XXX
 SG_ VCBATT1_a182_chargedAmpHours m182 : 47|8@1+ (60,0) [0|15300] "" Vector__XXX
 SG_ VCBATT1_a182_calibrationLostFaul m182 : 55|1@1+ (1,0) [0|1] "" Vector__XXX
 SG_ VCBATT1_a182_samplingHWError m182 : 56|1@1+ (1,0) [0|1] "" Vector__XXX
 SG_ VCBATT1_a182_brickOverDischarged m182 : 57|1@1+ (1,0) [0|1] "" Vector__XXX
 SG_ VCBATT1_a182_impedanceGrowth m182 : 58|1@1+ (1,0) [0|1] "" Vector__XXX
 SG_ VCBATT1_a182_batteryType m182 : 59|3@1+ (1,0) [0|7] "" Vector__XXX
 SG_ VCBATT1_a182_bleedFetTestFailure m182 : 62|1@1+ (1,0) [0|1] "" Vector__XXX
 SG_ VCBATT1_a182_weakShort m182 : 63|1@1+ (1,0) [0|1] "" Vector__XXX
 SG_ VCBATT1_a188_sleepBypassCurrent m188 : 16|8@1+ (0.2,0) [0|51] "" Vector__XXX
 SG_ VCBATT1_a188_IBSCurrent m188 : 24|10@1- (0.08,0) [-40.96|40.88] "" Vector__XXX
 SG_ VCBATT1_a188_LVSupport m188 : 34|1@1+ (1,0) [0|1] "" Vector__XXX
 SG_ VCBATT1_a188_bridgeEFuseState m188 : 35|3@1+ (1,0) [0|7] "" Vector__XXX
 SG_ VCBATT1_a188_bridgeState m188 : 40|4@1+ (1,0) [0|15] "" Vector__XXX
 SG_ VCBATT1_a188_frontPrivBusAwake m188 : 44|1@1+ (1,0) [0|1] "" Vector__XXX
 SG_ VCBATT1_a188_sleepShutdownStep m188 : 45|3@1+ (1,0) [0|7] "" Vector__XXX
 SG_ VCBATT1_a188_vehiclePowerState m188 : 48|5@1+ (1,0) [0|31] "" Vector__XXX
 SG_ VCBATT1_a188_timeNotSleeping m188 : 56|6@1+ (1,0) [0|63] "" Vector__XXX
 SG_ VCBATT1_a188_CANAfterQuiet m188 : 62|1@1+ (1,0) [0|1] "" Vector__XXX
 SG_ VCBATT1_a191_vehiclePowerState m191 : 16|2@1+ (1,0) [0|3] "" Vector__XXX
 SG_ VCBATT1_a191_hvState m191 : 18|3@1+ (1,0) [0|7] "" Vector__XXX
 SG_ VCBATT1_a191_reverseBatteryEFuse m191 : 21|1@1+ (1,0) [0|1] "" Vector__XXX
 SG_ VCBATT1_a191_vehicleLoadShedActi m191 : 22|1@1+ (1,0) [0|1] "" Vector__XXX
 SG_ VCBATT1_a191_vehicleLoadShedHvFa m191 : 23|1@1+ (1,0) [0|1] "" Vector__XXX
 SG_ VCBATT1_a191_vehicleLoadShedPost m191 : 24|1@1+ (1,0) [0|1] "" Vector__XXX
 SG_ VCBATT1_a191_IBSVoltage m191 : 25|8@1+ (0.08741903,0) [0|22.29185265] "" Vector__XXX
 SG_ VCBATT1_a191_a180_DCDCNotSupport m191 : 33|1@1+ (1,0) [0|1] "" Vector__XXX
 SG_ VCBATT1_a191_MOSState m191 : 34|2@1+ (1,0) [0|3] "" Vector__XXX
 SG_ VCBATT1_a191_LVBMSVoltage m191 : 36|8@1+ (0.08741903,0) [0|22.29185265] "" Vector__XXX
 SG_ VCBATT1_a191_ECPAState m191 : 44|2@1+ (1,0) [0|3] "" Vector__XXX
 SG_ VCBATT1_a191_LVBMSCurrentTargetV m191 : 46|1@1+ (1,0) [0|1] "" Vector__XXX
 SG_ VCBATT1_a191_LVBMSVoltageTargetV m191 : 47|1@1+ (1,0) [0|1] "" Vector__XXX
 SG_ VCBATT1_a191_serviceMode m191 : 48|1@1+ (1,0) [0|1] "" Vector__XXX
 SG_ VCBATT1_a191_frunkOpen m191 : 49|1@1+ (1,0) [0|1] "" Vector__XXX
 SG_ VCBATT1_a191_vehicleLoadShedStag m191 : 50|2@1+ (1,0) [0|3] "" Vector__XXX
 SG_ VCBATT1_a191_exitDriveWarningTim m191 : 52|1@1+ (1,0) [0|1] "" Vector__XXX
 SG_ VCBATT1_a191_LVBMSMIA m191 : 53|1@1+ (1,0) [0|1] "" Vector__XXX
 SG_ VCBATT1_a191_PCS_MIA m191 : 54|1@1+ (1,0) [0|1] "" Vector__XXX
 SG_ VCBATT1_a191_NotEnoughPowerForSu m191 : 55|1@1+ (1,0) [0|1] "" Vector__XXX
 SG_ VCBATT1_a191_bmsState m191 : 56|4@1+ (1,0) [0|15] "" Vector__XXX
 SG_ VCBATT1_a196_factoryMode m196 : 16|1@1+ (1,0) [0|1] "" Vector__XXX
 SG_ VCBATT1_a196_serviceMode m196 : 17|1@1+ (1,0) [0|1] "" Vector__XXX
 SG_ VCBATT1_a196_transportMode m196 : 18|1@1+ (1,0) [0|1] "" Vector__XXX
 SG_ VCBATT1_a196_frunkOpen m196 : 19|1@1+ (1,0) [0|1] "" Vector__XXX
 SG_ VCBATT1_a196_vehiclePowerState m196 : 20|2@1+ (1,0) [0|3] "" Vector__XXX
 SG_ VCBATT1_a196_batterySMState m196 : 24|4@1+ (1,0) [0|15] "" Vector__XXX
 SG_ VCBATT1_a196_disconnectedBattery m196 : 28|12@1+ (0.004884005,-10) [-10|10.000000475] "" Vector__XXX
 SG_ VCBATT1_a196_disconnectedBa_0002 m196 : 40|8@1+ (0.0392156876624,6) [6|16.0000003539] "" Vector__XXX
 SG_ VCBATT1_a196_disconnectedBa_0001 m196 : 48|8@1+ (0.0392156876624,6) [6|16.0000003539] "" Vector__XXX
 SG_ VCBATT1_a196_ECPAState m196 : 56|2@1+ (1,0) [0|3] "" Vector__XXX
 SG_ VCBATT1_a204_vbusVoltage m204 : 16|10@1+ (0.025,0) [0|25.575] "" Vector__XXX
 SG_ VCBATT1_a204_ARailLocked m204 : 26|1@1+ (1,0) [0|1] "" Vector__XXX
 SG_ VCBATT1_a204_uvLoadshedFaultInje m204 : 27|1@1+ (1,0) [0|1] "" Vector__XXX
 SG_ VCBATT1_a204_batBridgeCurrent m204 : 32|16@1- (0.0625,0) [-2048|2047.9375] "" Vector__XXX
 SG_ VCBATT1_a205_busVoltage m205 : 16|10@1+ (0.025,0) [0|25.575] "" Vector__XXX
 SG_ VCBATT1_a205_ARailLocked m205 : 26|1@1+ (1,0) [0|1] "" Vector__XXX
 SG_ VCBATT1_a205_ovLoadshedFaultInje m205 : 27|1@1+ (1,0) [0|1] "" Vector__XXX
 SG_ VCBATT1_a205_batBridgeCurrent m205 : 32|16@1- (0.0625,0) [-2048|2047.9375] "" Vector__XXX
 SG_ VCBATT1_a212_IBSTemp m212 : 16|16@1- (0.01,0) [-327.68|327.67] "" Vector__XXX
 SG_ VCBATT1_a213_IBSVolts m213 : 16|12@1+ (0.005443676,0) [0|22.29185322] "" Vector__XXX
 SG_ VCBATT1_a213_IBSAh m213 : 32|14@1- (0.01,0) [-81.92|81.91] "" Vector__XXX
 SG_ VCBATT1_a213_LVBatteryTemp m213 : 48|16@1- (0.01,0) [-327.68|327.67] "" Vector__XXX
 SG_ VCBATT1_a216_inDrive m216 : 16|1@1+ (1,0) [0|1] "" Vector__XXX
 SG_ VCBATT1_a216_hvState m216 : 17|3@1+ (1,0) [0|7] "" Vector__XXX
 SG_ VCBATT1_a216_vcleftFastBlowImmin m216 : 20|1@1+ (1,0) [0|1] "" Vector__XXX
 SG_ VCBATT1_a216_vcleftFastBlowDebou m216 : 21|1@1+ (1,0) [0|1] "" Vector__XXX
 SG_ VCBATT1_a216_vcleftStaticImminen m216 : 22|1@1+ (1,0) [0|1] "" Vector__XXX
 SG_ VCBATT1_a216_vcleftDynamicImmine m216 : 23|1@1+ (1,0) [0|1] "" Vector__XXX
 SG_ VCBATT1_a219_IBSVolts m219 : 16|12@1+ (0.005443676,0) [0|22.29185322] "" Vector__XXX
 SG_ VCBATT1_a219_IBSAh m219 : 32|14@1- (0.01,0) [-81.92|81.91] "" Vector__XXX
 SG_ VCBATT1_a219_IBSCurrent m219 : 48|16@1- (0.005,0) [-163.84|163.835] "" Vector__XXX
 SG_ VCBATT1_a220_DI_gear m220 : 16|3@1+ (1,0) [0|7] "" Vector__XXX
 SG_ VCBATT1_a220_redundancyRequired m220 : 19|1@1+ (1,0) [0|1] "" Vector__XXX
 SG_ VCBATT1_a220_vehicleSpeed m220 : 20|12@1+ (0.08,-40) [-40|287.6] "" Vector__XXX
 SG_ VCBATT1_a220_lvHealthStatus m220 : 32|3@1+ (1,0) [0|7] "" Vector__XXX
 SG_ VCBATT1_a220_factoryMode m220 : 35|1@1+ (1,0) [0|1] "" Vector__XXX
 SG_ VCBATT1_a220_serviceMode m220 : 36|1@1+ (1,0) [0|1] "" Vector__XXX
 SG_ VCBATT1_a220_unhealthyReason m220 : 40|5@1+ (1,0) [0|31] "" Vector__XXX
 SG_ VCBATT1_a221_IBSCurrent m221 : 16|16@1- (0.005,0) [-163.84|163.835] "" Vector__XXX
 SG_ VCBATT1_a221_PCSCurrent m221 : 32|8@1+ (0.5,-127) [-127|0.5] "" Vector__XXX
 SG_ VCBATT1_a221_serviceMode m221 : 40|1@1+ (1,0) [0|1] "" Vector__XXX
 SG_ VCBATT1_a221_frunkOpen m221 : 41|1@1+ (1,0) [0|1] "" Vector__XXX
 SG_ VCBATT1_a223_failedArmingSetup m223 : 16|1@1+ (1,0) [0|1] "" Vector__XXX
 SG_ VCBATT1_a223_failedFaultInject m223 : 17|1@1+ (1,0) [0|1] "" Vector__XXX
 SG_ VCBATT1_a223_overvoltageFaultAct m223 : 18|1@1+ (1,0) [0|1] "" Vector__XXX
 SG_ VCBATT1_a223_sharedBridgeShutdow m223 : 19|1@1+ (1,0) [0|1] "" Vector__XXX
 SG_ VCBATT1_a223_timedOut m223 : 20|1@1+ (1,0) [0|1] "" Vector__XXX
 SG_ VCBATT1_a224_ocSenseAmpCurrent m224 : 16|12@1+ (0.1,0) [0|409.5] "" Vector__XXX
 SG_ VCBATT1_a224_hardwareLoadshedFau m224 : 28|1@1+ (1,0) [0|1] "" Vector__XXX
 SG_ VCBATT1_a224_ocLoadshedFaultActi m224 : 29|1@1+ (1,0) [0|1] "" Vector__XXX
 SG_ VCBATT1_a224_faultChannelPi_0003 m224 : 30|1@1+ (1,0) [0|1] "" Vector__XXX
 SG_ VCBATT1_a224_faultChannelPi_0002 m224 : 31|1@1+ (1,0) [0|1] "" Vector__XXX
 SG_ VCBATT1_a224_faultChannelPinActi m224 : 32|1@1+ (1,0) [0|1] "" Vector__XXX
 SG_ VCBATT1_a224_faultChannelPi_0001 m224 : 33|1@1+ (1,0) [0|1] "" Vector__XXX
 SG_ VCBATT1_a224_hardwareLoadsh_0001 m224 : 34|1@1+ (1,0) [0|1] "" Vector__XXX
 SG_ VCBATT1_a229_bridgeOpened m229 : 16|1@1+ (1,0) [0|1] "" Vector__XXX
 SG_ VCBATT1_a229_lvBatteryElecDisc m229 : 17|1@1+ (1,0) [0|1] "" Vector__XXX
 SG_ VCBATT1_a229_lvBatteryEFuseOff m229 : 18|1@1+ (1,0) [0|1] "" Vector__XXX
 SG_ VCBATT1_a229_lvBatteryActiveDece m229 : 19|1@1+ (1,0) [0|1] "" Vector__XXX
 SG_ VCBATT1_a229_lvBatteryRevEfuseOf m229 : 20|1@1+ (1,0) [0|1] "" Vector__XXX
 SG_ VCBATT1_a229_lvBatteryComms m229 : 21|1@1+ (1,0) [0|1] "" Vector__XXX
 SG_ VCBATT1_a235_hvcRightDomainFailu m235 : 16|3@1+ (1,0) [0|7] "" Vector__XXX
 SG_ VCBATT1_a235_hvcLeftDomainFailur m235 : 19|3@1+ (1,0) [0|7] "" Vector__XXX
 SG_ VCBATT1_a235_timedOut m235 : 22|1@1+ (1,0) [0|1] "" Vector__XXX
 SG_ VCBATT1_a243_IBSVolts m243 : 16|12@1+ (0.005443676,0) [0|22.29185322] "" Vector__XXX
 SG_ VCBATT1_a243_IBSCurrent m243 : 32|16@1- (0.005,0) [-163.84|163.835] "" Vector__XXX
 SG_ VCBATT1_a243_LVBatteryTemp m243 : 48|16@1- (0.01,0) [-327.68|327.67] "" Vector__XXX
 SG_ VCBATT1_a244_brakeValveECUEFuseC m244 : 16|16@1+ (0.1,0) [0|6553.5] "" Vector__XXX
 SG_ VCBATT1_a244_brakeValveECUEFuseV m244 : 32|16@1+ (0.1,0) [0|6553.5] "" Vector__XXX
 SG_ VCBATT1_a245_current m245 : 16|16@1+ (0.1,0) [0|6553.5] "" Vector__XXX
 SG_ VCBATT1_a245_voltage m245 : 32|16@1+ (0.1,0) [0|6553.5] "" Vector__XXX
 SG_ VCBATT1_a245_vbatProtVoltage m245 : 48|16@1+ (0.1,0) [0|6553.5] "" Vector__XXX
 SG_ VCBATT1_a253_currentNotTapered m253 : 16|1@1+ (1,0) [0|1] "" Vector__XXX
 SG_ VCBATT1_a253_ampHourTargetNotRea m253 : 17|1@1+ (1,0) [0|1] "" Vector__XXX
 SG_ VCBATT1_a253_IBSCurrent m253 : 18|16@1- (0.005,0) [-163.84|163.835] "" Vector__XXX
 SG_ VCBATT1_a253_IBSAmpHours m253 : 34|14@1- (0.01,0) [-81.92|81.91] "" Vector__XXX
 SG_ VCBATT1_a253_LVBatteryTemp m253 : 48|7@1+ (1,-40) [-40|87] "" Vector__XXX
 SG_ VCBATT1_a253_firstChargeOTA m253 : 55|1@1+ (1,0) [0|1] "" Vector__XXX
 SG_ VCBATT1_a253_firstChargePOR m253 : 56|1@1+ (1,0) [0|1] "" Vector__XXX
 SG_ VCBATT1_a253_serviceMode m253 : 57|1@1+ (1,0) [0|1] "" Vector__XXX
 SG_ VCBATT1_a253_frunkOpen m253 : 58|1@1+ (1,0) [0|1] "" Vector__XXX
 SG_ VCBATT1_a259_serviceMode m259 : 16|1@1+ (1,0) [0|1] "" Vector__XXX
 SG_ VCBATT1_a259_voltageDropCounter m259 : 17|3@1+ (2,0) [0|14] "" Vector__XXX
 SG_ VCBATT1_a259_minVoltageReached m259 : 20|12@1+ (0.005443676,0) [0|22.29185322] "" Vector__XXX
 SG_ VCBATT1_a259_IBSTemp m259 : 32|16@1- (0.01,0) [-327.68|327.67] "" Vector__XXX
 SG_ VCBATT1_a259_maxCurrentReached m259 : 48|16@1- (0.005,0) [-163.84|163.835] "" Vector__XXX
 SG_ VCBATT1_a260_IBSVolts m260 : 16|12@1+ (0.005443676,0) [0|22.29185322] "" Vector__XXX
 SG_ VCBATT1_a260_IBSAh m260 : 28|12@1- (0.1,0) [-204.8|204.7] "" Vector__XXX
 SG_ VCBATT1_a260_vehiclePowerState m260 : 40|2@1+ (1,0) [0|3] "" Vector__XXX
 SG_ VCBATT1_a260_batterySMState m260 : 42|4@1+ (1,0) [0|15] "" Vector__XXX
 SG_ VCBATT1_a260_HV_UP m260 : 46|1@1+ (1,0) [0|1] "" Vector__XXX
 SG_ VCBATT1_a260_notEnoughPowerForSu m260 : 47|1@1+ (1,0) [0|1] "" Vector__XXX
 SG_ VCBATT1_a260_coolantHasBeenFille m260 : 48|1@1+ (1,0) [0|1] "" Vector__XXX
 SG_ VCBATT1_a260_ampHourTrigger m260 : 49|1@1+ (1,0) [0|1] "" Vector__XXX
 SG_ VCBATT1_a260_voltageTrigger m260 : 50|1@1+ (1,0) [0|1] "" Vector__XXX
 SG_ VCBATT1_a260_crashDetected m260 : 51|1@1+ (1,0) [0|1] "" Vector__XXX
 SG_ VCBATT1_a260_BMS_MIA m260 : 52|1@1+ (1,0) [0|1] "" Vector__XXX
 SG_ VCBATT1_a260_PCS_MIA m260 : 53|1@1+ (1,0) [0|1] "" Vector__XXX
 SG_ VCBATT1_a260_HVBlockingMismatch m260 : 54|1@1+ (1,0) [0|1] "" Vector__XXX
 SG_ VCBATT1_a260_serviceMode m260 : 55|1@1+ (1,0) [0|1] "" Vector__XXX
 SG_ VCBATT1_a260_dcdcLVSupportStatus m260 : 56|2@1+ (1,0) [0|3] "" Vector__XXX
 SG_ VCBATT1_a260_PCSAndVCREFuseStabl m260 : 58|1@1+ (1,0) [0|1] "" Vector__XXX
 SG_ VCBATT1_a260_bmsState m260 : 59|4@1+ (1,0) [0|15] "" Vector__XXX
 SG_ VCBATT1_a297_bmbDeviceId m297 : 16|4@1+ (1,1) [1|16] "" Vector__XXX
 SG_ VCBATT1_a297_bmbDeviceFaultTempM m297 : 24|8@1+ (1,0) [0|255] "" Vector__XXX
 SG_ VCBATT1_a359_IBSVolts m359 : 16|12@1+ (0.005443676,0) [0|22.29185322] "" Vector__XXX
 SG_ VCBATT1_a359_IBSAh m359 : 28|12@1- (0.1,0) [-204.8|204.7] "" Vector__XXX
 SG_ VCBATT1_a359_vehiclePowerState m359 : 40|2@1+ (1,0) [0|3] "" Vector__XXX
 SG_ VCBATT1_a359_batterySMState m359 : 42|4@1+ (1,0) [0|15] "" Vector__XXX
 SG_ VCBATT1_a359_hvState m359 : 48|3@1+ (1,0) [0|7] "" Vector__XXX
 SG_ VCBATT1_a359_coolantHasBeenFille m359 : 51|1@1+ (1,0) [0|1] "" Vector__XXX
 SG_ VCBATT1_a359_crashDetected m359 : 52|1@1+ (1,0) [0|1] "" Vector__XXX
 SG_ VCBATT1_a359_BMS_MIA m359 : 53|1@1+ (1,0) [0|1] "" Vector__XXX
 SG_ VCBATT1_a359_PCS_MIA m359 : 54|1@1+ (1,0) [0|1] "" Vector__XXX
 SG_ VCBATT1_a359_serviceMode m359 : 55|1@1+ (1,0) [0|1] "" Vector__XXX
 SG_ VCBATT1_a359_dcdcLVSupportStatus m359 : 56|2@1+ (1,0) [0|3] "" Vector__XXX
 SG_ VCBATT1_a359_bmsState m359 : 58|4@1+ (1,0) [0|15] "" Vector__XXX
 SG_ VCBATT1_a363_minBleedCharge m363 : 16|15@1+ (0.001,0) [0|32.767] "" Vector__XXX
 SG_ VCBATT1_a363_avgBleedCharge m363 : 32|15@1+ (0.001,0) [0|32.767] "" Vector__XXX
 SG_ VCBATT1_a363_checkIntervalDays m363 : 48|5@1+ (1,0) [0|31] "" Vector__XXX
 SG_ VCBATT1_a363_minBleedChargeBrick m363 : 56|5@1+ (1,1) [1|32] "" Vector__XXX
 SG_ VCBATT1_a363_setFromNvm m363 : 61|1@1+ (1,0) [0|1] "" Vector__XXX
 SG_ VCBATT1_a370_IBSVolts m370 : 16|12@1+ (0.005443676,0) [0|22.29185322] "" Vector__XXX
 SG_ VCBATT1_a370_IBSAh m370 : 28|12@1- (0.1,0) [-204.8|204.7] "" Vector__XXX
 SG_ VCBATT1_a370_notEnoughPowerForSu m370 : 40|1@1+ (1,0) [0|1] "" Vector__XXX
 SG_ VCBATT1_a370_serviceMode m370 : 41|1@1+ (1,0) [0|1] "" Vector__XXX
 SG_ VCBATT1_a370_sleepCurrent m370 : 42|10@1+ (0.1,0) [0|102.3] "" Vector__XXX
 SG_ VCBATT1_a370_SOC m370 : 52|3@1+ (2.5,5) [5|22.5] "" Vector__XXX
 SG_ VCBATT1_a371_shortedCellTestTrig m371 : 16|1@1+ (1,0) [0|1] "" Vector__XXX
 SG_ VCBATT1_a371_voltDropOnHighCurre m371 : 17|1@1+ (1,0) [0|1] "" Vector__XXX
 SG_ VCBATT1_a371_deadLVMinimalAhDisc m371 : 18|1@1+ (1,0) [0|1] "" Vector__XXX
 SG_ VCBATT1_a371_resistanceEstimatio m371 : 19|1@1+ (1,0) [0|1] "" Vector__XXX
 SG_ VCBATT1_a371_dcrMilliOhmsAboveTh m371 : 20|1@1+ (1,0) [0|1] "" Vector__XXX
 SG_ VCBATT1_a371_prechargeLVLoadRedu m371 : 21|1@1+ (1,0) [0|1] "" Vector__XXX
 SG_ VCBATT1_a371_instantPrechargeDCR m371 : 22|1@1+ (1,0) [0|1] "" Vector__XXX
 SG_ VCBATT1_a372_bmbDeviceId m372 : 16|4@1+ (1,1) [1|16] "" Vector__XXX
 SG_ VCBATT1_a372_bmbDeviceFaultBrick m372 : 24|16@1+ (1,0) [0|65535] "" Vector__XXX
 SG_ VCBATT1_a387_shortedCellFaultCou m387 : 16|3@1+ (1,0) [0|7] "" Vector__XXX
 SG_ VCBATT1_a387_minVoltageReached m387 : 19|12@1+ (0.005443676,0) [0|22.29185322] "" Vector__XXX
 SG_ VCBATT1_a387_opportunisticTest m387 : 31|1@1+ (1,0) [0|1] "" Vector__XXX
 SG_ VCBATT1_a387_IBSTemp m387 : 32|16@1- (0.01,0) [-327.68|327.67] "" Vector__XXX
 SG_ VCBATT1_a387_maxCurrentReached m387 : 48|16@1- (0.005,0) [-163.84|163.835] "" Vector__XXX
 SG_ VCBATT1_a388_shortedCellFaultCou m388 : 16|3@1+ (1,0) [0|7] "" Vector__XXX
 SG_ VCBATT1_a388_minVoltageReached m388 : 19|12@1+ (0.005443676,0) [0|22.29185322] "" Vector__XXX
 SG_ VCBATT1_a388_opportunisticTest m388 : 31|1@1+ (1,0) [0|1] "" Vector__XXX
 SG_ VCBATT1_a388_IBSTemp m388 : 32|16@1- (0.01,0) [-327.68|327.67] "" Vector__XXX
 SG_ VCBATT1_a388_maxCurrentReached m388 : 48|16@1- (0.005,0) [-163.84|163.835] "" Vector__XXX
 SG_ VCBATT1_a392_bmbDeviceId m392 : 16|4@1+ (1,1) [1|16] "" Vector__XXX
 SG_ VCBATT1_a392_bmbDeviceFaultBrick m392 : 24|16@1+ (1,0) [0|65535] "" Vector__XXX
 SG_ VCBATT1_a401_LVBatteryTemp m401 : 16|7@1+ (1,-40) [-40|87] "" Vector__XXX
 SG_ VCBATT1_a401_IBSCurrent m401 : 24|12@1- (0.1,0) [-204.8|204.7] "" Vector__XXX
 SG_ VCBATT1_a401_IBSVoltage m401 : 36|11@1+ (0.0108873518184,0) [0|22.2864091723] "" Vector__XXX
 SG_ VCBATT1_a401_IBSAmpHours m401 : 48|8@1+ (0.01,-2.55) [-2.55|4.4408920985e-16] "" Vector__XXX
 SG_ VCBATT1_a402_LVBatteryTemp m402 : 16|7@1+ (1,-40) [-40|87] "" Vector__XXX
 SG_ VCBATT1_a402_batterySMState m402 : 24|4@1+ (1,0) [0|15] "" Vector__XXX
 SG_ VCBATT1_a402_failureToPrechargeR m402 : 28|1@1+ (1,0) [0|1] "" Vector__XXX
 SG_ VCBATT1_a402_electricalDisconnec m402 : 29|1@1+ (1,0) [0|1] "" Vector__XXX
 SG_ VCBATT1_a402_communicationDiscon m402 : 30|1@1+ (1,0) [0|1] "" Vector__XXX
 SG_ VCBATT1_a402_reverseBatteryFault m402 : 31|1@1+ (1,0) [0|1] "" Vector__XXX
 SG_ VCBATT1_a402_MOSOpen m402 : 32|1@1+ (1,0) [0|1] "" Vector__XXX
 SG_ VCBATT1_a402_serviceMode m402 : 33|1@1+ (1,0) [0|1] "" Vector__XXX
 SG_ VCBATT1_a402_frunkOpen m402 : 34|1@1+ (1,0) [0|1] "" Vector__XXX
 SG_ VCBATT1_a404_minVoltageReached m404 : 16|12@1+ (0.005443676,0) [0|22.29185322] "" Vector__XXX
 SG_ VCBATT1_a404_IBSTemp m404 : 32|16@1- (0.01,0) [-327.68|327.67] "" Vector__XXX
 SG_ VCBATT1_a404_maxCurrentReached m404 : 48|16@1- (0.005,0) [-163.84|163.835] "" Vector__XXX
 SG_ VCBATT1_a407_dcrMilliOhms m407 : 16|8@1+ (0.2,0) [0|51] "" Vector__XXX
 SG_ VCBATT1_a407_dcr12VThreshold m407 : 24|4@1+ (1,0) [0|15] "" Vector__XXX
 SG_ VCBATT1_a407_avgIntervalCurrent m407 : 28|5@1+ (1,-31) [-31|0] "" Vector__XXX
 SG_ VCBATT1_a407_intervalCurrentVari m407 : 33|6@1+ (0.1,0) [0|6.3] "" Vector__XXX
 SG_ VCBATT1_a407_avgPulseCurrent m407 : 39|7@1+ (1,-127) [-127|0] "" Vector__XXX
 SG_ VCBATT1_a407_pulseCurrentVarianc m407 : 46|6@1+ (0.25,0) [0|15.75] "" Vector__XXX
 SG_ VCBATT1_a407_IBSTemperature m407 : 52|8@1+ (0.5,-30) [-30|97.5] "" Vector__XXX
 SG_ VCBATT1_a407_testCounter m407 : 60|2@1+ (1,0) [0|3] "" Vector__XXX
 SG_ VCBATT1_a407_testingExpended m407 : 62|1@1+ (1,0) [0|1] "" Vector__XXX
 SG_ VCBATT1_a407_opportunisticTest m407 : 63|1@1+ (1,0) [0|1] "" Vector__XXX
 SG_ VCBATT1_a414_failureReason m414 : 16|6@1+ (1,0) [0|63] "" Vector__XXX
 SG_ VCBATT1_a414_loadUnattemptedOnFa m414 : 22|1@1+ (1,0) [0|1] "" Vector__XXX
 SG_ VCBATT1_a414_deviceStuckOnFailur m414 : 23|1@1+ (1,0) [0|1] "" Vector__XXX
 SG_ VCBATT1_a414_followerVCLeftSelfT m414 : 24|1@1+ (1,0) [0|1] "" Vector__XXX
 SG_ VCBATT1_a414_bridgeFailedToOpen m414 : 25|1@1+ (1,0) [0|1] "" Vector__XXX
 SG_ VCBATT1_a414_uvLoadshedVsenseDig m414 : 26|1@1+ (1,0) [0|1] "" Vector__XXX
 SG_ VCBATT1_a415_upstreamEFuseStuckO m415 : 16|1@1+ (1,0) [0|1] "" Vector__XXX
 SG_ VCBATT1_a416_brickVoltageMin m416 : 16|10@1+ (0.005,0) [0|5.115] "" Vector__XXX
 SG_ VCBATT1_a416_brickVoltageMax m416 : 26|10@1+ (0.005,0) [0|5.115] "" Vector__XXX
 SG_ VCBATT1_a416_packCurrent m416 : 36|10@1- (5,0) [-2560|2555] "" Vector__XXX
 SG_ VCBATT1_a416_socMin m416 : 46|8@1+ (0.5,0) [0|127.5] "" Vector__XXX
 SG_ VCBATT1_a416_brickId m416 : 54|8@1+ (1,1) [1|256] "" Vector__XXX
 SG_ VCBATT1_a417_brickVoltageMin m417 : 16|10@1+ (0.005,0) [0|5.115] "" Vector__XXX
 SG_ VCBATT1_a417_brickVoltageMax m417 : 26|10@1+ (0.005,0) [0|5.115] "" Vector__XXX
 SG_ VCBATT1_a417_packCurrent m417 : 36|10@1- (5,0) [-2560|2555] "" Vector__XXX
 SG_ VCBATT1_a417_socMax m417 : 46|8@1+ (0.5,0) [0|127.5] "" Vector__XXX
 SG_ VCBATT1_a417_brickId m417 : 54|8@1+ (1,1) [1|256] "" Vector__XXX
 SG_ VCBATT1_a418_brickVoltageMin m418 : 16|10@1+ (0.005,0) [0|5.115] "" Vector__XXX
 SG_ VCBATT1_a418_brickVoltageMax m418 : 26|10@1+ (0.005,0) [0|5.115] "" Vector__XXX
 SG_ VCBATT1_a418_packCurrent m418 : 36|10@1- (5,0) [-2560|2555] "" Vector__XXX
 SG_ VCBATT1_a418_socMax m418 : 46|8@1+ (0.5,0) [0|127.5] "" Vector__XXX
 SG_ VCBATT1_a418_brickId m418 : 54|8@1+ (1,1) [1|256] "" Vector__XXX
 SG_ VCBATT1_a419_brickVoltageMin m419 : 16|10@1+ (0.005,0) [0|5.115] "" Vector__XXX
 SG_ VCBATT1_a419_brickVoltageMax m419 : 26|10@1+ (0.005,0) [0|5.115] "" Vector__XXX
 SG_ VCBATT1_a419_packCurrent m419 : 36|10@1- (5,0) [-2560|2555] "" Vector__XXX
 SG_ VCBATT1_a419_socMin m419 : 46|8@1+ (0.5,0) [0|127.5] "" Vector__XXX
 SG_ VCBATT1_a419_brickId m419 : 54|8@1+ (1,1) [1|256] "" Vector__XXX
 SG_ VCBATT1_a421_vehiclePowerState m421 : 16|2@1+ (1,0) [0|3] "" Vector__XXX
 SG_ VCBATT1_a421_LVBMSSOC m421 : 18|5@1+ (3,0) [0|93] "" Vector__XXX
 SG_ VCBATT1_a421_capacityTestUrgency m421 : 24|3@1+ (1,0) [0|7] "" Vector__XXX
 SG_ VCBATT1_a421_energyActiveDecel m421 : 27|1@1+ (1,0) [0|1] "" Vector__XXX
 SG_ VCBATT1_a421_energyCriticalPullo m421 : 28|1@1+ (1,0) [0|1] "" Vector__XXX
 SG_ VCBATT1_a421_powerActiveDecel m421 : 29|1@1+ (1,0) [0|1] "" Vector__XXX
 SG_ VCBATT1_a423_brickVoltageMin m423 : 16|10@1+ (0.005,0) [0|5.115] "" Vector__XXX
 SG_ VCBATT1_a423_brickVoltageMax m423 : 26|10@1+ (0.005,0) [0|5.115] "" Vector__XXX
 SG_ VCBATT1_a423_packCurrent m423 : 36|10@1- (5,0) [-2560|2555] "" Vector__XXX
 SG_ VCBATT1_a423_socMin m423 : 46|8@1+ (0.5,0) [0|127.5] "" Vector__XXX
 SG_ VCBATT1_a423_brickId m423 : 54|8@1+ (1,1) [1|256] "" Vector__XXX
 SG_ VCBATT1_a424_brickVoltageMin m424 : 16|10@1+ (0.005,0) [0|5.115] "" Vector__XXX
 SG_ VCBATT1_a424_brickVoltageMax m424 : 26|10@1+ (0.005,0) [0|5.115] "" Vector__XXX
 SG_ VCBATT1_a424_packCurrent m424 : 36|10@1- (5,0) [-2560|2555] "" Vector__XXX
 SG_ VCBATT1_a424_socMin m424 : 46|8@1+ (0.5,0) [0|127.5] "" Vector__XXX
 SG_ VCBATT1_a424_brickId m424 : 54|8@1+ (1,1) [1|256] "" Vector__XXX
 SG_ VCBATT1_a431_netPackCurrent m431 : 16|16@1- (0.1,0) [-3276.8|3276.7] "" Vector__XXX
 SG_ VCBATT1_a431_maxChargeCurrentLim m431 : 32|16@1- (0.1,0) [-3276.8|3276.7] "" Vector__XXX
 SG_ VCBATT1_a431_hvjbCurrentLimit m431 : 48|16@1- (0.1,0) [-3276.8|3276.7] "" Vector__XXX
 SG_ VCBATT1_a432_targetCurrent m432 : 16|16@1- (0.1,0) [-3276.8|3276.7] "" Vector__XXX
 SG_ VCBATT1_a432_packCurrent m432 : 32|16@1- (0.1,0) [-3276.8|3276.7] "" Vector__XXX
 SG_ VCBATT1_a433_bmbModuleId m433 : 16|16@1+ (1,0) [0|65535] "" Vector__XXX
 SG_ VCBATT1_a433_packTypeData m433 : 32|8@1+ (1,0) [0|255] "" Vector__XXX
 SG_ VCBATT1_a433_cellTypeData m433 : 40|8@1+ (1,0) [0|255] "" Vector__XXX
 SG_ VCBATT1_a433_bmbModuleIdValid m433 : 48|1@1+ (1,0) [0|1] "" Vector__XXX
 SG_ VCBATT1_a433_useBmbModuleId m433 : 49|1@1+ (1,0) [0|1] "" Vector__XXX
 SG_ VCBATT1_a434_bmbModuleId m434 : 16|16@1+ (1,0) [0|65535] "" Vector__XXX
 SG_ VCBATT1_a434_packTypeData m434 : 32|8@1+ (1,0) [0|255] "" Vector__XXX
 SG_ VCBATT1_a434_cellTypeData m434 : 40|8@1+ (1,0) [0|255] "" Vector__XXX
 SG_ VCBATT1_a434_bmbModuleIdValid m434 : 48|1@1+ (1,0) [0|1] "" Vector__XXX
 SG_ VCBATT1_a434_useBmbModuleId m434 : 49|1@1+ (1,0) [0|1] "" Vector__XXX
 SG_ VCBATT1_a436_netPackCurrent m436 : 16|16@1- (0.1,0) [-3276.8|3276.7] "" Vector__XXX
 SG_ VCBATT1_a436_maxDischargeCurrent m436 : 32|16@1- (0.1,0) [-3276.8|3276.7] "" Vector__XXX
 SG_ VCBATT1_a436_hvjbCurrentLimit m436 : 48|16@1- (0.1,0) [-3276.8|3276.7] "" Vector__XXX
 SG_ VCBATT1_a437_nvmDataMissingA m437 : 16|1@1+ (1,0) [0|1] "" Vector__XXX
 SG_ VCBATT1_a437_nvmDataMissingB m437 : 17|1@1+ (1,0) [0|1] "" Vector__XXX
 SG_ VCBATT1_a438_temperature m438 : 16|16@1+ (0.01,0) [0|655.35] "" Vector__XXX
 SG_ VCBATT1_a438_sensorId m438 : 32|6@1+ (1,1) [1|64] "" Vector__XXX
 SG_ VCBATT1_a439_temperature m439 : 16|16@1+ (0.01,0) [0|655.35] "" Vector__XXX
 SG_ VCBATT1_a439_sensorId m439 : 32|6@1+ (1,1) [1|64] "" Vector__XXX
 SG_ VCBATT1_a441_bmbModuleId m441 : 16|16@1+ (1,0) [0|65535] "" Vector__XXX
 SG_ VCBATT1_a441_bmbModuleIdPrev m441 : 32|16@1+ (1,0) [0|65535] "" Vector__XXX
 SG_ VCBATT1_a446_cell1Voltage m446 : 16|9@1+ (0.01,0) [0|5.11] "" Vector__XXX
 SG_ VCBATT1_a446_cell2Voltage m446 : 25|9@1+ (0.01,0) [0|5.11] "" Vector__XXX
 SG_ VCBATT1_a446_cell3Voltage m446 : 34|9@1+ (0.01,0) [0|5.11] "" Vector__XXX
 SG_ VCBATT1_a446_cell4Voltage m446 : 43|9@1+ (0.01,0) [0|5.11] "" Vector__XXX
 SG_ VCBATT1_a446_sumCellVoltage m446 : 52|8@1+ (0.1,0) [0|25.5] "" Vector__XXX
 SG_ VCBATT1_a446_deepDischargeFlag m446 : 60|1@1+ (1,0) [0|1] "" Vector__XXX
 SG_ VCBATT1_a446_serviceMode m446 : 61|1@1+ (1,0) [0|1] "" Vector__XXX
 SG_ VCBATT1_a446_frunkOpen m446 : 62|1@1+ (1,0) [0|1] "" Vector__XXX
 SG_ VCBATT1_a462_CellOVLevel1 m462 : 16|1@1+ (1,0) [0|1] "" Vector__XXX
 SG_ VCBATT1_a462_CellOVLevel2 m462 : 17|1@1+ (1,0) [0|1] "" Vector__XXX
 SG_ VCBATT1_a462_CellOVLevel3 m462 : 18|1@1+ (1,0) [0|1] "" Vector__XXX
 SG_ VCBATT1_a462_CellUVLevel1 m462 : 19|1@1+ (1,0) [0|1] "" Vector__XXX
 SG_ VCBATT1_a462_CellUVLevel2 m462 : 20|1@1+ (1,0) [0|1] "" Vector__XXX
 SG_ VCBATT1_a462_ModuleOTLevel1 m462 : 21|1@1+ (1,0) [0|1] "" Vector__XXX
 SG_ VCBATT1_a462_PackOVLevel1 m462 : 22|1@1+ (1,0) [0|1] "" Vector__XXX
 SG_ VCBATT1_a462_PackOVLevel2 m462 : 23|1@1+ (1,0) [0|1] "" Vector__XXX
 SG_ VCBATT1_a462_DischrgOCLevel1 m462 : 24|1@1+ (1,0) [0|1] "" Vector__XXX
 SG_ VCBATT1_a462_HardwareOCLevel2 m462 : 25|1@1+ (1,0) [0|1] "" Vector__XXX
 SG_ VCBATT1_a462_ChrgOCLevel1 m462 : 26|1@1+ (1,0) [0|1] "" Vector__XXX
 SG_ VCBATT1_a462_ChrgOCLevel2 m462 : 27|1@1+ (1,0) [0|1] "" Vector__XXX
 SG_ VCBATT1_a462_MOSFETOTLevel1 m462 : 28|1@1+ (1,0) [0|1] "" Vector__XXX
 SG_ VCBATT1_a462_CPA_State m462 : 29|1@1+ (1,0) [0|1] "" Vector__XXX
 SG_ VCBATT1_a462_NTCTempDiffWarnLeve m462 : 30|1@1+ (1,0) [0|1] "" Vector__XXX
 SG_ VCBATT1_a462_KBValueLostFault m462 : 31|1@1+ (1,0) [0|1] "" Vector__XXX
 SG_ VCBATT1_a462_BalanceCircuitFault m462 : 32|1@1+ (1,0) [0|1] "" Vector__XXX
 SG_ VCBATT1_a462_MOSOpenFault m462 : 33|1@1+ (1,0) [0|1] "" Vector__XXX
 SG_ VCBATT1_a462_DeepDischarge m462 : 34|1@1+ (1,0) [0|1] "" Vector__XXX
 SG_ VCBATT1_a462_SamplingError m462 : 35|1@1+ (1,0) [0|1] "" Vector__XXX
 SG_ VCBATT1_a462_MOSFETStuckClose m462 : 36|1@1+ (1,0) [0|1] "" Vector__XXX
 SG_ VCBATT1_a462_MOSFETStuckOpen m462 : 37|1@1+ (1,0) [0|1] "" Vector__XXX
 SG_ VCBATT1_a462_Imbalance m462 : 38|1@1+ (1,0) [0|1] "" Vector__XXX
 SG_ VCBATT1_a462_serviceMode m462 : 39|1@1+ (1,0) [0|1] "" Vector__XXX
 SG_ VCBATT1_a462_frunkOpen m462 : 40|1@1+ (1,0) [0|1] "" Vector__XXX
 SG_ VCBATT1_a475_channel m475 : 16|3@1+ (1,0) [0|7] "" Vector__XXX
 SG_ VCBATT1_a475_reset m475 : 19|1@1+ (1,0) [0|1] "" Vector__XXX
 SG_ VCBATT1_a475_spiError m475 : 20|1@1+ (1,0) [0|1] "" Vector__XXX
 SG_ VCBATT1_a475_autoOn m475 : 21|1@1+ (1,0) [0|1] "" Vector__XXX
 SG_ VCBATT1_a475_diagnosticBit m475 : 22|1@1+ (1,0) [0|1] "" Vector__XXX
 SG_ VCBATT1_a475_deviceError m475 : 23|1@1+ (1,0) [0|1] "" Vector__XXX
 SG_ VCBATT1_a475_unexpectedLock m475 : 24|1@1+ (1,0) [0|1] "" Vector__XXX
 SG_ VCBATT1_a475_unexpectedFailSafe m475 : 25|1@1+ (1,0) [0|1] "" Vector__XXX
 SG_ VCBATT1_a475_disableOutputFault m475 : 26|1@1+ (1,0) [0|1] "" Vector__XXX
 SG_ VCBATT1_a475_vsUndervoltage m475 : 27|1@1+ (1,0) [0|1] "" Vector__XXX
 SG_ VCBATT1_a475_hardShort m475 : 28|1@1+ (1,0) [0|1] "" Vector__XXX
 SG_ VCBATT1_a475_prechargeFailure m475 : 29|1@1+ (1,0) [0|1] "" Vector__XXX
 SG_ VCBATT1_a475_vdsMax m475 : 30|1@1+ (1,0) [0|1] "" Vector__XXX
 SG_ VCBATT1_a475_bypassSaturation m475 : 31|1@1+ (1,0) [0|1] "" Vector__XXX
 SG_ VCBATT1_a475_fuseLatch m475 : 32|1@1+ (1,0) [0|1] "" Vector__XXX
 SG_ VCBATT1_a475_deviceOvertemperatu m475 : 33|1@1+ (1,0) [0|1] "" Vector__XXX
 SG_ VCBATT1_a475_ntcOvertemperature m475 : 34|1@1+ (1,0) [0|1] "" Vector__XXX
 SG_ VCBATT1_a475_vgsLow m475 : 35|1@1+ (1,0) [0|1] "" Vector__XXX
 SG_ VCBATT1_a475_chargePumpLow m475 : 36|1@1+ (1,0) [0|1] "" Vector__XXX
 SG_ VCBATT1_a475_watchdog m475 : 37|1@1+ (1,0) [0|1] "" Vector__XXX
 SG_ VCBATT1_a475_spiNotDone m475 : 38|1@1+ (1,0) [0|1] "" Vector__XXX
 SG_ VCBATT1_a475_csUndervoltage m475 : 39|1@1+ (1,0) [0|1] "" Vector__XXX
 SG_ VCBATT1_a475_configIncorrect m475 : 40|1@1+ (1,0) [0|1] "" Vector__XXX
 SG_ VCBATT1_a475_bufferFull m475 : 41|1@1+ (1,0) [0|1] "" Vector__XXX
 SG_ VCBATT1_a475_hitAlertRateLimit m475 : 42|1@1+ (1,0) [0|1] "" Vector__XXX
 SG_ VCBATT1_a475_hwlo m475 : 43|1@1+ (1,0) [0|1] "" Vector__XXX
 SG_ VCBATT1_a475_dinState m475 : 44|1@1+ (1,0) [0|1] "" Vector__XXX
 SG_ VCBATT1_a475_enable m475 : 45|1@1+ (1,0) [0|1] "" Vector__XXX
 SG_ VCBATT1_a476_FRM1_timedOut m476 : 16|1@1+ (1,0) [0|1] "" Vector__XXX
 SG_ VCBATT1_a476_FRM2_timedOut m476 : 17|1@1+ (1,0) [0|1] "" Vector__XXX
 SG_ VCBATT1_a476_FRM3_timedOut m476 : 18|1@1+ (1,0) [0|1] "" Vector__XXX
 SG_ VCBATT1_a476_FRM4_timedOut m476 : 19|1@1+ (1,0) [0|1] "" Vector__XXX
 SG_ VCBATT1_a476_FRM5_timedOut m476 : 20|1@1+ (1,0) [0|1] "" Vector__XXX
 SG_ VCBATT1_a476_FRM6_timedOut m476 : 21|1@1+ (1,0) [0|1] "" Vector__XXX
 SG_ VCBATT1_a476_FRM7_timedOut m476 : 22|1@1+ (1,0) [0|1] "" Vector__XXX
 SG_ VCBATT1_a476_FRM8_timedOut m476 : 23|1@1+ (1,0) [0|1] "" Vector__XXX
 SG_ VCBATT1_a476_FRM9_timedOut m476 : 24|1@1+ (1,0) [0|1] "" Vector__XXX
 SG_ VCBATT1_a476_FRM10_timedOut m476 : 25|1@1+ (1,0) [0|1] "" Vector__XXX
 SG_ VCBATT1_a476_FRM11_timedOut m476 : 26|1@1+ (1,0) [0|1] "" Vector__XXX
 SG_ VCBATT1_a476_FRM12_timedOut m476 : 27|1@1+ (1,0) [0|1] "" Vector__XXX
 SG_ VCBATT1_a476_factoryMode m476 : 28|1@1+ (1,0) [0|1] "" Vector__XXX
 SG_ VCBATT1_a476_serviceMode m476 : 29|1@1+ (1,0) [0|1] "" Vector__XXX
 SG_ VCBATT1_a476_transportMode m476 : 30|1@1+ (1,0) [0|1] "" Vector__XXX
 SG_ VCBATT1_a476_frunkOpen m476 : 31|1@1+ (1,0) [0|1] "" Vector__XXX
 SG_ VCBATT1_a476_vehiclePowerState m476 : 32|2@1+ (1,0) [0|3] "" Vector__XXX
 SG_ VCBATT1_a476_batterySMState m476 : 34|4@1+ (1,0) [0|15] "" Vector__XXX
 SG_ VCBATT1_a476_ECPAState m476 : 38|2@1+ (1,0) [0|3] "" Vector__XXX
 SG_ VCBATT1_a477_cell1Voltage m477 : 16|9@1+ (0.01,0) [0|5.11] "" Vector__XXX
 SG_ VCBATT1_a477_cell2Voltage m477 : 25|9@1+ (0.01,0) [0|5.11] "" Vector__XXX
 SG_ VCBATT1_a477_cell3Voltage m477 : 34|9@1+ (0.01,0) [0|5.11] "" Vector__XXX
 SG_ VCBATT1_a477_cell4Voltage m477 : 43|9@1+ (0.01,0) [0|5.11] "" Vector__XXX
 SG_ VCBATT1_a477_sumCellVoltage m477 : 52|8@1+ (0.1,0) [0|25.5] "" Vector__XXX
 SG_ VCBATT1_a477_deepDischargeFlag m477 : 60|1@1+ (1,0) [0|1] "" Vector__XXX
 SG_ VCBATT1_a477_serviceMode m477 : 61|1@1+ (1,0) [0|1] "" Vector__XXX
 SG_ VCBATT1_a477_frunkOpen m477 : 62|1@1+ (1,0) [0|1] "" Vector__XXX
 SG_ VCBATT1_a478_battFaultPackOverVo m478 : 16|1@1+ (1,0) [0|1] "" Vector__XXX
 SG_ VCBATT1_a478_battFaultHardwareOv m478 : 17|1@1+ (1,0) [0|1] "" Vector__XXX
 SG_ VCBATT1_a478_battFaultChargeOver m478 : 18|1@1+ (1,0) [0|1] "" Vector__XXX
 SG_ VCBATT1_a478_battFaultCellUnderV m478 : 19|1@1+ (1,0) [0|1] "" Vector__XXX
 SG_ VCBATT1_a478_battFaultCellOverVo m478 : 20|1@1+ (1,0) [0|1] "" Vector__XXX
 SG_ VCBATT1_a478_vehiclePowerState m478 : 21|2@1+ (1,0) [0|3] "" Vector__XXX
 SG_ VCBATT1_a478_batterySMState m478 : 24|4@1+ (1,0) [0|15] "" Vector__XXX
 SG_ VCBATT1_a478_bmsState m478 : 28|4@1+ (1,0) [0|15] "" Vector__XXX
 SG_ VCBATT1_a478_dcdcLVSupportStatus m478 : 32|2@1+ (1,0) [0|3] "" Vector__XXX
 SG_ VCBATT1_a478_factoryMode m478 : 34|1@1+ (1,0) [0|1] "" Vector__XXX
 SG_ VCBATT1_a478_serviceMode m478 : 35|1@1+ (1,0) [0|1] "" Vector__XXX
 SG_ VCBATT1_a478_transportMode m478 : 36|1@1+ (1,0) [0|1] "" Vector__XXX
 SG_ VCBATT1_a478_notEnoughPowerForSu m478 : 37|1@1+ (1,0) [0|1] "" Vector__XXX
 SG_ VCBATT1_a478_crashDetected m478 : 38|1@1+ (1,0) [0|1] "" Vector__XXX
 SG_ VCBATT1_a478_BMS_MIA m478 : 39|1@1+ (1,0) [0|1] "" Vector__XXX
 SG_ VCBATT1_a478_PCS_MIA m478 : 40|1@1+ (1,0) [0|1] "" Vector__XXX
 SG_ VCBATT1_a478_HVBlockingMismatch m478 : 41|1@1+ (1,0) [0|1] "" Vector__XXX
 SG_ VCBATT1_a478_HV_UP m478 : 42|1@1+ (1,0) [0|1] "" Vector__XXX
 SG_ VCBATT1_a478_pcsEFuseStable m478 : 43|1@1+ (1,0) [0|1] "" Vector__XXX
 SG_ VCBATT1_a478_vcrightEFuseStable m478 : 44|1@1+ (1,0) [0|1] "" Vector__XXX
 SG_ VCBATT1_a478_contactorEFuseStabl m478 : 45|1@1+ (1,0) [0|1] "" Vector__XXX
 SG_ VCBATT1_a478_hvcEFuseStable m478 : 46|1@1+ (1,0) [0|1] "" Vector__XXX
 SG_ VCBATT1_a478_frunkOpen m478 : 47|1@1+ (1,0) [0|1] "" Vector__XXX
 SG_ VCBATT1_a479_FRM3_timedOut m479 : 16|1@1+ (1,0) [0|1] "" Vector__XXX
 SG_ VCBATT1_a479_ECPAState m479 : 17|2@1+ (1,0) [0|3] "" Vector__XXX
 SG_ VCBATT1_a479_factoryMode m479 : 19|1@1+ (1,0) [0|1] "" Vector__XXX
 SG_ VCBATT1_a479_serviceMode m479 : 20|1@1+ (1,0) [0|1] "" Vector__XXX
 SG_ VCBATT1_a479_transportMode m479 : 21|1@1+ (1,0) [0|1] "" Vector__XXX
 SG_ VCBATT1_a479_frunkLatchStatus m479 : 24|4@1+ (1,0) [0|15] "" Vector__XXX
 SG_ VCBATT1_a479_vehiclePowerState m479 : 28|2@1+ (1,0) [0|3] "" Vector__XXX
 SG_ VCBATT1_a479_batterySMState m479 : 32|4@1+ (1,0) [0|15] "" Vector__XXX
 SG_ VCBATT1_a480_channel m480 : 16|2@1+ (1,0) [0|3] "" Vector__XXX
 SG_ VCBATT1_a480_reset m480 : 18|1@1+ (1,0) [0|1] "" Vector__XXX
 SG_ VCBATT1_a480_spiError m480 : 19|1@1+ (1,0) [0|1] "" Vector__XXX
 SG_ VCBATT1_a480_autoOn m480 : 20|1@1+ (1,0) [0|1] "" Vector__XXX
 SG_ VCBATT1_a480_diagnosticBit m480 : 21|1@1+ (1,0) [0|1] "" Vector__XXX
 SG_ VCBATT1_a480_deviceError m480 : 22|1@1+ (1,0) [0|1] "" Vector__XXX
 SG_ VCBATT1_a480_overcurrent m480 : 23|1@1+ (1,0) [0|1] "" Vector__XXX
 SG_ VCBATT1_a480_unexpectedLock m480 : 24|1@1+ (1,0) [0|1] "" Vector__XXX
 SG_ VCBATT1_a480_disableOutputFault m480 : 25|1@1+ (1,0) [0|1] "" Vector__XXX
 SG_ VCBATT1_a480_vsUndervoltage m480 : 26|1@1+ (1,0) [0|1] "" Vector__XXX
 SG_ VCBATT1_a480_hardShort m480 : 27|1@1+ (1,0) [0|1] "" Vector__XXX
 SG_ VCBATT1_a480_vdsMax m480 : 28|1@1+ (1,0) [0|1] "" Vector__XXX
 SG_ VCBATT1_a480_bypassSaturation m480 : 29|1@1+ (1,0) [0|1] "" Vector__XXX
 SG_ VCBATT1_a480_fuseLatch m480 : 30|1@1+ (1,0) [0|1] "" Vector__XXX
 SG_ VCBATT1_a480_deviceOvertemperatu m480 : 31|1@1+ (1,0) [0|1] "" Vector__XXX
 SG_ VCBATT1_a480_ntcOvertemperature m480 : 32|1@1+ (1,0) [0|1] "" Vector__XXX
 SG_ VCBATT1_a480_vgsLow m480 : 33|1@1+ (1,0) [0|1] "" Vector__XXX
 SG_ VCBATT1_a480_chargePumpLow m480 : 34|1@1+ (1,0) [0|1] "" Vector__XXX
 SG_ VCBATT1_a480_watchdog m480 : 35|1@1+ (1,0) [0|1] "" Vector__XXX
 SG_ VCBATT1_a480_spiNotDone m480 : 36|1@1+ (1,0) [0|1] "" Vector__XXX
 SG_ VCBATT1_a480_configIncorrect m480 : 37|1@1+ (1,0) [0|1] "" Vector__XXX
 SG_ VCBATT1_a480_bufferFull m480 : 38|1@1+ (1,0) [0|1] "" Vector__XXX
 SG_ VCBATT1_a480_hitAlertRateLimit m480 : 39|1@1+ (1,0) [0|1] "" Vector__XXX
 SG_ VCBATT1_a480_hwlo m480 : 40|1@1+ (1,0) [0|1] "" Vector__XXX
 SG_ VCBATT1_a480_enable m480 : 41|1@1+ (1,0) [0|1] "" Vector__XXX
 SG_ VCBATT1_a482_lvBridgeEFuseCurren m482 : 16|16@1+ (0.1,0) [0|6553.5] "" Vector__XXX
 SG_ VCBATT1_a482_lvBridgeEFuseVoltag m482 : 32|16@1+ (0.1,0) [0|6553.5] "" Vector__XXX
 SG_ VCBATT1_a482_lvBridgeEFuseTemp m482 : 48|11@1+ (0.125,-40) [-40|215.875] "" Vector__XXX
 SG_ VCBATT1_a482_lvBridgeEFuseRemain m482 : 59|4@1+ (1,0) [0|15] "" Vector__XXX
 SG_ VCBATT1_a484_upstreamEFuseStuckO m484 : 16|1@1+ (1,0) [0|1] "" Vector__XXX
 SG_ VCBATT1_a484_upstreamEFuseVoltag m484 : 17|6@1+ (1,0) [0|63] "" Vector__XXX
 SG_ VCBATT1_a484_vbusVoltage m484 : 24|6@1+ (1,0) [0|63] "" Vector__XXX
 SG_ VCBATT1_a484_upstreamEFuseRatio m484 : 32|7@1+ (1,0) [0|127] "" Vector__XXX
 SG_ VCBATT1_a485_upstreamEfuseUnatte m485 : 16|1@1+ (1,0) [0|1] "" Vector__XXX
 SG_ VCBATT1_a486_bridgeFailedArmingS m486 : 16|1@1+ (1,0) [0|1] "" Vector__XXX
 SG_ VCBATT1_a486_bridgeFailedSyncChe m486 : 17|1@1+ (1,0) [0|1] "" Vector__XXX
 SG_ VCBATT1_a486_localBridgeOutputOn m486 : 18|1@1+ (1,0) [0|1] "" Vector__XXX
 SG_ VCBATT1_a486_localBridgeSyncArme m486 : 19|1@1+ (1,0) [0|1] "" Vector__XXX
 SG_ VCBATT1_a486_localBridgeDinState m486 : 20|1@1+ (1,0) [0|1] "" Vector__XXX
 SG_ VCBATT1_a486_remoteBridgeOutputO m486 : 21|1@1+ (1,0) [0|1] "" Vector__XXX
 SG_ VCBATT1_a486_remoteBridgeOu_0001 m486 : 22|1@1+ (1,0) [0|1] "" Vector__XXX
 SG_ VCBATT1_a486_remoteBridgeSyncArm m486 : 23|1@1+ (1,0) [0|1] "" Vector__XXX
 SG_ VCBATT1_a486_remoteBridgeSy_0001 m486 : 24|1@1+ (1,0) [0|1] "" Vector__XXX
 SG_ VCBATT1_a486_remoteBridgeDinStat m486 : 25|1@1+ (1,0) [0|1] "" Vector__XXX
 SG_ VCBATT1_a486_remoteBridgeDi_0001 m486 : 26|1@1+ (1,0) [0|1] "" Vector__XXX
 SG_ VCBATT1_a493_minBrickSocId m493 : 16|7@1+ (1,1) [1|128] "" Vector__XXX
 SG_ VCBATT1_a493_minBrickSocByOcvMax m493 : 24|8@1+ (0.5,0) [0|127.5] "" Vector__XXX
 SG_ VCBATT1_a493_maxBrickSocId m493 : 32|7@1+ (1,1) [1|128] "" Vector__XXX
 SG_ VCBATT1_a493_maxBrickSocByOcvMin m493 : 40|8@1+ (0.5,0) [0|127.5] "" Vector__XXX
 SG_ VCBATT1_a493_maxBrickSoc m493 : 48|7@1+ (1,0) [0|127] "" Vector__XXX
 SG_ VCBATT1_a493_avgBrickSoc m493 : 56|7@1+ (1,0) [0|127] "" Vector__XXX
 SG_ VCBATT1_a495_SoCUnrecoverable m495 : 16|1@1+ (1,0) [0|1] "" Vector__XXX
 SG_ VCBATT1_a495_SocTooLow m495 : 17|1@1+ (1,0) [0|1] "" Vector__XXX
 SG_ VCBATT1_a495_retryExpended m495 : 18|1@1+ (1,0) [0|1] "" Vector__XXX
 SG_ VCBATT1_a495_LVBMSMIA m495 : 19|1@1+ (1,0) [0|1] "" Vector__XXX
 SG_ VCBATT1_a495_reverseBatteryEFuse m495 : 20|1@1+ (1,0) [0|1] "" Vector__XXX
 SG_ VCBATT1_a495_DCDCOff m495 : 21|1@1+ (1,0) [0|1] "" Vector__XXX
 SG_ VCBATT1_a495_HVOff m495 : 22|1@1+ (1,0) [0|1] "" Vector__XXX
 SG_ VCBATT1_a495_externalInteraction m495 : 23|1@1+ (1,0) [0|1] "" Vector__XXX
 SG_ VCBATT1_a495_serviceMode m495 : 24|1@1+ (1,0) [0|1] "" Vector__XXX
 SG_ VCBATT1_a495_frunkOpen m495 : 25|1@1+ (1,0) [0|1] "" Vector__XXX
 SG_ VCBATT1_a495_externalPowerSupply m495 : 26|1@1+ (1,0) [0|1] "" Vector__XXX
 SG_ VCBATT1_a496_reverseBatteryEFuse m496 : 16|1@1+ (1,0) [0|1] "" Vector__XXX
 SG_ VCBATT1_a496_vehicleLoadShedActi m496 : 17|1@1+ (1,0) [0|1] "" Vector__XXX
 SG_ VCBATT1_a496_MOSState m496 : 18|2@1+ (1,0) [0|3] "" Vector__XXX
 SG_ VCBATT1_a496_serviceMode m496 : 20|1@1+ (1,0) [0|1] "" Vector__XXX
 SG_ VCBATT1_a496_frunkOpen m496 : 21|1@1+ (1,0) [0|1] "" Vector__XXX
 SG_ VCBATT1_a496_PCS_MIA m496 : 22|1@1+ (1,0) [0|1] "" Vector__XXX
 SG_ VCBATT1_a496_NotEnoughPowerForSu m496 : 23|1@1+ (1,0) [0|1] "" Vector__XXX
 SG_ VCBATT1_a496_bmsState m496 : 24|4@1+ (1,0) [0|15] "" Vector__XXX
 SG_ VCBATT1_a497_serviceMode m497 : 16|1@1+ (1,0) [0|1] "" Vector__XXX
 SG_ VCBATT1_a497_FactoryMode m497 : 17|1@1+ (1,0) [0|1] "" Vector__XXX
 SG_ VCBATT1_a497_SOC m497 : 24|7@1+ (1,0) [0|127] "" Vector__XXX
 SG_ VCBATT1_a497_PackCurrent m497 : 32|12@1+ (0.2,-600) [-600|219] "" Vector__XXX
 SG_ VCBATT1_a497_SumCellVoltage m497 : 48|8@1+ (0.1,0) [0|25.5] "" Vector__XXX
 SG_ VCBATT1_a497_frunkOpen m497 : 56|1@1+ (1,0) [0|1] "" Vector__XXX
 SG_ VCBATT1_a500_channel m500 : 16|8@1+ (1,0) [0|255] "" Vector__XXX
 SG_ VCBATT1_a500_mismatchedState m500 : 24|3@1+ (1,0) [0|7] "" Vector__XXX
 SG_ VCBATT1_a503_brickVoltageMin m503 : 16|10@1+ (0.005,0) [0|5.115] "" Vector__XXX
 SG_ VCBATT1_a503_brickVoltageMax m503 : 26|10@1+ (0.005,0) [0|5.115] "" Vector__XXX
 SG_ VCBATT1_a503_packCurrent m503 : 36|10@1- (5,0) [-2560|2555] "" Vector__XXX
 SG_ VCBATT1_a503_socMax m503 : 46|8@1+ (0.5,0) [0|127.5] "" Vector__XXX
 SG_ VCBATT1_a503_brickId m503 : 54|8@1+ (1,1) [1|256] "" Vector__XXX
 SG_ VCBATT1_a509_channel m509 : 16|3@1+ (1,0) [0|7] "" Vector__XXX
 SG_ VCBATT1_a509_state m509 : 19|3@1+ (1,0) [0|7] "" Vector__XXX
 SG_ VCBATT1_a509_expectedState m509 : 24|3@1+ (1,0) [0|7] "" Vector__XXX
 SG_ VCBATT1_a509_hardwareLockout m509 : 27|1@1+ (1,0) [0|1] "" Vector__XXX
 SG_ VCBATT1_a509_unlocksRemaining m509 : 32|8@1+ (1,0) [0|255] "" Vector__XXX
 SG_ VCBATT1_a510_sumCellVoltage m510 : 16|8@1+ (0.1,0) [0|25.5] "" Vector__XXX
 SG_ VCBATT1_a510_packVoltage m510 : 24|8@1+ (0.1,0) [0|25.5] "" Vector__XXX
 SG_ VCBATT1_a510_targetPCSVoltage m510 : 32|8@1+ (0.1,0) [0|25.5] "" Vector__XXX
 SG_ VCBATT1_a510_serviceMode m510 : 40|1@1+ (1,0) [0|1] "" Vector__XXX
 SG_ VCBATT1_a510_frunkOpen m510 : 41|1@1+ (1,0) [0|1] "" Vector__XXX
 SG_ VCBATT1_a512_packVoltageInt_0001 m512 : 16|8@1+ (0.1,0) [0|25.5] "" Vector__XXX
 SG_ VCBATT1_a512_packVoltageInterval m512 : 24|8@1+ (0.1,0) [0|25.5] "" Vector__XXX
 SG_ VCBATT1_a512_packTemperature m512 : 32|8@1+ (1,-40) [-40|215] "" Vector__XXX
 SG_ VCBATT1_a512_sumCellVoltage m512 : 40|8@1+ (0.1,0) [0|25.5] "" Vector__XXX
 SG_ VCBATT1_a512_overcurrentDirectio m512 : 48|2@1+ (1,0) [0|3] "" Vector__XXX
 SG_ VCBATT1_a512_serviceMode m512 : 50|1@1+ (1,0) [0|1] "" Vector__XXX
 SG_ VCBATT1_a512_frunkOpen m512 : 51|1@1+ (1,0) [0|1] "" Vector__XXX
 SG_ VCBATT1_a512_vehiclePowerState m512 : 52|2@1+ (1,0) [0|3] "" Vector__XXX
 SG_ VCBATT1_a513_packCurrent m513 : 16|12@1+ (0.2,-600) [-600|219] "" Vector__XXX
 SG_ VCBATT1_a513_packTemperature m513 : 32|8@1+ (1,-40) [-40|215] "" Vector__XXX
 SG_ VCBATT1_a513_packVoltage m513 : 40|8@1+ (0.1,0) [0|25.5] "" Vector__XXX
 SG_ VCBATT1_a513_packSOC m513 : 48|10@1+ (0.1,0) [0|102.3] "" Vector__XXX
 SG_ VCBATT1_a513_serviceMode m513 : 58|1@1+ (1,0) [0|1] "" Vector__XXX
 SG_ VCBATT1_a513_frunkOpen m513 : 59|1@1+ (1,0) [0|1] "" Vector__XXX
 SG_ VCBATT1_a513_vehiclePowerState m513 : 60|2@1+ (1,0) [0|3] "" Vector__XXX
 SG_ VCBATT1_a514_cell1Voltage m514 : 16|7@1+ (0.08,0) [0|10.16] "" Vector__XXX
 SG_ VCBATT1_a514_cell2Voltage m514 : 23|7@1+ (0.08,0) [0|10.16] "" Vector__XXX
 SG_ VCBATT1_a514_cell3Voltage m514 : 30|7@1+ (0.08,0) [0|10.16] "" Vector__XXX
 SG_ VCBATT1_a514_cell4Voltage m514 : 37|7@1+ (0.08,0) [0|10.16] "" Vector__XXX
 SG_ VCBATT1_a514_packVoltage m514 : 44|8@1+ (0.1,0) [0|25.5] "" Vector__XXX
 SG_ VCBATT1_a514_packSOC m514 : 52|8@1+ (0.4,0) [0|102] "" Vector__XXX
 SG_ VCBATT1_a514_serviceMode m514 : 60|1@1+ (1,0) [0|1] "" Vector__XXX
 SG_ VCBATT1_a514_frunkOpen m514 : 61|1@1+ (1,0) [0|1] "" Vector__XXX
 SG_ VCBATT1_a514_vehiclePowerState m514 : 62|2@1+ (1,0) [0|3] "" Vector__XXX
 SG_ VCBATT1_a515_cell1Voltage m515 : 16|7@1+ (0.08,0) [0|10.16] "" Vector__XXX
 SG_ VCBATT1_a515_cell2Voltage m515 : 23|7@1+ (0.08,0) [0|10.16] "" Vector__XXX
 SG_ VCBATT1_a515_cell3Voltage m515 : 30|7@1+ (0.08,0) [0|10.16] "" Vector__XXX
 SG_ VCBATT1_a515_cell4Voltage m515 : 37|7@1+ (0.08,0) [0|10.16] "" Vector__XXX
 SG_ VCBATT1_a515_packVoltage m515 : 44|8@1+ (0.1,0) [0|25.5] "" Vector__XXX
 SG_ VCBATT1_a515_packSOC m515 : 52|8@1+ (0.4,0) [0|102] "" Vector__XXX
 SG_ VCBATT1_a515_serviceMode m515 : 60|1@1+ (1,0) [0|1] "" Vector__XXX
 SG_ VCBATT1_a515_frunkOpen m515 : 61|1@1+ (1,0) [0|1] "" Vector__XXX
 SG_ VCBATT1_a515_vehiclePowerState m515 : 62|2@1+ (1,0) [0|3] "" Vector__XXX
 SG_ VCBATT1_a518_packVoltage m518 : 16|8@1+ (0.1,0) [0|25.5] "" Vector__XXX
 SG_ VCBATT1_a518_IBSVoltage m518 : 24|9@1+ (0.05,0) [0|25.55] "" Vector__XXX
 SG_ VCBATT1_a518_targetPCSVoltage m518 : 33|8@1+ (0.1,0) [0|25.5] "" Vector__XXX
 SG_ VCBATT1_a518_outputVoltageAtPCS m518 : 41|8@1+ (0.1,0) [0|25.5] "" Vector__XXX
 SG_ VCBATT1_a518_packSOC m518 : 49|10@1+ (0.1,0) [0|102.3] "" Vector__XXX
 SG_ VCBATT1_a518_serviceMode m518 : 59|1@1+ (1,0) [0|1] "" Vector__XXX
 SG_ VCBATT1_a518_frunkOpen m518 : 60|1@1+ (1,0) [0|1] "" Vector__XXX
 SG_ VCBATT1_a518_vehiclePowerState m518 : 61|2@1+ (1,0) [0|3] "" Vector__XXX
 SG_ VCBATT1_a521_vcleftEFuseCurrent m521 : 16|16@1- (0.1,0) [-3276.8|3276.7] "" Vector__XXX
 SG_ VCBATT1_a521_vcleftEFuseTemp m521 : 32|8@1+ (0.75,0) [0|191.25] "" Vector__XXX
 SG_ VCBATT1_a521_ambientTemp m521 : 40|8@1+ (0.5,-40) [-40|87.5] "" Vector__XXX
 SG_ VCBATT1_a521_serviceMode m521 : 48|1@1+ (1,0) [0|1] "" Vector__XXX
 SG_ VCBATT1_a521_frunkOpen m521 : 49|1@1+ (1,0) [0|1] "" Vector__XXX
 SG_ VCBATT1_a523_channel m523 : 16|8@1+ (1,0) [0|255] "" Vector__XXX
 SG_ VCBATT1_a523_control2Byte1 m523 : 24|8@1+ (1,0) [0|255] "" Vector__XXX
 SG_ VCBATT1_a523_control2Byte2 m523 : 32|8@1+ (1,0) [0|255] "" Vector__XXX
 SG_ VCBATT1_a523_control2Byte3 m523 : 40|8@1+ (1,0) [0|255] "" Vector__XXX
 SG_ VCBATT1_a523_control3Byte2 m523 : 48|8@1+ (1,0) [0|255] "" Vector__XXX
 SG_ VCBATT1_a523_control3Byte3 m523 : 56|8@1+ (1,0) [0|255] "" Vector__XXX
 SG_ VCBATT1_a525_GTW_twelveVBatteryT m525 : 16|3@1+ (1,0) [0|7] "" Vector__XXX
 SG_ VCBATT1_a525_newLVBatteryType m525 : 19|3@1+ (1,0) [0|7] "" Vector__XXX
 SG_ VCBATT1_a525_initialLVBatteryTyp m525 : 24|3@1+ (1,0) [0|7] "" Vector__XXX
 SG_ VCBATT1_a525_serviceMode m525 : 27|1@1+ (1,0) [0|1] "" Vector__XXX
 SG_ VCBATT1_a525_factoryGated m525 : 28|1@1+ (1,0) [0|1] "" Vector__XXX
 SG_ VCBATT1_a525_frunkOpen m525 : 29|1@1+ (1,0) [0|1] "" Vector__XXX
 SG_ VCBATT1_a527_cell1Voltage m527 : 16|10@1+ (0.01,0) [0|10.23] "" Vector__XXX
 SG_ VCBATT1_a527_cell2Voltage m527 : 26|10@1+ (0.01,0) [0|10.23] "" Vector__XXX
 SG_ VCBATT1_a527_cell3Voltage m527 : 36|10@1+ (0.01,0) [0|10.23] "" Vector__XXX
 SG_ VCBATT1_a527_cell4Voltage m527 : 46|10@1+ (0.01,0) [0|10.23] "" Vector__XXX
 SG_ VCBATT1_a527_serviceMode m527 : 56|1@1+ (1,0) [0|1] "" Vector__XXX
 SG_ VCBATT1_a527_frunkOpen m527 : 57|1@1+ (1,0) [0|1] "" Vector__XXX
 SG_ VCBATT1_a528_ECPAStateSNA m528 : 16|1@1+ (1,0) [0|1] "" Vector__XXX
 SG_ VCBATT1_a528_ECPAFrameTimeout m528 : 17|1@1+ (1,0) [0|1] "" Vector__XXX
 SG_ VCBATT1_a528_currentSenseFaulted m528 : 18|1@1+ (1,0) [0|1] "" Vector__XXX
 SG_ VCBATT1_a528_serviceMode m528 : 19|1@1+ (1,0) [0|1] "" Vector__XXX
 SG_ VCBATT1_a528_frunkOpen m528 : 20|1@1+ (1,0) [0|1] "" Vector__XXX
 SG_ VCBATT1_a533_temperature m533 : 16|16@1+ (0.01,0) [0|655.35] "" Vector__XXX
 SG_ VCBATT1_a541_PackTemperature m541 : 16|9@1+ (0.5,-50) [-50|205.5] "" Vector__XXX
 SG_ VCBATT1_a541_ChargeCurrentLimit m541 : 25|10@1+ (0.05,0) [0|51.15] "" Vector__XXX
 SG_ VCBATT1_a541_PeakCurrent m541 : 35|10@1+ (0.05,0) [0|51.15] "" Vector__XXX
 SG_ VCBATT1_a541_AverageCurrent m541 : 45|10@1+ (0.05,0) [0|51.15] "" Vector__XXX
 SG_ VCBATT1_a541_SOC m541 : 56|7@1+ (1,0) [0|127] "" Vector__XXX
 SG_ VCBATT1_a544_serviceMode m544 : 16|1@1+ (1,0) [0|1] "" Vector__XXX
 SG_ VCBATT1_a544_frunkOpen m544 : 17|1@1+ (1,0) [0|1] "" Vector__XXX
 SG_ VCBATT1_a544_LVBMSSOC m544 : 18|5@1+ (3,0) [0|93] "" Vector__XXX
 SG_ VCBATT1_a545_GTW_twelveVBatteryT m545 : 16|3@1+ (1,0) [0|7] "" Vector__XXX
 SG_ VCBATT1_a545_newLVBatteryType m545 : 19|3@1+ (1,0) [0|7] "" Vector__XXX
 SG_ VCBATT1_a545_serviceMode m545 : 22|1@1+ (1,0) [0|1] "" Vector__XXX
 SG_ VCBATT1_a545_factoryGated m545 : 23|1@1+ (1,0) [0|1] "" Vector__XXX
 SG_ VCBATT1_a545_frunkOpen m545 : 24|1@1+ (1,0) [0|1] "" Vector__XXX
 SG_ VCBATT1_a548_vehiclePowerState m548 : 16|2@1+ (1,0) [0|3] "" Vector__XXX
 SG_ VCBATT1_a548_notEnoughPowerForSu m548 : 18|1@1+ (1,0) [0|1] "" Vector__XXX
 SG_ VCBATT1_a548_HVBlockingMismatch m548 : 19|1@1+ (1,0) [0|1] "" Vector__XXX
 SG_ VCBATT1_a548_LVBatteryCannotSupp m548 : 20|1@1+ (1,0) [0|1] "" Vector__XXX
 SG_ VCBATT1_a548_DI_gear m548 : 21|3@1+ (1,0) [0|7] "" Vector__XXX
 SG_ VCBATT1_a548_backstopBucketCount m548 : 24|5@1+ (0.035,0) [0|1.085] "" Vector__XXX
 SG_ VCBATT1_a548_hvState m548 : 29|3@1+ (1,0) [0|7] "" Vector__XXX
 SG_ VCBATT1_a548_BMS_MIA m548 : 32|1@1+ (1,0) [0|1] "" Vector__XXX
 SG_ VCBATT1_a548_PCS_MIA m548 : 33|1@1+ (1,0) [0|1] "" Vector__XXX
 SG_ VCBATT1_a548_ampHourBucketCount m548 : 34|6@1+ (0.01,0) [0|0.63] "" Vector__XXX
 SG_ VCBATT1_a548_LVBMSSOC m548 : 40|5@1+ (3,0) [0|93] "" Vector__XXX
 SG_ VCBATT1_a548_serviceMode m548 : 45|1@1+ (1,0) [0|1] "" Vector__XXX
 SG_ VCBATT1_a548_frunkOpen m548 : 46|1@1+ (1,0) [0|1] "" Vector__XXX
 SG_ VCBATT1_a548_PCSTargetVoltage m548 : 48|8@1+ (0.1,0) [0|25.5] "" Vector__XXX
 SG_ VCBATT1_a548_ampHourBucketFilled m548 : 56|1@1+ (1,0) [0|1] "" Vector__XXX
 SG_ VCBATT1_a548_HVNotConfirmedUpTri m548 : 57|1@1+ (1,0) [0|1] "" Vector__XXX
 SG_ VCBATT1_a548_PCSNotMeetingTarget m548 : 58|1@1+ (1,0) [0|1] "" Vector__XXX
 SG_ VCBATT1_a548_PCSMIATrigger m548 : 59|1@1+ (1,0) [0|1] "" Vector__XXX
 SG_ VCBATT1_a548_PCSSaturatedTrigger m548 : 60|1@1+ (1,0) [0|1] "" Vector__XXX
 SG_ VCBATT1_a548_backstopHit m548 : 61|1@1+ (1,0) [0|1] "" Vector__XXX
 SG_ VCBATT1_a555_cell1Voltage m555 : 16|10@1+ (0.01,0) [0|10.23] "" Vector__XXX
 SG_ VCBATT1_a555_cell2Voltage m555 : 26|10@1+ (0.01,0) [0|10.23] "" Vector__XXX
 SG_ VCBATT1_a555_cell3Voltage m555 : 36|10@1+ (0.01,0) [0|10.23] "" Vector__XXX
 SG_ VCBATT1_a555_cell4Voltage m555 : 46|10@1+ (0.01,0) [0|10.23] "" Vector__XXX
 SG_ VCBATT1_a559_SOC m559 : 16|7@1+ (1,0) [0|127] "" Vector__XXX
 SG_ VCBATT1_a559_PackCurrent m559 : 24|12@1+ (0.2,-600) [-600|219] "" Vector__XXX
 SG_ VCBATT1_a559_vehiclePowerState m559 : 36|2@1+ (1,0) [0|3] "" Vector__XXX
 SG_ VCBATT1_a559_batterySMState m559 : 40|4@1+ (1,0) [0|15] "" Vector__XXX
 SG_ VCBATT1_a559_bmsState m559 : 44|4@1+ (1,0) [0|15] "" Vector__XXX
 SG_ VCBATT1_a559_dcdcLVSupportStatus m559 : 48|2@1+ (1,0) [0|3] "" Vector__XXX
 SG_ VCBATT1_a559_factoryMode m559 : 50|1@1+ (1,0) [0|1] "" Vector__XXX
 SG_ VCBATT1_a559_serviceMode m559 : 51|1@1+ (1,0) [0|1] "" Vector__XXX
 SG_ VCBATT1_a559_transportMode m559 : 52|1@1+ (1,0) [0|1] "" Vector__XXX
 SG_ VCBATT1_a559_notEnoughPowerForSu m559 : 53|1@1+ (1,0) [0|1] "" Vector__XXX
 SG_ VCBATT1_a559_crashDetected m559 : 54|1@1+ (1,0) [0|1] "" Vector__XXX
 SG_ VCBATT1_a559_BMS_MIA m559 : 55|1@1+ (1,0) [0|1] "" Vector__XXX
 SG_ VCBATT1_a559_PCS_MIA m559 : 56|1@1+ (1,0) [0|1] "" Vector__XXX
 SG_ VCBATT1_a559_HVBlockingMismatch m559 : 57|1@1+ (1,0) [0|1] "" Vector__XXX
 SG_ VCBATT1_a559_HV_UP m559 : 58|1@1+ (1,0) [0|1] "" Vector__XXX
 SG_ VCBATT1_a559_pcsEFuseStable m559 : 59|1@1+ (1,0) [0|1] "" Vector__XXX
 SG_ VCBATT1_a559_vcrightEFuseStable m559 : 60|1@1+ (1,0) [0|1] "" Vector__XXX
 SG_ VCBATT1_a559_contactorEFuseStabl m559 : 61|1@1+ (1,0) [0|1] "" Vector__XXX
 SG_ VCBATT1_a559_hvcEFuseStable m559 : 62|1@1+ (1,0) [0|1] "" Vector__XXX
 SG_ VCBATT1_a559_frunkOpen m559 : 63|1@1+ (1,0) [0|1] "" Vector__XXX
 SG_ VCBATT1_a561_efuseTemperature m561 : 16|5@1+ (4,0) [0|124] "" Vector__XXX
 SG_ VCBATT1_a561_packTemperature m561 : 21|5@1+ (4,0) [0|124] "" Vector__XXX
 SG_ VCBATT1_a561_ambientTemperature m561 : 26|6@1+ (4,0) [0|252] "" Vector__XXX
 SG_ VCBATT1_a561_cell1Voltage m561 : 32|7@1+ (0.04,0) [0|5.08] "" Vector__XXX
 SG_ VCBATT1_a561_cell2Voltage m561 : 39|7@1+ (0.04,0) [0|5.08] "" Vector__XXX
 SG_ VCBATT1_a561_cell3Voltage m561 : 46|7@1+ (0.04,0) [0|5.08] "" Vector__XXX
 SG_ VCBATT1_a561_cell4Voltage m561 : 53|7@1+ (0.04,0) [0|5.08] "" Vector__XXX
 SG_ VCBATT1_a561_factoryMode m561 : 60|1@1+ (1,0) [0|1] "" Vector__XXX
 SG_ VCBATT1_a561_serviceMode m561 : 61|1@1+ (1,0) [0|1] "" Vector__XXX
 SG_ VCBATT1_a561_frunkOpen m561 : 62|1@1+ (1,0) [0|1] "" Vector__XXX
 SG_ VCBATT1_a562_efuseTemperature m562 : 16|5@1+ (4,0) [0|124] "" Vector__XXX
 SG_ VCBATT1_a562_packTemperature m562 : 21|5@1+ (4,0) [0|124] "" Vector__XXX
 SG_ VCBATT1_a562_ambientTemperature m562 : 26|6@1+ (4,0) [0|252] "" Vector__XXX
 SG_ VCBATT1_a562_cell1Voltage m562 : 32|7@1+ (0.04,0) [0|5.08] "" Vector__XXX
 SG_ VCBATT1_a562_cell2Voltage m562 : 39|7@1+ (0.04,0) [0|5.08] "" Vector__XXX
 SG_ VCBATT1_a562_cell3Voltage m562 : 46|7@1+ (0.04,0) [0|5.08] "" Vector__XXX
 SG_ VCBATT1_a562_cell4Voltage m562 : 53|7@1+ (0.04,0) [0|5.08] "" Vector__XXX
 SG_ VCBATT1_a562_factoryMode m562 : 60|1@1+ (1,0) [0|1] "" Vector__XXX
 SG_ VCBATT1_a562_serviceMode m562 : 61|1@1+ (1,0) [0|1] "" Vector__XXX
 SG_ VCBATT1_a562_frunkOpen m562 : 62|1@1+ (1,0) [0|1] "" Vector__XXX
 SG_ VCBATT1_a580_rightHeadlightCurre m580 : 16|16@1+ (0.1,0) [0|6553.5] "" Vector__XXX
 SG_ VCBATT1_a582_batterySMState m582 : 16|4@1+ (1,0) [0|15] "" Vector__XXX
 SG_ VCBATT1_a582_PCSCurrent m582 : 24|8@1+ (0.5,-127) [-127|0.5] "" Vector__XXX
 SG_ VCBATT1_a582_LVBusVoltage m582 : 32|8@1+ (0.1,0) [0|25.5] "" Vector__XXX
 SG_ VCBATT1_a582_LVBusVoltageSource m582 : 40|2@1+ (1,0) [0|3] "" Vector__XXX
 SG_ VCBATT1_a582_batteryType m582 : 42|3@1+ (1,0) [0|7] "" Vector__XXX
 SG_ VCBATT1_a582_inFactoryMode m582 : 45|1@1+ (1,0) [0|1] "" Vector__XXX
 SG_ VCBATT1_a582_frunkOpen m582 : 46|1@1+ (1,0) [0|1] "" Vector__XXX
 SG_ VCBATT1_a585_daysSincePreviousTe m585 : 16|14@1+ (0.1,-0.1) [-0.1|1638.2] "" Vector__XXX
 SG_ VCBATT1_a585_testUrgency m585 : 32|3@1+ (1,0) [0|7] "" Vector__XXX
 SG_ VCBATT1_a585_hoursSinceUserPrese m585 : 35|12@1+ (0.1,-0.1) [-0.1|409.4] "" Vector__XXX
 SG_ VCBATT1_a585_userPresenceState m585 : 48|2@1+ (1,0) [0|3] "" Vector__XXX
 SG_ VCBATT1_a585_periodicTriggerActi m585 : 50|1@1+ (1,0) [0|1] "" Vector__XXX
 SG_ VCBATT1_a585_developmentCar m585 : 51|1@1+ (1,0) [0|1] "" Vector__XXX
 SG_ VCBATT1_a585_updateStarted m585 : 52|1@1+ (1,0) [0|1] "" Vector__XXX
 SG_ VCBATT1_a585_factoryMode m585 : 53|1@1+ (1,0) [0|1] "" Vector__XXX
 SG_ VCBATT1_a585_serviceMode m585 : 54|1@1+ (1,0) [0|1] "" Vector__XXX
 SG_ VCBATT1_a587_factoryMode m587 : 16|1@1+ (1,0) [0|1] "" Vector__XXX
 SG_ VCBATT1_a587_serviceMode m587 : 17|1@1+ (1,0) [0|1] "" Vector__XXX
 SG_ VCBATT1_a587_transportMode m587 : 18|1@1+ (1,0) [0|1] "" Vector__XXX
 SG_ VCBATT1_a587_frunkOpen m587 : 19|1@1+ (1,0) [0|1] "" Vector__XXX
 SG_ VCBATT1_a587_LVBMS_packCurrent_v m587 : 20|1@1+ (1,0) [0|1] "" Vector__XXX
 SG_ VCBATT1_a587_vehiclePowerState m587 : 21|2@1+ (1,0) [0|3] "" Vector__XXX
 SG_ VCBATT1_a587_batterySMState m587 : 24|4@1+ (1,0) [0|15] "" Vector__XXX
 SG_ VCBATT1_a587_LVBMS_packCurrent m587 : 28|12@1+ (0.2,-600) [-600|219] "" Vector__XXX
 SG_ VCBATT1_a587_IBSCurrent m587 : 40|12@1- (0.1,0) [-204.8|204.7] "" Vector__XXX
 SG_ VCBATT1_a592_vcleftCutoffEFuseCu m592 : 16|1@1+ (1,0) [0|1] "" Vector__XXX
 SG_ VCBATT1_a592_vcleftCutoffCurveOf m592 : 17|3@1+ (1,0) [0|7] "" Vector__XXX
 SG_ VCBATT1_a592_vcleftCutoffATerm m592 : 24|16@1+ (50,0) [0|3276750] "" Vector__XXX
 SG_ VCBATT1_a592_vcleftCutoffBTerm m592 : 40|8@1- (1,-78) [-206|49] "" Vector__XXX
 SG_ VCBATT1_a592_vcleftCutoffCTerm m592 : 48|16@1- (50,0) [-1638400|1638350] "" Vector__XXX
 SG_ VCBATT1_a593_vcleftCutoffEFuseFa m593 : 16|1@1+ (1,0) [0|1] "" Vector__XXX
 SG_ VCBATT1_a593_vcleftCutoffCurrent m593 : 17|12@1+ (0.1,0) [0|409.5] "" Vector__XXX
 SG_ VCBATT1_a593_vcleftCutoffTimingT m593 : 32|16@1+ (1,0) [0|65535] "" Vector__XXX
 SG_ VCBATT1_a593_vcleftCutoffMaxCoun m593 : 48|5@1+ (1,0) [0|31] "" Vector__XXX
 SG_ VCBATT1_a597_EPBReleased m597 : 16|1@1+ (1,0) [0|1] "" Vector__XXX
 SG_ VCBATT1_a597_LVNotBeingSupported m597 : 17|1@1+ (1,0) [0|1] "" Vector__XXX
 SG_ VCBATT1_a597_LVBMB_currentInvali m597 : 18|1@1+ (1,0) [0|1] "" Vector__XXX
 SG_ VCBATT1_a597_IBSCurrentInvalid m597 : 19|1@1+ (1,0) [0|1] "" Vector__XXX
 SG_ VCBATT1_a597_LVBMB_eFuseOpen m597 : 20|1@1+ (1,0) [0|1] "" Vector__XXX
 SG_ VCBATT1_a597_vehicleIsUpdating m597 : 21|1@1+ (1,0) [0|1] "" Vector__XXX
 SG_ VCBATT1_a597_LVBusVoltageNotCont m597 : 22|1@1+ (1,0) [0|1] "" Vector__XXX
 SG_ VCBATT1_a597_lostLVBusControl m597 : 23|1@1+ (1,0) [0|1] "" Vector__XXX
 SG_ VCBATT1_a597_externalPowerSupply m597 : 24|1@1+ (1,0) [0|1] "" Vector__XXX
 SG_ VCBATT1_a597_lvBatteryLowCharge m597 : 25|1@1+ (1,0) [0|1] "" Vector__XXX
 SG_ VCBATT1_a597_closedDChgResult m597 : 26|2@1+ (1,0) [0|3] "" Vector__XXX
 SG_ VCBATT1_a597_closedChgResult m597 : 28|2@1+ (1,0) [0|3] "" Vector__XXX
 SG_ VCBATT1_a597_selfTestState m597 : 30|2@1+ (1,0) [0|3] "" Vector__XXX
 SG_ VCBATT1_a598_LVBMS_packCurrent m598 : 16|12@1+ (0.0025,0) [0|10.2375] "" Vector__XXX
 SG_ VCBATT1_a598_IBSCurrent m598 : 28|12@1- (0.0025,0) [-5.12|5.1175] "" Vector__XXX
 SG_ VCBATT1_a598_closedChgIBSCurrent m598 : 40|4@1+ (1,0) [0|15] "" Vector__XXX
 SG_ VCBATT1_a598_closedChgPackCurren m598 : 44|4@1+ (1,0) [0|15] "" Vector__XXX
 SG_ VCBATT1_a598_closedDChgIBSCurren m598 : 48|4@1+ (1,0) [0|15] "" Vector__XXX
 SG_ VCBATT1_a598_closedDChgPackCurre m598 : 52|4@1+ (1,0) [0|15] "" Vector__XXX
 SG_ VCBATT1_a598_closedDChgResult m598 : 56|2@1+ (1,0) [0|3] "" Vector__XXX
 SG_ VCBATT1_a598_closedChgResult m598 : 58|2@1+ (1,0) [0|3] "" Vector__XXX
 SG_ VCBATT1_a599_GTW_twelveVBatteryT m599 : 16|3@1+ (1,0) [0|7] "" Vector__XXX
 SG_ VCBATT1_a599_newLVBatteryType m599 : 19|3@1+ (1,0) [0|7] "" Vector__XXX
 SG_ VCBATT1_a599_initialLVBatteryTyp m599 : 24|3@1+ (1,0) [0|7] "" Vector__XXX
 SG_ VCBATT1_a599_serviceMode m599 : 27|1@1+ (1,0) [0|1] "" Vector__XXX
 SG_ VCBATT1_a599_factoryGated m599 : 28|1@1+ (1,0) [0|1] "" Vector__XXX
 SG_ VCBATT1_a599_frunkOpen m599 : 29|1@1+ (1,0) [0|1] "" Vector__XXX
 SG_ VCBATT1_a600_factoryMode m600 : 16|1@1+ (1,0) [0|1] "" Vector__XXX
 SG_ VCBATT1_a600_serviceMode m600 : 17|1@1+ (1,0) [0|1] "" Vector__XXX
 SG_ VCBATT1_a600_transportMode m600 : 18|1@1+ (1,0) [0|1] "" Vector__XXX
 SG_ VCBATT1_a600_frunkOpen m600 : 19|1@1+ (1,0) [0|1] "" Vector__XXX
 SG_ VCBATT1_a600_vehiclePowerState m600 : 20|2@1+ (1,0) [0|3] "" Vector__XXX
 SG_ VCBATT1_a600_batterySMState m600 : 24|4@1+ (1,0) [0|15] "" Vector__XXX
 SG_ VCBATT1_a600_LVBMS_packCurrent m600 : 28|12@1+ (0.2,-600) [-600|219] "" Vector__XXX
 SG_ VCBATT1_a600_IBSCurrent m600 : 40|12@1- (0.1,0) [-204.8|204.7] "" Vector__XXX
 SG_ VCBATT1_a600_version m600 : 52|4@1+ (1,0) [0|15] "" Vector__XXX
 SG_ VCBATT1_a601_subUsageId m601 : 16|16@1+ (1,0) [0|65535] "" Vector__XXX
 SG_ VCBATT1_a608_deltaV m608 : 16|16@1+ (0.0001,0) [0|6.5535] "" Vector__XXX
 SG_ VCBATT1_a608_bleedFetFailureBric m608 : 32|5@1+ (1,1) [1|32] "" Vector__XXX
 SG_ VCBATT1_a608_retryCount m608 : 40|4@1+ (1,0) [0|15] "" Vector__XXX
 SG_ VCBATT1_a608_setFromNvm m608 : 44|1@1+ (1,0) [0|1] "" Vector__XXX

CM_ BO_ 1339 "VCBATT1 ECU message: alert log";
CM_ SG_ 1339 VCBATT1_alertID "VCBATT1 ECU: alert ID";
CM_ SG_ 1339 VCBATT1_alertState "VCBATT1 ECU: alert state";
CM_ SG_ 1339 VCBATT1_a001_InternalWatchdog "VCBATT1 ECU: a001 internal watchdog";
CM_ SG_ 1339 VCBATT1_a015_NVMMMemOverflow "VCBATT1 ECU: a015 NVMM mem overflow";
CM_ SG_ 1339 VCBATT1_a015_NVMMFilesystemError "VCBATT1 ECU: a015 NVMM filesystem error";
CM_ SG_ 1339 VCBATT1_a015_NVMMRecordIDError "VCBATT1 ECU: a015 NVMM record ID error";
CM_ SG_ 1339 VCBATT1_a059_voltageDrop "VCBATT1 ECU: a059 voltage drop";
CM_ SG_ 1339 VCBATT1_a059_resistanceEstimate "VCBATT1 ECU: a059 resistance estimate";
CM_ SG_ 1339 VCBATT1_a059_current "VCBATT1 ECU: a059 current";
CM_ SG_ 1339 VCBATT1_a063_switchChannel "VCBATT1 ECU: a063 switch channel";
CM_ SG_ 1339 VCBATT1_a063_switchType "VCBATT1 ECU: a063 switch type";
CM_ SG_ 1339 VCBATT1_a063_ADCVoltage "VCBATT1 ECU: a063 ADC voltage";
CM_ SG_ 1339 VCBATT1_a063_disconnected "VCBATT1 ECU: a063 disconnected";
CM_ SG_ 1339 VCBATT1_a063_indeterminate "VCBATT1 ECU: a063 indeterminate";
CM_ SG_ 1339 VCBATT1_a063_stuckActive "VCBATT1 ECU: a063 stuck active";
CM_ SG_ 1339 VCBATT1_a063_faulted "VCBATT1 ECU: a063 faulted";
CM_ SG_ 1339 VCBATT1_a091_FRONTIPC_faultsAndE "VCBATT1 ECU: a091 FRONTIPC faults and extras";
CM_ SG_ 1339 VCBATT1_a091_FRONTIPC_state "VCBATT1 ECU: a091 FRONTIPC state";
CM_ SG_ 1339 VCBATT1_a096_FRONTIPC_status "VCBATT1 ECU: a096 FRONTIPC status";
CM_ SG_ 1339 VCBATT1_a098_FRONTIPC_temperatur "VCBATT1 ECU: a098 FRONTIPC temperature";
CM_ SG_ 1339 VCBATT1_a098_FRONTIPC_thermalCon "VCBATT1 ECU: a098 FRONTIPC thermal control";
CM_ SG_ 1339 VCBATT1_a106_BATTIPC_dcdcRailSta "VCBATT1 ECU: a106 BATTIPC dcdc rail status";
CM_ SG_ 1339 VCBATT1_a106_BATTIPC_dcdcStatus "VCBATT1 ECU: a106 BATTIPC dcdc status";
CM_ SG_ 1339 VCBATT1_a106_VEH_dcdcStatus "VCBATT1 ECU: a106 VEH dcdc status";
CM_ SG_ 1339 VCBATT1_a106_VEH_thermalControl "VCBATT1 ECU: a106 VEH thermal control";
CM_ SG_ 1339 VCBATT1_a106_VEH_dcdcRailStatus "VCBATT1 ECU: a106 VEH dcdc rail status";
CM_ SG_ 1339 VCBATT1_a106_CH_dcdcRailStatus "VCBATT1 ECU: a106 CH dcdc rail status";
CM_ SG_ 1339 VCBATT1_a106_CH_alertMatrix "VCBATT1 ECU: a106 CH alert matrix";
CM_ SG_ 1339 VCBATT1_a106_FRONTIPC_thermalCon "VCBATT1 ECU: a106 FRONTIPC thermal control";
CM_ SG_ 1339 VCBATT1_a106_FRONTIPC_dcdcRailSt "VCBATT1 ECU: a106 FRONTIPC dcdc rail status";
CM_ SG_ 1339 VCBATT1_a106_FRONTIPC_dcdcStatus "VCBATT1 ECU: a106 FRONTIPC dcdc status";
CM_ SG_ 1339 VCBATT1_a108_FRONTIPC_status "VCBATT1 ECU: a108 FRONTIPC status";
CM_ SG_ 1339 VCBATT1_a108_FRONTIPC_temperatur "VCBATT1 ECU: a108 FRONTIPC temperature";
CM_ SG_ 1339 VCBATT1_a108_FRONTIPC_thermalCon "VCBATT1 ECU: a108 FRONTIPC thermal control";
CM_ SG_ 1339 VCBATT1_a108_FRONTIPC_motorStatu "VCBATT1 ECU: a108 FRONTIPC motor status";
CM_ SG_ 1339 VCBATT1_a120_BATTIPC_speed "VCBATT1 ECU: a120 BATTIPC speed";
CM_ SG_ 1339 VCBATT1_a120_FRONTIPC_speed "VCBATT1 ECU: a120 FRONTIPC speed";
CM_ SG_ 1339 VCBATT1_a120_FRONTIPC_systemStat "VCBATT1 ECU: a120 FRONTIPC system status";
CM_ SG_ 1339 VCBATT1_a120_BATTIPC_systemStatu "VCBATT1 ECU: a120 BATTIPC system status";
CM_ SG_ 1339 VCBATT1_a120_FRONTIPC_systemPowe "VCBATT1 ECU: a120 FRONTIPC system power";
CM_ SG_ 1339 VCBATT1_a120_FRONTIPC_autonomyHe "VCBATT1 ECU: a120 FRONTIPC autonomy health";
CM_ SG_ 1339 VCBATT1_a120_BATTIPC_chassisCont "VCBATT1 ECU: a120 BATTIPC chassis control2";
CM_ SG_ 1339 VCBATT1_a120_FRONTIPC_chassisCon "VCBATT1 ECU: a120 FRONTIPC chassis control2";
CM_ SG_ 1339 VCBATT1_a120_FRONTIPC_odometerSt "VCBATT1 ECU: a120 FRONTIPC odometer status";
CM_ SG_ 1339 VCBATT1_a124_FRONTIPC_status "VCBATT1 ECU: a124 FRONTIPC status";
CM_ SG_ 1339 VCBATT1_a124_BATTIPC_status "VCBATT1 ECU: a124 BATTIPC status";
CM_ SG_ 1339 VCBATT1_a125_FRONTIPC_leftStalk "VCBATT1 ECU: a125 FRONTIPC left stalk";
CM_ SG_ 1339 VCBATT1_a125_FRONTIPC_steerAngle "VCBATT1 ECU: a125 FRONTIPC steer angle";
CM_ SG_ 1339 VCBATT1_a125_FRONTIPC_info "VCBATT1 ECU: a125 FRONTIPC info";
CM_ SG_ 1339 VCBATT1_a126_FRONTIPC_sysStatus "VCBATT1 ECU: a126 FRONTIPC sys status";
CM_ SG_ 1339 VCBATT1_a126_BATTIPC_sysStatus "VCBATT1 ECU: a126 BATTIPC sys status";
CM_ SG_ 1339 VCBATT1_a126_FRONTIPC_status "VCBATT1 ECU: a126 FRONTIPC status";
CM_ SG_ 1339 VCBATT1_a126_BATTIPC_status "VCBATT1 ECU: a126 BATTIPC status";
CM_ SG_ 1339 VCBATT1_a127_vcleftEFuseCurrent "VCBATT1 ECU: a127 vcleft e fuse current";
CM_ SG_ 1339 VCBATT1_a127_vcleftEFuseVoltage "VCBATT1 ECU: a127 vcleft e fuse voltage";
CM_ SG_ 1339 VCBATT1_a127_vcleftEFuseTemp "VCBATT1 ECU: a127 vcleft e fuse temp";
CM_ SG_ 1339 VCBATT1_a127_vcleftEFuseRemainin "VCBATT1 ECU: a127 vcleft e fuse remaining retries";
CM_ SG_ 1339 VCBATT1_a129_epas1EFuseCurrent "VCBATT1 ECU: a129 epas1 e fuse current";
CM_ SG_ 1339 VCBATT1_a129_epas1EFuseVoltage "VCBATT1 ECU: a129 epas1 e fuse voltage";
CM_ SG_ 1339 VCBATT1_a129_epas1EFuseTemp "VCBATT1 ECU: a129 epas1 e fuse temp";
CM_ SG_ 1339 VCBATT1_a130_autopilot1EFuseCurr "VCBATT1 ECU: a130 autopilot1 e fuse current";
CM_ SG_ 1339 VCBATT1_a130_autopilot1EFuseVolt "VCBATT1 ECU: a130 autopilot1 e fuse voltage";
CM_ SG_ 1339 VCBATT1_a130_autopilot1EFuseTemp "VCBATT1 ECU: a130 autopilot1 e fuse temp";
CM_ SG_ 1339 VCBATT1_a130_autopilot1EFuseRema "VCBATT1 ECU: a130 autopilot1 e fuse remaining retries";
CM_ SG_ 1339 VCBATT1_a131_FRONTIPC_power "VCBATT1 ECU: a131 FRONTIPC power";
CM_ SG_ 1339 VCBATT1_a131_BATTIPC_power "VCBATT1 ECU: a131 BATTIPC power";
CM_ SG_ 1339 VCBATT1_a132_iBoosterCurrent "VCBATT1 ECU: a132 i booster current";
CM_ SG_ 1339 VCBATT1_a132_iBoosterVoltage "VCBATT1 ECU: a132 i booster voltage";
CM_ SG_ 1339 VCBATT1_a132_iBoosterEFuseTemp "VCBATT1 ECU: a132 i booster e fuse temp";
CM_ SG_ 1339 VCBATT1_a133_BATTIPC_primaryActu "VCBATT1 ECU: a133 BATTIPC primary actuator";
CM_ SG_ 1339 VCBATT1_a133_FRONTIPC_secondaryA "VCBATT1 ECU: a133 FRONTIPC secondary actuator";
CM_ SG_ 1339 VCBATT1_a144_FRONTIPC_status "VCBATT1 ECU: a144 FRONTIPC status";
CM_ SG_ 1339 VCBATT1_a144_BATTIPC_status "VCBATT1 ECU: a144 BATTIPC status";
CM_ SG_ 1339 VCBATT1_a164_lockoutVoltage "VCBATT1 ECU: a164 lockout voltage";
CM_ SG_ 1339 VCBATT1_a165_lockoutVoltage "VCBATT1 ECU: a165 lockout voltage";
CM_ SG_ 1339 VCBATT1_a180_vehiclePowerState "VCBATT1 ECU: a180 vehicle power state";
CM_ SG_ 1339 VCBATT1_a180_hvState "VCBATT1 ECU: a180 hv state";
CM_ SG_ 1339 VCBATT1_a180_bmsState "VCBATT1 ECU: a180 bms state";
CM_ SG_ 1339 VCBATT1_a180_notEnoughPowerForSu "VCBATT1 ECU: a180 not enough power for support";
CM_ SG_ 1339 VCBATT1_a180_pcsEFuseStable "VCBATT1 ECU: a180 pcs e fuse stable";
CM_ SG_ 1339 VCBATT1_a180_vcrightEFuseStable "VCBATT1 ECU: a180 vcright e fuse stable";
CM_ SG_ 1339 VCBATT1_a180_contactorEFuseStabl "VCBATT1 ECU: a180 contactor e fuse stable";
CM_ SG_ 1339 VCBATT1_a180_hvcEFuseStable "VCBATT1 ECU: a180 hvc e fuse stable";
CM_ SG_ 1339 VCBATT1_a180_replaceLVBattery "VCBATT1 ECU: a180 replace LV battery";
CM_ SG_ 1339 VCBATT1_a180_BMS_MIA "VCBATT1 ECU: a180 BMS MIA";
CM_ SG_ 1339 VCBATT1_a180_PCS_MIA "VCBATT1 ECU: a180 PCS MIA";
CM_ SG_ 1339 VCBATT1_a180_HVBlockingMismatch "VCBATT1 ECU: a180 HV blocking mismatch";
CM_ SG_ 1339 VCBATT1_a180_serviceMode "Signal reported by VCBATT1 ECU";
CM_ SG_ 1339 VCBATT1_a180_transportMode "VCBATT1 ECU: a180 transport mode";
CM_ SG_ 1339 VCBATT1_a180_frunkOpen "VCBATT1 ECU: a180 frunk open";
CM_ SG_ 1339 VCBATT1_a180_dcdcLVSupportStatus "VCBATT1 ECU: a180 dcdc LV support status";
CM_ SG_ 1339 VCBATT1_a180_IBSVoltage "VCBATT1 ECU: a180 IBS voltage";
CM_ SG_ 1339 VCBATT1_a180_targetPCSVoltage "VCBATT1 ECU: a180 target PCS voltage";
CM_ SG_ 1339 VCBATT1_a182_deadLV "VCBATT1 ECU: a182 dead LV";
CM_ SG_ 1339 VCBATT1_a182_voltageDrop "VCBATT1 ECU: a182 voltage drop";
CM_ SG_ 1339 VCBATT1_a182_overcharge "VCBATT1 ECU: a182 overcharge";
CM_ SG_ 1339 VCBATT1_a182_LVFloorReached "VCBATT1 ECU: a182 LV floor reached";
CM_ SG_ 1339 VCBATT1_a182_shortedCell "VCBATT1 ECU: a182 shorted cell";
CM_ SG_ 1339 VCBATT1_a182_postPORExcessiveAh "VCBATT1 ECU: a182 post POR excessive ah";
CM_ SG_ 1339 VCBATT1_a182_resistanceEstimatio "VCBATT1 ECU: a182 resistance estimation hard failure";
CM_ SG_ 1339 VCBATT1_a182_dcrMilliOhmsAboveTh "VCBATT1 ECU: a182 dcr milli ohms above threshold";
CM_ SG_ 1339 VCBATT1_a182_prechargeLVLoadRedu "VCBATT1 ECU: a182 precharge LV load reduction";
CM_ SG_ 1339 VCBATT1_a182_factoryMode "VCBATT1 ECU: a182 factory mode";
CM_ SG_ 1339 VCBATT1_a182_serviceMode "Signal reported by VCBATT1 ECU";
CM_ SG_ 1339 VCBATT1_a182_transportMode "VCBATT1 ECU: a182 transport mode";
CM_ SG_ 1339 VCBATT1_a182_frunkOpen "VCBATT1 ECU: a182 frunk open";
CM_ SG_ 1339 VCBATT1_a182_packOverDischarged "VCBATT1 ECU: a182 pack over discharged";
CM_ SG_ 1339 VCBATT1_a182_cellImbalance "VCBATT1 ECU: a182 cell imbalance";
CM_ SG_ 1339 VCBATT1_a182_instantPrechargeDCR "VCBATT1 ECU: a182 instant precharge DCR too high";
CM_ SG_ 1339 VCBATT1_a182_ambientTemp "VCBATT1 ECU: a182 ambient temp";
CM_ SG_ 1339 VCBATT1_a182_dischargedAmpHours "VCBATT1 ECU: a182 discharged amp hours";
CM_ SG_ 1339 VCBATT1_a182_chargedAmpHours "VCBATT1 ECU: a182 charged amp hours";
CM_ SG_ 1339 VCBATT1_a182_calibrationLostFaul "VCBATT1 ECU: a182 calibration lost fault";
CM_ SG_ 1339 VCBATT1_a182_samplingHWError "VCBATT1 ECU: a182 sampling HW error";
CM_ SG_ 1339 VCBATT1_a182_brickOverDischarged "VCBATT1 ECU: a182 brick over discharged";
CM_ SG_ 1339 VCBATT1_a182_impedanceGrowth "VCBATT1 ECU: a182 impedance growth";
CM_ SG_ 1339 VCBATT1_a182_batteryType "VCBATT1 ECU: a182 battery type";
CM_ SG_ 1339 VCBATT1_a182_bleedFetTestFailure "VCBATT1 ECU: a182 bleed fet test failure";
CM_ SG_ 1339 VCBATT1_a182_weakShort "VCBATT1 ECU: a182 weak short";
CM_ SG_ 1339 VCBATT1_a188_sleepBypassCurrent "VCBATT1 ECU: a188 sleep bypass current";
CM_ SG_ 1339 VCBATT1_a188_IBSCurrent "VCBATT1 ECU: a188 IBS current";
CM_ SG_ 1339 VCBATT1_a188_LVSupport "VCBATT1 ECU: a188 LV support";
CM_ SG_ 1339 VCBATT1_a188_bridgeEFuseState "VCBATT1 ECU: a188 bridge e fuse state";
CM_ SG_ 1339 VCBATT1_a188_bridgeState "VCBATT1 ECU: a188 bridge state";
CM_ SG_ 1339 VCBATT1_a188_frontPrivBusAwake "VCBATT1 ECU: a188 front priv bus awake";
CM_ SG_ 1339 VCBATT1_a188_sleepShutdownStep "VCBATT1 ECU: a188 sleep shutdown step";
CM_ SG_ 1339 VCBATT1_a188_vehiclePowerState "VCBATT1 ECU: a188 vehicle power state";
CM_ SG_ 1339 VCBATT1_a188_timeNotSleeping "VCBATT1 ECU: a188 time not sleeping";
CM_ SG_ 1339 VCBATT1_a188_CANAfterQuiet "VCBATT1 ECU: a188 CAN after quiet";
CM_ SG_ 1339 VCBATT1_a191_vehiclePowerState "VCBATT1 ECU: a191 vehicle power state";
CM_ SG_ 1339 VCBATT1_a191_hvState "VCBATT1 ECU: a191 hv state";
CM_ SG_ 1339 VCBATT1_a191_reverseBatteryEFuse "VCBATT1 ECU: a191 reverse battery e fuse fault";
CM_ SG_ 1339 VCBATT1_a191_vehicleLoadShedActi "VCBATT1 ECU: a191 vehicle load shed active";
CM_ SG_ 1339 VCBATT1_a191_vehicleLoadShedHvFa "VCBATT1 ECU: a191 vehicle load shed hv fault active";
CM_ SG_ 1339 VCBATT1_a191_vehicleLoadShedPost "VCBATT1 ECU: a191 vehicle load shed post crash active";
CM_ SG_ 1339 VCBATT1_a191_IBSVoltage "VCBATT1 ECU: a191 IBS voltage";
CM_ SG_ 1339 VCBATT1_a191_a180_DCDCNotSupport "VCBATT1 ECU: a191 a180 DCDC not supporting LV bus";
CM_ SG_ 1339 VCBATT1_a191_MOSState "VCBATT1 ECU: a191 MOS state";
CM_ SG_ 1339 VCBATT1_a191_LVBMSVoltage "VCBATT1 ECU: a191 LVBMS voltage";
CM_ SG_ 1339 VCBATT1_a191_ECPAState "VCBATT1 ECU: a191 ECPA state";
CM_ SG_ 1339 VCBATT1_a191_LVBMSCurrentTargetV "VCBATT1 ECU: a191 LVBMS current target valid";
CM_ SG_ 1339 VCBATT1_a191_LVBMSVoltageTargetV "VCBATT1 ECU: a191 LVBMS voltage target valid";
CM_ SG_ 1339 VCBATT1_a191_serviceMode "Signal reported by VCBATT1 ECU";
CM_ SG_ 1339 VCBATT1_a191_frunkOpen "VCBATT1 ECU: a191 frunk open";
CM_ SG_ 1339 VCBATT1_a191_vehicleLoadShedStag "VCBATT1 ECU: a191 vehicle load shed stage";
CM_ SG_ 1339 VCBATT1_a191_exitDriveWarningTim "VCBATT1 ECU: a191 exit drive warning timer expired";
CM_ SG_ 1339 VCBATT1_a191_LVBMSMIA "VCBATT1 ECU: a191 LVBMSMIA";
CM_ SG_ 1339 VCBATT1_a191_PCS_MIA "VCBATT1 ECU: a191 PCS MIA";
CM_ SG_ 1339 VCBATT1_a191_NotEnoughPowerForSu "VCBATT1 ECU: a191 not enough power for support";
CM_ SG_ 1339 VCBATT1_a191_bmsState "VCBATT1 ECU: a191 bms state";
CM_ SG_ 1339 VCBATT1_a196_factoryMode "VCBATT1 ECU: a196 factory mode";
CM_ SG_ 1339 VCBATT1_a196_serviceMode "Signal reported by VCBATT1 ECU";
CM_ SG_ 1339 VCBATT1_a196_transportMode "VCBATT1 ECU: a196 transport mode";
CM_ SG_ 1339 VCBATT1_a196_frunkOpen "VCBATT1 ECU: a196 frunk open";
CM_ SG_ 1339 VCBATT1_a196_vehiclePowerState "VCBATT1 ECU: a196 vehicle power state";
CM_ SG_ 1339 VCBATT1_a196_batterySMState "VCBATT1 ECU: a196 battery SM state";
CM_ SG_ 1339 VCBATT1_a196_disconnectedBattery "VCBATT1 ECU: a196 disconnected battery test current";
CM_ SG_ 1339 VCBATT1_a196_disconnectedBa_0002 "VCBATT1 ECU: a196 disconnected battery test voltage";
CM_ SG_ 1339 VCBATT1_a196_disconnectedBa_0001 "VCBATT1 ECU: a196 disconnected battery test prev voltage";
CM_ SG_ 1339 VCBATT1_a196_ECPAState "VCBATT1 ECU: a196 ECPA state";
CM_ SG_ 1339 VCBATT1_a204_vbusVoltage "VCBATT1 ECU: a204 vbus voltage";
CM_ SG_ 1339 VCBATT1_a204_ARailLocked "VCBATT1 ECU: a204 a rail locked";
CM_ SG_ 1339 VCBATT1_a204_uvLoadshedFaultInje "VCBATT1 ECU: a204 uv loadshed fault inject";
CM_ SG_ 1339 VCBATT1_a204_batBridgeCurrent "VCBATT1 ECU: a204 bat bridge current";
CM_ SG_ 1339 VCBATT1_a205_busVoltage "VCBATT1 ECU: a205 bus voltage";
CM_ SG_ 1339 VCBATT1_a205_ARailLocked "VCBATT1 ECU: a205 a rail locked";
CM_ SG_ 1339 VCBATT1_a205_ovLoadshedFaultInje "VCBATT1 ECU: a205 ov loadshed fault inject";
CM_ SG_ 1339 VCBATT1_a205_batBridgeCurrent "VCBATT1 ECU: a205 bat bridge current";
CM_ SG_ 1339 VCBATT1_a212_IBSTemp "VCBATT1 ECU: a212 IBS temp";
CM_ SG_ 1339 VCBATT1_a213_IBSVolts "VCBATT1 ECU: a213 IBS volts";
CM_ SG_ 1339 VCBATT1_a213_IBSAh "VCBATT1 ECU: a213 IBS ah";
CM_ SG_ 1339 VCBATT1_a213_LVBatteryTemp "VCBATT1 ECU: a213 LV battery temp";
CM_ SG_ 1339 VCBATT1_a216_inDrive "VCBATT1 ECU: a216 in drive";
CM_ SG_ 1339 VCBATT1_a216_hvState "VCBATT1 ECU: a216 hv state";
CM_ SG_ 1339 VCBATT1_a216_vcleftFastBlowImmin "VCBATT1 ECU: a216 vcleft fast blow imminent";
CM_ SG_ 1339 VCBATT1_a216_vcleftFastBlowDebou "VCBATT1 ECU: a216 vcleft fast blow debounce imminent";
CM_ SG_ 1339 VCBATT1_a216_vcleftStaticImminen "VCBATT1 ECU: a216 vcleft static imminent";
CM_ SG_ 1339 VCBATT1_a216_vcleftDynamicImmine "VCBATT1 ECU: a216 vcleft dynamic imminent";
CM_ SG_ 1339 VCBATT1_a219_IBSVolts "VCBATT1 ECU: a219 IBS volts";
CM_ SG_ 1339 VCBATT1_a219_IBSAh "VCBATT1 ECU: a219 IBS ah";
CM_ SG_ 1339 VCBATT1_a219_IBSCurrent "VCBATT1 ECU: a219 IBS current";
CM_ SG_ 1339 VCBATT1_a220_DI_gear "VCBATT1 ECU: a220 DI gear";
CM_ SG_ 1339 VCBATT1_a220_redundancyRequired "VCBATT1 ECU: a220 redundancy required";
CM_ SG_ 1339 VCBATT1_a220_vehicleSpeed "VCBATT1 ECU: a220 vehicle speed";
CM_ SG_ 1339 VCBATT1_a220_lvHealthStatus "VCBATT1 ECU: a220 lv health status";
CM_ SG_ 1339 VCBATT1_a220_factoryMode "VCBATT1 ECU: a220 factory mode";
CM_ SG_ 1339 VCBATT1_a220_serviceMode "Signal reported by VCBATT1 ECU";
CM_ SG_ 1339 VCBATT1_a220_unhealthyReason "VCBATT1 ECU: a220 unhealthy reason";
CM_ SG_ 1339 VCBATT1_a221_IBSCurrent "VCBATT1 ECU: a221 IBS current";
CM_ SG_ 1339 VCBATT1_a221_PCSCurrent "VCBATT1 ECU: a221 PCS current";
CM_ SG_ 1339 VCBATT1_a221_serviceMode "Signal reported by VCBATT1 ECU";
CM_ SG_ 1339 VCBATT1_a221_frunkOpen "VCBATT1 ECU: a221 frunk open";
CM_ SG_ 1339 VCBATT1_a223_failedArmingSetup "VCBATT1 ECU: a223 failed arming setup";
CM_ SG_ 1339 VCBATT1_a223_failedFaultInject "VCBATT1 ECU: a223 failed fault inject";
CM_ SG_ 1339 VCBATT1_a223_overvoltageFaultAct "VCBATT1 ECU: a223 overvoltage fault active";
CM_ SG_ 1339 VCBATT1_a223_sharedBridgeShutdow "VCBATT1 ECU: a223 shared bridge shutdown active";
CM_ SG_ 1339 VCBATT1_a223_timedOut "VCBATT1 ECU: a223 timed out";
CM_ SG_ 1339 VCBATT1_a224_ocSenseAmpCurrent "VCBATT1 ECU: a224 oc sense amp current";
CM_ SG_ 1339 VCBATT1_a224_hardwareLoadshedFau "VCBATT1 ECU: a224 hardware loadshed fault active";
CM_ SG_ 1339 VCBATT1_a224_ocLoadshedFaultActi "VCBATT1 ECU: a224 oc loadshed fault active";
CM_ SG_ 1339 VCBATT1_a224_faultChannelPi_0003 "VCBATT1 ECU: a224 fault channel pin active slow";
CM_ SG_ 1339 VCBATT1_a224_faultChannelPi_0002 "VCBATT1 ECU: a224 fault channel pin active medium";
CM_ SG_ 1339 VCBATT1_a224_faultChannelPinActi "VCBATT1 ECU: a224 fault channel pin active fast";
CM_ SG_ 1339 VCBATT1_a224_faultChannelPi_0001 "VCBATT1 ECU: a224 fault channel pin active ingoing";
CM_ SG_ 1339 VCBATT1_a224_hardwareLoadsh_0001 "VCBATT1 ECU: a224 hardware loadshed fault active ingoing";
CM_ SG_ 1339 VCBATT1_a229_bridgeOpened "VCBATT1 ECU: a229 bridge opened";
CM_ SG_ 1339 VCBATT1_a229_lvBatteryElecDisc "VCBATT1 ECU: a229 lv battery elec disc";
CM_ SG_ 1339 VCBATT1_a229_lvBatteryEFuseOff "VCBATT1 ECU: a229 lv battery e fuse off";
CM_ SG_ 1339 VCBATT1_a229_lvBatteryActiveDece "VCBATT1 ECU: a229 lv battery active decel energy";
CM_ SG_ 1339 VCBATT1_a229_lvBatteryRevEfuseOf "VCBATT1 ECU: a229 lv battery rev efuse off";
CM_ SG_ 1339 VCBATT1_a229_lvBatteryComms "VCBATT1 ECU: a229 lv battery comms";
CM_ SG_ 1339 VCBATT1_a235_hvcRightDomainFailu "VCBATT1 ECU: a235 hvc right domain failure reason";
CM_ SG_ 1339 VCBATT1_a235_hvcLeftDomainFailur "VCBATT1 ECU: a235 hvc left domain failure reason";
CM_ SG_ 1339 VCBATT1_a235_timedOut "VCBATT1 ECU: a235 timed out";
CM_ SG_ 1339 VCBATT1_a243_IBSVolts "VCBATT1 ECU: a243 IBS volts";
CM_ SG_ 1339 VCBATT1_a243_IBSCurrent "VCBATT1 ECU: a243 IBS current";
CM_ SG_ 1339 VCBATT1_a243_LVBatteryTemp "VCBATT1 ECU: a243 LV battery temp";
CM_ SG_ 1339 VCBATT1_a244_brakeValveECUEFuseC "VCBATT1 ECU: a244 brake valve ECUE fuse current";
CM_ SG_ 1339 VCBATT1_a244_brakeValveECUEFuseV "VCBATT1 ECU: a244 brake valve ECUE fuse voltage";
CM_ SG_ 1339 VCBATT1_a245_current "VCBATT1 ECU: a245 current";
CM_ SG_ 1339 VCBATT1_a245_voltage "VCBATT1 ECU: a245 voltage";
CM_ SG_ 1339 VCBATT1_a245_vbatProtVoltage "VCBATT1 ECU: a245 vbat prot voltage";
CM_ SG_ 1339 VCBATT1_a253_currentNotTapered "VCBATT1 ECU: a253 current not tapered";
CM_ SG_ 1339 VCBATT1_a253_ampHourTargetNotRea "VCBATT1 ECU: a253 amp hour target not reached";
CM_ SG_ 1339 VCBATT1_a253_IBSCurrent "VCBATT1 ECU: a253 IBS current";
CM_ SG_ 1339 VCBATT1_a253_IBSAmpHours "VCBATT1 ECU: a253 IBS amp hours";
CM_ SG_ 1339 VCBATT1_a253_LVBatteryTemp "VCBATT1 ECU: a253 LV battery temp";
CM_ SG_ 1339 VCBATT1_a253_firstChargeOTA "VCBATT1 ECU: a253 first charge OTA";
CM_ SG_ 1339 VCBATT1_a253_firstChargePOR "VCBATT1 ECU: a253 first charge POR";
CM_ SG_ 1339 VCBATT1_a253_serviceMode "Signal reported by VCBATT1 ECU";
CM_ SG_ 1339 VCBATT1_a253_frunkOpen "VCBATT1 ECU: a253 frunk open";
CM_ SG_ 1339 VCBATT1_a259_serviceMode "Signal reported by VCBATT1 ECU";
CM_ SG_ 1339 VCBATT1_a259_voltageDropCounter "VCBATT1 ECU: a259 voltage drop counter";
CM_ SG_ 1339 VCBATT1_a259_minVoltageReached "VCBATT1 ECU: a259 min voltage reached";
CM_ SG_ 1339 VCBATT1_a259_IBSTemp "VCBATT1 ECU: a259 IBS temp";
CM_ SG_ 1339 VCBATT1_a259_maxCurrentReached "VCBATT1 ECU: a259 max current reached";
CM_ SG_ 1339 VCBATT1_a260_IBSVolts "VCBATT1 ECU: a260 IBS volts";
CM_ SG_ 1339 VCBATT1_a260_IBSAh "VCBATT1 ECU: a260 IBS ah";
CM_ SG_ 1339 VCBATT1_a260_vehiclePowerState "VCBATT1 ECU: a260 vehicle power state";
CM_ SG_ 1339 VCBATT1_a260_batterySMState "VCBATT1 ECU: a260 battery SM state";
CM_ SG_ 1339 VCBATT1_a260_HV_UP "VCBATT1 ECU: a260 HV UP";
CM_ SG_ 1339 VCBATT1_a260_notEnoughPowerForSu "VCBATT1 ECU: a260 not enough power for support";
CM_ SG_ 1339 VCBATT1_a260_coolantHasBeenFille "VCBATT1 ECU: a260 coolant has been filled";
CM_ SG_ 1339 VCBATT1_a260_ampHourTrigger "VCBATT1 ECU: a260 amp hour trigger";
CM_ SG_ 1339 VCBATT1_a260_voltageTrigger "VCBATT1 ECU: a260 voltage trigger";
CM_ SG_ 1339 VCBATT1_a260_crashDetected "VCBATT1 ECU: a260 crash detected";
CM_ SG_ 1339 VCBATT1_a260_BMS_MIA "VCBATT1 ECU: a260 BMS MIA";
CM_ SG_ 1339 VCBATT1_a260_PCS_MIA "VCBATT1 ECU: a260 PCS MIA";
CM_ SG_ 1339 VCBATT1_a260_HVBlockingMismatch "VCBATT1 ECU: a260 HV blocking mismatch";
CM_ SG_ 1339 VCBATT1_a260_serviceMode "Signal reported by VCBATT1 ECU";
CM_ SG_ 1339 VCBATT1_a260_dcdcLVSupportStatus "VCBATT1 ECU: a260 dcdc LV support status";
CM_ SG_ 1339 VCBATT1_a260_PCSAndVCREFuseStabl "VCBATT1 ECU: a260 PCS and VCRE fuse stable";
CM_ SG_ 1339 VCBATT1_a260_bmsState "VCBATT1 ECU: a260 bms state";
CM_ SG_ 1339 VCBATT1_a297_bmbDeviceId "VCBATT1 ECU: a297 bmb device id";
CM_ SG_ 1339 VCBATT1_a297_bmbDeviceFaultTempM "VCBATT1 ECU: a297 bmb device fault temp mask";
CM_ SG_ 1339 VCBATT1_a359_IBSVolts "VCBATT1 ECU: a359 IBS volts";
CM_ SG_ 1339 VCBATT1_a359_IBSAh "VCBATT1 ECU: a359 IBS ah";
CM_ SG_ 1339 VCBATT1_a359_vehiclePowerState "VCBATT1 ECU: a359 vehicle power state";
CM_ SG_ 1339 VCBATT1_a359_batterySMState "VCBATT1 ECU: a359 battery SM state";
CM_ SG_ 1339 VCBATT1_a359_hvState "VCBATT1 ECU: a359 hv state";
CM_ SG_ 1339 VCBATT1_a359_coolantHasBeenFille "VCBATT1 ECU: a359 coolant has been filled";
CM_ SG_ 1339 VCBATT1_a359_crashDetected "VCBATT1 ECU: a359 crash detected";
CM_ SG_ 1339 VCBATT1_a359_BMS_MIA "VCBATT1 ECU: a359 BMS MIA";
CM_ SG_ 1339 VCBATT1_a359_PCS_MIA "VCBATT1 ECU: a359 PCS MIA";
CM_ SG_ 1339 VCBATT1_a359_serviceMode "Signal reported by VCBATT1 ECU";
CM_ SG_ 1339 VCBATT1_a359_dcdcLVSupportStatus "VCBATT1 ECU: a359 dcdc LV support status";
CM_ SG_ 1339 VCBATT1_a359_bmsState "VCBATT1 ECU: a359 bms state";
CM_ SG_ 1339 VCBATT1_a363_minBleedCharge "VCBATT1 ECU: a363 min bleed charge";
CM_ SG_ 1339 VCBATT1_a363_avgBleedCharge "VCBATT1 ECU: a363 avg bleed charge";
CM_ SG_ 1339 VCBATT1_a363_checkIntervalDays "VCBATT1 ECU: a363 check interval days";
CM_ SG_ 1339 VCBATT1_a363_minBleedChargeBrick "VCBATT1 ECU: a363 min bleed charge brick id";
CM_ SG_ 1339 VCBATT1_a363_setFromNvm "VCBATT1 ECU: a363 set from nvm";
CM_ SG_ 1339 VCBATT1_a370_IBSVolts "VCBATT1 ECU: a370 IBS volts";
CM_ SG_ 1339 VCBATT1_a370_IBSAh "VCBATT1 ECU: a370 IBS ah";
CM_ SG_ 1339 VCBATT1_a370_notEnoughPowerForSu "VCBATT1 ECU: a370 not enough power for support";
CM_ SG_ 1339 VCBATT1_a370_serviceMode "Signal reported by VCBATT1 ECU";
CM_ SG_ 1339 VCBATT1_a370_sleepCurrent "VCBATT1 ECU: a370 sleep current";
CM_ SG_ 1339 VCBATT1_a370_SOC "VCBATT1 ECU: a370 SOC";
CM_ SG_ 1339 VCBATT1_a371_shortedCellTestTrig "VCBATT1 ECU: a371 shorted cell test trigger";
CM_ SG_ 1339 VCBATT1_a371_voltDropOnHighCurre "VCBATT1 ECU: a371 volt drop on high current trigger";
CM_ SG_ 1339 VCBATT1_a371_deadLVMinimalAhDisc "VCBATT1 ECU: a371 dead LV minimal ah discharged trigger";
CM_ SG_ 1339 VCBATT1_a371_resistanceEstimatio "VCBATT1 ECU: a371 resistance estimation hard fail trigger";
CM_ SG_ 1339 VCBATT1_a371_dcrMilliOhmsAboveTh "VCBATT1 ECU: a371 dcr milli ohms above threshold trigger";
CM_ SG_ 1339 VCBATT1_a371_prechargeLVLoadRedu "VCBATT1 ECU: a371 precharge LV load reduction trigger";
CM_ SG_ 1339 VCBATT1_a371_instantPrechargeDCR "VCBATT1 ECU: a371 instant precharge DCR too high trigger";
CM_ SG_ 1339 VCBATT1_a372_bmbDeviceId "VCBATT1 ECU: a372 bmb device id";
CM_ SG_ 1339 VCBATT1_a372_bmbDeviceFaultBrick "VCBATT1 ECU: a372 bmb device fault brick mask";
CM_ SG_ 1339 VCBATT1_a387_shortedCellFaultCou "VCBATT1 ECU: a387 shorted cell fault counter";
CM_ SG_ 1339 VCBATT1_a387_minVoltageReached "VCBATT1 ECU: a387 min voltage reached";
CM_ SG_ 1339 VCBATT1_a387_opportunisticTest "VCBATT1 ECU: a387 opportunistic test";
CM_ SG_ 1339 VCBATT1_a387_IBSTemp "VCBATT1 ECU: a387 IBS temp";
CM_ SG_ 1339 VCBATT1_a387_maxCurrentReached "VCBATT1 ECU: a387 max current reached";
CM_ SG_ 1339 VCBATT1_a388_shortedCellFaultCou "VCBATT1 ECU: a388 shorted cell fault counter";
CM_ SG_ 1339 VCBATT1_a388_minVoltageReached "VCBATT1 ECU: a388 min voltage reached";
CM_ SG_ 1339 VCBATT1_a388_opportunisticTest "VCBATT1 ECU: a388 opportunistic test";
CM_ SG_ 1339 VCBATT1_a388_IBSTemp "VCBATT1 ECU: a388 IBS temp";
CM_ SG_ 1339 VCBATT1_a388_maxCurrentReached "VCBATT1 ECU: a388 max current reached";
CM_ SG_ 1339 VCBATT1_a392_bmbDeviceId "VCBATT1 ECU: a392 bmb device id";
CM_ SG_ 1339 VCBATT1_a392_bmbDeviceFaultBrick "VCBATT1 ECU: a392 bmb device fault brick mask";
CM_ SG_ 1339 VCBATT1_a401_LVBatteryTemp "VCBATT1 ECU: a401 LV battery temp";
CM_ SG_ 1339 VCBATT1_a401_IBSCurrent "VCBATT1 ECU: a401 IBS current";
CM_ SG_ 1339 VCBATT1_a401_IBSVoltage "VCBATT1 ECU: a401 IBS voltage";
CM_ SG_ 1339 VCBATT1_a401_IBSAmpHours "VCBATT1 ECU: a401 IBS amp hours";
CM_ SG_ 1339 VCBATT1_a402_LVBatteryTemp "VCBATT1 ECU: a402 LV battery temp";
CM_ SG_ 1339 VCBATT1_a402_batterySMState "VCBATT1 ECU: a402 battery SM state";
CM_ SG_ 1339 VCBATT1_a402_failureToPrechargeR "VCBATT1 ECU: a402 failure to precharge risk";
CM_ SG_ 1339 VCBATT1_a402_electricalDisconnec "VCBATT1 ECU: a402 electrical disconnect LV battery";
CM_ SG_ 1339 VCBATT1_a402_communicationDiscon "VCBATT1 ECU: a402 communication disconnect LV battery";
CM_ SG_ 1339 VCBATT1_a402_reverseBatteryFault "VCBATT1 ECU: a402 reverse battery fault";
CM_ SG_ 1339 VCBATT1_a402_MOSOpen "VCBATT1 ECU: a402 MOS open";
CM_ SG_ 1339 VCBATT1_a402_serviceMode "Signal reported by VCBATT1 ECU";
CM_ SG_ 1339 VCBATT1_a402_frunkOpen "VCBATT1 ECU: a402 frunk open";
CM_ SG_ 1339 VCBATT1_a404_minVoltageReached "VCBATT1 ECU: a404 min voltage reached";
CM_ SG_ 1339 VCBATT1_a404_IBSTemp "VCBATT1 ECU: a404 IBS temp";
CM_ SG_ 1339 VCBATT1_a404_maxCurrentReached "VCBATT1 ECU: a404 max current reached";
CM_ SG_ 1339 VCBATT1_a407_dcrMilliOhms "VCBATT1 ECU: a407 dcr milli ohms";
CM_ SG_ 1339 VCBATT1_a407_dcr12VThreshold "VCBATT1 ECU: a407 dcr12 v threshold";
CM_ SG_ 1339 VCBATT1_a407_avgIntervalCurrent "VCBATT1 ECU: a407 avg interval current";
CM_ SG_ 1339 VCBATT1_a407_intervalCurrentVari "VCBATT1 ECU: a407 interval current variance";
CM_ SG_ 1339 VCBATT1_a407_avgPulseCurrent "VCBATT1 ECU: a407 avg pulse current";
CM_ SG_ 1339 VCBATT1_a407_pulseCurrentVarianc "VCBATT1 ECU: a407 pulse current variance shifted";
CM_ SG_ 1339 VCBATT1_a407_IBSTemperature "VCBATT1 ECU: a407 IBS temperature";
CM_ SG_ 1339 VCBATT1_a407_testCounter "VCBATT1 ECU: a407 test counter";
CM_ SG_ 1339 VCBATT1_a407_testingExpended "VCBATT1 ECU: a407 testing expended";
CM_ SG_ 1339 VCBATT1_a407_opportunisticTest "VCBATT1 ECU: a407 opportunistic test";
CM_ SG_ 1339 VCBATT1_a414_failureReason "VCBATT1 ECU: a414 failure reason";
CM_ SG_ 1339 VCBATT1_a414_loadUnattemptedOnFa "VCBATT1 ECU: a414 load unattempted on failure";
CM_ SG_ 1339 VCBATT1_a414_deviceStuckOnFailur "VCBATT1 ECU: a414 device stuck on failure";
CM_ SG_ 1339 VCBATT1_a414_followerVCLeftSelfT "VCBATT1 ECU: a414 follower VC left self test failure";
CM_ SG_ 1339 VCBATT1_a414_bridgeFailedToOpen "VCBATT1 ECU: a414 bridge failed to open";
CM_ SG_ 1339 VCBATT1_a414_uvLoadshedVsenseDig "VCBATT1 ECU: a414 uv loadshed vsense dig in";
CM_ SG_ 1339 VCBATT1_a415_upstreamEFuseStuckO "VCBATT1 ECU: a415 upstream e fuse stuck off";
CM_ SG_ 1339 VCBATT1_a416_brickVoltageMin "VCBATT1 ECU: a416 brick voltage min";
CM_ SG_ 1339 VCBATT1_a416_brickVoltageMax "VCBATT1 ECU: a416 brick voltage max";
CM_ SG_ 1339 VCBATT1_a416_packCurrent "VCBATT1 ECU: a416 pack current";
CM_ SG_ 1339 VCBATT1_a416_socMin "VCBATT1 ECU: a416 soc min";
CM_ SG_ 1339 VCBATT1_a416_brickId "VCBATT1 ECU: a416 brick id";
CM_ SG_ 1339 VCBATT1_a417_brickVoltageMin "VCBATT1 ECU: a417 brick voltage min";
CM_ SG_ 1339 VCBATT1_a417_brickVoltageMax "VCBATT1 ECU: a417 brick voltage max";
CM_ SG_ 1339 VCBATT1_a417_packCurrent "VCBATT1 ECU: a417 pack current";
CM_ SG_ 1339 VCBATT1_a417_socMax "VCBATT1 ECU: a417 soc max";
CM_ SG_ 1339 VCBATT1_a417_brickId "VCBATT1 ECU: a417 brick id";
CM_ SG_ 1339 VCBATT1_a418_brickVoltageMin "VCBATT1 ECU: a418 brick voltage min";
CM_ SG_ 1339 VCBATT1_a418_brickVoltageMax "VCBATT1 ECU: a418 brick voltage max";
CM_ SG_ 1339 VCBATT1_a418_packCurrent "VCBATT1 ECU: a418 pack current";
CM_ SG_ 1339 VCBATT1_a418_socMax "VCBATT1 ECU: a418 soc max";
CM_ SG_ 1339 VCBATT1_a418_brickId "VCBATT1 ECU: a418 brick id";
CM_ SG_ 1339 VCBATT1_a419_brickVoltageMin "VCBATT1 ECU: a419 brick voltage min";
CM_ SG_ 1339 VCBATT1_a419_brickVoltageMax "VCBATT1 ECU: a419 brick voltage max";
CM_ SG_ 1339 VCBATT1_a419_packCurrent "VCBATT1 ECU: a419 pack current";
CM_ SG_ 1339 VCBATT1_a419_socMin "VCBATT1 ECU: a419 soc min";
CM_ SG_ 1339 VCBATT1_a419_brickId "VCBATT1 ECU: a419 brick id";
CM_ SG_ 1339 VCBATT1_a421_vehiclePowerState "VCBATT1 ECU: a421 vehicle power state";
CM_ SG_ 1339 VCBATT1_a421_LVBMSSOC "VCBATT1 ECU: a421 LVBMSSOC";
CM_ SG_ 1339 VCBATT1_a421_capacityTestUrgency "VCBATT1 ECU: a421 capacity test urgency";
CM_ SG_ 1339 VCBATT1_a421_energyActiveDecel "VCBATT1 ECU: a421 energy active decel";
CM_ SG_ 1339 VCBATT1_a421_energyCriticalPullo "VCBATT1 ECU: a421 energy critical pullover";
CM_ SG_ 1339 VCBATT1_a421_powerActiveDecel "VCBATT1 ECU: a421 power active decel";
CM_ SG_ 1339 VCBATT1_a423_brickVoltageMin "VCBATT1 ECU: a423 brick voltage min";
CM_ SG_ 1339 VCBATT1_a423_brickVoltageMax "VCBATT1 ECU: a423 brick voltage max";
CM_ SG_ 1339 VCBATT1_a423_packCurrent "VCBATT1 ECU: a423 pack current";
CM_ SG_ 1339 VCBATT1_a423_socMin "VCBATT1 ECU: a423 soc min";
CM_ SG_ 1339 VCBATT1_a423_brickId "VCBATT1 ECU: a423 brick id";
CM_ SG_ 1339 VCBATT1_a424_brickVoltageMin "VCBATT1 ECU: a424 brick voltage min";
CM_ SG_ 1339 VCBATT1_a424_brickVoltageMax "VCBATT1 ECU: a424 brick voltage max";
CM_ SG_ 1339 VCBATT1_a424_packCurrent "VCBATT1 ECU: a424 pack current";
CM_ SG_ 1339 VCBATT1_a424_socMin "VCBATT1 ECU: a424 soc min";
CM_ SG_ 1339 VCBATT1_a424_brickId "VCBATT1 ECU: a424 brick id";
CM_ SG_ 1339 VCBATT1_a431_netPackCurrent "VCBATT1 ECU: a431 net pack current";
CM_ SG_ 1339 VCBATT1_a431_maxChargeCurrentLim "VCBATT1 ECU: a431 max charge current limit";
CM_ SG_ 1339 VCBATT1_a431_hvjbCurrentLimit "VCBATT1 ECU: a431 hvjb current limit";
CM_ SG_ 1339 VCBATT1_a432_targetCurrent "VCBATT1 ECU: a432 target current";
CM_ SG_ 1339 VCBATT1_a432_packCurrent "VCBATT1 ECU: a432 pack current";
CM_ SG_ 1339 VCBATT1_a433_bmbModuleId "VCBATT1 ECU: a433 bmb module id";
CM_ SG_ 1339 VCBATT1_a433_packTypeData "VCBATT1 ECU: a433 pack type data";
CM_ SG_ 1339 VCBATT1_a433_cellTypeData "VCBATT1 ECU: a433 cell type data";
CM_ SG_ 1339 VCBATT1_a433_bmbModuleIdValid "VCBATT1 ECU: a433 bmb module id valid";
CM_ SG_ 1339 VCBATT1_a433_useBmbModuleId "VCBATT1 ECU: a433 use bmb module id";
CM_ SG_ 1339 VCBATT1_a434_bmbModuleId "VCBATT1 ECU: a434 bmb module id";
CM_ SG_ 1339 VCBATT1_a434_packTypeData "VCBATT1 ECU: a434 pack type data";
CM_ SG_ 1339 VCBATT1_a434_cellTypeData "VCBATT1 ECU: a434 cell type data";
CM_ SG_ 1339 VCBATT1_a434_bmbModuleIdValid "VCBATT1 ECU: a434 bmb module id valid";
CM_ SG_ 1339 VCBATT1_a434_useBmbModuleId "VCBATT1 ECU: a434 use bmb module id";
CM_ SG_ 1339 VCBATT1_a436_netPackCurrent "VCBATT1 ECU: a436 net pack current";
CM_ SG_ 1339 VCBATT1_a436_maxDischargeCurrent "VCBATT1 ECU: a436 max discharge current limit";
CM_ SG_ 1339 VCBATT1_a436_hvjbCurrentLimit "VCBATT1 ECU: a436 hvjb current limit";
CM_ SG_ 1339 VCBATT1_a437_nvmDataMissingA "VCBATT1 ECU: a437 nvm data missing a";
CM_ SG_ 1339 VCBATT1_a437_nvmDataMissingB "VCBATT1 ECU: a437 nvm data missing b";
CM_ SG_ 1339 VCBATT1_a438_temperature "VCBATT1 ECU: a438 temperature";
CM_ SG_ 1339 VCBATT1_a438_sensorId "VCBATT1 ECU: a438 sensor id";
CM_ SG_ 1339 VCBATT1_a439_temperature "VCBATT1 ECU: a439 temperature";
CM_ SG_ 1339 VCBATT1_a439_sensorId "VCBATT1 ECU: a439 sensor id";
CM_ SG_ 1339 VCBATT1_a441_bmbModuleId "VCBATT1 ECU: a441 bmb module id";
CM_ SG_ 1339 VCBATT1_a441_bmbModuleIdPrev "VCBATT1 ECU: a441 bmb module id prev";
CM_ SG_ 1339 VCBATT1_a446_cell1Voltage "VCBATT1 ECU: a446 cell1 voltage";
CM_ SG_ 1339 VCBATT1_a446_cell2Voltage "VCBATT1 ECU: a446 cell2 voltage";
CM_ SG_ 1339 VCBATT1_a446_cell3Voltage "VCBATT1 ECU: a446 cell3 voltage";
CM_ SG_ 1339 VCBATT1_a446_cell4Voltage "VCBATT1 ECU: a446 cell4 voltage";
CM_ SG_ 1339 VCBATT1_a446_sumCellVoltage "VCBATT1 ECU: a446 sum cell voltage";
CM_ SG_ 1339 VCBATT1_a446_deepDischargeFlag "VCBATT1 ECU: a446 deep discharge flag";
CM_ SG_ 1339 VCBATT1_a446_serviceMode "Signal reported by VCBATT1 ECU";
CM_ SG_ 1339 VCBATT1_a446_frunkOpen "VCBATT1 ECU: a446 frunk open";
CM_ SG_ 1339 VCBATT1_a462_CellOVLevel1 "VCBATT1 ECU: a462 cell OV level1";
CM_ SG_ 1339 VCBATT1_a462_CellOVLevel2 "VCBATT1 ECU: a462 cell OV level2";
CM_ SG_ 1339 VCBATT1_a462_CellOVLevel3 "VCBATT1 ECU: a462 cell OV level3";
CM_ SG_ 1339 VCBATT1_a462_CellUVLevel1 "VCBATT1 ECU: a462 cell UV level1";
CM_ SG_ 1339 VCBATT1_a462_CellUVLevel2 "VCBATT1 ECU: a462 cell UV level2";
CM_ SG_ 1339 VCBATT1_a462_ModuleOTLevel1 "VCBATT1 ECU: a462 module OT level1";
CM_ SG_ 1339 VCBATT1_a462_PackOVLevel1 "VCBATT1 ECU: a462 pack OV level1";
CM_ SG_ 1339 VCBATT1_a462_PackOVLevel2 "VCBATT1 ECU: a462 pack OV level2";
CM_ SG_ 1339 VCBATT1_a462_DischrgOCLevel1 "VCBATT1 ECU: a462 dischrg OC level1";
CM_ SG_ 1339 VCBATT1_a462_HardwareOCLevel2 "VCBATT1 ECU: a462 hardware OC level2";
CM_ SG_ 1339 VCBATT1_a462_ChrgOCLevel1 "VCBATT1 ECU: a462 chrg OC level1";
CM_ SG_ 1339 VCBATT1_a462_ChrgOCLevel2 "VCBATT1 ECU: a462 chrg OC level2";
CM_ SG_ 1339 VCBATT1_a462_MOSFETOTLevel1 "VCBATT1 ECU: a462 MOSFETOT level1";
CM_ SG_ 1339 VCBATT1_a462_CPA_State "VCBATT1 ECU: a462 CPA state";
CM_ SG_ 1339 VCBATT1_a462_NTCTempDiffWarnLeve "VCBATT1 ECU: a462 NTC temp diff warn level1";
CM_ SG_ 1339 VCBATT1_a462_KBValueLostFault "VCBATT1 ECU: a462 KB value lost fault";
CM_ SG_ 1339 VCBATT1_a462_BalanceCircuitFault "VCBATT1 ECU: a462 balance circuit fault";
CM_ SG_ 1339 VCBATT1_a462_MOSOpenFault "VCBATT1 ECU: a462 MOS open fault";
CM_ SG_ 1339 VCBATT1_a462_DeepDischarge "VCBATT1 ECU: a462 deep discharge";
CM_ SG_ 1339 VCBATT1_a462_SamplingError "VCBATT1 ECU: a462 sampling error";
CM_ SG_ 1339 VCBATT1_a462_MOSFETStuckClose "VCBATT1 ECU: a462 MOSFET stuck close";
CM_ SG_ 1339 VCBATT1_a462_MOSFETStuckOpen "VCBATT1 ECU: a462 MOSFET stuck open";
CM_ SG_ 1339 VCBATT1_a462_Imbalance "VCBATT1 ECU: a462 imbalance";
CM_ SG_ 1339 VCBATT1_a462_serviceMode "Signal reported by VCBATT1 ECU";
CM_ SG_ 1339 VCBATT1_a462_frunkOpen "VCBATT1 ECU: a462 frunk open";
CM_ SG_ 1339 VCBATT1_a475_channel "VCBATT1 ECU: a475 channel";
CM_ SG_ 1339 VCBATT1_a475_reset "VCBATT1 ECU: a475 reset";
CM_ SG_ 1339 VCBATT1_a475_spiError "VCBATT1 ECU: a475 spi error";
CM_ SG_ 1339 VCBATT1_a475_autoOn "VCBATT1 ECU: a475 auto on";
CM_ SG_ 1339 VCBATT1_a475_diagnosticBit "VCBATT1 ECU: a475 diagnostic bit";
CM_ SG_ 1339 VCBATT1_a475_deviceError "VCBATT1 ECU: a475 device error";
CM_ SG_ 1339 VCBATT1_a475_unexpectedLock "VCBATT1 ECU: a475 unexpected lock";
CM_ SG_ 1339 VCBATT1_a475_unexpectedFailSafe "VCBATT1 ECU: a475 unexpected fail safe";
CM_ SG_ 1339 VCBATT1_a475_disableOutputFault "VCBATT1 ECU: a475 disable output fault";
CM_ SG_ 1339 VCBATT1_a475_vsUndervoltage "VCBATT1 ECU: a475 vs undervoltage";
CM_ SG_ 1339 VCBATT1_a475_hardShort "VCBATT1 ECU: a475 hard short";
CM_ SG_ 1339 VCBATT1_a475_prechargeFailure "VCBATT1 ECU: a475 precharge failure";
CM_ SG_ 1339 VCBATT1_a475_vdsMax "VCBATT1 ECU: a475 vds max";
CM_ SG_ 1339 VCBATT1_a475_bypassSaturation "VCBATT1 ECU: a475 bypass saturation";
CM_ SG_ 1339 VCBATT1_a475_fuseLatch "VCBATT1 ECU: a475 fuse latch";
CM_ SG_ 1339 VCBATT1_a475_deviceOvertemperatu "VCBATT1 ECU: a475 device overtemperature";
CM_ SG_ 1339 VCBATT1_a475_ntcOvertemperature "VCBATT1 ECU: a475 ntc overtemperature";
CM_ SG_ 1339 VCBATT1_a475_vgsLow "VCBATT1 ECU: a475 vgs low";
CM_ SG_ 1339 VCBATT1_a475_chargePumpLow "VCBATT1 ECU: a475 charge pump low";
CM_ SG_ 1339 VCBATT1_a475_watchdog "VCBATT1 ECU: a475 watchdog";
CM_ SG_ 1339 VCBATT1_a475_spiNotDone "VCBATT1 ECU: a475 spi not done";
CM_ SG_ 1339 VCBATT1_a475_csUndervoltage "VCBATT1 ECU: a475 cs undervoltage";
CM_ SG_ 1339 VCBATT1_a475_configIncorrect "VCBATT1 ECU: a475 config incorrect";
CM_ SG_ 1339 VCBATT1_a475_bufferFull "VCBATT1 ECU: a475 buffer full";
CM_ SG_ 1339 VCBATT1_a475_hitAlertRateLimit "VCBATT1 ECU: a475 hit alert rate limit";
CM_ SG_ 1339 VCBATT1_a475_hwlo "VCBATT1 ECU: a475 hwlo";
CM_ SG_ 1339 VCBATT1_a475_dinState "VCBATT1 ECU: a475 din state";
CM_ SG_ 1339 VCBATT1_a475_enable "VCBATT1 ECU: a475 enable";
CM_ SG_ 1339 VCBATT1_a476_FRM1_timedOut "VCBATT1 ECU: a476 FRM1 timed out";
CM_ SG_ 1339 VCBATT1_a476_FRM2_timedOut "VCBATT1 ECU: a476 FRM2 timed out";
CM_ SG_ 1339 VCBATT1_a476_FRM3_timedOut "VCBATT1 ECU: a476 FRM3 timed out";
CM_ SG_ 1339 VCBATT1_a476_FRM4_timedOut "VCBATT1 ECU: a476 FRM4 timed out";
CM_ SG_ 1339 VCBATT1_a476_FRM5_timedOut "VCBATT1 ECU: a476 FRM5 timed out";
CM_ SG_ 1339 VCBATT1_a476_FRM6_timedOut "VCBATT1 ECU: a476 FRM6 timed out";
CM_ SG_ 1339 VCBATT1_a476_FRM7_timedOut "VCBATT1 ECU: a476 FRM7 timed out";
CM_ SG_ 1339 VCBATT1_a476_FRM8_timedOut "VCBATT1 ECU: a476 FRM8 timed out";
CM_ SG_ 1339 VCBATT1_a476_FRM9_timedOut "VCBATT1 ECU: a476 FRM9 timed out";
CM_ SG_ 1339 VCBATT1_a476_FRM10_timedOut "VCBATT1 ECU: a476 FRM10 timed out";
CM_ SG_ 1339 VCBATT1_a476_FRM11_timedOut "VCBATT1 ECU: a476 FRM11 timed out";
CM_ SG_ 1339 VCBATT1_a476_FRM12_timedOut "VCBATT1 ECU: a476 FRM12 timed out";
CM_ SG_ 1339 VCBATT1_a476_factoryMode "VCBATT1 ECU: a476 factory mode";
CM_ SG_ 1339 VCBATT1_a476_serviceMode "Signal reported by VCBATT1 ECU";
CM_ SG_ 1339 VCBATT1_a476_transportMode "VCBATT1 ECU: a476 transport mode";
CM_ SG_ 1339 VCBATT1_a476_frunkOpen "VCBATT1 ECU: a476 frunk open";
CM_ SG_ 1339 VCBATT1_a476_vehiclePowerState "VCBATT1 ECU: a476 vehicle power state";
CM_ SG_ 1339 VCBATT1_a476_batterySMState "VCBATT1 ECU: a476 battery SM state";
CM_ SG_ 1339 VCBATT1_a476_ECPAState "VCBATT1 ECU: a476 ECPA state";
CM_ SG_ 1339 VCBATT1_a477_cell1Voltage "VCBATT1 ECU: a477 cell1 voltage";
CM_ SG_ 1339 VCBATT1_a477_cell2Voltage "VCBATT1 ECU: a477 cell2 voltage";
CM_ SG_ 1339 VCBATT1_a477_cell3Voltage "VCBATT1 ECU: a477 cell3 voltage";
CM_ SG_ 1339 VCBATT1_a477_cell4Voltage "VCBATT1 ECU: a477 cell4 voltage";
CM_ SG_ 1339 VCBATT1_a477_sumCellVoltage "VCBATT1 ECU: a477 sum cell voltage";
CM_ SG_ 1339 VCBATT1_a477_deepDischargeFlag "VCBATT1 ECU: a477 deep discharge flag";
CM_ SG_ 1339 VCBATT1_a477_serviceMode "Signal reported by VCBATT1 ECU";
CM_ SG_ 1339 VCBATT1_a477_frunkOpen "VCBATT1 ECU: a477 frunk open";
CM_ SG_ 1339 VCBATT1_a478_battFaultPackOverVo "VCBATT1 ECU: a478 batt fault pack over voltage";
CM_ SG_ 1339 VCBATT1_a478_battFaultHardwareOv "VCBATT1 ECU: a478 batt fault hardware over current";
CM_ SG_ 1339 VCBATT1_a478_battFaultChargeOver "VCBATT1 ECU: a478 batt fault charge over current";
CM_ SG_ 1339 VCBATT1_a478_battFaultCellUnderV "VCBATT1 ECU: a478 batt fault cell under voltage";
CM_ SG_ 1339 VCBATT1_a478_battFaultCellOverVo "VCBATT1 ECU: a478 batt fault cell over voltage";
CM_ SG_ 1339 VCBATT1_a478_vehiclePowerState "VCBATT1 ECU: a478 vehicle power state";
CM_ SG_ 1339 VCBATT1_a478_batterySMState "VCBATT1 ECU: a478 battery SM state";
CM_ SG_ 1339 VCBATT1_a478_bmsState "VCBATT1 ECU: a478 bms state";
CM_ SG_ 1339 VCBATT1_a478_dcdcLVSupportStatus "VCBATT1 ECU: a478 dcdc LV support status";
CM_ SG_ 1339 VCBATT1_a478_factoryMode "VCBATT1 ECU: a478 factory mode";
CM_ SG_ 1339 VCBATT1_a478_serviceMode "Signal reported by VCBATT1 ECU";
CM_ SG_ 1339 VCBATT1_a478_transportMode "VCBATT1 ECU: a478 transport mode";
CM_ SG_ 1339 VCBATT1_a478_notEnoughPowerForSu "VCBATT1 ECU: a478 not enough power for support";
CM_ SG_ 1339 VCBATT1_a478_crashDetected "VCBATT1 ECU: a478 crash detected";
CM_ SG_ 1339 VCBATT1_a478_BMS_MIA "VCBATT1 ECU: a478 BMS MIA";
CM_ SG_ 1339 VCBATT1_a478_PCS_MIA "VCBATT1 ECU: a478 PCS MIA";
CM_ SG_ 1339 VCBATT1_a478_HVBlockingMismatch "VCBATT1 ECU: a478 HV blocking mismatch";
CM_ SG_ 1339 VCBATT1_a478_HV_UP "VCBATT1 ECU: a478 HV UP";
CM_ SG_ 1339 VCBATT1_a478_pcsEFuseStable "VCBATT1 ECU: a478 pcs e fuse stable";
CM_ SG_ 1339 VCBATT1_a478_vcrightEFuseStable "VCBATT1 ECU: a478 vcright e fuse stable";
CM_ SG_ 1339 VCBATT1_a478_contactorEFuseStabl "VCBATT1 ECU: a478 contactor e fuse stable";
CM_ SG_ 1339 VCBATT1_a478_hvcEFuseStable "VCBATT1 ECU: a478 hvc e fuse stable";
CM_ SG_ 1339 VCBATT1_a478_frunkOpen "VCBATT1 ECU: a478 frunk open";
CM_ SG_ 1339 VCBATT1_a479_FRM3_timedOut "VCBATT1 ECU: a479 FRM3 timed out";
CM_ SG_ 1339 VCBATT1_a479_ECPAState "VCBATT1 ECU: a479 ECPA state";
CM_ SG_ 1339 VCBATT1_a479_factoryMode "VCBATT1 ECU: a479 factory mode";
CM_ SG_ 1339 VCBATT1_a479_serviceMode "Signal reported by VCBATT1 ECU";
CM_ SG_ 1339 VCBATT1_a479_transportMode "VCBATT1 ECU: a479 transport mode";
CM_ SG_ 1339 VCBATT1_a479_frunkLatchStatus "VCBATT1 ECU: a479 frunk latch status";
CM_ SG_ 1339 VCBATT1_a479_vehiclePowerState "VCBATT1 ECU: a479 vehicle power state";
CM_ SG_ 1339 VCBATT1_a479_batterySMState "VCBATT1 ECU: a479 battery SM state";
CM_ SG_ 1339 VCBATT1_a480_channel "VCBATT1 ECU: a480 channel";
CM_ SG_ 1339 VCBATT1_a480_reset "VCBATT1 ECU: a480 reset";
CM_ SG_ 1339 VCBATT1_a480_spiError "VCBATT1 ECU: a480 spi error";
CM_ SG_ 1339 VCBATT1_a480_autoOn "VCBATT1 ECU: a480 auto on";
CM_ SG_ 1339 VCBATT1_a480_diagnosticBit "VCBATT1 ECU: a480 diagnostic bit";
CM_ SG_ 1339 VCBATT1_a480_deviceError "VCBATT1 ECU: a480 device error";
CM_ SG_ 1339 VCBATT1_a480_overcurrent "VCBATT1 ECU: a480 overcurrent";
CM_ SG_ 1339 VCBATT1_a480_unexpectedLock "VCBATT1 ECU: a480 unexpected lock";
CM_ SG_ 1339 VCBATT1_a480_disableOutputFault "VCBATT1 ECU: a480 disable output fault";
CM_ SG_ 1339 VCBATT1_a480_vsUndervoltage "VCBATT1 ECU: a480 vs undervoltage";
CM_ SG_ 1339 VCBATT1_a480_hardShort "VCBATT1 ECU: a480 hard short";
CM_ SG_ 1339 VCBATT1_a480_vdsMax "VCBATT1 ECU: a480 vds max";
CM_ SG_ 1339 VCBATT1_a480_bypassSaturation "VCBATT1 ECU: a480 bypass saturation";
CM_ SG_ 1339 VCBATT1_a480_fuseLatch "VCBATT1 ECU: a480 fuse latch";
CM_ SG_ 1339 VCBATT1_a480_deviceOvertemperatu "VCBATT1 ECU: a480 device overtemperature";
CM_ SG_ 1339 VCBATT1_a480_ntcOvertemperature "VCBATT1 ECU: a480 ntc overtemperature";
CM_ SG_ 1339 VCBATT1_a480_vgsLow "VCBATT1 ECU: a480 vgs low";
CM_ SG_ 1339 VCBATT1_a480_chargePumpLow "VCBATT1 ECU: a480 charge pump low";
CM_ SG_ 1339 VCBATT1_a480_watchdog "VCBATT1 ECU: a480 watchdog";
CM_ SG_ 1339 VCBATT1_a480_spiNotDone "VCBATT1 ECU: a480 spi not done";
CM_ SG_ 1339 VCBATT1_a480_configIncorrect "VCBATT1 ECU: a480 config incorrect";
CM_ SG_ 1339 VCBATT1_a480_bufferFull "VCBATT1 ECU: a480 buffer full";
CM_ SG_ 1339 VCBATT1_a480_hitAlertRateLimit "VCBATT1 ECU: a480 hit alert rate limit";
CM_ SG_ 1339 VCBATT1_a480_hwlo "VCBATT1 ECU: a480 hwlo";
CM_ SG_ 1339 VCBATT1_a480_enable "VCBATT1 ECU: a480 enable";
CM_ SG_ 1339 VCBATT1_a482_lvBridgeEFuseCurren "VCBATT1 ECU: a482 lv bridge e fuse current";
CM_ SG_ 1339 VCBATT1_a482_lvBridgeEFuseVoltag "VCBATT1 ECU: a482 lv bridge e fuse voltage";
CM_ SG_ 1339 VCBATT1_a482_lvBridgeEFuseTemp "VCBATT1 ECU: a482 lv bridge e fuse temp";
CM_ SG_ 1339 VCBATT1_a482_lvBridgeEFuseRemain "VCBATT1 ECU: a482 lv bridge e fuse remaining retries";
CM_ SG_ 1339 VCBATT1_a484_upstreamEFuseStuckO "VCBATT1 ECU: a484 upstream e fuse stuck on";
CM_ SG_ 1339 VCBATT1_a484_upstreamEFuseVoltag "VCBATT1 ECU: a484 upstream e fuse voltage";
CM_ SG_ 1339 VCBATT1_a484_vbusVoltage "VCBATT1 ECU: a484 vbus voltage";
CM_ SG_ 1339 VCBATT1_a484_upstreamEFuseRatio "VCBATT1 ECU: a484 upstream e fuse ratio";
CM_ SG_ 1339 VCBATT1_a485_upstreamEfuseUnatte "VCBATT1 ECU: a485 upstream efuse unattempted on";
CM_ SG_ 1339 VCBATT1_a486_bridgeFailedArmingS "VCBATT1 ECU: a486 bridge failed arming setup";
CM_ SG_ 1339 VCBATT1_a486_bridgeFailedSyncChe "VCBATT1 ECU: a486 bridge failed sync check";
CM_ SG_ 1339 VCBATT1_a486_localBridgeOutputOn "VCBATT1 ECU: a486 local bridge output on";
CM_ SG_ 1339 VCBATT1_a486_localBridgeSyncArme "VCBATT1 ECU: a486 local bridge sync armed";
CM_ SG_ 1339 VCBATT1_a486_localBridgeDinState "VCBATT1 ECU: a486 local bridge din state";
CM_ SG_ 1339 VCBATT1_a486_remoteBridgeOutputO "VCBATT1 ECU: a486 remote bridge output on";
CM_ SG_ 1339 VCBATT1_a486_remoteBridgeOu_0001 "VCBATT1 ECU: a486 remote bridge output on valid";
CM_ SG_ 1339 VCBATT1_a486_remoteBridgeSyncArm "VCBATT1 ECU: a486 remote bridge sync armed";
CM_ SG_ 1339 VCBATT1_a486_remoteBridgeSy_0001 "VCBATT1 ECU: a486 remote bridge sync armed valid";
CM_ SG_ 1339 VCBATT1_a486_remoteBridgeDinStat "VCBATT1 ECU: a486 remote bridge din state";
CM_ SG_ 1339 VCBATT1_a486_remoteBridgeDi_0001 "VCBATT1 ECU: a486 remote bridge din state valid";
CM_ SG_ 1339 VCBATT1_a493_minBrickSocId "VCBATT1 ECU: a493 min brick soc id";
CM_ SG_ 1339 VCBATT1_a493_minBrickSocByOcvMax "VCBATT1 ECU: a493 min brick soc by ocv max";
CM_ SG_ 1339 VCBATT1_a493_maxBrickSocId "VCBATT1 ECU: a493 max brick soc id";
CM_ SG_ 1339 VCBATT1_a493_maxBrickSocByOcvMin "VCBATT1 ECU: a493 max brick soc by ocv min";
CM_ SG_ 1339 VCBATT1_a493_maxBrickSoc "VCBATT1 ECU: a493 max brick soc";
CM_ SG_ 1339 VCBATT1_a493_avgBrickSoc "VCBATT1 ECU: a493 avg brick soc";
CM_ SG_ 1339 VCBATT1_a495_SoCUnrecoverable "VCBATT1 ECU: a495 so c unrecoverable";
CM_ SG_ 1339 VCBATT1_a495_SocTooLow "VCBATT1 ECU: a495 soc too low";
CM_ SG_ 1339 VCBATT1_a495_retryExpended "VCBATT1 ECU: a495 retry expended";
CM_ SG_ 1339 VCBATT1_a495_LVBMSMIA "VCBATT1 ECU: a495 LVBMSMIA";
CM_ SG_ 1339 VCBATT1_a495_reverseBatteryEFuse "VCBATT1 ECU: a495 reverse battery e fuse fault";
CM_ SG_ 1339 VCBATT1_a495_DCDCOff "VCBATT1 ECU: a495 DCDC off";
CM_ SG_ 1339 VCBATT1_a495_HVOff "VCBATT1 ECU: a495 HV off";
CM_ SG_ 1339 VCBATT1_a495_externalInteraction "VCBATT1 ECU: a495 external interaction";
CM_ SG_ 1339 VCBATT1_a495_serviceMode "Signal reported by VCBATT1 ECU";
CM_ SG_ 1339 VCBATT1_a495_frunkOpen "VCBATT1 ECU: a495 frunk open";
CM_ SG_ 1339 VCBATT1_a495_externalPowerSupply "VCBATT1 ECU: a495 external power supply";
CM_ SG_ 1339 VCBATT1_a496_reverseBatteryEFuse "VCBATT1 ECU: a496 reverse battery e fuse fault";
CM_ SG_ 1339 VCBATT1_a496_vehicleLoadShedActi "VCBATT1 ECU: a496 vehicle load shed active";
CM_ SG_ 1339 VCBATT1_a496_MOSState "VCBATT1 ECU: a496 MOS state";
CM_ SG_ 1339 VCBATT1_a496_serviceMode "Signal reported by VCBATT1 ECU";
CM_ SG_ 1339 VCBATT1_a496_frunkOpen "VCBATT1 ECU: a496 frunk open";
CM_ SG_ 1339 VCBATT1_a496_PCS_MIA "VCBATT1 ECU: a496 PCS MIA";
CM_ SG_ 1339 VCBATT1_a496_NotEnoughPowerForSu "VCBATT1 ECU: a496 not enough power for support";
CM_ SG_ 1339 VCBATT1_a496_bmsState "VCBATT1 ECU: a496 bms state";
CM_ SG_ 1339 VCBATT1_a497_serviceMode "Signal reported by VCBATT1 ECU";
CM_ SG_ 1339 VCBATT1_a497_FactoryMode "VCBATT1 ECU: a497 factory mode";
CM_ SG_ 1339 VCBATT1_a497_SOC "VCBATT1 ECU: a497 SOC";
CM_ SG_ 1339 VCBATT1_a497_PackCurrent "VCBATT1 ECU: a497 pack current";
CM_ SG_ 1339 VCBATT1_a497_SumCellVoltage "VCBATT1 ECU: a497 sum cell voltage";
CM_ SG_ 1339 VCBATT1_a497_frunkOpen "VCBATT1 ECU: a497 frunk open";
CM_ SG_ 1339 VCBATT1_a500_channel "VCBATT1 ECU: a500 channel";
CM_ SG_ 1339 VCBATT1_a500_mismatchedState "VCBATT1 ECU: a500 mismatched state";
CM_ SG_ 1339 VCBATT1_a503_brickVoltageMin "VCBATT1 ECU: a503 brick voltage min";
CM_ SG_ 1339 VCBATT1_a503_brickVoltageMax "VCBATT1 ECU: a503 brick voltage max";
CM_ SG_ 1339 VCBATT1_a503_packCurrent "VCBATT1 ECU: a503 pack current";
CM_ SG_ 1339 VCBATT1_a503_socMax "VCBATT1 ECU: a503 soc max";
CM_ SG_ 1339 VCBATT1_a503_brickId "VCBATT1 ECU: a503 brick id";
CM_ SG_ 1339 VCBATT1_a509_channel "VCBATT1 ECU: a509 channel";
CM_ SG_ 1339 VCBATT1_a509_state "VCBATT1 ECU: a509 state";
CM_ SG_ 1339 VCBATT1_a509_expectedState "VCBATT1 ECU: a509 expected state";
CM_ SG_ 1339 VCBATT1_a509_hardwareLockout "VCBATT1 ECU: a509 hardware lockout";
CM_ SG_ 1339 VCBATT1_a509_unlocksRemaining "VCBATT1 ECU: a509 unlocks remaining";
CM_ SG_ 1339 VCBATT1_a510_sumCellVoltage "VCBATT1 ECU: a510 sum cell voltage";
CM_ SG_ 1339 VCBATT1_a510_packVoltage "VCBATT1 ECU: a510 pack voltage";
CM_ SG_ 1339 VCBATT1_a510_targetPCSVoltage "VCBATT1 ECU: a510 target PCS voltage";
CM_ SG_ 1339 VCBATT1_a510_serviceMode "Signal reported by VCBATT1 ECU";
CM_ SG_ 1339 VCBATT1_a510_frunkOpen "VCBATT1 ECU: a510 frunk open";
CM_ SG_ 1339 VCBATT1_a512_packVoltageInt_0001 "VCBATT1 ECU: a512 pack voltage interval min";
CM_ SG_ 1339 VCBATT1_a512_packVoltageInterval "VCBATT1 ECU: a512 pack voltage interval max";
CM_ SG_ 1339 VCBATT1_a512_packTemperature "VCBATT1 ECU: a512 pack temperature";
CM_ SG_ 1339 VCBATT1_a512_sumCellVoltage "VCBATT1 ECU: a512 sum cell voltage";
CM_ SG_ 1339 VCBATT1_a512_overcurrentDirectio "VCBATT1 ECU: a512 overcurrent direction";
CM_ SG_ 1339 VCBATT1_a512_serviceMode "Signal reported by VCBATT1 ECU";
CM_ SG_ 1339 VCBATT1_a512_frunkOpen "VCBATT1 ECU: a512 frunk open";
CM_ SG_ 1339 VCBATT1_a512_vehiclePowerState "VCBATT1 ECU: a512 vehicle power state";
CM_ SG_ 1339 VCBATT1_a513_packCurrent "VCBATT1 ECU: a513 pack current";
CM_ SG_ 1339 VCBATT1_a513_packTemperature "VCBATT1 ECU: a513 pack temperature";
CM_ SG_ 1339 VCBATT1_a513_packVoltage "VCBATT1 ECU: a513 pack voltage";
CM_ SG_ 1339 VCBATT1_a513_packSOC "VCBATT1 ECU: a513 pack SOC";
CM_ SG_ 1339 VCBATT1_a513_serviceMode "Signal reported by VCBATT1 ECU";
CM_ SG_ 1339 VCBATT1_a513_frunkOpen "VCBATT1 ECU: a513 frunk open";
CM_ SG_ 1339 VCBATT1_a513_vehiclePowerState "VCBATT1 ECU: a513 vehicle power state";
CM_ SG_ 1339 VCBATT1_a514_cell1Voltage "VCBATT1 ECU: a514 cell1 voltage";
CM_ SG_ 1339 VCBATT1_a514_cell2Voltage "VCBATT1 ECU: a514 cell2 voltage";
CM_ SG_ 1339 VCBATT1_a514_cell3Voltage "VCBATT1 ECU: a514 cell3 voltage";
CM_ SG_ 1339 VCBATT1_a514_cell4Voltage "VCBATT1 ECU: a514 cell4 voltage";
CM_ SG_ 1339 VCBATT1_a514_packVoltage "VCBATT1 ECU: a514 pack voltage";
CM_ SG_ 1339 VCBATT1_a514_packSOC "VCBATT1 ECU: a514 pack SOC";
CM_ SG_ 1339 VCBATT1_a514_serviceMode "Signal reported by VCBATT1 ECU";
CM_ SG_ 1339 VCBATT1_a514_frunkOpen "VCBATT1 ECU: a514 frunk open";
CM_ SG_ 1339 VCBATT1_a514_vehiclePowerState "VCBATT1 ECU: a514 vehicle power state";
CM_ SG_ 1339 VCBATT1_a515_cell1Voltage "VCBATT1 ECU: a515 cell1 voltage";
CM_ SG_ 1339 VCBATT1_a515_cell2Voltage "VCBATT1 ECU: a515 cell2 voltage";
CM_ SG_ 1339 VCBATT1_a515_cell3Voltage "VCBATT1 ECU: a515 cell3 voltage";
CM_ SG_ 1339 VCBATT1_a515_cell4Voltage "VCBATT1 ECU: a515 cell4 voltage";
CM_ SG_ 1339 VCBATT1_a515_packVoltage "VCBATT1 ECU: a515 pack voltage";
CM_ SG_ 1339 VCBATT1_a515_packSOC "VCBATT1 ECU: a515 pack SOC";
CM_ SG_ 1339 VCBATT1_a515_serviceMode "Signal reported by VCBATT1 ECU";
CM_ SG_ 1339 VCBATT1_a515_frunkOpen "VCBATT1 ECU: a515 frunk open";
CM_ SG_ 1339 VCBATT1_a515_vehiclePowerState "VCBATT1 ECU: a515 vehicle power state";
CM_ SG_ 1339 VCBATT1_a518_packVoltage "VCBATT1 ECU: a518 pack voltage";
CM_ SG_ 1339 VCBATT1_a518_IBSVoltage "VCBATT1 ECU: a518 IBS voltage";
CM_ SG_ 1339 VCBATT1_a518_targetPCSVoltage "VCBATT1 ECU: a518 target PCS voltage";
CM_ SG_ 1339 VCBATT1_a518_outputVoltageAtPCS "VCBATT1 ECU: a518 output voltage at PCS";
CM_ SG_ 1339 VCBATT1_a518_packSOC "VCBATT1 ECU: a518 pack SOC";
CM_ SG_ 1339 VCBATT1_a518_serviceMode "Signal reported by VCBATT1 ECU";
CM_ SG_ 1339 VCBATT1_a518_frunkOpen "VCBATT1 ECU: a518 frunk open";
CM_ SG_ 1339 VCBATT1_a518_vehiclePowerState "VCBATT1 ECU: a518 vehicle power state";
CM_ SG_ 1339 VCBATT1_a521_vcleftEFuseCurrent "VCBATT1 ECU: a521 vcleft e fuse current";
CM_ SG_ 1339 VCBATT1_a521_vcleftEFuseTemp "VCBATT1 ECU: a521 vcleft e fuse temp";
CM_ SG_ 1339 VCBATT1_a521_ambientTemp "VCBATT1 ECU: a521 ambient temp";
CM_ SG_ 1339 VCBATT1_a521_serviceMode "Signal reported by VCBATT1 ECU";
CM_ SG_ 1339 VCBATT1_a521_frunkOpen "VCBATT1 ECU: a521 frunk open";
CM_ SG_ 1339 VCBATT1_a523_channel "VCBATT1 ECU: a523 channel";
CM_ SG_ 1339 VCBATT1_a523_control2Byte1 "VCBATT1 ECU: a523 control2 byte1";
CM_ SG_ 1339 VCBATT1_a523_control2Byte2 "VCBATT1 ECU: a523 control2 byte2";
CM_ SG_ 1339 VCBATT1_a523_control2Byte3 "VCBATT1 ECU: a523 control2 byte3";
CM_ SG_ 1339 VCBATT1_a523_control3Byte2 "VCBATT1 ECU: a523 control3 byte2";
CM_ SG_ 1339 VCBATT1_a523_control3Byte3 "VCBATT1 ECU: a523 control3 byte3";
CM_ SG_ 1339 VCBATT1_a525_GTW_twelveVBatteryT "VCBATT1 ECU: a525 GTW twelve v battery type";
CM_ SG_ 1339 VCBATT1_a525_newLVBatteryType "VCBATT1 ECU: a525 new LV battery type";
CM_ SG_ 1339 VCBATT1_a525_initialLVBatteryTyp "VCBATT1 ECU: a525 initial LV battery type";
CM_ SG_ 1339 VCBATT1_a525_serviceMode "Signal reported by VCBATT1 ECU";
CM_ SG_ 1339 VCBATT1_a525_factoryGated "VCBATT1 ECU: a525 factory gated";
CM_ SG_ 1339 VCBATT1_a525_frunkOpen "VCBATT1 ECU: a525 frunk open";
CM_ SG_ 1339 VCBATT1_a527_cell1Voltage "VCBATT1 ECU: a527 cell1 voltage";
CM_ SG_ 1339 VCBATT1_a527_cell2Voltage "VCBATT1 ECU: a527 cell2 voltage";
CM_ SG_ 1339 VCBATT1_a527_cell3Voltage "VCBATT1 ECU: a527 cell3 voltage";
CM_ SG_ 1339 VCBATT1_a527_cell4Voltage "VCBATT1 ECU: a527 cell4 voltage";
CM_ SG_ 1339 VCBATT1_a527_serviceMode "Signal reported by VCBATT1 ECU";
CM_ SG_ 1339 VCBATT1_a527_frunkOpen "VCBATT1 ECU: a527 frunk open";
CM_ SG_ 1339 VCBATT1_a528_ECPAStateSNA "VCBATT1 ECU: a528 ECPA state SNA";
CM_ SG_ 1339 VCBATT1_a528_ECPAFrameTimeout "VCBATT1 ECU: a528 ECPA frame timeout";
CM_ SG_ 1339 VCBATT1_a528_currentSenseFaulted "VCBATT1 ECU: a528 current sense faulted";
CM_ SG_ 1339 VCBATT1_a528_serviceMode "Signal reported by VCBATT1 ECU";
CM_ SG_ 1339 VCBATT1_a528_frunkOpen "VCBATT1 ECU: a528 frunk open";
CM_ SG_ 1339 VCBATT1_a533_temperature "VCBATT1 ECU: a533 temperature";
CM_ SG_ 1339 VCBATT1_a541_PackTemperature "VCBATT1 ECU: a541 pack temperature";
CM_ SG_ 1339 VCBATT1_a541_ChargeCurrentLimit "VCBATT1 ECU: a541 charge current limit";
CM_ SG_ 1339 VCBATT1_a541_PeakCurrent "VCBATT1 ECU: a541 peak current";
CM_ SG_ 1339 VCBATT1_a541_AverageCurrent "VCBATT1 ECU: a541 average current";
CM_ SG_ 1339 VCBATT1_a541_SOC "VCBATT1 ECU: a541 SOC";
CM_ SG_ 1339 VCBATT1_a544_serviceMode "Signal reported by VCBATT1 ECU";
CM_ SG_ 1339 VCBATT1_a544_frunkOpen "VCBATT1 ECU: a544 frunk open";
CM_ SG_ 1339 VCBATT1_a544_LVBMSSOC "VCBATT1 ECU: a544 LVBMSSOC";
CM_ SG_ 1339 VCBATT1_a545_GTW_twelveVBatteryT "VCBATT1 ECU: a545 GTW twelve v battery type";
CM_ SG_ 1339 VCBATT1_a545_newLVBatteryType "VCBATT1 ECU: a545 new LV battery type";
CM_ SG_ 1339 VCBATT1_a545_serviceMode "Signal reported by VCBATT1 ECU";
CM_ SG_ 1339 VCBATT1_a545_factoryGated "VCBATT1 ECU: a545 factory gated";
CM_ SG_ 1339 VCBATT1_a545_frunkOpen "VCBATT1 ECU: a545 frunk open";
CM_ SG_ 1339 VCBATT1_a548_vehiclePowerState "VCBATT1 ECU: a548 vehicle power state";
CM_ SG_ 1339 VCBATT1_a548_notEnoughPowerForSu "VCBATT1 ECU: a548 not enough power for support";
CM_ SG_ 1339 VCBATT1_a548_HVBlockingMismatch "VCBATT1 ECU: a548 HV blocking mismatch";
CM_ SG_ 1339 VCBATT1_a548_LVBatteryCannotSupp "VCBATT1 ECU: a548 LV battery cannot support vehicle";
CM_ SG_ 1339 VCBATT1_a548_DI_gear "VCBATT1 ECU: a548 DI gear";
CM_ SG_ 1339 VCBATT1_a548_backstopBucketCount "VCBATT1 ECU: a548 backstop bucket count";
CM_ SG_ 1339 VCBATT1_a548_hvState "VCBATT1 ECU: a548 hv state";
CM_ SG_ 1339 VCBATT1_a548_BMS_MIA "VCBATT1 ECU: a548 BMS MIA";
CM_ SG_ 1339 VCBATT1_a548_PCS_MIA "VCBATT1 ECU: a548 PCS MIA";
CM_ SG_ 1339 VCBATT1_a548_ampHourBucketCount "VCBATT1 ECU: a548 amp hour bucket count";
CM_ SG_ 1339 VCBATT1_a548_LVBMSSOC "VCBATT1 ECU: a548 LVBMSSOC";
CM_ SG_ 1339 VCBATT1_a548_serviceMode "Signal reported by VCBATT1 ECU";
CM_ SG_ 1339 VCBATT1_a548_frunkOpen "VCBATT1 ECU: a548 frunk open";
CM_ SG_ 1339 VCBATT1_a548_PCSTargetVoltage "VCBATT1 ECU: a548 PCS target voltage";
CM_ SG_ 1339 VCBATT1_a548_ampHourBucketFilled "VCBATT1 ECU: a548 amp hour bucket filled";
CM_ SG_ 1339 VCBATT1_a548_HVNotConfirmedUpTri "VCBATT1 ECU: a548 HV not confirmed up trigger";
CM_ SG_ 1339 VCBATT1_a548_PCSNotMeetingTarget "VCBATT1 ECU: a548 PCS not meeting target trigger";
CM_ SG_ 1339 VCBATT1_a548_PCSMIATrigger "VCBATT1 ECU: a548 PCSMIA trigger";
CM_ SG_ 1339 VCBATT1_a548_PCSSaturatedTrigger "VCBATT1 ECU: a548 PCS saturated trigger";
CM_ SG_ 1339 VCBATT1_a548_backstopHit "VCBATT1 ECU: a548 backstop hit";
CM_ SG_ 1339 VCBATT1_a555_cell1Voltage "VCBATT1 ECU: a555 cell1 voltage";
CM_ SG_ 1339 VCBATT1_a555_cell2Voltage "VCBATT1 ECU: a555 cell2 voltage";
CM_ SG_ 1339 VCBATT1_a555_cell3Voltage "VCBATT1 ECU: a555 cell3 voltage";
CM_ SG_ 1339 VCBATT1_a555_cell4Voltage "VCBATT1 ECU: a555 cell4 voltage";
CM_ SG_ 1339 VCBATT1_a559_SOC "VCBATT1 ECU: a559 SOC";
CM_ SG_ 1339 VCBATT1_a559_PackCurrent "VCBATT1 ECU: a559 pack current";
CM_ SG_ 1339 VCBATT1_a559_vehiclePowerState "VCBATT1 ECU: a559 vehicle power state";
CM_ SG_ 1339 VCBATT1_a559_batterySMState "VCBATT1 ECU: a559 battery SM state";
CM_ SG_ 1339 VCBATT1_a559_bmsState "VCBATT1 ECU: a559 bms state";
CM_ SG_ 1339 VCBATT1_a559_dcdcLVSupportStatus "VCBATT1 ECU: a559 dcdc LV support status";
CM_ SG_ 1339 VCBATT1_a559_factoryMode "VCBATT1 ECU: a559 factory mode";
CM_ SG_ 1339 VCBATT1_a559_serviceMode "Signal reported by VCBATT1 ECU";
CM_ SG_ 1339 VCBATT1_a559_transportMode "VCBATT1 ECU: a559 transport mode";
CM_ SG_ 1339 VCBATT1_a559_notEnoughPowerForSu "VCBATT1 ECU: a559 not enough power for support";
CM_ SG_ 1339 VCBATT1_a559_crashDetected "VCBATT1 ECU: a559 crash detected";
CM_ SG_ 1339 VCBATT1_a559_BMS_MIA "VCBATT1 ECU: a559 BMS MIA";
CM_ SG_ 1339 VCBATT1_a559_PCS_MIA "VCBATT1 ECU: a559 PCS MIA";
CM_ SG_ 1339 VCBATT1_a559_HVBlockingMismatch "VCBATT1 ECU: a559 HV blocking mismatch";
CM_ SG_ 1339 VCBATT1_a559_HV_UP "VCBATT1 ECU: a559 HV UP";
CM_ SG_ 1339 VCBATT1_a559_pcsEFuseStable "VCBATT1 ECU: a559 pcs e fuse stable";
CM_ SG_ 1339 VCBATT1_a559_vcrightEFuseStable "VCBATT1 ECU: a559 vcright e fuse stable";
CM_ SG_ 1339 VCBATT1_a559_contactorEFuseStabl "VCBATT1 ECU: a559 contactor e fuse stable";
CM_ SG_ 1339 VCBATT1_a559_hvcEFuseStable "VCBATT1 ECU: a559 hvc e fuse stable";
CM_ SG_ 1339 VCBATT1_a559_frunkOpen "VCBATT1 ECU: a559 frunk open";
CM_ SG_ 1339 VCBATT1_a561_efuseTemperature "VCBATT1 ECU: a561 efuse temperature";
CM_ SG_ 1339 VCBATT1_a561_packTemperature "VCBATT1 ECU: a561 pack temperature";
CM_ SG_ 1339 VCBATT1_a561_ambientTemperature "VCBATT1 ECU: a561 ambient temperature";
CM_ SG_ 1339 VCBATT1_a561_cell1Voltage "VCBATT1 ECU: a561 cell1 voltage";
CM_ SG_ 1339 VCBATT1_a561_cell2Voltage "VCBATT1 ECU: a561 cell2 voltage";
CM_ SG_ 1339 VCBATT1_a561_cell3Voltage "VCBATT1 ECU: a561 cell3 voltage";
CM_ SG_ 1339 VCBATT1_a561_cell4Voltage "VCBATT1 ECU: a561 cell4 voltage";
CM_ SG_ 1339 VCBATT1_a561_factoryMode "VCBATT1 ECU: a561 factory mode";
CM_ SG_ 1339 VCBATT1_a561_serviceMode "Signal reported by VCBATT1 ECU";
CM_ SG_ 1339 VCBATT1_a561_frunkOpen "VCBATT1 ECU: a561 frunk open";
CM_ SG_ 1339 VCBATT1_a562_efuseTemperature "VCBATT1 ECU: a562 efuse temperature";
CM_ SG_ 1339 VCBATT1_a562_packTemperature "VCBATT1 ECU: a562 pack temperature";
CM_ SG_ 1339 VCBATT1_a562_ambientTemperature "VCBATT1 ECU: a562 ambient temperature";
CM_ SG_ 1339 VCBATT1_a562_cell1Voltage "VCBATT1 ECU: a562 cell1 voltage";
CM_ SG_ 1339 VCBATT1_a562_cell2Voltage "VCBATT1 ECU: a562 cell2 voltage";
CM_ SG_ 1339 VCBATT1_a562_cell3Voltage "VCBATT1 ECU: a562 cell3 voltage";
CM_ SG_ 1339 VCBATT1_a562_cell4Voltage "VCBATT1 ECU: a562 cell4 voltage";
CM_ SG_ 1339 VCBATT1_a562_factoryMode "VCBATT1 ECU: a562 factory mode";
CM_ SG_ 1339 VCBATT1_a562_serviceMode "Signal reported by VCBATT1 ECU";
CM_ SG_ 1339 VCBATT1_a562_frunkOpen "VCBATT1 ECU: a562 frunk open";
CM_ SG_ 1339 VCBATT1_a580_rightHeadlightCurre "VCBATT1 ECU: a580 right headlight current";
CM_ SG_ 1339 VCBATT1_a582_batterySMState "VCBATT1 ECU: a582 battery SM state";
CM_ SG_ 1339 VCBATT1_a582_PCSCurrent "VCBATT1 ECU: a582 PCS current";
CM_ SG_ 1339 VCBATT1_a582_LVBusVoltage "VCBATT1 ECU: a582 LV bus voltage";
CM_ SG_ 1339 VCBATT1_a582_LVBusVoltageSource "VCBATT1 ECU: a582 LV bus voltage source";
CM_ SG_ 1339 VCBATT1_a582_batteryType "VCBATT1 ECU: a582 battery type";
CM_ SG_ 1339 VCBATT1_a582_inFactoryMode "VCBATT1 ECU: a582 in factory mode";
CM_ SG_ 1339 VCBATT1_a582_frunkOpen "VCBATT1 ECU: a582 frunk open";
CM_ SG_ 1339 VCBATT1_a585_daysSincePreviousTe "VCBATT1 ECU: a585 days since previous test";
CM_ SG_ 1339 VCBATT1_a585_testUrgency "VCBATT1 ECU: a585 test urgency";
CM_ SG_ 1339 VCBATT1_a585_hoursSinceUserPrese "VCBATT1 ECU: a585 hours since user presence update";
CM_ SG_ 1339 VCBATT1_a585_userPresenceState "VCBATT1 ECU: a585 user presence state";
CM_ SG_ 1339 VCBATT1_a585_periodicTriggerActi "VCBATT1 ECU: a585 periodic trigger active";
CM_ SG_ 1339 VCBATT1_a585_developmentCar "VCBATT1 ECU: a585 development car";
CM_ SG_ 1339 VCBATT1_a585_updateStarted "VCBATT1 ECU: a585 update started";
CM_ SG_ 1339 VCBATT1_a585_factoryMode "VCBATT1 ECU: a585 factory mode";
CM_ SG_ 1339 VCBATT1_a585_serviceMode "Signal reported by VCBATT1 ECU";
CM_ SG_ 1339 VCBATT1_a587_factoryMode "VCBATT1 ECU: a587 factory mode";
CM_ SG_ 1339 VCBATT1_a587_serviceMode "Signal reported by VCBATT1 ECU";
CM_ SG_ 1339 VCBATT1_a587_transportMode "VCBATT1 ECU: a587 transport mode";
CM_ SG_ 1339 VCBATT1_a587_frunkOpen "VCBATT1 ECU: a587 frunk open";
CM_ SG_ 1339 VCBATT1_a587_LVBMS_packCurrent_v "VCBATT1 ECU: a587 LVBMS pack current valid";
CM_ SG_ 1339 VCBATT1_a587_vehiclePowerState "VCBATT1 ECU: a587 vehicle power state";
CM_ SG_ 1339 VCBATT1_a587_batterySMState "VCBATT1 ECU: a587 battery SM state";
CM_ SG_ 1339 VCBATT1_a587_LVBMS_packCurrent "VCBATT1 ECU: a587 LVBMS pack current";
CM_ SG_ 1339 VCBATT1_a587_IBSCurrent "VCBATT1 ECU: a587 IBS current";
CM_ SG_ 1339 VCBATT1_a592_vcleftCutoffEFuseCu "VCBATT1 ECU: a592 vcleft cutoff e fuse curve type";
CM_ SG_ 1339 VCBATT1_a592_vcleftCutoffCurveOf "VCBATT1 ECU: a592 vcleft cutoff curve offset channel";
CM_ SG_ 1339 VCBATT1_a592_vcleftCutoffATerm "VCBATT1 ECU: a592 vcleft cutoff a term";
CM_ SG_ 1339 VCBATT1_a592_vcleftCutoffBTerm "VCBATT1 ECU: a592 vcleft cutoff b term";
CM_ SG_ 1339 VCBATT1_a592_vcleftCutoffCTerm "VCBATT1 ECU: a592 vcleft cutoff c term";
CM_ SG_ 1339 VCBATT1_a593_vcleftCutoffEFuseFa "VCBATT1 ECU: a593 vcleft cutoff e fuse fast blow type";
CM_ SG_ 1339 VCBATT1_a593_vcleftCutoffCurrent "VCBATT1 ECU: a593 vcleft cutoff current threshold";
CM_ SG_ 1339 VCBATT1_a593_vcleftCutoffTimingT "VCBATT1 ECU: a593 vcleft cutoff timing threshold ms";
CM_ SG_ 1339 VCBATT1_a593_vcleftCutoffMaxCoun "VCBATT1 ECU: a593 vcleft cutoff max count";
CM_ SG_ 1339 VCBATT1_a597_EPBReleased "VCBATT1 ECU: a597 EPB released";
CM_ SG_ 1339 VCBATT1_a597_LVNotBeingSupported "VCBATT1 ECU: a597 LV not being supported";
CM_ SG_ 1339 VCBATT1_a597_LVBMB_currentInvali "VCBATT1 ECU: a597 LVBMB current invalid";
CM_ SG_ 1339 VCBATT1_a597_IBSCurrentInvalid "VCBATT1 ECU: a597 IBS current invalid";
CM_ SG_ 1339 VCBATT1_a597_LVBMB_eFuseOpen "VCBATT1 ECU: a597 LVBMB e fuse open";
CM_ SG_ 1339 VCBATT1_a597_vehicleIsUpdating "VCBATT1 ECU: a597 vehicle is updating";
CM_ SG_ 1339 VCBATT1_a597_LVBusVoltageNotCont "VCBATT1 ECU: a597 LV bus voltage not controllable";
CM_ SG_ 1339 VCBATT1_a597_lostLVBusControl "VCBATT1 ECU: a597 lost LV bus control";
CM_ SG_ 1339 VCBATT1_a597_externalPowerSupply "VCBATT1 ECU: a597 external power supply";
CM_ SG_ 1339 VCBATT1_a597_lvBatteryLowCharge "VCBATT1 ECU: a597 lv battery low charge";
CM_ SG_ 1339 VCBATT1_a597_closedDChgResult "VCBATT1 ECU: a597 closed d chg result";
CM_ SG_ 1339 VCBATT1_a597_closedChgResult "VCBATT1 ECU: a597 closed chg result";
CM_ SG_ 1339 VCBATT1_a597_selfTestState "VCBATT1 ECU: a597 self test state";
CM_ SG_ 1339 VCBATT1_a598_LVBMS_packCurrent "VCBATT1 ECU: a598 LVBMS pack current";
CM_ SG_ 1339 VCBATT1_a598_IBSCurrent "VCBATT1 ECU: a598 IBS current";
CM_ SG_ 1339 VCBATT1_a598_closedChgIBSCurrent "VCBATT1 ECU: a598 closed chg IBS current count";
CM_ SG_ 1339 VCBATT1_a598_closedChgPackCurren "VCBATT1 ECU: a598 closed chg pack current count";
CM_ SG_ 1339 VCBATT1_a598_closedDChgIBSCurren "VCBATT1 ECU: a598 closed d chg IBS current count";
CM_ SG_ 1339 VCBATT1_a598_closedDChgPackCurre "VCBATT1 ECU: a598 closed d chg pack current count";
CM_ SG_ 1339 VCBATT1_a598_closedDChgResult "VCBATT1 ECU: a598 closed d chg result";
CM_ SG_ 1339 VCBATT1_a598_closedChgResult "VCBATT1 ECU: a598 closed chg result";
CM_ SG_ 1339 VCBATT1_a599_GTW_twelveVBatteryT "VCBATT1 ECU: a599 GTW twelve v battery type";
CM_ SG_ 1339 VCBATT1_a599_newLVBatteryType "VCBATT1 ECU: a599 new LV battery type";
CM_ SG_ 1339 VCBATT1_a599_initialLVBatteryTyp "VCBATT1 ECU: a599 initial LV battery type";
CM_ SG_ 1339 VCBATT1_a599_serviceMode "Signal reported by VCBATT1 ECU";
CM_ SG_ 1339 VCBATT1_a599_factoryGated "VCBATT1 ECU: a599 factory gated";
CM_ SG_ 1339 VCBATT1_a599_frunkOpen "VCBATT1 ECU: a599 frunk open";
CM_ SG_ 1339 VCBATT1_a600_factoryMode "VCBATT1 ECU: a600 factory mode";
CM_ SG_ 1339 VCBATT1_a600_serviceMode "Signal reported by VCBATT1 ECU";
CM_ SG_ 1339 VCBATT1_a600_transportMode "VCBATT1 ECU: a600 transport mode";
CM_ SG_ 1339 VCBATT1_a600_frunkOpen "VCBATT1 ECU: a600 frunk open";
CM_ SG_ 1339 VCBATT1_a600_vehiclePowerState "VCBATT1 ECU: a600 vehicle power state";
CM_ SG_ 1339 VCBATT1_a600_batterySMState "VCBATT1 ECU: a600 battery SM state";
CM_ SG_ 1339 VCBATT1_a600_LVBMS_packCurrent "VCBATT1 ECU: a600 LVBMS pack current";
CM_ SG_ 1339 VCBATT1_a600_IBSCurrent "VCBATT1 ECU: a600 IBS current";
CM_ SG_ 1339 VCBATT1_a600_version "VCBATT1 ECU: a600 version";
CM_ SG_ 1339 VCBATT1_a601_subUsageId "VCBATT1 ECU: a601 sub usage id";
CM_ SG_ 1339 VCBATT1_a608_deltaV "VCBATT1 ECU: a608 delta v";
CM_ SG_ 1339 VCBATT1_a608_bleedFetFailureBric "VCBATT1 ECU: a608 bleed fet failure brick id";
CM_ SG_ 1339 VCBATT1_a608_retryCount "VCBATT1 ECU: a608 retry count";
CM_ SG_ 1339 VCBATT1_a608_setFromNvm "VCBATT1 ECU: a608 set from nvm";
BA_DEF_ BO_ "GenMsgCycleTime" INT 0 3600000;
BA_DEF_ BO_ "GenMsgSendType" ENUM "Cyclic","NotUsed","NotUsed","NotUsed","NotUsed","NotUsed","NotUsed","IfActive","NoMsgSendType","NotUsed";
BA_DEF_ BO_ "VFrameFormat" ENUM "StandardCAN","ExtendedCAN","reserved","J1939PG","reserved","reserved","reserved","reserved","reserved","reserved","reserved","reserved","reserved","reserved","StandardCAN_FD","ExtendedCAN_FD";
BA_DEF_ BO_ "CANFD_BRS" ENUM "0","1";
BA_DEF_ SG_ "SystemSignalLongSymbol" STRING;
BA_DEF_ SG_ "Confidence" ENUM "layout-only","plausible","validated";
BA_DEF_DEF_ "GenMsgCycleTime" 0;
BA_DEF_DEF_ "GenMsgSendType" "NoMsgSendType";
BA_DEF_DEF_ "VFrameFormat" "StandardCAN";
BA_DEF_DEF_ "CANFD_BRS" "1";
BA_DEF_DEF_ "SystemSignalLongSymbol" "";
BA_DEF_DEF_ "Confidence" "layout-only";
BA_ "SystemSignalLongSymbol" SG_ 1339 VCBATT1_a091_FRONTIPC_faultsAndE "VCBATT1_a091_FRONTIPC_faultsAndExtras";
BA_ "SystemSignalLongSymbol" SG_ 1339 VCBATT1_a098_FRONTIPC_temperatur "VCBATT1_a098_FRONTIPC_temperature";
BA_ "SystemSignalLongSymbol" SG_ 1339 VCBATT1_a098_FRONTIPC_thermalCon "VCBATT1_a098_FRONTIPC_thermalControl";
BA_ "SystemSignalLongSymbol" SG_ 1339 VCBATT1_a106_BATTIPC_dcdcRailSta "VCBATT1_a106_BATTIPC_dcdcRailStatus";
BA_ "SystemSignalLongSymbol" SG_ 1339 VCBATT1_a106_FRONTIPC_thermalCon "VCBATT1_a106_FRONTIPC_thermalControl";
BA_ "SystemSignalLongSymbol" SG_ 1339 VCBATT1_a106_FRONTIPC_dcdcRailSt "VCBATT1_a106_FRONTIPC_dcdcRailStatus";
BA_ "SystemSignalLongSymbol" SG_ 1339 VCBATT1_a108_FRONTIPC_temperatur "VCBATT1_a108_FRONTIPC_temperature";
BA_ "SystemSignalLongSymbol" SG_ 1339 VCBATT1_a108_FRONTIPC_thermalCon "VCBATT1_a108_FRONTIPC_thermalControl";
BA_ "SystemSignalLongSymbol" SG_ 1339 VCBATT1_a108_FRONTIPC_motorStatu "VCBATT1_a108_FRONTIPC_motorStatus";
BA_ "SystemSignalLongSymbol" SG_ 1339 VCBATT1_a120_FRONTIPC_systemStat "VCBATT1_a120_FRONTIPC_systemStatus";
BA_ "SystemSignalLongSymbol" SG_ 1339 VCBATT1_a120_BATTIPC_systemStatu "VCBATT1_a120_BATTIPC_systemStatus";
BA_ "SystemSignalLongSymbol" SG_ 1339 VCBATT1_a120_FRONTIPC_systemPowe "VCBATT1_a120_FRONTIPC_systemPower";
BA_ "SystemSignalLongSymbol" SG_ 1339 VCBATT1_a120_FRONTIPC_autonomyHe "VCBATT1_a120_FRONTIPC_autonomyHealth";
BA_ "SystemSignalLongSymbol" SG_ 1339 VCBATT1_a120_BATTIPC_chassisCont "VCBATT1_a120_BATTIPC_chassisControl2";
BA_ "SystemSignalLongSymbol" SG_ 1339 VCBATT1_a120_FRONTIPC_chassisCon "VCBATT1_a120_FRONTIPC_chassisControl2";
BA_ "SystemSignalLongSymbol" SG_ 1339 VCBATT1_a120_FRONTIPC_odometerSt "VCBATT1_a120_FRONTIPC_odometerStatus";
BA_ "SystemSignalLongSymbol" SG_ 1339 VCBATT1_a127_vcleftEFuseRemainin "VCBATT1_a127_vcleftEFuseRemainingRetries";
BA_ "SystemSignalLongSymbol" SG_ 1339 VCBATT1_a130_autopilot1EFuseCurr "VCBATT1_a130_autopilot1EFuseCurrent";
BA_ "SystemSignalLongSymbol" SG_ 1339 VCBATT1_a130_autopilot1EFuseVolt "VCBATT1_a130_autopilot1EFuseVoltage";
BA_ "SystemSignalLongSymbol" SG_ 1339 VCBATT1_a130_autopilot1EFuseRema "VCBATT1_a130_autopilot1EFuseRemainingRetries";
BA_ "SystemSignalLongSymbol" SG_ 1339 VCBATT1_a133_BATTIPC_primaryActu "VCBATT1_a133_BATTIPC_primaryActuator";
BA_ "SystemSignalLongSymbol" SG_ 1339 VCBATT1_a133_FRONTIPC_secondaryA "VCBATT1_a133_FRONTIPC_secondaryActuator";
BA_ "SystemSignalLongSymbol" SG_ 1339 VCBATT1_a180_notEnoughPowerForSu "VCBATT1_a180_notEnoughPowerForSupport";
BA_ "SystemSignalLongSymbol" SG_ 1339 VCBATT1_a180_contactorEFuseStabl "VCBATT1_a180_contactorEFuseStable";
BA_ "SystemSignalLongSymbol" SG_ 1339 VCBATT1_a182_resistanceEstimatio "VCBATT1_a182_resistanceEstimationHardFailure";
BA_ "SystemSignalLongSymbol" SG_ 1339 VCBATT1_a182_dcrMilliOhmsAboveTh "VCBATT1_a182_dcrMilliOhmsAboveThreshold";
BA_ "SystemSignalLongSymbol" SG_ 1339 VCBATT1_a182_prechargeLVLoadRedu "VCBATT1_a182_prechargeLVLoadReduction";
BA_ "SystemSignalLongSymbol" SG_ 1339 VCBATT1_a182_instantPrechargeDCR "VCBATT1_a182_instantPrechargeDCRTooHigh";
BA_ "SystemSignalLongSymbol" SG_ 1339 VCBATT1_a182_calibrationLostFaul "VCBATT1_a182_calibrationLostFault";
BA_ "SystemSignalLongSymbol" SG_ 1339 VCBATT1_a191_reverseBatteryEFuse "VCBATT1_a191_reverseBatteryEFuseFault";
BA_ "SystemSignalLongSymbol" SG_ 1339 VCBATT1_a191_vehicleLoadShedActi "VCBATT1_a191_vehicleLoadShedActive";
BA_ "SystemSignalLongSymbol" SG_ 1339 VCBATT1_a191_vehicleLoadShedHvFa "VCBATT1_a191_vehicleLoadShedHvFaultActive";
BA_ "SystemSignalLongSymbol" SG_ 1339 VCBATT1_a191_vehicleLoadShedPost "VCBATT1_a191_vehicleLoadShedPostCrashActive";
BA_ "SystemSignalLongSymbol" SG_ 1339 VCBATT1_a191_a180_DCDCNotSupport "VCBATT1_a191_a180_DCDCNotSupportingLVBus";
BA_ "SystemSignalLongSymbol" SG_ 1339 VCBATT1_a191_LVBMSCurrentTargetV "VCBATT1_a191_LVBMSCurrentTargetValid";
BA_ "SystemSignalLongSymbol" SG_ 1339 VCBATT1_a191_LVBMSVoltageTargetV "VCBATT1_a191_LVBMSVoltageTargetValid";
BA_ "SystemSignalLongSymbol" SG_ 1339 VCBATT1_a191_vehicleLoadShedStag "VCBATT1_a191_vehicleLoadShedStage";
BA_ "SystemSignalLongSymbol" SG_ 1339 VCBATT1_a191_exitDriveWarningTim "VCBATT1_a191_exitDriveWarningTimerExpired";
BA_ "SystemSignalLongSymbol" SG_ 1339 VCBATT1_a191_NotEnoughPowerForSu "VCBATT1_a191_NotEnoughPowerForSupport";
BA_ "SystemSignalLongSymbol" SG_ 1339 VCBATT1_a196_disconnectedBattery "VCBATT1_a196_disconnectedBatteryTestCurrent";
BA_ "SystemSignalLongSymbol" SG_ 1339 VCBATT1_a196_disconnectedBa_0002 "VCBATT1_a196_disconnectedBatteryTestVoltage";
BA_ "SystemSignalLongSymbol" SG_ 1339 VCBATT1_a196_disconnectedBa_0001 "VCBATT1_a196_disconnectedBatteryTestPrevVoltage";
BA_ "SystemSignalLongSymbol" SG_ 1339 VCBATT1_a204_uvLoadshedFaultInje "VCBATT1_a204_uvLoadshedFaultInject";
BA_ "SystemSignalLongSymbol" SG_ 1339 VCBATT1_a205_ovLoadshedFaultInje "VCBATT1_a205_ovLoadshedFaultInject";
BA_ "SystemSignalLongSymbol" SG_ 1339 VCBATT1_a216_vcleftFastBlowImmin "VCBATT1_a216_vcleftFastBlowImminent";
BA_ "SystemSignalLongSymbol" SG_ 1339 VCBATT1_a216_vcleftFastBlowDebou "VCBATT1_a216_vcleftFastBlowDebounceImminent";
BA_ "SystemSignalLongSymbol" SG_ 1339 VCBATT1_a216_vcleftStaticImminen "VCBATT1_a216_vcleftStaticImminent";
BA_ "SystemSignalLongSymbol" SG_ 1339 VCBATT1_a216_vcleftDynamicImmine "VCBATT1_a216_vcleftDynamicImminent";
BA_ "SystemSignalLongSymbol" SG_ 1339 VCBATT1_a223_overvoltageFaultAct "VCBATT1_a223_overvoltageFaultActive";
BA_ "SystemSignalLongSymbol" SG_ 1339 VCBATT1_a223_sharedBridgeShutdow "VCBATT1_a223_sharedBridgeShutdownActive";
BA_ "SystemSignalLongSymbol" SG_ 1339 VCBATT1_a224_hardwareLoadshedFau "VCBATT1_a224_hardwareLoadshedFaultActive";
BA_ "SystemSignalLongSymbol" SG_ 1339 VCBATT1_a224_ocLoadshedFaultActi "VCBATT1_a224_ocLoadshedFaultActive";
BA_ "SystemSignalLongSymbol" SG_ 1339 VCBATT1_a224_faultChannelPi_0003 "VCBATT1_a224_faultChannelPinActiveSlow";
BA_ "SystemSignalLongSymbol" SG_ 1339 VCBATT1_a224_faultChannelPi_0002 "VCBATT1_a224_faultChannelPinActiveMedium";
BA_ "SystemSignalLongSymbol" SG_ 1339 VCBATT1_a224_faultChannelPinActi "VCBATT1_a224_faultChannelPinActiveFast";
BA_ "SystemSignalLongSymbol" SG_ 1339 VCBATT1_a224_faultChannelPi_0001 "VCBATT1_a224_faultChannelPinActiveIngoing";
BA_ "SystemSignalLongSymbol" SG_ 1339 VCBATT1_a224_hardwareLoadsh_0001 "VCBATT1_a224_hardwareLoadshedFaultActiveIngoing";
BA_ "SystemSignalLongSymbol" SG_ 1339 VCBATT1_a229_lvBatteryActiveDece "VCBATT1_a229_lvBatteryActiveDecelEnergy";
BA_ "SystemSignalLongSymbol" SG_ 1339 VCBATT1_a229_lvBatteryRevEfuseOf "VCBATT1_a229_lvBatteryRevEfuseOff";
BA_ "SystemSignalLongSymbol" SG_ 1339 VCBATT1_a235_hvcRightDomainFailu "VCBATT1_a235_hvcRightDomainFailureReason";
BA_ "SystemSignalLongSymbol" SG_ 1339 VCBATT1_a235_hvcLeftDomainFailur "VCBATT1_a235_hvcLeftDomainFailureReason";
BA_ "SystemSignalLongSymbol" SG_ 1339 VCBATT1_a244_brakeValveECUEFuseC "VCBATT1_a244_brakeValveECUEFuseCurrent";
BA_ "SystemSignalLongSymbol" SG_ 1339 VCBATT1_a244_brakeValveECUEFuseV "VCBATT1_a244_brakeValveECUEFuseVoltage";
BA_ "SystemSignalLongSymbol" SG_ 1339 VCBATT1_a253_ampHourTargetNotRea "VCBATT1_a253_ampHourTargetNotReached";
BA_ "SystemSignalLongSymbol" SG_ 1339 VCBATT1_a260_notEnoughPowerForSu "VCBATT1_a260_notEnoughPowerForSupport";
BA_ "SystemSignalLongSymbol" SG_ 1339 VCBATT1_a260_coolantHasBeenFille "VCBATT1_a260_coolantHasBeenFilled";
BA_ "SystemSignalLongSymbol" SG_ 1339 VCBATT1_a260_PCSAndVCREFuseStabl "VCBATT1_a260_PCSAndVCREFuseStable";
BA_ "SystemSignalLongSymbol" SG_ 1339 VCBATT1_a297_bmbDeviceFaultTempM "VCBATT1_a297_bmbDeviceFaultTempMask";
BA_ "SystemSignalLongSymbol" SG_ 1339 VCBATT1_a359_coolantHasBeenFille "VCBATT1_a359_coolantHasBeenFilled";
BA_ "SystemSignalLongSymbol" SG_ 1339 VCBATT1_a363_minBleedChargeBrick "VCBATT1_a363_minBleedChargeBrickId";
BA_ "SystemSignalLongSymbol" SG_ 1339 VCBATT1_a370_notEnoughPowerForSu "VCBATT1_a370_notEnoughPowerForSupport";
BA_ "SystemSignalLongSymbol" SG_ 1339 VCBATT1_a371_shortedCellTestTrig "VCBATT1_a371_shortedCellTestTrigger";
BA_ "SystemSignalLongSymbol" SG_ 1339 VCBATT1_a371_voltDropOnHighCurre "VCBATT1_a371_voltDropOnHighCurrentTrigger";
BA_ "SystemSignalLongSymbol" SG_ 1339 VCBATT1_a371_deadLVMinimalAhDisc "VCBATT1_a371_deadLVMinimalAhDischargedTrigger";
BA_ "SystemSignalLongSymbol" SG_ 1339 VCBATT1_a371_resistanceEstimatio "VCBATT1_a371_resistanceEstimationHardFailTrigger";
BA_ "SystemSignalLongSymbol" SG_ 1339 VCBATT1_a371_dcrMilliOhmsAboveTh "VCBATT1_a371_dcrMilliOhmsAboveThresholdTrigger";
BA_ "SystemSignalLongSymbol" SG_ 1339 VCBATT1_a371_prechargeLVLoadRedu "VCBATT1_a371_prechargeLVLoadReductionTrigger";
BA_ "SystemSignalLongSymbol" SG_ 1339 VCBATT1_a371_instantPrechargeDCR "VCBATT1_a371_instantPrechargeDCRTooHighTrigger";
BA_ "SystemSignalLongSymbol" SG_ 1339 VCBATT1_a372_bmbDeviceFaultBrick "VCBATT1_a372_bmbDeviceFaultBrickMask";
BA_ "SystemSignalLongSymbol" SG_ 1339 VCBATT1_a387_shortedCellFaultCou "VCBATT1_a387_shortedCellFaultCounter";
BA_ "SystemSignalLongSymbol" SG_ 1339 VCBATT1_a388_shortedCellFaultCou "VCBATT1_a388_shortedCellFaultCounter";
BA_ "SystemSignalLongSymbol" SG_ 1339 VCBATT1_a392_bmbDeviceFaultBrick "VCBATT1_a392_bmbDeviceFaultBrickMask";
BA_ "SystemSignalLongSymbol" SG_ 1339 VCBATT1_a402_failureToPrechargeR "VCBATT1_a402_failureToPrechargeRisk";
BA_ "SystemSignalLongSymbol" SG_ 1339 VCBATT1_a402_electricalDisconnec "VCBATT1_a402_electricalDisconnectLVBattery";
BA_ "SystemSignalLongSymbol" SG_ 1339 VCBATT1_a402_communicationDiscon "VCBATT1_a402_communicationDisconnectLVBattery";
BA_ "SystemSignalLongSymbol" SG_ 1339 VCBATT1_a407_intervalCurrentVari "VCBATT1_a407_intervalCurrentVariance";
BA_ "SystemSignalLongSymbol" SG_ 1339 VCBATT1_a407_pulseCurrentVarianc "VCBATT1_a407_pulseCurrentVarianceShifted";
BA_ "SystemSignalLongSymbol" SG_ 1339 VCBATT1_a414_loadUnattemptedOnFa "VCBATT1_a414_loadUnattemptedOnFailure";
BA_ "SystemSignalLongSymbol" SG_ 1339 VCBATT1_a414_deviceStuckOnFailur "VCBATT1_a414_deviceStuckOnFailure";
BA_ "SystemSignalLongSymbol" SG_ 1339 VCBATT1_a414_followerVCLeftSelfT "VCBATT1_a414_followerVCLeftSelfTestFailure";
BA_ "SystemSignalLongSymbol" SG_ 1339 VCBATT1_a414_uvLoadshedVsenseDig "VCBATT1_a414_uvLoadshedVsenseDigIn";
BA_ "SystemSignalLongSymbol" SG_ 1339 VCBATT1_a415_upstreamEFuseStuckO "VCBATT1_a415_upstreamEFuseStuckOff";
BA_ "SystemSignalLongSymbol" SG_ 1339 VCBATT1_a421_energyCriticalPullo "VCBATT1_a421_energyCriticalPullover";
BA_ "SystemSignalLongSymbol" SG_ 1339 VCBATT1_a431_maxChargeCurrentLim "VCBATT1_a431_maxChargeCurrentLimit";
BA_ "SystemSignalLongSymbol" SG_ 1339 VCBATT1_a436_maxDischargeCurrent "VCBATT1_a436_maxDischargeCurrentLimit";
BA_ "SystemSignalLongSymbol" SG_ 1339 VCBATT1_a462_NTCTempDiffWarnLeve "VCBATT1_a462_NTCTempDiffWarnLevel1";
BA_ "SystemSignalLongSymbol" SG_ 1339 VCBATT1_a475_deviceOvertemperatu "VCBATT1_a475_deviceOvertemperature";
BA_ "SystemSignalLongSymbol" SG_ 1339 VCBATT1_a478_battFaultPackOverVo "VCBATT1_a478_battFaultPackOverVoltage";
BA_ "SystemSignalLongSymbol" SG_ 1339 VCBATT1_a478_battFaultHardwareOv "VCBATT1_a478_battFaultHardwareOverCurrent";
BA_ "SystemSignalLongSymbol" SG_ 1339 VCBATT1_a478_battFaultChargeOver "VCBATT1_a478_battFaultChargeOverCurrent";
BA_ "SystemSignalLongSymbol" SG_ 1339 VCBATT1_a478_battFaultCellUnderV "VCBATT1_a478_battFaultCellUnderVoltage";
BA_ "SystemSignalLongSymbol" SG_ 1339 VCBATT1_a478_battFaultCellOverVo "VCBATT1_a478_battFaultCellOverVoltage";
BA_ "SystemSignalLongSymbol" SG_ 1339 VCBATT1_a478_notEnoughPowerForSu "VCBATT1_a478_notEnoughPowerForSupport";
BA_ "SystemSignalLongSymbol" SG_ 1339 VCBATT1_a478_contactorEFuseStabl "VCBATT1_a478_contactorEFuseStable";
BA_ "SystemSignalLongSymbol" SG_ 1339 VCBATT1_a480_deviceOvertemperatu "VCBATT1_a480_deviceOvertemperature";
BA_ "SystemSignalLongSymbol" SG_ 1339 VCBATT1_a482_lvBridgeEFuseCurren "VCBATT1_a482_lvBridgeEFuseCurrent";
BA_ "SystemSignalLongSymbol" SG_ 1339 VCBATT1_a482_lvBridgeEFuseVoltag "VCBATT1_a482_lvBridgeEFuseVoltage";
BA_ "SystemSignalLongSymbol" SG_ 1339 VCBATT1_a482_lvBridgeEFuseRemain "VCBATT1_a482_lvBridgeEFuseRemainingRetries";
BA_ "SystemSignalLongSymbol" SG_ 1339 VCBATT1_a484_upstreamEFuseStuckO "VCBATT1_a484_upstreamEFuseStuckOn";
BA_ "SystemSignalLongSymbol" SG_ 1339 VCBATT1_a484_upstreamEFuseVoltag "VCBATT1_a484_upstreamEFuseVoltage";
BA_ "SystemSignalLongSymbol" SG_ 1339 VCBATT1_a485_upstreamEfuseUnatte "VCBATT1_a485_upstreamEfuseUnattemptedOn";
BA_ "SystemSignalLongSymbol" SG_ 1339 VCBATT1_a486_bridgeFailedArmingS "VCBATT1_a486_bridgeFailedArmingSetup";
BA_ "SystemSignalLongSymbol" SG_ 1339 VCBATT1_a486_bridgeFailedSyncChe "VCBATT1_a486_bridgeFailedSyncCheck";
BA_ "SystemSignalLongSymbol" SG_ 1339 VCBATT1_a486_localBridgeSyncArme "VCBATT1_a486_localBridgeSyncArmed";
BA_ "SystemSignalLongSymbol" SG_ 1339 VCBATT1_a486_remoteBridgeOutputO "VCBATT1_a486_remoteBridgeOutputOn";
BA_ "SystemSignalLongSymbol" SG_ 1339 VCBATT1_a486_remoteBridgeOu_0001 "VCBATT1_a486_remoteBridgeOutputOnValid";
BA_ "SystemSignalLongSymbol" SG_ 1339 VCBATT1_a486_remoteBridgeSyncArm "VCBATT1_a486_remoteBridgeSyncArmed";
BA_ "SystemSignalLongSymbol" SG_ 1339 VCBATT1_a486_remoteBridgeSy_0001 "VCBATT1_a486_remoteBridgeSyncArmedValid";
BA_ "SystemSignalLongSymbol" SG_ 1339 VCBATT1_a486_remoteBridgeDinStat "VCBATT1_a486_remoteBridgeDinState";
BA_ "SystemSignalLongSymbol" SG_ 1339 VCBATT1_a486_remoteBridgeDi_0001 "VCBATT1_a486_remoteBridgeDinStateValid";
BA_ "SystemSignalLongSymbol" SG_ 1339 VCBATT1_a495_reverseBatteryEFuse "VCBATT1_a495_reverseBatteryEFuseFault";
BA_ "SystemSignalLongSymbol" SG_ 1339 VCBATT1_a496_reverseBatteryEFuse "VCBATT1_a496_reverseBatteryEFuseFault";
BA_ "SystemSignalLongSymbol" SG_ 1339 VCBATT1_a496_vehicleLoadShedActi "VCBATT1_a496_vehicleLoadShedActive";
BA_ "SystemSignalLongSymbol" SG_ 1339 VCBATT1_a496_NotEnoughPowerForSu "VCBATT1_a496_NotEnoughPowerForSupport";
BA_ "SystemSignalLongSymbol" SG_ 1339 VCBATT1_a512_packVoltageInt_0001 "VCBATT1_a512_packVoltageIntervalMin";
BA_ "SystemSignalLongSymbol" SG_ 1339 VCBATT1_a512_packVoltageInterval "VCBATT1_a512_packVoltageIntervalMax";
BA_ "SystemSignalLongSymbol" SG_ 1339 VCBATT1_a512_overcurrentDirectio "VCBATT1_a512_overcurrentDirection";
BA_ "SystemSignalLongSymbol" SG_ 1339 VCBATT1_a525_GTW_twelveVBatteryT "VCBATT1_a525_GTW_twelveVBatteryType";
BA_ "SystemSignalLongSymbol" SG_ 1339 VCBATT1_a525_initialLVBatteryTyp "VCBATT1_a525_initialLVBatteryType";
BA_ "SystemSignalLongSymbol" SG_ 1339 VCBATT1_a545_GTW_twelveVBatteryT "VCBATT1_a545_GTW_twelveVBatteryType";
BA_ "SystemSignalLongSymbol" SG_ 1339 VCBATT1_a548_notEnoughPowerForSu "VCBATT1_a548_notEnoughPowerForSupport";
BA_ "SystemSignalLongSymbol" SG_ 1339 VCBATT1_a548_LVBatteryCannotSupp "VCBATT1_a548_LVBatteryCannotSupportVehicle";
BA_ "SystemSignalLongSymbol" SG_ 1339 VCBATT1_a548_HVNotConfirmedUpTri "VCBATT1_a548_HVNotConfirmedUpTrigger";
BA_ "SystemSignalLongSymbol" SG_ 1339 VCBATT1_a548_PCSNotMeetingTarget "VCBATT1_a548_PCSNotMeetingTargetTrigger";
BA_ "SystemSignalLongSymbol" SG_ 1339 VCBATT1_a559_notEnoughPowerForSu "VCBATT1_a559_notEnoughPowerForSupport";
BA_ "SystemSignalLongSymbol" SG_ 1339 VCBATT1_a559_contactorEFuseStabl "VCBATT1_a559_contactorEFuseStable";
BA_ "SystemSignalLongSymbol" SG_ 1339 VCBATT1_a580_rightHeadlightCurre "VCBATT1_a580_rightHeadlightCurrent";
BA_ "SystemSignalLongSymbol" SG_ 1339 VCBATT1_a585_daysSincePreviousTe "VCBATT1_a585_daysSincePreviousTest";
BA_ "SystemSignalLongSymbol" SG_ 1339 VCBATT1_a585_hoursSinceUserPrese "VCBATT1_a585_hoursSinceUserPresenceUpdate";
BA_ "SystemSignalLongSymbol" SG_ 1339 VCBATT1_a585_periodicTriggerActi "VCBATT1_a585_periodicTriggerActive";
BA_ "SystemSignalLongSymbol" SG_ 1339 VCBATT1_a587_LVBMS_packCurrent_v "VCBATT1_a587_LVBMS_packCurrent_valid";
BA_ "SystemSignalLongSymbol" SG_ 1339 VCBATT1_a592_vcleftCutoffEFuseCu "VCBATT1_a592_vcleftCutoffEFuseCurveType";
BA_ "SystemSignalLongSymbol" SG_ 1339 VCBATT1_a592_vcleftCutoffCurveOf "VCBATT1_a592_vcleftCutoffCurveOffsetChannel";
BA_ "SystemSignalLongSymbol" SG_ 1339 VCBATT1_a593_vcleftCutoffEFuseFa "VCBATT1_a593_vcleftCutoffEFuseFastBlowType";
BA_ "SystemSignalLongSymbol" SG_ 1339 VCBATT1_a593_vcleftCutoffCurrent "VCBATT1_a593_vcleftCutoffCurrentThreshold";
BA_ "SystemSignalLongSymbol" SG_ 1339 VCBATT1_a593_vcleftCutoffTimingT "VCBATT1_a593_vcleftCutoffTimingThresholdMs";
BA_ "SystemSignalLongSymbol" SG_ 1339 VCBATT1_a593_vcleftCutoffMaxCoun "VCBATT1_a593_vcleftCutoffMaxCount";
BA_ "SystemSignalLongSymbol" SG_ 1339 VCBATT1_a597_LVBMB_currentInvali "VCBATT1_a597_LVBMB_currentInvalid";
BA_ "SystemSignalLongSymbol" SG_ 1339 VCBATT1_a597_LVBusVoltageNotCont "VCBATT1_a597_LVBusVoltageNotControllable";
BA_ "SystemSignalLongSymbol" SG_ 1339 VCBATT1_a598_closedChgIBSCurrent "VCBATT1_a598_closedChgIBSCurrentCount";
BA_ "SystemSignalLongSymbol" SG_ 1339 VCBATT1_a598_closedChgPackCurren "VCBATT1_a598_closedChgPackCurrentCount";
BA_ "SystemSignalLongSymbol" SG_ 1339 VCBATT1_a598_closedDChgIBSCurren "VCBATT1_a598_closedDChgIBSCurrentCount";
BA_ "SystemSignalLongSymbol" SG_ 1339 VCBATT1_a598_closedDChgPackCurre "VCBATT1_a598_closedDChgPackCurrentCount";
BA_ "SystemSignalLongSymbol" SG_ 1339 VCBATT1_a599_GTW_twelveVBatteryT "VCBATT1_a599_GTW_twelveVBatteryType";
BA_ "SystemSignalLongSymbol" SG_ 1339 VCBATT1_a599_initialLVBatteryTyp "VCBATT1_a599_initialLVBatteryType";
BA_ "SystemSignalLongSymbol" SG_ 1339 VCBATT1_a608_bleedFetFailureBric "VCBATT1_a608_bleedFetFailureBrickId";
