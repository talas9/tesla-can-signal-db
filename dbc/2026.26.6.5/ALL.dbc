VERSION "dbc-export 1 2026.26.6.5"

NS_ :

BS_:

BU_: ADSP APB APP APS APSB BB BMS CC CMP CMPD CP DAS DI DIF DIR DPB EPAS3P EPAS3S EPASTP EPASTS EPBL EPBR ESP EVSE FC GTW HCML HCMR HVP IBST ICR IDB LS OCS1P PARK PCS PCS2 PM PMF PMR PNCD PTC RADC RCM RCM2 RCM3 RCU SCCM SCM SCS SDCR TAS TCU TCU2 TPMS TRCM UI UIS UMC USM V2G VC VCBATT VCBATT0 VCBATT1 VCBATT2 VCCC VCFRONT VCFRONT1 VCFRONT2 VCLEFT VCRIGHT VCSEAT2L VCSEAT2R VCSEC VEH

BO_ 1009 RCM2_alertMatrix: 8 RCM2
 SG_ RCM2_matrixIndex M : 0|4@1+ (1,0) [0|15] "" Vector__XXX
 SG_ RCM2_a000_crashDetected m0 : 4|1@1+ (1,0) [0|1] "" Vector__XXX
 SG_ RCM2_a001_nearDeploy m0 : 5|1@1+ (1,0) [0|1] "" Vector__XXX
 SG_ RCM2_a002_airbagsUnArmed m0 : 6|1@1+ (1,0) [0|1] "" Vector__XXX
 SG_ RCM2_a003_warningIndicator m0 : 7|1@1+ (1,0) [0|1] "" Vector__XXX
 SG_ RCM2_a004_crashAlgoWakeup m0 : 8|1@1+ (1,0) [0|1] "" Vector__XXX
 SG_ RCM2_a005_abuseImmunityThrshold m0 : 9|1@1+ (1,0) [0|1] "" Vector__XXX
 SG_ RCM2_a006_supplierDiagEnabled m0 : 10|1@1+ (1,0) [0|1] "" Vector__XXX
 SG_ RCM2_a007_pedProCrashDetected m0 : 11|1@1+ (1,0) [0|1] "" Vector__XXX
 SG_ RCM2_a008_factoryMode m0 : 12|1@1+ (1,0) [0|1] "" Vector__XXX
 SG_ RCM2_a009_edrDataAreaLocked m0 : 13|1@1+ (1,0) [0|1] "" Vector__XXX
 SG_ RCM2_a010_pedProEDRDataLocked m0 : 14|1@1+ (1,0) [0|1] "" Vector__XXX
 SG_ RCM2_a011_placeholder0 m0 : 15|1@1+ (1,0) [0|1] "" Vector__XXX
 SG_ RCM2_a012_placeholder1 m0 : 16|1@1+ (1,0) [0|1] "" Vector__XXX
 SG_ RCM2_a013_placeholder2 m0 : 17|1@1+ (1,0) [0|1] "" Vector__XXX
 SG_ RCM2_a014_pedProNearDeploy m0 : 18|1@1+ (1,0) [0|1] "" Vector__XXX
 SG_ RCM2_a015_noDeployCrashCal m0 : 19|1@1+ (1,0) [0|1] "" Vector__XXX
 SG_ RCM2_a016_noDeployPedProCal m0 : 20|1@1+ (1,0) [0|1] "" Vector__XXX
 SG_ RCM2_a017_ecuLogAvailable m0 : 21|1@1+ (1,0) [0|1] "" Vector__XXX
 SG_ RCM2_a047_batteryESRhigh m0 : 22|1@1+ (1,0) [0|1] "" Vector__XXX
 SG_ RCM2_a048_batteryVoltageTooHigh m0 : 23|1@1+ (1,0) [0|1] "" Vector__XXX
 SG_ RCM2_a049_batteryVoltageTooLow m0 : 24|1@1+ (1,0) [0|1] "" Vector__XXX
 SG_ RCM2_a050_driverABStg1Sht2Gnd m0 : 25|1@1+ (1,0) [0|1] "" Vector__XXX
 SG_ RCM2_a051_driverABStg1Sht2Bat m0 : 26|1@1+ (1,0) [0|1] "" Vector__XXX
 SG_ RCM2_a052_driverABStg1Open m0 : 27|1@1+ (1,0) [0|1] "" Vector__XXX
 SG_ RCM2_a053_driverABStg1Short m0 : 28|1@1+ (1,0) [0|1] "" Vector__XXX
 SG_ RCM2_a054_driverABStg1CrssCoup m0 : 29|1@1+ (1,0) [0|1] "" Vector__XXX
 SG_ RCM2_a055_driverABStg1Config m0 : 30|1@1+ (1,0) [0|1] "" Vector__XXX
 SG_ RCM2_a056_driverABStg2Sht2Gnd m0 : 31|1@1+ (1,0) [0|1] "" Vector__XXX
 SG_ RCM2_a057_driverABStg2Sht2Bat m0 : 32|1@1+ (1,0) [0|1] "" Vector__XXX
 SG_ RCM2_a058_driverABStg2Open m0 : 33|1@1+ (1,0) [0|1] "" Vector__XXX
 SG_ RCM2_a059_driverABStg2Short m0 : 34|1@1+ (1,0) [0|1] "" Vector__XXX
 SG_ RCM2_a060_driverABStg2CrssCoup m0 : 35|1@1+ (1,0) [0|1] "" Vector__XXX
 SG_ RCM2_a061_driverABStg2Config m0 : 36|1@1+ (1,0) [0|1] "" Vector__XXX
 SG_ RCM2_a062_passABStg1Sht2Gnd m0 : 37|1@1+ (1,0) [0|1] "" Vector__XXX
 SG_ RCM2_a063_passABStg1Sht2Bat m0 : 38|1@1+ (1,0) [0|1] "" Vector__XXX
 SG_ RCM2_a064_passABStg1Open m0 : 39|1@1+ (1,0) [0|1] "" Vector__XXX
 SG_ RCM2_a065_passABStg1Short m0 : 40|1@1+ (1,0) [0|1] "" Vector__XXX
 SG_ RCM2_a066_passABStg1CrssCoup m0 : 41|1@1+ (1,0) [0|1] "" Vector__XXX
 SG_ RCM2_a067_passABStg1Config m0 : 42|1@1+ (1,0) [0|1] "" Vector__XXX
 SG_ RCM2_a068_passABStg2Sht2Gnd m0 : 43|1@1+ (1,0) [0|1] "" Vector__XXX
 SG_ RCM2_a069_passABStg2Sht2Bat m0 : 44|1@1+ (1,0) [0|1] "" Vector__XXX
 SG_ RCM2_a070_passABStg2Open m0 : 45|1@1+ (1,0) [0|1] "" Vector__XXX
 SG_ RCM2_a071_passABStg2Short m0 : 46|1@1+ (1,0) [0|1] "" Vector__XXX
 SG_ RCM2_a072_passABStg2CrssCoup m0 : 47|1@1+ (1,0) [0|1] "" Vector__XXX
 SG_ RCM2_a073_passABStg2Config m0 : 48|1@1+ (1,0) [0|1] "" Vector__XXX
 SG_ RCM2_a074_passActiveVentSht2Gnd m0 : 49|1@1+ (1,0) [0|1] "" Vector__XXX
 SG_ RCM2_a075_passActiveVentSht2Bat m0 : 50|1@1+ (1,0) [0|1] "" Vector__XXX
 SG_ RCM2_a076_passActiveVentOpen m0 : 51|1@1+ (1,0) [0|1] "" Vector__XXX
 SG_ RCM2_a077_passActiveVentShort m0 : 52|1@1+ (1,0) [0|1] "" Vector__XXX
 SG_ RCM2_a078_passActiveVentCrssCoup m0 : 53|1@1+ (1,0) [0|1] "" Vector__XXX
 SG_ RCM2_a079_passActiveVentConfig m0 : 54|1@1+ (1,0) [0|1] "" Vector__XXX
 SG_ RCM2_a080_pretenShldLeftSht2Gnd m0 : 55|1@1+ (1,0) [0|1] "" Vector__XXX
 SG_ RCM2_a081_pretenShldLeftSht2Bat m0 : 56|1@1+ (1,0) [0|1] "" Vector__XXX
 SG_ RCM2_a082_pretenShldLeftOpen m0 : 57|1@1+ (1,0) [0|1] "" Vector__XXX
 SG_ RCM2_a083_pretenShldLeftShort m0 : 58|1@1+ (1,0) [0|1] "" Vector__XXX
 SG_ RCM2_a084_pretenShldLeftCrossC m0 : 59|1@1+ (1,0) [0|1] "" Vector__XXX
 SG_ RCM2_a085_pretenShldLeftConfig m0 : 60|1@1+ (1,0) [0|1] "" Vector__XXX
 SG_ RCM2_a086_pretenShldRightSht2Gnd m0 : 61|1@1+ (1,0) [0|1] "" Vector__XXX
 SG_ RCM2_a087_pretenShldRightSht2Bat m0 : 62|1@1+ (1,0) [0|1] "" Vector__XXX
 SG_ RCM2_a088_pretenShldRightOpen m0 : 63|1@1+ (1,0) [0|1] "" Vector__XXX
 SG_ RCM2_a089_pretenShldRightShort m1 : 4|1@1+ (1,0) [0|1] "" Vector__XXX
 SG_ RCM2_a090_pretenShldRightCrssCou m1 : 5|1@1+ (1,0) [0|1] "" Vector__XXX
 SG_ RCM2_a091_pretenShldRightConfig m1 : 6|1@1+ (1,0) [0|1] "" Vector__XXX
 SG_ RCM2_a092_pretenLapLeftSht2Gnd m1 : 7|1@1+ (1,0) [0|1] "" Vector__XXX
 SG_ RCM2_a093_pretenLapLeftSht2Bat m1 : 8|1@1+ (1,0) [0|1] "" Vector__XXX
 SG_ RCM2_a094_pretenLapLeftOpen m1 : 9|1@1+ (1,0) [0|1] "" Vector__XXX
 SG_ RCM2_a095_pretenLapLeftShort m1 : 10|1@1+ (1,0) [0|1] "" Vector__XXX
 SG_ RCM2_a096_pretenLapLeftCrssCoup m1 : 11|1@1+ (1,0) [0|1] "" Vector__XXX
 SG_ RCM2_a097_pretenLapLeftConfig m1 : 12|1@1+ (1,0) [0|1] "" Vector__XXX
 SG_ RCM2_a098_pretenLapRightSht2Gnd m1 : 13|1@1+ (1,0) [0|1] "" Vector__XXX
 SG_ RCM2_a099_pretenLapRightSht2Bat m1 : 14|1@1+ (1,0) [0|1] "" Vector__XXX
 SG_ RCM2_a100_pretenLapRightOpen m1 : 15|1@1+ (1,0) [0|1] "" Vector__XXX
 SG_ RCM2_a101_pretenLapRightShort m1 : 16|1@1+ (1,0) [0|1] "" Vector__XXX
 SG_ RCM2_a102_pretenLapRightCrssCoup m1 : 17|1@1+ (1,0) [0|1] "" Vector__XXX
 SG_ RCM2_a103_pretenLapRightConfig m1 : 18|1@1+ (1,0) [0|1] "" Vector__XXX
 SG_ RCM2_a104_loadLimLeftSht2Gnd m1 : 19|1@1+ (1,0) [0|1] "" Vector__XXX
 SG_ RCM2_a105_loadLimLeftSht2Bat m1 : 20|1@1+ (1,0) [0|1] "" Vector__XXX
 SG_ RCM2_a106_loadLimLeftOpen m1 : 21|1@1+ (1,0) [0|1] "" Vector__XXX
 SG_ RCM2_a107_loadLimLeftShort m1 : 22|1@1+ (1,0) [0|1] "" Vector__XXX
 SG_ RCM2_a108_loadLimLeftCrssCoup m1 : 23|1@1+ (1,0) [0|1] "" Vector__XXX
 SG_ RCM2_a109_loadLimLeftConfig m1 : 24|1@1+ (1,0) [0|1] "" Vector__XXX
 SG_ RCM2_a110_loadLimRightSht2Gnd m1 : 25|1@1+ (1,0) [0|1] "" Vector__XXX
 SG_ RCM2_a111_loadLimRightSht2Bat m1 : 26|1@1+ (1,0) [0|1] "" Vector__XXX
 SG_ RCM2_a112_loadLimRightOpen m1 : 27|1@1+ (1,0) [0|1] "" Vector__XXX
 SG_ RCM2_a113_loadLimRightShort m1 : 28|1@1+ (1,0) [0|1] "" Vector__XXX
 SG_ RCM2_a114_loadLimRightCrssCoup m1 : 29|1@1+ (1,0) [0|1] "" Vector__XXX
 SG_ RCM2_a115_loadLimRightConfig m1 : 30|1@1+ (1,0) [0|1] "" Vector__XXX
 SG_ RCM2_a116_kneeABDrvrSht2Gnd m1 : 31|1@1+ (1,0) [0|1] "" Vector__XXX
 SG_ RCM2_a117_kneeABDrvrSht2Bat m1 : 32|1@1+ (1,0) [0|1] "" Vector__XXX
 SG_ RCM2_a118_kneeABDrvrOpen m1 : 33|1@1+ (1,0) [0|1] "" Vector__XXX
 SG_ RCM2_a119_kneeABDrvrShort m1 : 34|1@1+ (1,0) [0|1] "" Vector__XXX
 SG_ RCM2_a120_kneeABDrvrCrssCoup m1 : 35|1@1+ (1,0) [0|1] "" Vector__XXX
 SG_ RCM2_a121_kneeABDrvrConfig m1 : 36|1@1+ (1,0) [0|1] "" Vector__XXX
 SG_ RCM2_a122_kneeABPassSht2Gnd m1 : 37|1@1+ (1,0) [0|1] "" Vector__XXX
 SG_ RCM2_a123_kneeABPassSht2Bat m1 : 38|1@1+ (1,0) [0|1] "" Vector__XXX
 SG_ RCM2_a124_kneeABPassOpen m1 : 39|1@1+ (1,0) [0|1] "" Vector__XXX
 SG_ RCM2_a125_kneeABPassShort m1 : 40|1@1+ (1,0) [0|1] "" Vector__XXX
 SG_ RCM2_a126_kneeABPassCrssCoup m1 : 41|1@1+ (1,0) [0|1] "" Vector__XXX
 SG_ RCM2_a127_kneeABPassConfig m1 : 42|1@1+ (1,0) [0|1] "" Vector__XXX
 SG_ RCM2_a128_sideAB1stRowLSht2Gnd m1 : 43|1@1+ (1,0) [0|1] "" Vector__XXX
 SG_ RCM2_a129_sideAB1stRowLSht2Bat m1 : 44|1@1+ (1,0) [0|1] "" Vector__XXX
 SG_ RCM2_a130_sideAB1stRowLOpen m1 : 45|1@1+ (1,0) [0|1] "" Vector__XXX
 SG_ RCM2_a131_sideAB1stRowLShort m1 : 46|1@1+ (1,0) [0|1] "" Vector__XXX
 SG_ RCM2_a132_sideAB1stRowLCrssCoup m1 : 47|1@1+ (1,0) [0|1] "" Vector__XXX
 SG_ RCM2_a133_sideAB1stRowLConfig m1 : 48|1@1+ (1,0) [0|1] "" Vector__XXX
 SG_ RCM2_a134_sideAB1stRowRSht2Gnd m1 : 49|1@1+ (1,0) [0|1] "" Vector__XXX
 SG_ RCM2_a135_sideAB1stRowRSht2Bat m1 : 50|1@1+ (1,0) [0|1] "" Vector__XXX
 SG_ RCM2_a136_sideAB1stRowROpen m1 : 51|1@1+ (1,0) [0|1] "" Vector__XXX
 SG_ RCM2_a137_sideAB1stRowRShort m1 : 52|1@1+ (1,0) [0|1] "" Vector__XXX
 SG_ RCM2_a138_sideAB1stRowRCrssCoup m1 : 53|1@1+ (1,0) [0|1] "" Vector__XXX
 SG_ RCM2_a139_sideAB1stRowRConfig m1 : 54|1@1+ (1,0) [0|1] "" Vector__XXX
 SG_ RCM2_a140_hvdPyroSht2Gnd m1 : 55|1@1+ (1,0) [0|1] "" Vector__XXX
 SG_ RCM2_a141_hvdPyroSht2Bat m1 : 56|1@1+ (1,0) [0|1] "" Vector__XXX
 SG_ RCM2_a142_hvdPyroOpen m1 : 57|1@1+ (1,0) [0|1] "" Vector__XXX
 SG_ RCM2_a143_hvdPyroShort m1 : 58|1@1+ (1,0) [0|1] "" Vector__XXX
 SG_ RCM2_a144_hvdPyroCrssCoup m1 : 59|1@1+ (1,0) [0|1] "" Vector__XXX
 SG_ RCM2_a145_hvdPyroConfig m1 : 60|1@1+ (1,0) [0|1] "" Vector__XXX
 SG_ RCM2_a146_curABLeftSht2Gnd m1 : 61|1@1+ (1,0) [0|1] "" Vector__XXX
 SG_ RCM2_a147_curABLeftSht2Bat m1 : 62|1@1+ (1,0) [0|1] "" Vector__XXX
 SG_ RCM2_a148_curABLeftOpen m1 : 63|1@1+ (1,0) [0|1] "" Vector__XXX
 SG_ RCM2_a149_curABLeftShort m2 : 4|1@1+ (1,0) [0|1] "" Vector__XXX
 SG_ RCM2_a150_curABLeftCrssCoup m2 : 5|1@1+ (1,0) [0|1] "" Vector__XXX
 SG_ RCM2_a151_curABLeftConfig m2 : 6|1@1+ (1,0) [0|1] "" Vector__XXX
 SG_ RCM2_a152_curABRightSht2Gnd m2 : 7|1@1+ (1,0) [0|1] "" Vector__XXX
 SG_ RCM2_a153_curABRightSht2Bat m2 : 8|1@1+ (1,0) [0|1] "" Vector__XXX
 SG_ RCM2_a154_curABRightOpen m2 : 9|1@1+ (1,0) [0|1] "" Vector__XXX
 SG_ RCM2_a155_curABRightShort m2 : 10|1@1+ (1,0) [0|1] "" Vector__XXX
 SG_ RCM2_a156_curABRightCrssCoup m2 : 11|1@1+ (1,0) [0|1] "" Vector__XXX
 SG_ RCM2_a157_curABRightConfig m2 : 12|1@1+ (1,0) [0|1] "" Vector__XXX
 SG_ RCM2_a158_preten2ndRowLSht2Gnd m2 : 13|1@1+ (1,0) [0|1] "" Vector__XXX
 SG_ RCM2_a159_preten2ndRowLSht2Bat m2 : 14|1@1+ (1,0) [0|1] "" Vector__XXX
 SG_ RCM2_a160_preten2ndRowLOpen m2 : 15|1@1+ (1,0) [0|1] "" Vector__XXX
 SG_ RCM2_a161_preten2ndRowLShort m2 : 16|1@1+ (1,0) [0|1] "" Vector__XXX
 SG_ RCM2_a162_preten2ndRowLCrssCoup m2 : 17|1@1+ (1,0) [0|1] "" Vector__XXX
 SG_ RCM2_a163_preten2ndRowLCgf m2 : 18|1@1+ (1,0) [0|1] "" Vector__XXX
 SG_ RCM2_a164_preten2ndRowRSht2Gnd m2 : 19|1@1+ (1,0) [0|1] "" Vector__XXX
 SG_ RCM2_a165_preten2ndRowRSht2Bat m2 : 20|1@1+ (1,0) [0|1] "" Vector__XXX
 SG_ RCM2_a166_preten2ndRowROpen m2 : 21|1@1+ (1,0) [0|1] "" Vector__XXX
 SG_ RCM2_a167_preten2ndRowRShort m2 : 22|1@1+ (1,0) [0|1] "" Vector__XXX
 SG_ RCM2_a168_preten2ndRowRCrssCoup m2 : 23|1@1+ (1,0) [0|1] "" Vector__XXX
 SG_ RCM2_a169_preten2ndRowRCgf m2 : 24|1@1+ (1,0) [0|1] "" Vector__XXX
 SG_ RCM2_a170_curAB2ndRowLSht2Gnd m2 : 25|1@1+ (1,0) [0|1] "" Vector__XXX
 SG_ RCM2_a171_curAB2ndRowLSht2Bat m2 : 26|1@1+ (1,0) [0|1] "" Vector__XXX
 SG_ RCM2_a172_curAB2ndRowLOpen m2 : 27|1@1+ (1,0) [0|1] "" Vector__XXX
 SG_ RCM2_a173_curAB2ndRowLShort m2 : 28|1@1+ (1,0) [0|1] "" Vector__XXX
 SG_ RCM2_a174_curAB2ndRowLCrssCoup m2 : 29|1@1+ (1,0) [0|1] "" Vector__XXX
 SG_ RCM2_a175_curAB2ndRowLConfig m2 : 30|1@1+ (1,0) [0|1] "" Vector__XXX
 SG_ RCM2_a176_curAB2ndRowRSht2Gnd m2 : 31|1@1+ (1,0) [0|1] "" Vector__XXX
 SG_ RCM2_a177_curAB2ndRowRSht2Bat m2 : 32|1@1+ (1,0) [0|1] "" Vector__XXX
 SG_ RCM2_a178_curAB2ndRowROpen m2 : 33|1@1+ (1,0) [0|1] "" Vector__XXX
 SG_ RCM2_a179_curAB2ndRowRShort m2 : 34|1@1+ (1,0) [0|1] "" Vector__XXX
 SG_ RCM2_a180_curAB2ndRowRCrssCoup m2 : 35|1@1+ (1,0) [0|1] "" Vector__XXX
 SG_ RCM2_a181_curAB2ndRowRConfig m2 : 36|1@1+ (1,0) [0|1] "" Vector__XXX
 SG_ RCM2_a182_hoodActuatorRSht2Gnd m2 : 37|1@1+ (1,0) [0|1] "" Vector__XXX
 SG_ RCM2_a183_hoodActuatorRSht2Bat m2 : 38|1@1+ (1,0) [0|1] "" Vector__XXX
 SG_ RCM2_a184_hoodActuatorROpen m2 : 39|1@1+ (1,0) [0|1] "" Vector__XXX
 SG_ RCM2_a185_hoodActuatorRShort m2 : 40|1@1+ (1,0) [0|1] "" Vector__XXX
 SG_ RCM2_a186_hoodActuatorRCrssCoup m2 : 41|1@1+ (1,0) [0|1] "" Vector__XXX
 SG_ RCM2_a187_hoodActuatorRConfig m2 : 42|1@1+ (1,0) [0|1] "" Vector__XXX
 SG_ RCM2_a188_hoodActuatorLSht2Gnd m2 : 43|1@1+ (1,0) [0|1] "" Vector__XXX
 SG_ RCM2_a189_hoodActuatorLSht2Bat m2 : 44|1@1+ (1,0) [0|1] "" Vector__XXX
 SG_ RCM2_a190_hoodActuatorLOpen m2 : 45|1@1+ (1,0) [0|1] "" Vector__XXX
 SG_ RCM2_a191_hoodActuatorLShort m2 : 46|1@1+ (1,0) [0|1] "" Vector__XXX
 SG_ RCM2_a192_hoodActuatorLCrssCoup m2 : 47|1@1+ (1,0) [0|1] "" Vector__XXX
 SG_ RCM2_a193_hoodActuatorLConfig m2 : 48|1@1+ (1,0) [0|1] "" Vector__XXX
 SG_ RCM2_a194_driverABAVSht2Gnd m2 : 49|1@1+ (1,0) [0|1] "" Vector__XXX
 SG_ RCM2_a195_driverABAVSht2Bat m2 : 50|1@1+ (1,0) [0|1] "" Vector__XXX
 SG_ RCM2_a196_driverABAVOpen m2 : 51|1@1+ (1,0) [0|1] "" Vector__XXX
 SG_ RCM2_a197_driverABAVShort m2 : 52|1@1+ (1,0) [0|1] "" Vector__XXX
 SG_ RCM2_a198_driverABAVCrossCoup m2 : 53|1@1+ (1,0) [0|1] "" Vector__XXX
 SG_ RCM2_a199_driverABAVConfig m2 : 54|1@1+ (1,0) [0|1] "" Vector__XXX
 SG_ RCM2_a200_driverFSABSht2Gnd m2 : 55|1@1+ (1,0) [0|1] "" Vector__XXX
 SG_ RCM2_a201_driverFSABSht2Bat m2 : 56|1@1+ (1,0) [0|1] "" Vector__XXX
 SG_ RCM2_a202_driverFSABOpen m2 : 57|1@1+ (1,0) [0|1] "" Vector__XXX
 SG_ RCM2_a203_driverFSABShort m2 : 58|1@1+ (1,0) [0|1] "" Vector__XXX
 SG_ RCM2_a204_driverFSABCrossCoup m2 : 59|1@1+ (1,0) [0|1] "" Vector__XXX
 SG_ RCM2_a205_driverFSABConfig m2 : 60|1@1+ (1,0) [0|1] "" Vector__XXX
 SG_ RCM2_a206_sideAB2ndRowLSht2Gnd m2 : 61|1@1+ (1,0) [0|1] "" Vector__XXX
 SG_ RCM2_a207_sideAB2ndRowLSht2Bat m2 : 62|1@1+ (1,0) [0|1] "" Vector__XXX
 SG_ RCM2_a208_sideAB2ndRowLOpen m2 : 63|1@1+ (1,0) [0|1] "" Vector__XXX
 SG_ RCM2_a209_sideAB2ndRowLShort m3 : 4|1@1+ (1,0) [0|1] "" Vector__XXX
 SG_ RCM2_a210_sideAB2ndRowLCrssCoup m3 : 5|1@1+ (1,0) [0|1] "" Vector__XXX
 SG_ RCM2_a211_sideAB2ndRowLConfig m3 : 6|1@1+ (1,0) [0|1] "" Vector__XXX
 SG_ RCM2_a212_sideAB2ndRowRSht2Gnd m3 : 7|1@1+ (1,0) [0|1] "" Vector__XXX
 SG_ RCM2_a213_sideAB2ndRowRSht2Bat m3 : 8|1@1+ (1,0) [0|1] "" Vector__XXX
 SG_ RCM2_a214_sideAB2ndRowROpen m3 : 9|1@1+ (1,0) [0|1] "" Vector__XXX
 SG_ RCM2_a215_sideAB2ndRowRShort m3 : 10|1@1+ (1,0) [0|1] "" Vector__XXX
 SG_ RCM2_a216_sideAB2ndRowRCrssCoup m3 : 11|1@1+ (1,0) [0|1] "" Vector__XXX
 SG_ RCM2_a217_sideAB2ndRowRConfig m3 : 12|1@1+ (1,0) [0|1] "" Vector__XXX
 SG_ RCM2_a250_ens1Sht2Bat m3 : 13|1@1+ (1,0) [0|1] "" Vector__XXX
 SG_ RCM2_a251_ens1Sht2Gnd m3 : 14|1@1+ (1,0) [0|1] "" Vector__XXX
 SG_ RCM2_a252_ens1Config m3 : 15|1@1+ (1,0) [0|1] "" Vector__XXX
 SG_ RCM2_a253_ens2Sht2Bat m3 : 16|1@1+ (1,0) [0|1] "" Vector__XXX
 SG_ RCM2_a254_ens2Sht2Gnd m3 : 17|1@1+ (1,0) [0|1] "" Vector__XXX
 SG_ RCM2_a255_ens2Config m3 : 18|1@1+ (1,0) [0|1] "" Vector__XXX
 SG_ RCM2_a256_ens3Sht2Bat m3 : 19|1@1+ (1,0) [0|1] "" Vector__XXX
 SG_ RCM2_a257_ens3Sht2Gnd m3 : 20|1@1+ (1,0) [0|1] "" Vector__XXX
 SG_ RCM2_a258_ens3Config m3 : 21|1@1+ (1,0) [0|1] "" Vector__XXX
 SG_ RCM2_a259_ens4Sht2Bat m3 : 22|1@1+ (1,0) [0|1] "" Vector__XXX
 SG_ RCM2_a260_ens4Sht2Gnd m3 : 23|1@1+ (1,0) [0|1] "" Vector__XXX
 SG_ RCM2_a261_ens4Config m3 : 24|1@1+ (1,0) [0|1] "" Vector__XXX
 SG_ RCM2_a264_imuYawR8OffCompPosLife m3 : 25|1@1+ (1,0) [0|1] "" Vector__XXX
 SG_ RCM2_a265_imuYawR8OffCompNegLife m3 : 26|1@1+ (1,0) [0|1] "" Vector__XXX
 SG_ RCM2_a266_imuYawR8OffCompPosFLDC m3 : 27|1@1+ (1,0) [0|1] "" Vector__XXX
 SG_ RCM2_a267_imuYawR8OffCompNegFLDC m3 : 28|1@1+ (1,0) [0|1] "" Vector__XXX
 SG_ RCM2_a268_imuYawR8OffCompPosSLDC m3 : 29|1@1+ (1,0) [0|1] "" Vector__XXX
 SG_ RCM2_a269_imuYawR8OffCompNegSLDC m3 : 30|1@1+ (1,0) [0|1] "" Vector__XXX
 SG_ RCM2_a270_imuPtchR8OffCompPosLif m3 : 31|1@1+ (1,0) [0|1] "" Vector__XXX
 SG_ RCM2_a271_imuPtchR8OffCompNegLif m3 : 32|1@1+ (1,0) [0|1] "" Vector__XXX
 SG_ RCM2_a272_imuPtchR8OffCompPosFLD m3 : 33|1@1+ (1,0) [0|1] "" Vector__XXX
 SG_ RCM2_a273_imuPtchR8OffCompNegFLD m3 : 34|1@1+ (1,0) [0|1] "" Vector__XXX
 SG_ RCM2_a274_imuPtchR8OffCompPosSLD m3 : 35|1@1+ (1,0) [0|1] "" Vector__XXX
 SG_ RCM2_a275_imuPtchR8OffCompNegSLD m3 : 36|1@1+ (1,0) [0|1] "" Vector__XXX
 SG_ RCM2_a276_imuRollR8OffCompPosLif m3 : 37|1@1+ (1,0) [0|1] "" Vector__XXX
 SG_ RCM2_a277_imuRollR8OffCompNegLif m3 : 38|1@1+ (1,0) [0|1] "" Vector__XXX
 SG_ RCM2_a278_imuRollR8OffCompPosFLD m3 : 39|1@1+ (1,0) [0|1] "" Vector__XXX
 SG_ RCM2_a279_imuRollR8OffCompNegFLD m3 : 40|1@1+ (1,0) [0|1] "" Vector__XXX
 SG_ RCM2_a280_imuRollR8OffCompPosSLD m3 : 41|1@1+ (1,0) [0|1] "" Vector__XXX
 SG_ RCM2_a281_imuRollR8OffCompNegSLD m3 : 42|1@1+ (1,0) [0|1] "" Vector__XXX
 SG_ RCM2_a282_imuLongAOffCompPosLife m3 : 43|1@1+ (1,0) [0|1] "" Vector__XXX
 SG_ RCM2_a283_imuLongAOffCompNegLife m3 : 44|1@1+ (1,0) [0|1] "" Vector__XXX
 SG_ RCM2_a284_imuLongAOffCompPosFLDC m3 : 45|1@1+ (1,0) [0|1] "" Vector__XXX
 SG_ RCM2_a285_imuLongAOffCompNegFLDC m3 : 46|1@1+ (1,0) [0|1] "" Vector__XXX
 SG_ RCM2_a286_imuLongAOffCompPosSLDC m3 : 47|1@1+ (1,0) [0|1] "" Vector__XXX
 SG_ RCM2_a287_imuLongAOffCompNegSLDC m3 : 48|1@1+ (1,0) [0|1] "" Vector__XXX
 SG_ RCM2_a288_imuLatAcOffCompPosLife m3 : 49|1@1+ (1,0) [0|1] "" Vector__XXX
 SG_ RCM2_a289_imuLatAcOffCompNegLife m3 : 50|1@1+ (1,0) [0|1] "" Vector__XXX
 SG_ RCM2_a290_imuLatAcOffCompPosFLDC m3 : 51|1@1+ (1,0) [0|1] "" Vector__XXX
 SG_ RCM2_a291_imuLatAcOffCompNegFLDC m3 : 52|1@1+ (1,0) [0|1] "" Vector__XXX
 SG_ RCM2_a292_imuLatAcOffCompPosSLDC m3 : 53|1@1+ (1,0) [0|1] "" Vector__XXX
 SG_ RCM2_a293_imuLatAcOffCompNegSLDC m3 : 54|1@1+ (1,0) [0|1] "" Vector__XXX
 SG_ RCM2_a294_imuVertAOffCompPosLife m3 : 55|1@1+ (1,0) [0|1] "" Vector__XXX
 SG_ RCM2_a295_imuVertAOffCompNegLife m3 : 56|1@1+ (1,0) [0|1] "" Vector__XXX
 SG_ RCM2_a296_imuVertAOffCompPosFLDC m3 : 57|1@1+ (1,0) [0|1] "" Vector__XXX
 SG_ RCM2_a297_imuVertAOffCompNegFLDC m3 : 58|1@1+ (1,0) [0|1] "" Vector__XXX
 SG_ RCM2_a298_imuVertAOffCompPosSLDC m3 : 59|1@1+ (1,0) [0|1] "" Vector__XXX
 SG_ RCM2_a299_imuVertAOffCompNegSLDC m3 : 60|1@1+ (1,0) [0|1] "" Vector__XXX
 SG_ RCM2_a300_imuAccXHgMonChlPerm m3 : 61|1@1+ (1,0) [0|1] "" Vector__XXX
 SG_ RCM2_a301_imuAccXHgMonChlTemp m3 : 62|1@1+ (1,0) [0|1] "" Vector__XXX
 SG_ RCM2_a302_imuAccYHgMonChlPerm m3 : 63|1@1+ (1,0) [0|1] "" Vector__XXX
 SG_ RCM2_a303_imuAccYHgMonChlTemp m4 : 4|1@1+ (1,0) [0|1] "" Vector__XXX
 SG_ RCM2_a304_imuYawR8SnsrPermBG m4 : 5|1@1+ (1,0) [0|1] "" Vector__XXX
 SG_ RCM2_a305_imuYawR8SnsrPermInit m4 : 6|1@1+ (1,0) [0|1] "" Vector__XXX
 SG_ RCM2_a306_imuYawR8SnsrPermLF m4 : 7|1@1+ (1,0) [0|1] "" Vector__XXX
 SG_ RCM2_a307_imuYawR8ChnlMonTmpLF m4 : 8|1@1+ (1,0) [0|1] "" Vector__XXX
 SG_ RCM2_a308_imuPitchR8SnsrPermBG m4 : 9|1@1+ (1,0) [0|1] "" Vector__XXX
 SG_ RCM2_a309_imuPitchR8SnsrPermInit m4 : 10|1@1+ (1,0) [0|1] "" Vector__XXX
 SG_ RCM2_a310_imuPitchR8SnsrPermLF m4 : 11|1@1+ (1,0) [0|1] "" Vector__XXX
 SG_ RCM2_a311_imuPitchR8ChnlMonTmpLF m4 : 12|1@1+ (1,0) [0|1] "" Vector__XXX
 SG_ RCM2_a312_imuRollR8SnsrPermBG m4 : 13|1@1+ (1,0) [0|1] "" Vector__XXX
 SG_ RCM2_a313_imuRollR8SnsrPermInit m4 : 14|1@1+ (1,0) [0|1] "" Vector__XXX
 SG_ RCM2_a314_imuRollR8SnsrPermLF m4 : 15|1@1+ (1,0) [0|1] "" Vector__XXX
 SG_ RCM2_a315_imuRollR8ChnlMonTmpLF m4 : 16|1@1+ (1,0) [0|1] "" Vector__XXX
 SG_ RCM2_a316_imuAccXLgMonChlPerm m4 : 17|1@1+ (1,0) [0|1] "" Vector__XXX
 SG_ RCM2_a317_imuAccXLgMonChlTemp m4 : 18|1@1+ (1,0) [0|1] "" Vector__XXX
 SG_ RCM2_a318_imuAccYLgMonChlPerm m4 : 19|1@1+ (1,0) [0|1] "" Vector__XXX
 SG_ RCM2_a319_imuAccYLgMonChlTemp m4 : 20|1@1+ (1,0) [0|1] "" Vector__XXX
 SG_ RCM2_a320_imuAccZLgMonChlPerm m4 : 21|1@1+ (1,0) [0|1] "" Vector__XXX
 SG_ RCM2_a321_imuAccZLgMonChlTemp m4 : 22|1@1+ (1,0) [0|1] "" Vector__XXX
 SG_ RCM2_a322_imuCalibrationFailed m4 : 23|1@1+ (1,0) [0|1] "" Vector__XXX
 SG_ RCM2_a323_imuCalibrationNotDone m4 : 24|1@1+ (1,0) [0|1] "" Vector__XXX
 SG_ RCM2_a350_upFrntSnsrLSht2Gnd m4 : 25|1@1+ (1,0) [0|1] "" Vector__XXX
 SG_ RCM2_a351_upFrntSnsrLSht2Bat m4 : 26|1@1+ (1,0) [0|1] "" Vector__XXX
 SG_ RCM2_a352_upFrntSnsrLOpen m4 : 27|1@1+ (1,0) [0|1] "" Vector__XXX
 SG_ RCM2_a353_upFrntSnsrLCrssCoup m4 : 28|1@1+ (1,0) [0|1] "" Vector__XXX
 SG_ RCM2_a354_upFrntSnsrLCommErr m4 : 29|1@1+ (1,0) [0|1] "" Vector__XXX
 SG_ RCM2_a355_upFrntSnsrLInitTyp m4 : 30|1@1+ (1,0) [0|1] "" Vector__XXX
 SG_ RCM2_a356_upFrntSnsrLConfig m4 : 31|1@1+ (1,0) [0|1] "" Vector__XXX
 SG_ RCM2_a357_upFrntSnsrLDefect m4 : 32|1@1+ (1,0) [0|1] "" Vector__XXX
 SG_ RCM2_a358_upFrntSnsrLSigMon m4 : 33|1@1+ (1,0) [0|1] "" Vector__XXX
 SG_ RCM2_a360_upFrntSnsrRSht2Gnd m4 : 34|1@1+ (1,0) [0|1] "" Vector__XXX
 SG_ RCM2_a361_upFrntSnsrRSht2Bat m4 : 35|1@1+ (1,0) [0|1] "" Vector__XXX
 SG_ RCM2_a362_upFrntSnsrROpen m4 : 36|1@1+ (1,0) [0|1] "" Vector__XXX
 SG_ RCM2_a363_upFrntSnsrRCrssCoup m4 : 37|1@1+ (1,0) [0|1] "" Vector__XXX
 SG_ RCM2_a364_upFrntSnsrRCommErr m4 : 38|1@1+ (1,0) [0|1] "" Vector__XXX
 SG_ RCM2_a365_upFrntSnsrRInitTyp m4 : 39|1@1+ (1,0) [0|1] "" Vector__XXX
 SG_ RCM2_a366_upFrntSnsrRConfig m4 : 40|1@1+ (1,0) [0|1] "" Vector__XXX
 SG_ RCM2_a367_upFrntSnsrRDefect m4 : 41|1@1+ (1,0) [0|1] "" Vector__XXX
 SG_ RCM2_a368_upFrntSnsrRSigMon m4 : 42|1@1+ (1,0) [0|1] "" Vector__XXX
 SG_ RCM2_a370_upFrntSnsrMidLSht2Gnd m4 : 43|1@1+ (1,0) [0|1] "" Vector__XXX
 SG_ RCM2_a371_upFrntSnsrMidLSht2Bat m4 : 44|1@1+ (1,0) [0|1] "" Vector__XXX
 SG_ RCM2_a372_upFrntSnsrMidLOpen m4 : 45|1@1+ (1,0) [0|1] "" Vector__XXX
 SG_ RCM2_a373_upFrntSnsrMidLCrssCoup m4 : 46|1@1+ (1,0) [0|1] "" Vector__XXX
 SG_ RCM2_a374_upFrntSnsrMidLCommErr m4 : 47|1@1+ (1,0) [0|1] "" Vector__XXX
 SG_ RCM2_a375_upFrntSnsrMidLInitTyp m4 : 48|1@1+ (1,0) [0|1] "" Vector__XXX
 SG_ RCM2_a376_upFrntSnsrMidLConfig m4 : 49|1@1+ (1,0) [0|1] "" Vector__XXX
 SG_ RCM2_a377_upFrntSnsrMidLDefect m4 : 50|1@1+ (1,0) [0|1] "" Vector__XXX
 SG_ RCM2_a378_upFrntSnsrMidLSigMon m4 : 51|1@1+ (1,0) [0|1] "" Vector__XXX
 SG_ RCM2_a380_upFrntSnsrMidRSht2Gnd m4 : 52|1@1+ (1,0) [0|1] "" Vector__XXX
 SG_ RCM2_a381_upFrntSnsrMidRSht2Bat m4 : 53|1@1+ (1,0) [0|1] "" Vector__XXX
 SG_ RCM2_a382_upFrntSnsrMidROpen m4 : 54|1@1+ (1,0) [0|1] "" Vector__XXX
 SG_ RCM2_a383_upFrntSnsrMidRCrssCoup m4 : 55|1@1+ (1,0) [0|1] "" Vector__XXX
 SG_ RCM2_a384_upFrntSnsrMidRCommErr m4 : 56|1@1+ (1,0) [0|1] "" Vector__XXX
 SG_ RCM2_a385_upFrntSnsrMidRInitTyp m4 : 57|1@1+ (1,0) [0|1] "" Vector__XXX
 SG_ RCM2_a386_upFrntSnsrMidRConfig m4 : 58|1@1+ (1,0) [0|1] "" Vector__XXX
 SG_ RCM2_a387_upFrntSnsrMidRDefect m4 : 59|1@1+ (1,0) [0|1] "" Vector__XXX
 SG_ RCM2_a388_upFrntSnsrMidRSigMon m4 : 60|1@1+ (1,0) [0|1] "" Vector__XXX
 SG_ RCM2_a390_sideAccelBPilLSht2Gnd m4 : 61|1@1+ (1,0) [0|1] "" Vector__XXX
 SG_ RCM2_a391_sideAccelBPilLSht2Bat m4 : 62|1@1+ (1,0) [0|1] "" Vector__XXX
 SG_ RCM2_a392_sideAccelBPilLOpen m4 : 63|1@1+ (1,0) [0|1] "" Vector__XXX
 SG_ RCM2_a393_sideAccelBPilLCLosCoup m5 : 4|1@1+ (1,0) [0|1] "" Vector__XXX
 SG_ RCM2_a394_sideAccelBPilLCommErr m5 : 5|1@1+ (1,0) [0|1] "" Vector__XXX
 SG_ RCM2_a395_sideAccelBPilLInitTyp m5 : 6|1@1+ (1,0) [0|1] "" Vector__XXX
 SG_ RCM2_a396_sideAccelBPilLConfig m5 : 7|1@1+ (1,0) [0|1] "" Vector__XXX
 SG_ RCM2_a397_sideAccelBPilLDefect m5 : 8|1@1+ (1,0) [0|1] "" Vector__XXX
 SG_ RCM2_a398_sideAccelBPilLSigMon m5 : 9|1@1+ (1,0) [0|1] "" Vector__XXX
 SG_ RCM2_a400_sideAccelBPilRSht2Gnd m5 : 10|1@1+ (1,0) [0|1] "" Vector__XXX
 SG_ RCM2_a401_sideAccelBPilRSht2Bat m5 : 11|1@1+ (1,0) [0|1] "" Vector__XXX
 SG_ RCM2_a402_sideAccelBPilROpen m5 : 12|1@1+ (1,0) [0|1] "" Vector__XXX
 SG_ RCM2_a403_sideAccelBPilRCrssCoup m5 : 13|1@1+ (1,0) [0|1] "" Vector__XXX
 SG_ RCM2_a404_sideAccelBPilRCommErr m5 : 14|1@1+ (1,0) [0|1] "" Vector__XXX
 SG_ RCM2_a405_sideAccelBPilRInitTyp m5 : 15|1@1+ (1,0) [0|1] "" Vector__XXX
 SG_ RCM2_a406_sideAccelBPilRConfig m5 : 16|1@1+ (1,0) [0|1] "" Vector__XXX
 SG_ RCM2_a407_sideAccelBPilRDefect m5 : 17|1@1+ (1,0) [0|1] "" Vector__XXX
 SG_ RCM2_a408_sideAccelBPilRSigMon m5 : 18|1@1+ (1,0) [0|1] "" Vector__XXX
 SG_ RCM2_a410_sideAccelCPilLSht2Gnd m5 : 19|1@1+ (1,0) [0|1] "" Vector__XXX
 SG_ RCM2_a411_sideAccelCPilLSht2Bat m5 : 20|1@1+ (1,0) [0|1] "" Vector__XXX
 SG_ RCM2_a412_sideAccelCPilLOpen m5 : 21|1@1+ (1,0) [0|1] "" Vector__XXX
 SG_ RCM2_a413_sideAccelCPilLCrssCoup m5 : 22|1@1+ (1,0) [0|1] "" Vector__XXX
 SG_ RCM2_a414_sideAccelCPilLCommErr m5 : 23|1@1+ (1,0) [0|1] "" Vector__XXX
 SG_ RCM2_a415_sideAccelCPilLInitTyp m5 : 24|1@1+ (1,0) [0|1] "" Vector__XXX
 SG_ RCM2_a416_sideAccelCPilLConfig m5 : 25|1@1+ (1,0) [0|1] "" Vector__XXX
 SG_ RCM2_a417_sideAccelCPilLDefect m5 : 26|1@1+ (1,0) [0|1] "" Vector__XXX
 SG_ RCM2_a418_sideAccelCPilLSigMon m5 : 27|1@1+ (1,0) [0|1] "" Vector__XXX
 SG_ RCM2_a420_sideAccelCPilRSht2Gnd m5 : 28|1@1+ (1,0) [0|1] "" Vector__XXX
 SG_ RCM2_a421_sideAccelCPilRSht2Bat m5 : 29|1@1+ (1,0) [0|1] "" Vector__XXX
 SG_ RCM2_a422_sideAccelCPilROpen m5 : 30|1@1+ (1,0) [0|1] "" Vector__XXX
 SG_ RCM2_a423_sideAccelCPilRCrssCoup m5 : 31|1@1+ (1,0) [0|1] "" Vector__XXX
 SG_ RCM2_a424_sideAccelCPilRCommErr m5 : 32|1@1+ (1,0) [0|1] "" Vector__XXX
 SG_ RCM2_a425_sideAccelCPilRInitTyp m5 : 33|1@1+ (1,0) [0|1] "" Vector__XXX
 SG_ RCM2_a426_sideAccelCPilRConfig m5 : 34|1@1+ (1,0) [0|1] "" Vector__XXX
 SG_ RCM2_a427_sideAccelCPilRDefect m5 : 35|1@1+ (1,0) [0|1] "" Vector__XXX
 SG_ RCM2_a428_sideAccelCPilRSigMon m5 : 36|1@1+ (1,0) [0|1] "" Vector__XXX
 SG_ RCM2_a430_presFrntLDoorSht2Gnd m5 : 37|1@1+ (1,0) [0|1] "" Vector__XXX
 SG_ RCM2_a431_presFrntLDoorSht2Bat m5 : 38|1@1+ (1,0) [0|1] "" Vector__XXX
 SG_ RCM2_a432_presFrntLDoorOpen m5 : 39|1@1+ (1,0) [0|1] "" Vector__XXX
 SG_ RCM2_a433_presFrntLDoorCrssCoup m5 : 40|1@1+ (1,0) [0|1] "" Vector__XXX
 SG_ RCM2_a434_presFrntLDoorCommErr m5 : 41|1@1+ (1,0) [0|1] "" Vector__XXX
 SG_ RCM2_a435_presFrntLDoorInitTyp m5 : 42|1@1+ (1,0) [0|1] "" Vector__XXX
 SG_ RCM2_a436_presFrntLDoorConfig m5 : 43|1@1+ (1,0) [0|1] "" Vector__XXX
 SG_ RCM2_a437_presFrntLDoorDefect m5 : 44|1@1+ (1,0) [0|1] "" Vector__XXX
 SG_ RCM2_a438_presFrntLDoorSigMon m5 : 45|1@1+ (1,0) [0|1] "" Vector__XXX
 SG_ RCM2_a439_presDoorAbsolute1 m5 : 46|1@1+ (1,0) [0|1] "" Vector__XXX
 SG_ RCM2_a440_presFrntRDoorSht2Gnd m5 : 47|1@1+ (1,0) [0|1] "" Vector__XXX
 SG_ RCM2_a441_presFrntRDoorSht2Bat m5 : 48|1@1+ (1,0) [0|1] "" Vector__XXX
 SG_ RCM2_a442_presFrntRDoorOpen m5 : 49|1@1+ (1,0) [0|1] "" Vector__XXX
 SG_ RCM2_a443_presFrntRDoorCrssCoup m5 : 50|1@1+ (1,0) [0|1] "" Vector__XXX
 SG_ RCM2_a444_presFrntRDoorCommErr m5 : 51|1@1+ (1,0) [0|1] "" Vector__XXX
 SG_ RCM2_a445_presFrntRDoorInitTyp m5 : 52|1@1+ (1,0) [0|1] "" Vector__XXX
 SG_ RCM2_a446_presFrntRDoorConfig m5 : 53|1@1+ (1,0) [0|1] "" Vector__XXX
 SG_ RCM2_a447_presFrntRDoorDefect m5 : 54|1@1+ (1,0) [0|1] "" Vector__XXX
 SG_ RCM2_a448_presFrntRDoorSigMon m5 : 55|1@1+ (1,0) [0|1] "" Vector__XXX
 SG_ RCM2_a449_presDoorAbsolute2 m5 : 56|1@1+ (1,0) [0|1] "" Vector__XXX
 SG_ RCM2_a450_presPedProLSht2Gnd m5 : 57|1@1+ (1,0) [0|1] "" Vector__XXX
 SG_ RCM2_a451_presPedProLSht2Bat m5 : 58|1@1+ (1,0) [0|1] "" Vector__XXX
 SG_ RCM2_a452_presPedProLOpen m5 : 59|1@1+ (1,0) [0|1] "" Vector__XXX
 SG_ RCM2_a453_presPedProLCrssCoup m5 : 60|1@1+ (1,0) [0|1] "" Vector__XXX
 SG_ RCM2_a454_presPedProLCommErr m5 : 61|1@1+ (1,0) [0|1] "" Vector__XXX
 SG_ RCM2_a455_presPedProLInitTyp m5 : 62|1@1+ (1,0) [0|1] "" Vector__XXX
 SG_ RCM2_a456_presPedProLConfig m5 : 63|1@1+ (1,0) [0|1] "" Vector__XXX
 SG_ RCM2_a457_presPedProLDefect m6 : 4|1@1+ (1,0) [0|1] "" Vector__XXX
 SG_ RCM2_a458_presPedProLSigMon m6 : 5|1@1+ (1,0) [0|1] "" Vector__XXX
 SG_ RCM2_a460_presPedProRSht2Gnd m6 : 6|1@1+ (1,0) [0|1] "" Vector__XXX
 SG_ RCM2_a461_presPedProRSht2Bat m6 : 7|1@1+ (1,0) [0|1] "" Vector__XXX
 SG_ RCM2_a462_presPedProROpen m6 : 8|1@1+ (1,0) [0|1] "" Vector__XXX
 SG_ RCM2_a463_presPedProRCrssCoup m6 : 9|1@1+ (1,0) [0|1] "" Vector__XXX
 SG_ RCM2_a464_presPedProRCommErr m6 : 10|1@1+ (1,0) [0|1] "" Vector__XXX
 SG_ RCM2_a465_presPedProRInitTyp m6 : 11|1@1+ (1,0) [0|1] "" Vector__XXX
 SG_ RCM2_a466_presPedProRConfig m6 : 12|1@1+ (1,0) [0|1] "" Vector__XXX
 SG_ RCM2_a467_presPedProRDefect m6 : 13|1@1+ (1,0) [0|1] "" Vector__XXX
 SG_ RCM2_a468_presPedProRSigMon m6 : 14|1@1+ (1,0) [0|1] "" Vector__XXX
 SG_ RCM2_a469_presPedProAbsolute m6 : 15|1@1+ (1,0) [0|1] "" Vector__XXX
 SG_ RCM2_a470_upFrntPedProLSht2Gnd m6 : 16|1@1+ (1,0) [0|1] "" Vector__XXX
 SG_ RCM2_a471_upFrntPedProLSht2Bat m6 : 17|1@1+ (1,0) [0|1] "" Vector__XXX
 SG_ RCM2_a472_upFrntPedProLOpen m6 : 18|1@1+ (1,0) [0|1] "" Vector__XXX
 SG_ RCM2_a473_upFrntPedProLCrssCoup m6 : 19|1@1+ (1,0) [0|1] "" Vector__XXX
 SG_ RCM2_a474_upFrntPedProLCommErr m6 : 20|1@1+ (1,0) [0|1] "" Vector__XXX
 SG_ RCM2_a475_upFrntPedProLIntTyp m6 : 21|1@1+ (1,0) [0|1] "" Vector__XXX
 SG_ RCM2_a476_upFrntPedProLConfig m6 : 22|1@1+ (1,0) [0|1] "" Vector__XXX
 SG_ RCM2_a477_upFrntPedProLDefect m6 : 23|1@1+ (1,0) [0|1] "" Vector__XXX
 SG_ RCM2_a478_upFrntPedProLSigMon m6 : 24|1@1+ (1,0) [0|1] "" Vector__XXX
 SG_ RCM2_a480_upFrntPedProRSht2Gnd m6 : 25|1@1+ (1,0) [0|1] "" Vector__XXX
 SG_ RCM2_a481_upFrntPedProRSht2Bat m6 : 26|1@1+ (1,0) [0|1] "" Vector__XXX
 SG_ RCM2_a482_upFrntPedProROpen m6 : 27|1@1+ (1,0) [0|1] "" Vector__XXX
 SG_ RCM2_a483_upFrntPedProRCrssCoup m6 : 28|1@1+ (1,0) [0|1] "" Vector__XXX
 SG_ RCM2_a484_upFrntPedProRCommErr m6 : 29|1@1+ (1,0) [0|1] "" Vector__XXX
 SG_ RCM2_a485_upFrntPedProRIntTyp m6 : 30|1@1+ (1,0) [0|1] "" Vector__XXX
 SG_ RCM2_a486_upFrntPedProRConfig m6 : 31|1@1+ (1,0) [0|1] "" Vector__XXX
 SG_ RCM2_a487_upFrntPedProRDefect m6 : 32|1@1+ (1,0) [0|1] "" Vector__XXX
 SG_ RCM2_a488_upFrntPedProRSigMon m6 : 33|1@1+ (1,0) [0|1] "" Vector__XXX
 SG_ RCM2_a490_presRearLDoorSht2Gnd m6 : 34|1@1+ (1,0) [0|1] "" Vector__XXX
 SG_ RCM2_a491_presRearLDoorSht2Bat m6 : 35|1@1+ (1,0) [0|1] "" Vector__XXX
 SG_ RCM2_a492_presRearLDoorOpen m6 : 36|1@1+ (1,0) [0|1] "" Vector__XXX
 SG_ RCM2_a493_presRearLDoorCrssCoup m6 : 37|1@1+ (1,0) [0|1] "" Vector__XXX
 SG_ RCM2_a494_presRearLDoorCommErr m6 : 38|1@1+ (1,0) [0|1] "" Vector__XXX
 SG_ RCM2_a495_presRearLDoorInitTyp m6 : 39|1@1+ (1,0) [0|1] "" Vector__XXX
 SG_ RCM2_a496_presRearLDoorConfig m6 : 40|1@1+ (1,0) [0|1] "" Vector__XXX
 SG_ RCM2_a497_presRearLDoorDefect m6 : 41|1@1+ (1,0) [0|1] "" Vector__XXX
 SG_ RCM2_a498_presRearLDoorSigMon m6 : 42|1@1+ (1,0) [0|1] "" Vector__XXX
 SG_ RCM2_a500_presRearRDoorSht2Gnd m6 : 43|1@1+ (1,0) [0|1] "" Vector__XXX
 SG_ RCM2_a501_presRearRDoorSht2Bat m6 : 44|1@1+ (1,0) [0|1] "" Vector__XXX
 SG_ RCM2_a502_presRearRDoorOpen m6 : 45|1@1+ (1,0) [0|1] "" Vector__XXX
 SG_ RCM2_a503_presRearRDoorCrssCoup m6 : 46|1@1+ (1,0) [0|1] "" Vector__XXX
 SG_ RCM2_a504_presRearRDoorCommErr m6 : 47|1@1+ (1,0) [0|1] "" Vector__XXX
 SG_ RCM2_a505_presRearRDoorInitTyp m6 : 48|1@1+ (1,0) [0|1] "" Vector__XXX
 SG_ RCM2_a506_presRearRDoorConfig m6 : 49|1@1+ (1,0) [0|1] "" Vector__XXX
 SG_ RCM2_a507_presRearRDoorDefect m6 : 50|1@1+ (1,0) [0|1] "" Vector__XXX
 SG_ RCM2_a508_presRearRDoorSigMon m6 : 51|1@1+ (1,0) [0|1] "" Vector__XXX
 SG_ RCM2_a509_sideAccelDPilLSht2Gnd m6 : 52|1@1+ (1,0) [0|1] "" Vector__XXX
 SG_ RCM2_a510_sideAccelDPilLSht2Bat m6 : 53|1@1+ (1,0) [0|1] "" Vector__XXX
 SG_ RCM2_a511_sideAccelDPilLOpen m6 : 54|1@1+ (1,0) [0|1] "" Vector__XXX
 SG_ RCM2_a512_sideAccelDPilLCrssCoup m6 : 55|1@1+ (1,0) [0|1] "" Vector__XXX
 SG_ RCM2_a513_sideAccelDPilLCommErr m6 : 56|1@1+ (1,0) [0|1] "" Vector__XXX
 SG_ RCM2_a514_sideAccelDPilLInitTyp m6 : 57|1@1+ (1,0) [0|1] "" Vector__XXX
 SG_ RCM2_a515_sideAccelDPilLConfig m6 : 58|1@1+ (1,0) [0|1] "" Vector__XXX
 SG_ RCM2_a516_sideAccelDPilLDefect m6 : 59|1@1+ (1,0) [0|1] "" Vector__XXX
 SG_ RCM2_a517_sideAccelDPilLSigMon m6 : 60|1@1+ (1,0) [0|1] "" Vector__XXX
 SG_ RCM2_a518_sideAccelDPilRSht2Gnd m6 : 61|1@1+ (1,0) [0|1] "" Vector__XXX
 SG_ RCM2_a519_sideAccelDPilRSht2Bat m6 : 62|1@1+ (1,0) [0|1] "" Vector__XXX
 SG_ RCM2_a520_sideAccelDPilROpen m6 : 63|1@1+ (1,0) [0|1] "" Vector__XXX
 SG_ RCM2_a521_sideAccelDPilRCrssCoup m7 : 4|1@1+ (1,0) [0|1] "" Vector__XXX
 SG_ RCM2_a522_sideAccelDPilRCommErr m7 : 5|1@1+ (1,0) [0|1] "" Vector__XXX
 SG_ RCM2_a523_sideAccelDPilRInitTyp m7 : 6|1@1+ (1,0) [0|1] "" Vector__XXX
 SG_ RCM2_a524_sideAccelDPilRConfig m7 : 7|1@1+ (1,0) [0|1] "" Vector__XXX
 SG_ RCM2_a525_sideAccelDPilRDefect m7 : 8|1@1+ (1,0) [0|1] "" Vector__XXX
 SG_ RCM2_a526_sideAccelDPilRSigMon m7 : 9|1@1+ (1,0) [0|1] "" Vector__XXX
 SG_ RCM2_a527_upFrntSnsrCSht2Gnd m7 : 10|1@1+ (1,0) [0|1] "" Vector__XXX
 SG_ RCM2_a528_upFrntSnsrCSht2Bat m7 : 11|1@1+ (1,0) [0|1] "" Vector__XXX
 SG_ RCM2_a529_upFrntSnsrCOpen m7 : 12|1@1+ (1,0) [0|1] "" Vector__XXX
 SG_ RCM2_a530_upFrntSnsrCCrssCoup m7 : 13|1@1+ (1,0) [0|1] "" Vector__XXX
 SG_ RCM2_a531_upFrntSnsrCCommErr m7 : 14|1@1+ (1,0) [0|1] "" Vector__XXX
 SG_ RCM2_a532_upFrntSnsrCInitTyp m7 : 15|1@1+ (1,0) [0|1] "" Vector__XXX
 SG_ RCM2_a533_upFrntSnsrCConfig m7 : 16|1@1+ (1,0) [0|1] "" Vector__XXX
 SG_ RCM2_a534_upFrntSnsrCDefect m7 : 17|1@1+ (1,0) [0|1] "" Vector__XXX
 SG_ RCM2_a535_upFrntSnsrCSigMon m7 : 18|1@1+ (1,0) [0|1] "" Vector__XXX
 SG_ RCM2_a550_bucklHallLeftSht2Gnd m7 : 19|1@1+ (1,0) [0|1] "" Vector__XXX
 SG_ RCM2_a551_bucklHallLeftSht2Bat m7 : 20|1@1+ (1,0) [0|1] "" Vector__XXX
 SG_ RCM2_a552_bucklHallLeftOpen m7 : 21|1@1+ (1,0) [0|1] "" Vector__XXX
 SG_ RCM2_a553_bucklHallLeftUndef m7 : 22|1@1+ (1,0) [0|1] "" Vector__XXX
 SG_ RCM2_a554_bucklHallLeftCrssCoup m7 : 23|1@1+ (1,0) [0|1] "" Vector__XXX
 SG_ RCM2_a555_bucklHallLeftConfig m7 : 24|1@1+ (1,0) [0|1] "" Vector__XXX
 SG_ RCM2_a556_bucklHallRightSht2Gnd m7 : 25|1@1+ (1,0) [0|1] "" Vector__XXX
 SG_ RCM2_a557_bucklHallRightSht2Bat m7 : 26|1@1+ (1,0) [0|1] "" Vector__XXX
 SG_ RCM2_a558_bucklHallRightOpen m7 : 27|1@1+ (1,0) [0|1] "" Vector__XXX
 SG_ RCM2_a559_bucklHallRightUndef m7 : 28|1@1+ (1,0) [0|1] "" Vector__XXX
 SG_ RCM2_a560_bucklHallRightCrssCoup m7 : 29|1@1+ (1,0) [0|1] "" Vector__XXX
 SG_ RCM2_a561_bucklHallRightConfig m7 : 30|1@1+ (1,0) [0|1] "" Vector__XXX
 SG_ RCM2_a562_seaTrkPosLeftSht2Gnd m7 : 31|1@1+ (1,0) [0|1] "" Vector__XXX
 SG_ RCM2_a563_seaTrkPosLeftShtBat m7 : 32|1@1+ (1,0) [0|1] "" Vector__XXX
 SG_ RCM2_a564_seaTrkPosLeftOpen m7 : 33|1@1+ (1,0) [0|1] "" Vector__XXX
 SG_ RCM2_a565_seaTrkPosLeftUndefined m7 : 34|1@1+ (1,0) [0|1] "" Vector__XXX
 SG_ RCM2_a566_seaTrkPosLeftCrssCoup m7 : 35|1@1+ (1,0) [0|1] "" Vector__XXX
 SG_ RCM2_a567_seaTrkPosLeftConfig m7 : 36|1@1+ (1,0) [0|1] "" Vector__XXX
 SG_ RCM2_a568_occPROSSht2Gnd m7 : 37|1@1+ (1,0) [0|1] "" Vector__XXX
 SG_ RCM2_a569_occPROSSht2Bat m7 : 38|1@1+ (1,0) [0|1] "" Vector__XXX
 SG_ RCM2_a570_occPROSOpen m7 : 39|1@1+ (1,0) [0|1] "" Vector__XXX
 SG_ RCM2_a571_occPROSUndef m7 : 40|1@1+ (1,0) [0|1] "" Vector__XXX
 SG_ RCM2_a572_occPROSCrssCoup m7 : 41|1@1+ (1,0) [0|1] "" Vector__XXX
 SG_ RCM2_a573_occPROSConfig m7 : 42|1@1+ (1,0) [0|1] "" Vector__XXX
 SG_ RCM2_a587_sbrRearNetworkSht2Gnd m7 : 43|1@1+ (1,0) [0|1] "" Vector__XXX
 SG_ RCM2_a588_sbrRearNetworkSht2Bat m7 : 44|1@1+ (1,0) [0|1] "" Vector__XXX
 SG_ RCM2_a589_sbrRearNetworkOpen m7 : 45|1@1+ (1,0) [0|1] "" Vector__XXX
 SG_ RCM2_a590_sbrRearNetworkUndefine m7 : 46|1@1+ (1,0) [0|1] "" Vector__XXX
 SG_ RCM2_a591_sbrRearNetworkCrssCoup m7 : 47|1@1+ (1,0) [0|1] "" Vector__XXX
 SG_ RCM2_a592_sbrRearNetworkConfig m7 : 48|1@1+ (1,0) [0|1] "" Vector__XXX
 SG_ RCM2_a593_driveOrientationSht2Gn m7 : 49|1@1+ (1,0) [0|1] "" Vector__XXX
 SG_ RCM2_a594_driveOrientationSht2Ba m7 : 50|1@1+ (1,0) [0|1] "" Vector__XXX
 SG_ RCM2_a595_driveOrientationOpen m7 : 51|1@1+ (1,0) [0|1] "" Vector__XXX
 SG_ RCM2_a596_driveOrientationUndefi m7 : 52|1@1+ (1,0) [0|1] "" Vector__XXX
 SG_ RCM2_a597_driveOrientationCrssCo m7 : 53|1@1+ (1,0) [0|1] "" Vector__XXX
 SG_ RCM2_a598_driveOrientationConfig m7 : 54|1@1+ (1,0) [0|1] "" Vector__XXX
 SG_ RCM2_a600_comCANinternalTimeout m7 : 55|1@1+ (1,0) [0|1] "" Vector__XXX
 SG_ RCM2_a601_comChassisCANSilent m7 : 56|1@1+ (1,0) [0|1] "" Vector__XXX
 SG_ RCM2_a602_comChassisCANBusOff m7 : 57|1@1+ (1,0) [0|1] "" Vector__XXX
 SG_ RCM2_a603_comPARTYCANSilent m7 : 58|1@1+ (1,0) [0|1] "" Vector__XXX
 SG_ RCM2_a604_comPARTYCANBusOff m7 : 59|1@1+ (1,0) [0|1] "" Vector__XXX
 SG_ RCM2_a605_comStwAngStatMIA m7 : 60|1@1+ (1,0) [0|1] "" Vector__XXX
 SG_ RCM2_a606_comStwAngStatChkSm m7 : 61|1@1+ (1,0) [0|1] "" Vector__XXX
 SG_ RCM2_a607_comStwAngStatCntr m7 : 62|1@1+ (1,0) [0|1] "" Vector__XXX
 SG_ RCM2_a608_comDItorque1MIA m7 : 63|1@1+ (1,0) [0|1] "" Vector__XXX
 SG_ RCM2_a609_comDItorque1ChkSm m8 : 4|1@1+ (1,0) [0|1] "" Vector__XXX
 SG_ RCM2_a610_comDItorque1Cntr m8 : 5|1@1+ (1,0) [0|1] "" Vector__XXX
 SG_ RCM2_a611_comDItorque2MIA m8 : 6|1@1+ (1,0) [0|1] "" Vector__XXX
 SG_ RCM2_a612_comDItorque2ChkSm m8 : 7|1@1+ (1,0) [0|1] "" Vector__XXX
 SG_ RCM2_a613_comDItorque2Cntr m8 : 8|1@1+ (1,0) [0|1] "" Vector__XXX
 SG_ RCM2_a614_comESP135MIA m8 : 9|1@1+ (1,0) [0|1] "" Vector__XXX
 SG_ RCM2_a615_comESP135ChkSm m8 : 10|1@1+ (1,0) [0|1] "" Vector__XXX
 SG_ RCM2_a616_comESP135Cntr m8 : 11|1@1+ (1,0) [0|1] "" Vector__XXX
 SG_ RCM2_a617_comESP145MIA m8 : 12|1@1+ (1,0) [0|1] "" Vector__XXX
 SG_ RCM2_a618_comESP145ChkSm m8 : 13|1@1+ (1,0) [0|1] "" Vector__XXX
 SG_ RCM2_a619_comESP145Cntr m8 : 14|1@1+ (1,0) [0|1] "" Vector__XXX
 SG_ RCM2_a620_comInvalidVehicleSpeed m8 : 15|1@1+ (1,0) [0|1] "" Vector__XXX
 SG_ RCM2_a621_comESPBMIA m8 : 16|1@1+ (1,0) [0|1] "" Vector__XXX
 SG_ RCM2_a622_comESPBChkSm m8 : 17|1@1+ (1,0) [0|1] "" Vector__XXX
 SG_ RCM2_a623_comESPBCntr m8 : 18|1@1+ (1,0) [0|1] "" Vector__XXX
 SG_ RCM2_a624_comESPCMIA m8 : 19|1@1+ (1,0) [0|1] "" Vector__XXX
 SG_ RCM2_a625_comESPCChkSm m8 : 20|1@1+ (1,0) [0|1] "" Vector__XXX
 SG_ RCM2_a626_comESPCCntr m8 : 21|1@1+ (1,0) [0|1] "" Vector__XXX
 SG_ RCM2_a627_comEPBStatusMIA m8 : 22|1@1+ (1,0) [0|1] "" Vector__XXX
 SG_ RCM2_a628_comEPBStatusChkSm m8 : 23|1@1+ (1,0) [0|1] "" Vector__XXX
 SG_ RCM2_a629_comEPBStatusCntr m8 : 24|1@1+ (1,0) [0|1] "" Vector__XXX
 SG_ RCM2_a630_comGTWACSMIA m8 : 25|1@1+ (1,0) [0|1] "" Vector__XXX
 SG_ RCM2_a631_comGTWACSChkSm m8 : 26|1@1+ (1,0) [0|1] "" Vector__XXX
 SG_ RCM2_a632_comGTWACSCntr m8 : 27|1@1+ (1,0) [0|1] "" Vector__XXX
 SG_ RCM2_a633_comOCS1PMIA m8 : 28|1@1+ (1,0) [0|1] "" Vector__XXX
 SG_ RCM2_a634_comOCS1PChkSm m8 : 29|1@1+ (1,0) [0|1] "" Vector__XXX
 SG_ RCM2_a635_comOCS1PCntr m8 : 30|1@1+ (1,0) [0|1] "" Vector__XXX
 SG_ RCM2_a636_ocsFaulted m8 : 31|1@1+ (1,0) [0|1] "" Vector__XXX
 SG_ RCM2_a637_ocsUnknown m8 : 32|1@1+ (1,0) [0|1] "" Vector__XXX
 SG_ RCM2_a638_comGTWodoMIA m8 : 33|1@1+ (1,0) [0|1] "" Vector__XXX
 SG_ RCM2_a639_comGTWCarStateMIA m8 : 34|1@1+ (1,0) [0|1] "" Vector__XXX
 SG_ RCM2_a640_comTPMSStatusCMIA m8 : 35|1@1+ (1,0) [0|1] "" Vector__XXX
 SG_ RCM2_a641_comGTWCarConfigMIA m8 : 36|1@1+ (1,0) [0|1] "" Vector__XXX
 SG_ RCM2_a642_comVINmessageMIA m8 : 37|1@1+ (1,0) [0|1] "" Vector__XXX
 SG_ RCM2_a643_comDASSafetyFrntMIA m8 : 38|1@1+ (1,0) [0|1] "" Vector__XXX
 SG_ RCM2_a644_comDASSafetyFrntChkSm m8 : 39|1@1+ (1,0) [0|1] "" Vector__XXX
 SG_ RCM2_a645_comDASSafetyFrntCntr m8 : 40|1@1+ (1,0) [0|1] "" Vector__XXX
 SG_ RCM2_a646_comDIstateMIA m8 : 41|1@1+ (1,0) [0|1] "" Vector__XXX
 SG_ RCM2_a647_comDIstateChkSm m8 : 42|1@1+ (1,0) [0|1] "" Vector__XXX
 SG_ RCM2_a648_comDIstateCntr m8 : 43|1@1+ (1,0) [0|1] "" Vector__XXX
 SG_ RCM2_a649_comDIstate2MIA m8 : 44|1@1+ (1,0) [0|1] "" Vector__XXX
 SG_ RCM2_a650_comDIstate2ChkSm m8 : 45|1@1+ (1,0) [0|1] "" Vector__XXX
 SG_ RCM2_a651_comDIstate2Cntr m8 : 46|1@1+ (1,0) [0|1] "" Vector__XXX
 SG_ RCM2_a652_ambientTempFaulted m8 : 47|1@1+ (1,0) [0|1] "" Vector__XXX
 SG_ RCM2_a653_comGTWESP1MIA m8 : 48|1@1+ (1,0) [0|1] "" Vector__XXX
 SG_ RCM2_a654_comGTWESP1ChkSm m8 : 49|1@1+ (1,0) [0|1] "" Vector__XXX
 SG_ RCM2_a655_comGTWESP1Cntr m8 : 50|1@1+ (1,0) [0|1] "" Vector__XXX
 SG_ RCM2_a656_comVCSEATPrestMIA m8 : 51|1@1+ (1,0) [0|1] "" Vector__XXX
 SG_ RCM2_a657_comVCSEATPrestChkSm m8 : 52|1@1+ (1,0) [0|1] "" Vector__XXX
 SG_ RCM2_a658_comVCSEATPrestCntr m8 : 53|1@1+ (1,0) [0|1] "" Vector__XXX
 SG_ RCM2_a659_comVCSEATPbuckle m8 : 54|1@1+ (1,0) [0|1] "" Vector__XXX
 SG_ RCM2_a660_comVCSEATPOccpy m8 : 55|1@1+ (1,0) [0|1] "" Vector__XXX
 SG_ RCM2_a661_comVCSEATPocs m8 : 56|1@1+ (1,0) [0|1] "" Vector__XXX
 SG_ RCM2_a662_comVCSEATPstps m8 : 57|1@1+ (1,0) [0|1] "" Vector__XXX
 SG_ RCM2_a663_comVCSEATDrestMIA m8 : 58|1@1+ (1,0) [0|1] "" Vector__XXX
 SG_ RCM2_a664_comVCSEATDrestChkSm m8 : 59|1@1+ (1,0) [0|1] "" Vector__XXX
 SG_ RCM2_a665_comVCSEATDrestCntr m8 : 60|1@1+ (1,0) [0|1] "" Vector__XXX
 SG_ RCM2_a666_comVCSEATDbuckle m8 : 61|1@1+ (1,0) [0|1] "" Vector__XXX
 SG_ RCM2_a667_comVCSEATDOccpy m8 : 62|1@1+ (1,0) [0|1] "" Vector__XXX
 SG_ RCM2_a668_comVCSEATDstps m8 : 63|1@1+ (1,0) [0|1] "" Vector__XXX
 SG_ RCM2_a669_comEPBLstatusMIA m9 : 4|1@1+ (1,0) [0|1] "" Vector__XXX
 SG_ RCM2_a670_comEPBLstatusChkSm m9 : 5|1@1+ (1,0) [0|1] "" Vector__XXX
 SG_ RCM2_a671_comEPBLstatusCntr m9 : 6|1@1+ (1,0) [0|1] "" Vector__XXX
 SG_ RCM2_a672_comEPBRstatusMIA m9 : 7|1@1+ (1,0) [0|1] "" Vector__XXX
 SG_ RCM2_a673_comEPBRstatusChkSm m9 : 8|1@1+ (1,0) [0|1] "" Vector__XXX
 SG_ RCM2_a674_comEPBRstatusCntr m9 : 9|1@1+ (1,0) [0|1] "" Vector__XXX
 SG_ RCM2_a675_comUIodoMIA m9 : 10|1@1+ (1,0) [0|1] "" Vector__XXX
 SG_ RCM2_a676_comEPAS3PsysMIA m9 : 11|1@1+ (1,0) [0|1] "" Vector__XXX
 SG_ RCM2_a677_comEPAS3PsysChkSm m9 : 12|1@1+ (1,0) [0|1] "" Vector__XXX
 SG_ RCM2_a678_comEPAS3PsysCntr m9 : 13|1@1+ (1,0) [0|1] "" Vector__XXX
 SG_ RCM2_a679_comESPwheelSpeedsMIA m9 : 14|1@1+ (1,0) [0|1] "" Vector__XXX
 SG_ RCM2_a680_comESPwheelSpeedsChkSm m9 : 15|1@1+ (1,0) [0|1] "" Vector__XXX
 SG_ RCM2_a681_comESPwheelSpeedsCntr m9 : 16|1@1+ (1,0) [0|1] "" Vector__XXX
 SG_ RCM2_a682_comDIspeedMIA m9 : 17|1@1+ (1,0) [0|1] "" Vector__XXX
 SG_ RCM2_a683_comDIspeedChkSm m9 : 18|1@1+ (1,0) [0|1] "" Vector__XXX
 SG_ RCM2_a684_comDIspeedCntr m9 : 19|1@1+ (1,0) [0|1] "" Vector__XXX
 SG_ RCM2_a685_comDIchassControlMIA m9 : 20|1@1+ (1,0) [0|1] "" Vector__XXX
 SG_ RCM2_a686_comDIchassControlChkSm m9 : 21|1@1+ (1,0) [0|1] "" Vector__XXX
 SG_ RCM2_a687_comDIchassControlCntr m9 : 22|1@1+ (1,0) [0|1] "" Vector__XXX
 SG_ RCM2_a688_comVCLEFTrestMIA m9 : 23|1@1+ (1,0) [0|1] "" Vector__XXX
 SG_ RCM2_a689_comVCLEFTrestChkSm m9 : 24|1@1+ (1,0) [0|1] "" Vector__XXX
 SG_ RCM2_a690_comVCLEFTrestCntr m9 : 25|1@1+ (1,0) [0|1] "" Vector__XXX
 SG_ RCM2_a691_comVCLEFT1rLBuckle m9 : 26|1@1+ (1,0) [0|1] "" Vector__XXX
 SG_ RCM2_a692_comVCLEFT2rLBuckle m9 : 27|1@1+ (1,0) [0|1] "" Vector__XXX
 SG_ RCM2_a693_comVCLEFT1rLSTPS m9 : 28|1@1+ (1,0) [0|1] "" Vector__XXX
 SG_ RCM2_a694_comVCRIGHTrestMIA m9 : 29|1@1+ (1,0) [0|1] "" Vector__XXX
 SG_ RCM2_a695_comVCRIGHTrestChkSm m9 : 30|1@1+ (1,0) [0|1] "" Vector__XXX
 SG_ RCM2_a696_comVCRIGHTrestCntr m9 : 31|1@1+ (1,0) [0|1] "" Vector__XXX
 SG_ RCM2_a697_comVCRIGHT1rRBuckle m9 : 32|1@1+ (1,0) [0|1] "" Vector__XXX
 SG_ RCM2_a698_comVCRIGHT2rRBuckle m9 : 33|1@1+ (1,0) [0|1] "" Vector__XXX
 SG_ RCM2_a699_comVCRIGHTocs m9 : 34|1@1+ (1,0) [0|1] "" Vector__XXX
 SG_ RCM2_a700_comVCRIGHT1rRSTPS m9 : 35|1@1+ (1,0) [0|1] "" Vector__XXX
 SG_ RCM2_a701_comVCSECtpmsStatusMIA m9 : 36|1@1+ (1,0) [0|1] "" Vector__XXX
 SG_ RCM2_a750_linInternalTimeout m9 : 37|1@1+ (1,0) [0|1] "" Vector__XXX
 SG_ RCM2_a799_internalFault m9 : 38|1@1+ (1,0) [0|1] "" Vector__XXX
 SG_ RCM2_a800_crcFault m9 : 39|1@1+ (1,0) [0|1] "" Vector__XXX
 SG_ RCM2_a801_parameterLayoutID m9 : 40|1@1+ (1,0) [0|1] "" Vector__XXX
 SG_ RCM2_a802_parameterTransferID m9 : 41|1@1+ (1,0) [0|1] "" Vector__XXX
 SG_ RCM2_a803_algoVerifySensorID m9 : 42|1@1+ (1,0) [0|1] "" Vector__XXX
 SG_ RCM2_a804_configDataInconsistent m9 : 43|1@1+ (1,0) [0|1] "" Vector__XXX
 SG_ RCM2_a805_swVersionWrong m9 : 44|1@1+ (1,0) [0|1] "" Vector__XXX
 SG_ RCM2_a806_configVINnotLearned m9 : 45|1@1+ (1,0) [0|1] "" Vector__XXX
 SG_ RCM2_a807_configVINmismatch m9 : 46|1@1+ (1,0) [0|1] "" Vector__XXX
 SG_ RCM2_a808_configDriveNotLearned m9 : 47|1@1+ (1,0) [0|1] "" Vector__XXX
 SG_ RCM2_a809_configDriveMismatch m9 : 48|1@1+ (1,0) [0|1] "" Vector__XXX
 SG_ RCM2_a810_bootUpActionFailure m9 : 49|1@1+ (1,0) [0|1] "" Vector__XXX
 SG_ RCM2_a811_comAxleSpeed m9 : 50|1@1+ (1,0) [0|1] "" Vector__XXX
 SG_ RCM2_a812_idfMisuseMonitoringErr m9 : 51|1@1+ (1,0) [0|1] "" Vector__XXX
 SG_ RCM2_a813_idfEnviMonitoringError m9 : 52|1@1+ (1,0) [0|1] "" Vector__XXX
 SG_ RCM2_a814_idfEnviMonitoringEvent m9 : 53|1@1+ (1,0) [0|1] "" Vector__XXX
 SG_ RCM2_a815_upFrntPedProMLSht2Gnd m9 : 54|1@1+ (1,0) [0|1] "" Vector__XXX
 SG_ RCM2_a816_upFrntPedProMLSht2Bat m9 : 55|1@1+ (1,0) [0|1] "" Vector__XXX
 SG_ RCM2_a817_upFrntPedProMLOpen m9 : 56|1@1+ (1,0) [0|1] "" Vector__XXX
 SG_ RCM2_a818_upFrntPedProMLCrssCoup m9 : 57|1@1+ (1,0) [0|1] "" Vector__XXX
 SG_ RCM2_a819_upFrntPedProMLCommErr m9 : 58|1@1+ (1,0) [0|1] "" Vector__XXX
 SG_ RCM2_a820_upFrntPedProMLIntTyp m9 : 59|1@1+ (1,0) [0|1] "" Vector__XXX
 SG_ RCM2_a821_upFrntPedProMLConfig m9 : 60|1@1+ (1,0) [0|1] "" Vector__XXX
 SG_ RCM2_a822_upFrntPedProMLDefect m9 : 61|1@1+ (1,0) [0|1] "" Vector__XXX
 SG_ RCM2_a823_upFrntPedProMLSigMon m9 : 62|1@1+ (1,0) [0|1] "" Vector__XXX
 SG_ RCM2_a824_upFrntPedProMRSht2Gnd m9 : 63|1@1+ (1,0) [0|1] "" Vector__XXX
 SG_ RCM2_a825_upFrntPedProMRSht2Bat m10 : 4|1@1+ (1,0) [0|1] "" Vector__XXX
 SG_ RCM2_a826_upFrntPedProMROpen m10 : 5|1@1+ (1,0) [0|1] "" Vector__XXX
 SG_ RCM2_a827_upFrntPedProMRCrssCoup m10 : 6|1@1+ (1,0) [0|1] "" Vector__XXX
 SG_ RCM2_a828_upFrntPedProMRCommErr m10 : 7|1@1+ (1,0) [0|1] "" Vector__XXX
 SG_ RCM2_a829_upFrntPedProMRIntTyp m10 : 8|1@1+ (1,0) [0|1] "" Vector__XXX
 SG_ RCM2_a830_upFrntPedProMRConfig m10 : 9|1@1+ (1,0) [0|1] "" Vector__XXX
 SG_ RCM2_a831_upFrntPedProMRDefect m10 : 10|1@1+ (1,0) [0|1] "" Vector__XXX
 SG_ RCM2_a832_upFrntPedProMRSigMon m10 : 11|1@1+ (1,0) [0|1] "" Vector__XXX
 SG_ RCM2_a833_pretenShldCSht2Gnd m10 : 12|1@1+ (1,0) [0|1] "" Vector__XXX
 SG_ RCM2_a834_pretenShldCSht2Bat m10 : 13|1@1+ (1,0) [0|1] "" Vector__XXX
 SG_ RCM2_a835_pretenShldCOpen m10 : 14|1@1+ (1,0) [0|1] "" Vector__XXX
 SG_ RCM2_a836_pretenShldCShort m10 : 15|1@1+ (1,0) [0|1] "" Vector__XXX
 SG_ RCM2_a837_pretenShldCCrossC m10 : 16|1@1+ (1,0) [0|1] "" Vector__XXX
 SG_ RCM2_a838_pretenShldCConfig m10 : 17|1@1+ (1,0) [0|1] "" Vector__XXX
 SG_ RCM2_a839_preten2ndRowCSht2Gnd m10 : 18|1@1+ (1,0) [0|1] "" Vector__XXX
 SG_ RCM2_a840_preten2ndRowCSht2Bat m10 : 19|1@1+ (1,0) [0|1] "" Vector__XXX
 SG_ RCM2_a841_preten2ndRowCOpen m10 : 20|1@1+ (1,0) [0|1] "" Vector__XXX
 SG_ RCM2_a842_preten2ndRowCShort m10 : 21|1@1+ (1,0) [0|1] "" Vector__XXX
 SG_ RCM2_a843_preten2ndRowCCrssCoup m10 : 22|1@1+ (1,0) [0|1] "" Vector__XXX
 SG_ RCM2_a844_preten2ndRowCConfig m10 : 23|1@1+ (1,0) [0|1] "" Vector__XXX
 SG_ RCM2_a845_comUIchassisControlMIA m10 : 24|1@1+ (1,0) [0|1] "" Vector__XXX
 SG_ RCM2_a846_comSCCMstrAnglSnsMIA m10 : 25|1@1+ (1,0) [0|1] "" Vector__XXX
 SG_ RCM2_a847_comDASctrlMIA m10 : 26|1@1+ (1,0) [0|1] "" Vector__XXX
 SG_ RCM2_a848_comDIlocStatMIA m10 : 27|1@1+ (1,0) [0|1] "" Vector__XXX
 SG_ RCM2_a849_comIBSTparty1MIA m10 : 28|1@1+ (1,0) [0|1] "" Vector__XXX
 SG_ RCM2_a850_comVCFRONTlightingMIA m10 : 29|1@1+ (1,0) [0|1] "" Vector__XXX
 SG_ RCM2_a851_internalFaultTemp m10 : 30|1@1+ (1,0) [0|1] "" Vector__XXX
 SG_ RCM2_a852_autarkyEvent m10 : 31|1@1+ (1,0) [0|1] "" Vector__XXX
 SG_ RCM2_a853_ConfigParametersIncons m10 : 32|1@1+ (1,0) [0|1] "" Vector__XXX
 SG_ RCM2_a854_ConfigParametersNotLea m10 : 33|1@1+ (1,0) [0|1] "" Vector__XXX
 SG_ RCM2_a857_comVCLEFT2rCBuckle m10 : 34|1@1+ (1,0) [0|1] "" Vector__XXX
 SG_ RCM2_a858_comVCxLVPowerStateMIA m10 : 35|1@1+ (1,0) [0|1] "" Vector__XXX
 SG_ RCM2_a859_comVCxLVPowerStateChkS m10 : 36|1@1+ (1,0) [0|1] "" Vector__XXX
 SG_ RCM2_a860_comVCxLVPowerStateCntr m10 : 37|1@1+ (1,0) [0|1] "" Vector__XXX
 SG_ RCM2_a861_typeApprovalStringNotL m10 : 38|1@1+ (1,0) [0|1] "" Vector__XXX
 SG_ RCM2_a862_comPCSalertMatrixMIA m10 : 39|1@1+ (1,0) [0|1] "" Vector__XXX
 SG_ RCM2_a863_comVCFRONTalertMatrixM m10 : 40|1@1+ (1,0) [0|1] "" Vector__XXX
 SG_ RCM2_a864_comGTWepochTimeMIA m10 : 41|1@1+ (1,0) [0|1] "" Vector__XXX
 SG_ RCM2_a865_comVCLVBMSstatusHighMI m10 : 42|1@1+ (1,0) [0|1] "" Vector__XXX
 SG_ RCM2_a866_comDASstatusMIA m10 : 43|1@1+ (1,0) [0|1] "" Vector__XXX
 SG_ RCM2_a867_comPPBepbc1MIA m10 : 44|1@1+ (1,0) [0|1] "" Vector__XXX
 SG_ RCM2_a868_headAB3rdRowRSht2Gnd m10 : 45|1@1+ (1,0) [0|1] "" Vector__XXX
 SG_ RCM2_a869_headAB3rdRowRSht2Bat m10 : 46|1@1+ (1,0) [0|1] "" Vector__XXX
 SG_ RCM2_a870_headAB3rdRowROpen m10 : 47|1@1+ (1,0) [0|1] "" Vector__XXX
 SG_ RCM2_a871_headAB3rdRowRShort m10 : 48|1@1+ (1,0) [0|1] "" Vector__XXX
 SG_ RCM2_a872_headAB3rdRowRCrossC m10 : 49|1@1+ (1,0) [0|1] "" Vector__XXX
 SG_ RCM2_a873_headAB3rdRowRConfig m10 : 50|1@1+ (1,0) [0|1] "" Vector__XXX
 SG_ RCM2_a874_headAB3rdRowLSht2Gnd m10 : 51|1@1+ (1,0) [0|1] "" Vector__XXX
 SG_ RCM2_a875_headAB3rdRowLSht2Bat m10 : 52|1@1+ (1,0) [0|1] "" Vector__XXX
 SG_ RCM2_a876_headAB3rdRowLOpen m10 : 53|1@1+ (1,0) [0|1] "" Vector__XXX
 SG_ RCM2_a877_headAB3rdRowLShort m10 : 54|1@1+ (1,0) [0|1] "" Vector__XXX
 SG_ RCM2_a878_headAB3rdRowLCrossC m10 : 55|1@1+ (1,0) [0|1] "" Vector__XXX
 SG_ RCM2_a879_headAB3rdRowLConfig m10 : 56|1@1+ (1,0) [0|1] "" Vector__XXX
 SG_ RCM2_a880_comVCLEFT3rLBuckle m10 : 57|1@1+ (1,0) [0|1] "" Vector__XXX
 SG_ RCM2_a881_comVCRIGHT3rRBuckle m10 : 58|1@1+ (1,0) [0|1] "" Vector__XXX
 SG_ RCM2_a882_comPEBSbrakeSpeedMIA m10 : 59|1@1+ (1,0) [0|1] "" Vector__XXX
 SG_ RCM2_a883_comPEBSstatus2MIA m10 : 60|1@1+ (1,0) [0|1] "" Vector__XXX
 SG_ RCM2_a884_comPEBSstatus3MIA m10 : 61|1@1+ (1,0) [0|1] "" Vector__XXX
 SG_ RCM2_a885_comPEBSstatus2Counter m10 : 62|1@1+ (1,0) [0|1] "" Vector__XXX
 SG_ RCM2_a886_comPEBSstatus2CRC m10 : 63|1@1+ (1,0) [0|1] "" Vector__XXX

BO_ 1252 RCM3_alertLog: 8 RCM3
 SG_ RCM3_alertID : 0|1@1+ (1,0) [0|1] "" Vector__XXX
 SG_ RCM3_alertState : 15|1@1+ (1,0) [0|1] "" Vector__XXX

BO_ 2020 RCM3_alertMatrix: 8 RCM3
 SG_ RCM3_matrixIndex M : 0|4@1+ (1,0) [0|15] "" Vector__XXX
 SG_ RCM3_a001_LVPowerLossDetected m0 : 4|1@1+ (1,0) [0|1] "" Vector__XXX

BO_ 1297 RCM_alertLog: 8 RCM
 SG_ RCM_alertID M : 0|10@1+ (1,0) [0|1023] "" Vector__XXX
 SG_ RCM_alertState : 10|1@1+ (1,0) [0|1] "" Vector__XXX
 SG_ RCM_a000_eventArmStatus m0 : 11|1@1+ (1,0) [0|1] "" Vector__XXX
 SG_ RCM_a000_eventFactoryMode m0 : 12|1@1+ (1,0) [0|1] "" Vector__XXX
 SG_ RCM_a000_eventDiagEnabled m0 : 13|1@1+ (1,0) [0|1] "" Vector__XXX
 SG_ RCM_a000_eventDriveOrientation m0 : 14|1@1+ (1,0) [0|1] "" Vector__XXX
 SG_ RCM_a000_crashDetectedFront m0 : 16|1@1+ (1,0) [0|1] "" Vector__XXX
 SG_ RCM_a000_crashDetectedRear m0 : 17|1@1+ (1,0) [0|1] "" Vector__XXX
 SG_ RCM_a000_crashDetectedLeft m0 : 18|1@1+ (1,0) [0|1] "" Vector__XXX
 SG_ RCM_a000_crashDetectedRight m0 : 19|1@1+ (1,0) [0|1] "" Vector__XXX
 SG_ RCM_a000_crashDetectedRoll m0 : 20|1@1+ (1,0) [0|1] "" Vector__XXX
 SG_ RCM_a000_crashDetectedPreten m0 : 21|1@1+ (1,0) [0|1] "" Vector__XXX
 SG_ RCM_a000_crashDetectedStage1 m0 : 22|1@1+ (1,0) [0|1] "" Vector__XXX
 SG_ RCM_a000_crashDetectedStage2 m0 : 23|1@1+ (1,0) [0|1] "" Vector__XXX
 SG_ RCM_a000_crashDetectedHVpyro m0 : 24|1@1+ (1,0) [0|1] "" Vector__XXX
 SG_ RCM_a000_eventIDFsignal m0 : 25|1@1+ (1,0) [0|1] "" Vector__XXX
 SG_ RCM_a000_eventFrontLeftSeatbelt m0 : 26|1@1+ (1,0) [0|1] "" Vector__XXX
 SG_ RCM_a000_eventFrontRightSeatbelt m0 : 27|1@1+ (1,0) [0|1] "" Vector__XXX
 SG_ RCM_a000_eventVehicleSpeed m0 : 28|12@1+ (0.08,-40) [-40|287.6] "" Vector__XXX
 SG_ RCM_a000_eventSteeringAngle m0 : 45|14@0+ (0.1,-819.2) [-819.2|819.1] "" Vector__XXX
 SG_ RCM_a000_eventDriverBrakeApply m0 : 46|2@1+ (1,0) [0|3] "" Vector__XXX
 SG_ RCM_a000_eventAccelPedalPos m0 : 56|8@1+ (0.4,0) [0|102] "" Vector__XXX
 SG_ RCM_a001_eventArmStatus m1 : 11|1@1+ (1,0) [0|1] "" Vector__XXX
 SG_ RCM_a001_eventFactoryMode m1 : 12|1@1+ (1,0) [0|1] "" Vector__XXX
 SG_ RCM_a001_eventDiagEnabled m1 : 13|1@1+ (1,0) [0|1] "" Vector__XXX
 SG_ RCM_a001_eventDriveOrientation m1 : 14|1@1+ (1,0) [0|1] "" Vector__XXX
 SG_ RCM_a001_nearDeployFront m1 : 16|1@1+ (1,0) [0|1] "" Vector__XXX
 SG_ RCM_a001_nearDeployRear m1 : 17|1@1+ (1,0) [0|1] "" Vector__XXX
 SG_ RCM_a001_nearDeployLeft m1 : 18|1@1+ (1,0) [0|1] "" Vector__XXX
 SG_ RCM_a001_nearDeployRight m1 : 19|1@1+ (1,0) [0|1] "" Vector__XXX
 SG_ RCM_a001_nearDeployRoll m1 : 20|1@1+ (1,0) [0|1] "" Vector__XXX
 SG_ RCM_a001_nearDeployPretensioner m1 : 21|1@1+ (1,0) [0|1] "" Vector__XXX
 SG_ RCM_a001_eventIDFsignal m1 : 25|1@1+ (1,0) [0|1] "" Vector__XXX
 SG_ RCM_a001_eventFrontLeftSeatbelt m1 : 26|1@1+ (1,0) [0|1] "" Vector__XXX
 SG_ RCM_a001_eventFrontRightSeatbelt m1 : 27|1@1+ (1,0) [0|1] "" Vector__XXX
 SG_ RCM_a001_eventVehicleSpeed m1 : 28|12@1+ (0.08,-40) [-40|287.6] "" Vector__XXX
 SG_ RCM_a001_eventSteeringAngle m1 : 45|14@0+ (0.1,-819.2) [-819.2|819.1] "" Vector__XXX
 SG_ RCM_a001_eventDriverBrakeApply m1 : 46|2@1+ (1,0) [0|3] "" Vector__XXX
 SG_ RCM_a001_eventAccelPedalPos m1 : 56|8@1+ (0.4,0) [0|102] "" Vector__XXX
 SG_ RCM_a002_eventArmStatus m2 : 11|1@1+ (1,0) [0|1] "" Vector__XXX
 SG_ RCM_a002_eventFactoryMode m2 : 12|1@1+ (1,0) [0|1] "" Vector__XXX
 SG_ RCM_a002_eventDiagEnabled m2 : 13|1@1+ (1,0) [0|1] "" Vector__XXX
 SG_ RCM_a002_eventDriveOrientation m2 : 14|1@1+ (1,0) [0|1] "" Vector__XXX
 SG_ RCM_a002_airbagsUnArmed m2 : 16|1@1+ (1,0) [0|1] "" Vector__XXX
 SG_ RCM_a002_eventIDFsignal m2 : 25|1@1+ (1,0) [0|1] "" Vector__XXX
 SG_ RCM_a002_eventFrontLeftSeatbelt m2 : 26|1@1+ (1,0) [0|1] "" Vector__XXX
 SG_ RCM_a002_eventFrontRightSeatbelt m2 : 27|1@1+ (1,0) [0|1] "" Vector__XXX
 SG_ RCM_a002_eventVehicleSpeed m2 : 28|12@1+ (0.08,-40) [-40|287.6] "" Vector__XXX
 SG_ RCM_a002_eventSteeringAngle m2 : 45|14@0+ (0.1,-819.2) [-819.2|819.1] "" Vector__XXX
 SG_ RCM_a002_eventDriverBrakeApply m2 : 46|2@1+ (1,0) [0|3] "" Vector__XXX
 SG_ RCM_a002_eventAccelPedalPos m2 : 56|8@1+ (0.4,0) [0|102] "" Vector__XXX
 SG_ RCM_a003_eventArmStatus m3 : 11|1@1+ (1,0) [0|1] "" Vector__XXX
 SG_ RCM_a003_eventFactoryMode m3 : 12|1@1+ (1,0) [0|1] "" Vector__XXX
 SG_ RCM_a003_eventDiagEnabled m3 : 13|1@1+ (1,0) [0|1] "" Vector__XXX
 SG_ RCM_a003_eventDriveOrientation m3 : 14|1@1+ (1,0) [0|1] "" Vector__XXX
 SG_ RCM_a003_warningIndicatorOn m3 : 16|1@1+ (1,0) [0|1] "" Vector__XXX
 SG_ RCM_a003_eventIDFsignal m3 : 25|1@1+ (1,0) [0|1] "" Vector__XXX
 SG_ RCM_a003_eventFrontLeftSeatbelt m3 : 26|1@1+ (1,0) [0|1] "" Vector__XXX
 SG_ RCM_a003_eventFrontRightSeatbelt m3 : 27|1@1+ (1,0) [0|1] "" Vector__XXX
 SG_ RCM_a003_eventVehicleSpeed m3 : 28|12@1+ (0.08,-40) [-40|287.6] "" Vector__XXX
 SG_ RCM_a003_eventSteeringAngle m3 : 45|14@0+ (0.1,-819.2) [-819.2|819.1] "" Vector__XXX
 SG_ RCM_a003_eventDriverBrakeApply m3 : 46|2@1+ (1,0) [0|3] "" Vector__XXX
 SG_ RCM_a003_eventAccelPedalPos m3 : 56|8@1+ (0.4,0) [0|102] "" Vector__XXX
 SG_ RCM_a004_eventArmStatus m4 : 11|1@1+ (1,0) [0|1] "" Vector__XXX
 SG_ RCM_a004_eventFactoryMode m4 : 12|1@1+ (1,0) [0|1] "" Vector__XXX
 SG_ RCM_a004_eventDiagEnabled m4 : 13|1@1+ (1,0) [0|1] "" Vector__XXX
 SG_ RCM_a004_eventDriveOrientation m4 : 14|1@1+ (1,0) [0|1] "" Vector__XXX
 SG_ RCM_a004_frontAlgoDisabled m4 : 16|1@1+ (1,0) [0|1] "" Vector__XXX
 SG_ RCM_a004_sideAlgoDisabled m4 : 17|1@1+ (1,0) [0|1] "" Vector__XXX
 SG_ RCM_a004_rollAlgoDisabled m4 : 18|1@1+ (1,0) [0|1] "" Vector__XXX
 SG_ RCM_a004_idleMode m4 : 19|1@1+ (1,0) [0|1] "" Vector__XXX
 SG_ RCM_a004_internalFaultDetected m4 : 20|1@1+ (1,0) [0|1] "" Vector__XXX
 SG_ RCM_a004_swVersionMismatch m4 : 21|1@1+ (1,0) [0|1] "" Vector__XXX
 SG_ RCM_a004_paramLayoutIDInv m4 : 22|1@1+ (1,0) [0|1] "" Vector__XXX
 SG_ RCM_a004_algoPASIDMismatch m4 : 23|1@1+ (1,0) [0|1] "" Vector__XXX
 SG_ RCM_a004_eventIDFsignal m4 : 25|1@1+ (1,0) [0|1] "" Vector__XXX
 SG_ RCM_a004_eventFrontLeftSeatbelt m4 : 26|1@1+ (1,0) [0|1] "" Vector__XXX
 SG_ RCM_a004_eventFrontRightSeatbelt m4 : 27|1@1+ (1,0) [0|1] "" Vector__XXX
 SG_ RCM_a004_eventVehicleSpeed m4 : 28|12@1+ (0.08,-40) [-40|287.6] "" Vector__XXX
 SG_ RCM_a004_eventSteeringAngle m4 : 45|14@0+ (0.1,-819.2) [-819.2|819.1] "" Vector__XXX
 SG_ RCM_a004_eventDriverBrakeApply m4 : 46|2@1+ (1,0) [0|3] "" Vector__XXX
 SG_ RCM_a004_eventAccelPedalPos m4 : 56|8@1+ (0.4,0) [0|102] "" Vector__XXX
 SG_ RCM_a005_eventArmStatus m5 : 11|1@1+ (1,0) [0|1] "" Vector__XXX
 SG_ RCM_a005_eventFactoryMode m5 : 12|1@1+ (1,0) [0|1] "" Vector__XXX
 SG_ RCM_a005_eventDiagEnabled m5 : 13|1@1+ (1,0) [0|1] "" Vector__XXX
 SG_ RCM_a005_eventDriveOrientation m5 : 14|1@1+ (1,0) [0|1] "" Vector__XXX
 SG_ RCM_a005_externalCRCError m5 : 16|1@1+ (1,0) [0|1] "" Vector__XXX
 SG_ RCM_a005_eventIDFsignal m5 : 25|1@1+ (1,0) [0|1] "" Vector__XXX
 SG_ RCM_a005_eventFrontLeftSeatbelt m5 : 26|1@1+ (1,0) [0|1] "" Vector__XXX
 SG_ RCM_a005_eventFrontRightSeatbelt m5 : 27|1@1+ (1,0) [0|1] "" Vector__XXX
 SG_ RCM_a005_eventVehicleSpeed m5 : 28|12@1+ (0.08,-40) [-40|287.6] "" Vector__XXX
 SG_ RCM_a005_eventSteeringAngle m5 : 45|14@0+ (0.1,-819.2) [-819.2|819.1] "" Vector__XXX
 SG_ RCM_a005_eventDriverBrakeApply m5 : 46|2@1+ (1,0) [0|3] "" Vector__XXX
 SG_ RCM_a005_eventAccelPedalPos m5 : 56|8@1+ (0.4,0) [0|102] "" Vector__XXX
 SG_ RCM_a006_eventArmStatus m6 : 11|1@1+ (1,0) [0|1] "" Vector__XXX
 SG_ RCM_a006_eventFactoryMode m6 : 12|1@1+ (1,0) [0|1] "" Vector__XXX
 SG_ RCM_a006_eventDiagEnabled m6 : 13|1@1+ (1,0) [0|1] "" Vector__XXX
 SG_ RCM_a006_eventDriveOrientation m6 : 14|1@1+ (1,0) [0|1] "" Vector__XXX
 SG_ RCM_a006_batteryVoltageTooHigh m6 : 16|1@1+ (1,0) [0|1] "" Vector__XXX
 SG_ RCM_a006_batteryVoltageTooLow m6 : 17|1@1+ (1,0) [0|1] "" Vector__XXX
 SG_ RCM_a006_eventIDFsignal m6 : 25|1@1+ (1,0) [0|1] "" Vector__XXX
 SG_ RCM_a006_eventFrontLeftSeatbelt m6 : 26|1@1+ (1,0) [0|1] "" Vector__XXX
 SG_ RCM_a006_eventFrontRightSeatbelt m6 : 27|1@1+ (1,0) [0|1] "" Vector__XXX
 SG_ RCM_a006_eventVehicleSpeed m6 : 28|12@1+ (0.08,-40) [-40|287.6] "" Vector__XXX
 SG_ RCM_a006_eventSteeringAngle m6 : 45|14@0+ (0.1,-819.2) [-819.2|819.1] "" Vector__XXX
 SG_ RCM_a006_eventDriverBrakeApply m6 : 46|2@1+ (1,0) [0|3] "" Vector__XXX
 SG_ RCM_a006_eventAccelPedalPos m6 : 56|8@1+ (0.4,0) [0|102] "" Vector__XXX
 SG_ RCM_a008_eventArmStatus m8 : 11|1@1+ (1,0) [0|1] "" Vector__XXX
 SG_ RCM_a008_eventFactoryMode m8 : 12|1@1+ (1,0) [0|1] "" Vector__XXX
 SG_ RCM_a008_eventDiagEnabled m8 : 13|1@1+ (1,0) [0|1] "" Vector__XXX
 SG_ RCM_a008_eventDriveOrientation m8 : 14|1@1+ (1,0) [0|1] "" Vector__XXX
 SG_ RCM_a008_lossOfMainPwrSupMonit m8 : 16|1@1+ (1,0) [0|1] "" Vector__XXX
 SG_ RCM_a008_lossOfBckupPwrSupMonit m8 : 17|1@1+ (1,0) [0|1] "" Vector__XXX
 SG_ RCM_a008_normalShtdwnUnavail m8 : 18|1@1+ (1,0) [0|1] "" Vector__XXX
 SG_ RCM_a008_eventIDFsignal m8 : 25|1@1+ (1,0) [0|1] "" Vector__XXX
 SG_ RCM_a008_eventFrontLeftSeatbelt m8 : 26|1@1+ (1,0) [0|1] "" Vector__XXX
 SG_ RCM_a008_eventFrontRightSeatbelt m8 : 27|1@1+ (1,0) [0|1] "" Vector__XXX
 SG_ RCM_a008_eventVehicleSpeed m8 : 28|12@1+ (0.08,-40) [-40|287.6] "" Vector__XXX
 SG_ RCM_a008_eventSteeringAngle m8 : 45|14@0+ (0.1,-819.2) [-819.2|819.1] "" Vector__XXX
 SG_ RCM_a008_eventDriverBrakeApply m8 : 46|2@1+ (1,0) [0|3] "" Vector__XXX
 SG_ RCM_a008_eventAccelPedalPos m8 : 56|8@1+ (0.4,0) [0|102] "" Vector__XXX
 SG_ RCM_a009_eventArmStatus m9 : 11|1@1+ (1,0) [0|1] "" Vector__XXX
 SG_ RCM_a009_eventFactoryMode m9 : 12|1@1+ (1,0) [0|1] "" Vector__XXX
 SG_ RCM_a009_eventDiagEnabled m9 : 13|1@1+ (1,0) [0|1] "" Vector__XXX
 SG_ RCM_a009_eventDriveOrientation m9 : 14|1@1+ (1,0) [0|1] "" Vector__XXX
 SG_ RCM_a009_reprogramLimitExceeded m9 : 16|1@1+ (1,0) [0|1] "" Vector__XXX
 SG_ RCM_a009_eventIDFsignal m9 : 25|1@1+ (1,0) [0|1] "" Vector__XXX
 SG_ RCM_a009_eventFrontLeftSeatbelt m9 : 26|1@1+ (1,0) [0|1] "" Vector__XXX
 SG_ RCM_a009_eventFrontRightSeatbelt m9 : 27|1@1+ (1,0) [0|1] "" Vector__XXX
 SG_ RCM_a009_eventVehicleSpeed m9 : 28|12@1+ (0.08,-40) [-40|287.6] "" Vector__XXX
 SG_ RCM_a009_eventSteeringAngle m9 : 45|14@0+ (0.1,-819.2) [-819.2|819.1] "" Vector__XXX
 SG_ RCM_a009_eventDriverBrakeApply m9 : 46|2@1+ (1,0) [0|3] "" Vector__XXX
 SG_ RCM_a009_eventAccelPedalPos m9 : 56|8@1+ (0.4,0) [0|102] "" Vector__XXX
 SG_ RCM_a011_eventArmStatus m11 : 11|1@1+ (1,0) [0|1] "" Vector__XXX
 SG_ RCM_a011_eventFactoryMode m11 : 12|1@1+ (1,0) [0|1] "" Vector__XXX
 SG_ RCM_a011_eventDiagEnabled m11 : 13|1@1+ (1,0) [0|1] "" Vector__XXX
 SG_ RCM_a011_eventDriveOrientation m11 : 14|1@1+ (1,0) [0|1] "" Vector__XXX
 SG_ RCM_a011_edrDataAreaLocked m11 : 16|1@1+ (1,0) [0|1] "" Vector__XXX
 SG_ RCM_a011_eventIDFsignal m11 : 25|1@1+ (1,0) [0|1] "" Vector__XXX
 SG_ RCM_a011_eventFrontLeftSeatbelt m11 : 26|1@1+ (1,0) [0|1] "" Vector__XXX
 SG_ RCM_a011_eventFrontRightSeatbelt m11 : 27|1@1+ (1,0) [0|1] "" Vector__XXX
 SG_ RCM_a011_eventVehicleSpeed m11 : 28|12@1+ (0.08,-40) [-40|287.6] "" Vector__XXX
 SG_ RCM_a011_eventSteeringAngle m11 : 45|14@0+ (0.1,-819.2) [-819.2|819.1] "" Vector__XXX
 SG_ RCM_a011_eventDriverBrakeApply m11 : 46|2@1+ (1,0) [0|3] "" Vector__XXX
 SG_ RCM_a011_eventAccelPedalPos m11 : 56|8@1+ (0.4,0) [0|102] "" Vector__XXX
 SG_ RCM_a012_eventArmStatus m12 : 11|1@1+ (1,0) [0|1] "" Vector__XXX
 SG_ RCM_a012_eventFactoryMode m12 : 12|1@1+ (1,0) [0|1] "" Vector__XXX
 SG_ RCM_a012_eventDiagEnabled m12 : 13|1@1+ (1,0) [0|1] "" Vector__XXX
 SG_ RCM_a012_eventDriveOrientation m12 : 14|1@1+ (1,0) [0|1] "" Vector__XXX
 SG_ RCM_a012_vinMismatch m12 : 16|1@1+ (1,0) [0|1] "" Vector__XXX
 SG_ RCM_a012_vinNotProgrammed m12 : 17|1@1+ (1,0) [0|1] "" Vector__XXX
 SG_ RCM_a012_eventIDFsignal m12 : 25|1@1+ (1,0) [0|1] "" Vector__XXX
 SG_ RCM_a012_eventFrontLeftSeatbelt m12 : 26|1@1+ (1,0) [0|1] "" Vector__XXX
 SG_ RCM_a012_eventFrontRightSeatbelt m12 : 27|1@1+ (1,0) [0|1] "" Vector__XXX
 SG_ RCM_a012_eventVehicleSpeed m12 : 28|12@1+ (0.08,-40) [-40|287.6] "" Vector__XXX
 SG_ RCM_a012_eventSteeringAngle m12 : 45|14@0+ (0.1,-819.2) [-819.2|819.1] "" Vector__XXX
 SG_ RCM_a012_eventDriverBrakeApply m12 : 46|2@1+ (1,0) [0|3] "" Vector__XXX
 SG_ RCM_a012_eventAccelPedalPos m12 : 56|8@1+ (0.4,0) [0|102] "" Vector__XXX
 SG_ RCM_a013_eventArmStatus m13 : 11|1@1+ (1,0) [0|1] "" Vector__XXX
 SG_ RCM_a013_eventFactoryMode m13 : 12|1@1+ (1,0) [0|1] "" Vector__XXX
 SG_ RCM_a013_eventDiagEnabled m13 : 13|1@1+ (1,0) [0|1] "" Vector__XXX
 SG_ RCM_a013_eventDriveOrientation m13 : 14|1@1+ (1,0) [0|1] "" Vector__XXX
 SG_ RCM_a013_driveOrientiInitNotDone m13 : 16|1@1+ (1,0) [0|1] "" Vector__XXX
 SG_ RCM_a013_driveOrientPlausiCheck m13 : 17|1@1+ (1,0) [0|1] "" Vector__XXX
 SG_ RCM_a013_eventIDFsignal m13 : 25|1@1+ (1,0) [0|1] "" Vector__XXX
 SG_ RCM_a013_eventFrontLeftSeatbelt m13 : 26|1@1+ (1,0) [0|1] "" Vector__XXX
 SG_ RCM_a013_eventFrontRightSeatbelt m13 : 27|1@1+ (1,0) [0|1] "" Vector__XXX
 SG_ RCM_a013_eventVehicleSpeed m13 : 28|12@1+ (0.08,-40) [-40|287.6] "" Vector__XXX
 SG_ RCM_a013_eventSteeringAngle m13 : 45|14@0+ (0.1,-819.2) [-819.2|819.1] "" Vector__XXX
 SG_ RCM_a013_eventDriverBrakeApply m13 : 46|2@1+ (1,0) [0|3] "" Vector__XXX
 SG_ RCM_a013_eventAccelPedalPos m13 : 56|8@1+ (0.4,0) [0|102] "" Vector__XXX
 SG_ RCM_a014_eventArmStatus m14 : 11|1@1+ (1,0) [0|1] "" Vector__XXX
 SG_ RCM_a014_eventFactoryMode m14 : 12|1@1+ (1,0) [0|1] "" Vector__XXX
 SG_ RCM_a014_eventDiagEnabled m14 : 13|1@1+ (1,0) [0|1] "" Vector__XXX
 SG_ RCM_a014_eventDriveOrientation m14 : 14|1@1+ (1,0) [0|1] "" Vector__XXX
 SG_ RCM_a014_driverABStg1Sht2Gnd m14 : 16|1@1+ (1,0) [0|1] "" Vector__XXX
 SG_ RCM_a014_driverABStg1Sht2Bat m14 : 17|1@1+ (1,0) [0|1] "" Vector__XXX
 SG_ RCM_a014_driverABStg1Open m14 : 18|1@1+ (1,0) [0|1] "" Vector__XXX
 SG_ RCM_a014_driverABStg1Short m14 : 19|1@1+ (1,0) [0|1] "" Vector__XXX
 SG_ RCM_a014_driverABStg1CrossCoup m14 : 20|1@1+ (1,0) [0|1] "" Vector__XXX
 SG_ RCM_a014_driverABStg1Config m14 : 21|1@1+ (1,0) [0|1] "" Vector__XXX
 SG_ RCM_a014_eventIDFsignal m14 : 25|1@1+ (1,0) [0|1] "" Vector__XXX
 SG_ RCM_a014_eventFrontLeftSeatbelt m14 : 26|1@1+ (1,0) [0|1] "" Vector__XXX
 SG_ RCM_a014_eventFrontRightSeatbelt m14 : 27|1@1+ (1,0) [0|1] "" Vector__XXX
 SG_ RCM_a014_eventVehicleSpeed m14 : 28|12@1+ (0.08,-40) [-40|287.6] "" Vector__XXX
 SG_ RCM_a014_eventSteeringAngle m14 : 45|14@0+ (0.1,-819.2) [-819.2|819.1] "" Vector__XXX
 SG_ RCM_a014_eventDriverBrakeApply m14 : 46|2@1+ (1,0) [0|3] "" Vector__XXX
 SG_ RCM_a014_eventAccelPedalPos m14 : 56|8@1+ (0.4,0) [0|102] "" Vector__XXX
 SG_ RCM_a015_eventArmStatus m15 : 11|1@1+ (1,0) [0|1] "" Vector__XXX
 SG_ RCM_a015_eventFactoryMode m15 : 12|1@1+ (1,0) [0|1] "" Vector__XXX
 SG_ RCM_a015_eventDiagEnabled m15 : 13|1@1+ (1,0) [0|1] "" Vector__XXX
 SG_ RCM_a015_eventDriveOrientation m15 : 14|1@1+ (1,0) [0|1] "" Vector__XXX
 SG_ RCM_a015_driverABStg2Sht2Gnd m15 : 16|1@1+ (1,0) [0|1] "" Vector__XXX
 SG_ RCM_a015_driverABStg2Sht2Bat m15 : 17|1@1+ (1,0) [0|1] "" Vector__XXX
 SG_ RCM_a015_driverABStg2Open m15 : 18|1@1+ (1,0) [0|1] "" Vector__XXX
 SG_ RCM_a015_driverABStg2Short m15 : 19|1@1+ (1,0) [0|1] "" Vector__XXX
 SG_ RCM_a015_driverABStg2CrossCoup m15 : 20|1@1+ (1,0) [0|1] "" Vector__XXX
 SG_ RCM_a015_driverABStg2Config m15 : 21|1@1+ (1,0) [0|1] "" Vector__XXX
 SG_ RCM_a015_eventIDFsignal m15 : 25|1@1+ (1,0) [0|1] "" Vector__XXX
 SG_ RCM_a015_eventFrontLeftSeatbelt m15 : 26|1@1+ (1,0) [0|1] "" Vector__XXX
 SG_ RCM_a015_eventFrontRightSeatbelt m15 : 27|1@1+ (1,0) [0|1] "" Vector__XXX
 SG_ RCM_a015_eventVehicleSpeed m15 : 28|12@1+ (0.08,-40) [-40|287.6] "" Vector__XXX
 SG_ RCM_a015_eventSteeringAngle m15 : 45|14@0+ (0.1,-819.2) [-819.2|819.1] "" Vector__XXX
 SG_ RCM_a015_eventDriverBrakeApply m15 : 46|2@1+ (1,0) [0|3] "" Vector__XXX
 SG_ RCM_a015_eventAccelPedalPos m15 : 56|8@1+ (0.4,0) [0|102] "" Vector__XXX
 SG_ RCM_a016_eventArmStatus m16 : 11|1@1+ (1,0) [0|1] "" Vector__XXX
 SG_ RCM_a016_eventFactoryMode m16 : 12|1@1+ (1,0) [0|1] "" Vector__XXX
 SG_ RCM_a016_eventDiagEnabled m16 : 13|1@1+ (1,0) [0|1] "" Vector__XXX
 SG_ RCM_a016_eventDriveOrientation m16 : 14|1@1+ (1,0) [0|1] "" Vector__XXX
 SG_ RCM_a016_passABStg1Sht2Gnd m16 : 16|1@1+ (1,0) [0|1] "" Vector__XXX
 SG_ RCM_a016_passABStg1Sht2Bat m16 : 17|1@1+ (1,0) [0|1] "" Vector__XXX
 SG_ RCM_a016_passABStg1Open m16 : 18|1@1+ (1,0) [0|1] "" Vector__XXX
 SG_ RCM_a016_passABStg1Short m16 : 19|1@1+ (1,0) [0|1] "" Vector__XXX
 SG_ RCM_a016_passABStg1CrossCoup m16 : 20|1@1+ (1,0) [0|1] "" Vector__XXX
 SG_ RCM_a016_passABStg1Config m16 : 21|1@1+ (1,0) [0|1] "" Vector__XXX
 SG_ RCM_a016_eventIDFsignal m16 : 25|1@1+ (1,0) [0|1] "" Vector__XXX
 SG_ RCM_a016_eventFrontLeftSeatbelt m16 : 26|1@1+ (1,0) [0|1] "" Vector__XXX
 SG_ RCM_a016_eventFrontRightSeatbelt m16 : 27|1@1+ (1,0) [0|1] "" Vector__XXX
 SG_ RCM_a016_eventVehicleSpeed m16 : 28|12@1+ (0.08,-40) [-40|287.6] "" Vector__XXX
 SG_ RCM_a016_eventSteeringAngle m16 : 45|14@0+ (0.1,-819.2) [-819.2|819.1] "" Vector__XXX
 SG_ RCM_a016_eventDriverBrakeApply m16 : 46|2@1+ (1,0) [0|3] "" Vector__XXX
 SG_ RCM_a016_eventAccelPedalPos m16 : 56|8@1+ (0.4,0) [0|102] "" Vector__XXX
 SG_ RCM_a017_eventArmStatus m17 : 11|1@1+ (1,0) [0|1] "" Vector__XXX
 SG_ RCM_a017_eventFactoryMode m17 : 12|1@1+ (1,0) [0|1] "" Vector__XXX
 SG_ RCM_a017_eventDiagEnabled m17 : 13|1@1+ (1,0) [0|1] "" Vector__XXX
 SG_ RCM_a017_eventDriveOrientation m17 : 14|1@1+ (1,0) [0|1] "" Vector__XXX
 SG_ RCM_a017_passABStg2Sht2Gnd m17 : 16|1@1+ (1,0) [0|1] "" Vector__XXX
 SG_ RCM_a017_passABStg2Sht2Bat m17 : 17|1@1+ (1,0) [0|1] "" Vector__XXX
 SG_ RCM_a017_passABStg2Open m17 : 18|1@1+ (1,0) [0|1] "" Vector__XXX
 SG_ RCM_a017_passABStg2Short m17 : 19|1@1+ (1,0) [0|1] "" Vector__XXX
 SG_ RCM_a017_passABStg2CrossCoup m17 : 20|1@1+ (1,0) [0|1] "" Vector__XXX
 SG_ RCM_a017_passABStg2Config m17 : 21|1@1+ (1,0) [0|1] "" Vector__XXX
 SG_ RCM_a017_eventIDFsignal m17 : 25|1@1+ (1,0) [0|1] "" Vector__XXX
 SG_ RCM_a017_eventFrontLeftSeatbelt m17 : 26|1@1+ (1,0) [0|1] "" Vector__XXX
 SG_ RCM_a017_eventFrontRightSeatbelt m17 : 27|1@1+ (1,0) [0|1] "" Vector__XXX
 SG_ RCM_a017_eventVehicleSpeed m17 : 28|12@1+ (0.08,-40) [-40|287.6] "" Vector__XXX
 SG_ RCM_a017_eventSteeringAngle m17 : 45|14@0+ (0.1,-819.2) [-819.2|819.1] "" Vector__XXX
 SG_ RCM_a017_eventDriverBrakeApply m17 : 46|2@1+ (1,0) [0|3] "" Vector__XXX
 SG_ RCM_a017_eventAccelPedalPos m17 : 56|8@1+ (0.4,0) [0|102] "" Vector__XXX
 SG_ RCM_a018_eventArmStatus m18 : 11|1@1+ (1,0) [0|1] "" Vector__XXX
 SG_ RCM_a018_eventFactoryMode m18 : 12|1@1+ (1,0) [0|1] "" Vector__XXX
 SG_ RCM_a018_eventDiagEnabled m18 : 13|1@1+ (1,0) [0|1] "" Vector__XXX
 SG_ RCM_a018_eventDriveOrientation m18 : 14|1@1+ (1,0) [0|1] "" Vector__XXX
 SG_ RCM_a018_passActiveVentSht2Gnd m18 : 16|1@1+ (1,0) [0|1] "" Vector__XXX
 SG_ RCM_a018_passActiveVentSht2Bat m18 : 17|1@1+ (1,0) [0|1] "" Vector__XXX
 SG_ RCM_a018_passActiveVentOpen m18 : 18|1@1+ (1,0) [0|1] "" Vector__XXX
 SG_ RCM_a018_passActiveVentShort m18 : 19|1@1+ (1,0) [0|1] "" Vector__XXX
 SG_ RCM_a018_passActiveVentCrossCoup m18 : 20|1@1+ (1,0) [0|1] "" Vector__XXX
 SG_ RCM_a018_passActiveVentConfig m18 : 21|1@1+ (1,0) [0|1] "" Vector__XXX
 SG_ RCM_a018_eventIDFsignal m18 : 25|1@1+ (1,0) [0|1] "" Vector__XXX
 SG_ RCM_a018_eventFrontLeftSeatbelt m18 : 26|1@1+ (1,0) [0|1] "" Vector__XXX
 SG_ RCM_a018_eventFrontRightSeatbelt m18 : 27|1@1+ (1,0) [0|1] "" Vector__XXX
 SG_ RCM_a018_eventVehicleSpeed m18 : 28|12@1+ (0.08,-40) [-40|287.6] "" Vector__XXX
 SG_ RCM_a018_eventSteeringAngle m18 : 45|14@0+ (0.1,-819.2) [-819.2|819.1] "" Vector__XXX
 SG_ RCM_a018_eventDriverBrakeApply m18 : 46|2@1+ (1,0) [0|3] "" Vector__XXX
 SG_ RCM_a018_eventAccelPedalPos m18 : 56|8@1+ (0.4,0) [0|102] "" Vector__XXX
 SG_ RCM_a019_eventArmStatus m19 : 11|1@1+ (1,0) [0|1] "" Vector__XXX
 SG_ RCM_a019_eventFactoryMode m19 : 12|1@1+ (1,0) [0|1] "" Vector__XXX
 SG_ RCM_a019_eventDiagEnabled m19 : 13|1@1+ (1,0) [0|1] "" Vector__XXX
 SG_ RCM_a019_eventDriveOrientation m19 : 14|1@1+ (1,0) [0|1] "" Vector__XXX
 SG_ RCM_a019_pretenShldLeftSht2Gnd m19 : 16|1@1+ (1,0) [0|1] "" Vector__XXX
 SG_ RCM_a019_pretenShldLeftSht2Bat m19 : 17|1@1+ (1,0) [0|1] "" Vector__XXX
 SG_ RCM_a019_pretenShldLeftOpen m19 : 18|1@1+ (1,0) [0|1] "" Vector__XXX
 SG_ RCM_a019_pretenShldLeftShort m19 : 19|1@1+ (1,0) [0|1] "" Vector__XXX
 SG_ RCM_a019_pretenShldLeftCrossC m19 : 20|1@1+ (1,0) [0|1] "" Vector__XXX
 SG_ RCM_a019_pretenShldLeftConfig m19 : 21|1@1+ (1,0) [0|1] "" Vector__XXX
 SG_ RCM_a019_eventIDFsignal m19 : 25|1@1+ (1,0) [0|1] "" Vector__XXX
 SG_ RCM_a019_eventFrontLeftSeatbelt m19 : 26|1@1+ (1,0) [0|1] "" Vector__XXX
 SG_ RCM_a019_eventFrontRightSeatbelt m19 : 27|1@1+ (1,0) [0|1] "" Vector__XXX
 SG_ RCM_a019_eventVehicleSpeed m19 : 28|12@1+ (0.08,-40) [-40|287.6] "" Vector__XXX
 SG_ RCM_a019_eventSteeringAngle m19 : 45|14@0+ (0.1,-819.2) [-819.2|819.1] "" Vector__XXX
 SG_ RCM_a019_eventDriverBrakeApply m19 : 46|2@1+ (1,0) [0|3] "" Vector__XXX
 SG_ RCM_a019_eventAccelPedalPos m19 : 56|8@1+ (0.4,0) [0|102] "" Vector__XXX
 SG_ RCM_a020_eventArmStatus m20 : 11|1@1+ (1,0) [0|1] "" Vector__XXX
 SG_ RCM_a020_eventFactoryMode m20 : 12|1@1+ (1,0) [0|1] "" Vector__XXX
 SG_ RCM_a020_eventDiagEnabled m20 : 13|1@1+ (1,0) [0|1] "" Vector__XXX
 SG_ RCM_a020_eventDriveOrientation m20 : 14|1@1+ (1,0) [0|1] "" Vector__XXX
 SG_ RCM_a020_pretenShldRightSht2Gnd m20 : 16|1@1+ (1,0) [0|1] "" Vector__XXX
 SG_ RCM_a020_pretenShldRightSht2Bat m20 : 17|1@1+ (1,0) [0|1] "" Vector__XXX
 SG_ RCM_a020_pretenShldRightOpen m20 : 18|1@1+ (1,0) [0|1] "" Vector__XXX
 SG_ RCM_a020_pretenShldRightShort m20 : 19|1@1+ (1,0) [0|1] "" Vector__XXX
 SG_ RCM_a020_pretenShldRightCrossC m20 : 20|1@1+ (1,0) [0|1] "" Vector__XXX
 SG_ RCM_a020_pretenShldRightConfig m20 : 21|1@1+ (1,0) [0|1] "" Vector__XXX
 SG_ RCM_a020_eventIDFsignal m20 : 25|1@1+ (1,0) [0|1] "" Vector__XXX
 SG_ RCM_a020_eventFrontLeftSeatbelt m20 : 26|1@1+ (1,0) [0|1] "" Vector__XXX
 SG_ RCM_a020_eventFrontRightSeatbelt m20 : 27|1@1+ (1,0) [0|1] "" Vector__XXX
 SG_ RCM_a020_eventVehicleSpeed m20 : 28|12@1+ (0.08,-40) [-40|287.6] "" Vector__XXX
 SG_ RCM_a020_eventSteeringAngle m20 : 45|14@0+ (0.1,-819.2) [-819.2|819.1] "" Vector__XXX
 SG_ RCM_a020_eventDriverBrakeApply m20 : 46|2@1+ (1,0) [0|3] "" Vector__XXX
 SG_ RCM_a020_eventAccelPedalPos m20 : 56|8@1+ (0.4,0) [0|102] "" Vector__XXX
 SG_ RCM_a021_eventArmStatus m21 : 11|1@1+ (1,0) [0|1] "" Vector__XXX
 SG_ RCM_a021_eventFactoryMode m21 : 12|1@1+ (1,0) [0|1] "" Vector__XXX
 SG_ RCM_a021_eventDiagEnabled m21 : 13|1@1+ (1,0) [0|1] "" Vector__XXX
 SG_ RCM_a021_eventDriveOrientation m21 : 14|1@1+ (1,0) [0|1] "" Vector__XXX
 SG_ RCM_a021_pretenLapLeftSht2Gnd m21 : 16|1@1+ (1,0) [0|1] "" Vector__XXX
 SG_ RCM_a021_pretenLapLeftSht2Bat m21 : 17|1@1+ (1,0) [0|1] "" Vector__XXX
 SG_ RCM_a021_pretenLapLeftOpen m21 : 18|1@1+ (1,0) [0|1] "" Vector__XXX
 SG_ RCM_a021_pretenLapLeftShort m21 : 19|1@1+ (1,0) [0|1] "" Vector__XXX
 SG_ RCM_a021_pretenLapLeftCrossCoup m21 : 20|1@1+ (1,0) [0|1] "" Vector__XXX
 SG_ RCM_a021_pretenLapLeftConfig m21 : 21|1@1+ (1,0) [0|1] "" Vector__XXX
 SG_ RCM_a021_eventIDFsignal m21 : 25|1@1+ (1,0) [0|1] "" Vector__XXX
 SG_ RCM_a021_eventFrontLeftSeatbelt m21 : 26|1@1+ (1,0) [0|1] "" Vector__XXX
 SG_ RCM_a021_eventFrontRightSeatbelt m21 : 27|1@1+ (1,0) [0|1] "" Vector__XXX
 SG_ RCM_a021_eventVehicleSpeed m21 : 28|12@1+ (0.08,-40) [-40|287.6] "" Vector__XXX
 SG_ RCM_a021_eventSteeringAngle m21 : 45|14@0+ (0.1,-819.2) [-819.2|819.1] "" Vector__XXX
 SG_ RCM_a021_eventDriverBrakeApply m21 : 46|2@1+ (1,0) [0|3] "" Vector__XXX
 SG_ RCM_a021_eventAccelPedalPos m21 : 56|8@1+ (0.4,0) [0|102] "" Vector__XXX
 SG_ RCM_a022_eventArmStatus m22 : 11|1@1+ (1,0) [0|1] "" Vector__XXX
 SG_ RCM_a022_eventFactoryMode m22 : 12|1@1+ (1,0) [0|1] "" Vector__XXX
 SG_ RCM_a022_eventDiagEnabled m22 : 13|1@1+ (1,0) [0|1] "" Vector__XXX
 SG_ RCM_a022_eventDriveOrientation m22 : 14|1@1+ (1,0) [0|1] "" Vector__XXX
 SG_ RCM_a022_pretenLapRightSht2Gnd m22 : 16|1@1+ (1,0) [0|1] "" Vector__XXX
 SG_ RCM_a022_pretenLapRightSht2Bat m22 : 17|1@1+ (1,0) [0|1] "" Vector__XXX
 SG_ RCM_a022_pretenLapRightOpen m22 : 18|1@1+ (1,0) [0|1] "" Vector__XXX
 SG_ RCM_a022_pretenLapRightShort m22 : 19|1@1+ (1,0) [0|1] "" Vector__XXX
 SG_ RCM_a022_pretenLapRightCrossCoup m22 : 20|1@1+ (1,0) [0|1] "" Vector__XXX
 SG_ RCM_a022_pretenLapRightConfig m22 : 21|1@1+ (1,0) [0|1] "" Vector__XXX
 SG_ RCM_a022_eventIDFsignal m22 : 25|1@1+ (1,0) [0|1] "" Vector__XXX
 SG_ RCM_a022_eventFrontLeftSeatbelt m22 : 26|1@1+ (1,0) [0|1] "" Vector__XXX
 SG_ RCM_a022_eventFrontRightSeatbelt m22 : 27|1@1+ (1,0) [0|1] "" Vector__XXX
 SG_ RCM_a022_eventVehicleSpeed m22 : 28|12@1+ (0.08,-40) [-40|287.6] "" Vector__XXX
 SG_ RCM_a022_eventSteeringAngle m22 : 45|14@0+ (0.1,-819.2) [-819.2|819.1] "" Vector__XXX
 SG_ RCM_a022_eventDriverBrakeApply m22 : 46|2@1+ (1,0) [0|3] "" Vector__XXX
 SG_ RCM_a022_eventAccelPedalPos m22 : 56|8@1+ (0.4,0) [0|102] "" Vector__XXX
 SG_ RCM_a023_eventArmStatus m23 : 11|1@1+ (1,0) [0|1] "" Vector__XXX
 SG_ RCM_a023_eventFactoryMode m23 : 12|1@1+ (1,0) [0|1] "" Vector__XXX
 SG_ RCM_a023_eventDiagEnabled m23 : 13|1@1+ (1,0) [0|1] "" Vector__XXX
 SG_ RCM_a023_eventDriveOrientation m23 : 14|1@1+ (1,0) [0|1] "" Vector__XXX
 SG_ RCM_a023_loadLimLeftSht2Gnd m23 : 16|1@1+ (1,0) [0|1] "" Vector__XXX
 SG_ RCM_a023_loadLimLeftSht2Bat m23 : 17|1@1+ (1,0) [0|1] "" Vector__XXX
 SG_ RCM_a023_loadLimLeftOpen m23 : 18|1@1+ (1,0) [0|1] "" Vector__XXX
 SG_ RCM_a023_loadLimLeftShort m23 : 19|1@1+ (1,0) [0|1] "" Vector__XXX
 SG_ RCM_a023_loadLimLeftCrossCoup m23 : 20|1@1+ (1,0) [0|1] "" Vector__XXX
 SG_ RCM_a023_loadLimLeftConfig m23 : 21|1@1+ (1,0) [0|1] "" Vector__XXX
 SG_ RCM_a023_eventIDFsignal m23 : 25|1@1+ (1,0) [0|1] "" Vector__XXX
 SG_ RCM_a023_eventFrontLeftSeatbelt m23 : 26|1@1+ (1,0) [0|1] "" Vector__XXX
 SG_ RCM_a023_eventFrontRightSeatbelt m23 : 27|1@1+ (1,0) [0|1] "" Vector__XXX
 SG_ RCM_a023_eventVehicleSpeed m23 : 28|12@1+ (0.08,-40) [-40|287.6] "" Vector__XXX
 SG_ RCM_a023_eventSteeringAngle m23 : 45|14@0+ (0.1,-819.2) [-819.2|819.1] "" Vector__XXX
 SG_ RCM_a023_eventDriverBrakeApply m23 : 46|2@1+ (1,0) [0|3] "" Vector__XXX
 SG_ RCM_a023_eventAccelPedalPos m23 : 56|8@1+ (0.4,0) [0|102] "" Vector__XXX
 SG_ RCM_a024_eventArmStatus m24 : 11|1@1+ (1,0) [0|1] "" Vector__XXX
 SG_ RCM_a024_eventFactoryMode m24 : 12|1@1+ (1,0) [0|1] "" Vector__XXX
 SG_ RCM_a024_eventDiagEnabled m24 : 13|1@1+ (1,0) [0|1] "" Vector__XXX
 SG_ RCM_a024_eventDriveOrientation m24 : 14|1@1+ (1,0) [0|1] "" Vector__XXX
 SG_ RCM_a024_loadLimRightSht2Gnd m24 : 16|1@1+ (1,0) [0|1] "" Vector__XXX
 SG_ RCM_a024_loadLimRightSht2Bat m24 : 17|1@1+ (1,0) [0|1] "" Vector__XXX
 SG_ RCM_a024_loadLimRightOpen m24 : 18|1@1+ (1,0) [0|1] "" Vector__XXX
 SG_ RCM_a024_loadLimRightShort m24 : 19|1@1+ (1,0) [0|1] "" Vector__XXX
 SG_ RCM_a024_loadLimRightCrossCoup m24 : 20|1@1+ (1,0) [0|1] "" Vector__XXX
 SG_ RCM_a024_loadLimRightConfig m24 : 21|1@1+ (1,0) [0|1] "" Vector__XXX
 SG_ RCM_a024_eventIDFsignal m24 : 25|1@1+ (1,0) [0|1] "" Vector__XXX
 SG_ RCM_a024_eventFrontLeftSeatbelt m24 : 26|1@1+ (1,0) [0|1] "" Vector__XXX
 SG_ RCM_a024_eventFrontRightSeatbelt m24 : 27|1@1+ (1,0) [0|1] "" Vector__XXX
 SG_ RCM_a024_eventVehicleSpeed m24 : 28|12@1+ (0.08,-40) [-40|287.6] "" Vector__XXX
 SG_ RCM_a024_eventSteeringAngle m24 : 45|14@0+ (0.1,-819.2) [-819.2|819.1] "" Vector__XXX
 SG_ RCM_a024_eventDriverBrakeApply m24 : 46|2@1+ (1,0) [0|3] "" Vector__XXX
 SG_ RCM_a024_eventAccelPedalPos m24 : 56|8@1+ (0.4,0) [0|102] "" Vector__XXX
 SG_ RCM_a025_eventArmStatus m25 : 11|1@1+ (1,0) [0|1] "" Vector__XXX
 SG_ RCM_a025_eventFactoryMode m25 : 12|1@1+ (1,0) [0|1] "" Vector__XXX
 SG_ RCM_a025_eventDiagEnabled m25 : 13|1@1+ (1,0) [0|1] "" Vector__XXX
 SG_ RCM_a025_eventDriveOrientation m25 : 14|1@1+ (1,0) [0|1] "" Vector__XXX
 SG_ RCM_a025_kneeABDrvrSht2Gnd m25 : 16|1@1+ (1,0) [0|1] "" Vector__XXX
 SG_ RCM_a025_kneeABDrvrSht2Bat m25 : 17|1@1+ (1,0) [0|1] "" Vector__XXX
 SG_ RCM_a025_kneeABDrvrOpen m25 : 18|1@1+ (1,0) [0|1] "" Vector__XXX
 SG_ RCM_a025_kneeABDrvrShort m25 : 19|1@1+ (1,0) [0|1] "" Vector__XXX
 SG_ RCM_a025_kneeABDrvrCrossCoup m25 : 20|1@1+ (1,0) [0|1] "" Vector__XXX
 SG_ RCM_a025_kneeABDrvrConfig m25 : 21|1@1+ (1,0) [0|1] "" Vector__XXX
 SG_ RCM_a025_eventIDFsignal m25 : 25|1@1+ (1,0) [0|1] "" Vector__XXX
 SG_ RCM_a025_eventFrontLeftSeatbelt m25 : 26|1@1+ (1,0) [0|1] "" Vector__XXX
 SG_ RCM_a025_eventFrontRightSeatbelt m25 : 27|1@1+ (1,0) [0|1] "" Vector__XXX
 SG_ RCM_a025_eventVehicleSpeed m25 : 28|12@1+ (0.08,-40) [-40|287.6] "" Vector__XXX
 SG_ RCM_a025_eventSteeringAngle m25 : 45|14@0+ (0.1,-819.2) [-819.2|819.1] "" Vector__XXX
 SG_ RCM_a025_eventDriverBrakeApply m25 : 46|2@1+ (1,0) [0|3] "" Vector__XXX
 SG_ RCM_a025_eventAccelPedalPos m25 : 56|8@1+ (0.4,0) [0|102] "" Vector__XXX
 SG_ RCM_a026_eventArmStatus m26 : 11|1@1+ (1,0) [0|1] "" Vector__XXX
 SG_ RCM_a026_eventFactoryMode m26 : 12|1@1+ (1,0) [0|1] "" Vector__XXX
 SG_ RCM_a026_eventDiagEnabled m26 : 13|1@1+ (1,0) [0|1] "" Vector__XXX
 SG_ RCM_a026_eventDriveOrientation m26 : 14|1@1+ (1,0) [0|1] "" Vector__XXX
 SG_ RCM_a026_kneeABPassSht2Gnd m26 : 16|1@1+ (1,0) [0|1] "" Vector__XXX
 SG_ RCM_a026_kneeABPassSht2Bat m26 : 17|1@1+ (1,0) [0|1] "" Vector__XXX
 SG_ RCM_a026_kneeABPassOpen m26 : 18|1@1+ (1,0) [0|1] "" Vector__XXX
 SG_ RCM_a026_kneeABPassShort m26 : 19|1@1+ (1,0) [0|1] "" Vector__XXX
 SG_ RCM_a026_kneeABPassCrossCoup m26 : 20|1@1+ (1,0) [0|1] "" Vector__XXX
 SG_ RCM_a026_kneeABPassConfig m26 : 21|1@1+ (1,0) [0|1] "" Vector__XXX
 SG_ RCM_a026_eventIDFsignal m26 : 25|1@1+ (1,0) [0|1] "" Vector__XXX
 SG_ RCM_a026_eventFrontLeftSeatbelt m26 : 26|1@1+ (1,0) [0|1] "" Vector__XXX
 SG_ RCM_a026_eventFrontRightSeatbelt m26 : 27|1@1+ (1,0) [0|1] "" Vector__XXX
 SG_ RCM_a026_eventVehicleSpeed m26 : 28|12@1+ (0.08,-40) [-40|287.6] "" Vector__XXX
 SG_ RCM_a026_eventSteeringAngle m26 : 45|14@0+ (0.1,-819.2) [-819.2|819.1] "" Vector__XXX
 SG_ RCM_a026_eventDriverBrakeApply m26 : 46|2@1+ (1,0) [0|3] "" Vector__XXX
 SG_ RCM_a026_eventAccelPedalPos m26 : 56|8@1+ (0.4,0) [0|102] "" Vector__XXX
 SG_ RCM_a027_eventArmStatus m27 : 11|1@1+ (1,0) [0|1] "" Vector__XXX
 SG_ RCM_a027_eventFactoryMode m27 : 12|1@1+ (1,0) [0|1] "" Vector__XXX
 SG_ RCM_a027_eventDiagEnabled m27 : 13|1@1+ (1,0) [0|1] "" Vector__XXX
 SG_ RCM_a027_eventDriveOrientation m27 : 14|1@1+ (1,0) [0|1] "" Vector__XXX
 SG_ RCM_a027_sideAB1stRowLSht2Gnd m27 : 16|1@1+ (1,0) [0|1] "" Vector__XXX
 SG_ RCM_a027_sideAB1stRowLSht2Bat m27 : 17|1@1+ (1,0) [0|1] "" Vector__XXX
 SG_ RCM_a027_sideAB1stRowLOpen m27 : 18|1@1+ (1,0) [0|1] "" Vector__XXX
 SG_ RCM_a027_sideAB1stRowLShort m27 : 19|1@1+ (1,0) [0|1] "" Vector__XXX
 SG_ RCM_a027_sideAB1stRowLCrossCoup m27 : 20|1@1+ (1,0) [0|1] "" Vector__XXX
 SG_ RCM_a027_sideAB1stRowLConfig m27 : 21|1@1+ (1,0) [0|1] "" Vector__XXX
 SG_ RCM_a027_eventIDFsignal m27 : 25|1@1+ (1,0) [0|1] "" Vector__XXX
 SG_ RCM_a027_eventFrontLeftSeatbelt m27 : 26|1@1+ (1,0) [0|1] "" Vector__XXX
 SG_ RCM_a027_eventFrontRightSeatbelt m27 : 27|1@1+ (1,0) [0|1] "" Vector__XXX
 SG_ RCM_a027_eventVehicleSpeed m27 : 28|12@1+ (0.08,-40) [-40|287.6] "" Vector__XXX
 SG_ RCM_a027_eventSteeringAngle m27 : 45|14@0+ (0.1,-819.2) [-819.2|819.1] "" Vector__XXX
 SG_ RCM_a027_eventDriverBrakeApply m27 : 46|2@1+ (1,0) [0|3] "" Vector__XXX
 SG_ RCM_a027_eventAccelPedalPos m27 : 56|8@1+ (0.4,0) [0|102] "" Vector__XXX
 SG_ RCM_a028_eventArmStatus m28 : 11|1@1+ (1,0) [0|1] "" Vector__XXX
 SG_ RCM_a028_eventFactoryMode m28 : 12|1@1+ (1,0) [0|1] "" Vector__XXX
 SG_ RCM_a028_eventDiagEnabled m28 : 13|1@1+ (1,0) [0|1] "" Vector__XXX
 SG_ RCM_a028_eventDriveOrientation m28 : 14|1@1+ (1,0) [0|1] "" Vector__XXX
 SG_ RCM_a028_sideAB1stRowRSht2Gnd m28 : 16|1@1+ (1,0) [0|1] "" Vector__XXX
 SG_ RCM_a028_sideAB1stRowRSht2Bat m28 : 17|1@1+ (1,0) [0|1] "" Vector__XXX
 SG_ RCM_a028_sideAB1stRowROpen m28 : 18|1@1+ (1,0) [0|1] "" Vector__XXX
 SG_ RCM_a028_sideAB1stRowRShort m28 : 19|1@1+ (1,0) [0|1] "" Vector__XXX
 SG_ RCM_a028_sideAB1stRowRCrossCoup m28 : 20|1@1+ (1,0) [0|1] "" Vector__XXX
 SG_ RCM_a028_sideAB1stRowRConfig m28 : 21|1@1+ (1,0) [0|1] "" Vector__XXX
 SG_ RCM_a028_eventIDFsignal m28 : 25|1@1+ (1,0) [0|1] "" Vector__XXX
 SG_ RCM_a028_eventFrontLeftSeatbelt m28 : 26|1@1+ (1,0) [0|1] "" Vector__XXX
 SG_ RCM_a028_eventFrontRightSeatbelt m28 : 27|1@1+ (1,0) [0|1] "" Vector__XXX
 SG_ RCM_a028_eventVehicleSpeed m28 : 28|12@1+ (0.08,-40) [-40|287.6] "" Vector__XXX
 SG_ RCM_a028_eventSteeringAngle m28 : 45|14@0+ (0.1,-819.2) [-819.2|819.1] "" Vector__XXX
 SG_ RCM_a028_eventDriverBrakeApply m28 : 46|2@1+ (1,0) [0|3] "" Vector__XXX
 SG_ RCM_a028_eventAccelPedalPos m28 : 56|8@1+ (0.4,0) [0|102] "" Vector__XXX
 SG_ RCM_a029_eventArmStatus m29 : 11|1@1+ (1,0) [0|1] "" Vector__XXX
 SG_ RCM_a029_eventFactoryMode m29 : 12|1@1+ (1,0) [0|1] "" Vector__XXX
 SG_ RCM_a029_eventDiagEnabled m29 : 13|1@1+ (1,0) [0|1] "" Vector__XXX
 SG_ RCM_a029_eventDriveOrientation m29 : 14|1@1+ (1,0) [0|1] "" Vector__XXX
 SG_ RCM_a029_driverABAVSht2Gnd m29 : 16|1@1+ (1,0) [0|1] "" Vector__XXX
 SG_ RCM_a029_driverABAVSht2Bat m29 : 17|1@1+ (1,0) [0|1] "" Vector__XXX
 SG_ RCM_a029_driverABAVOpen m29 : 18|1@1+ (1,0) [0|1] "" Vector__XXX
 SG_ RCM_a029_driverABAVShort m29 : 19|1@1+ (1,0) [0|1] "" Vector__XXX
 SG_ RCM_a029_driverABAVCrossCoup m29 : 20|1@1+ (1,0) [0|1] "" Vector__XXX
 SG_ RCM_a029_driverABAVConfig m29 : 21|1@1+ (1,0) [0|1] "" Vector__XXX
 SG_ RCM_a029_eventIDFsignal m29 : 25|1@1+ (1,0) [0|1] "" Vector__XXX
 SG_ RCM_a029_eventFrontLeftSeatbelt m29 : 26|1@1+ (1,0) [0|1] "" Vector__XXX
 SG_ RCM_a029_eventFrontRightSeatbelt m29 : 27|1@1+ (1,0) [0|1] "" Vector__XXX
 SG_ RCM_a029_eventVehicleSpeed m29 : 28|12@1+ (0.08,-40) [-40|287.6] "" Vector__XXX
 SG_ RCM_a029_eventSteeringAngle m29 : 45|14@0+ (0.1,-819.2) [-819.2|819.1] "" Vector__XXX
 SG_ RCM_a029_eventDriverBrakeApply m29 : 46|2@1+ (1,0) [0|3] "" Vector__XXX
 SG_ RCM_a029_eventAccelPedalPos m29 : 56|8@1+ (0.4,0) [0|102] "" Vector__XXX
 SG_ RCM_a030_eventArmStatus m30 : 11|1@1+ (1,0) [0|1] "" Vector__XXX
 SG_ RCM_a030_eventFactoryMode m30 : 12|1@1+ (1,0) [0|1] "" Vector__XXX
 SG_ RCM_a030_eventDiagEnabled m30 : 13|1@1+ (1,0) [0|1] "" Vector__XXX
 SG_ RCM_a030_eventDriveOrientation m30 : 14|1@1+ (1,0) [0|1] "" Vector__XXX
 SG_ RCM_a030_farsideABSht2Gnd m30 : 16|1@1+ (1,0) [0|1] "" Vector__XXX
 SG_ RCM_a030_farsideABSht2Bat m30 : 17|1@1+ (1,0) [0|1] "" Vector__XXX
 SG_ RCM_a030_farsideABOpen m30 : 18|1@1+ (1,0) [0|1] "" Vector__XXX
 SG_ RCM_a030_farsideABShort m30 : 19|1@1+ (1,0) [0|1] "" Vector__XXX
 SG_ RCM_a030_farsideABCrossCoup m30 : 20|1@1+ (1,0) [0|1] "" Vector__XXX
 SG_ RCM_a030_farsideABConfig m30 : 21|1@1+ (1,0) [0|1] "" Vector__XXX
 SG_ RCM_a030_eventIDFsignal m30 : 25|1@1+ (1,0) [0|1] "" Vector__XXX
 SG_ RCM_a030_eventFrontLeftSeatbelt m30 : 26|1@1+ (1,0) [0|1] "" Vector__XXX
 SG_ RCM_a030_eventFrontRightSeatbelt m30 : 27|1@1+ (1,0) [0|1] "" Vector__XXX
 SG_ RCM_a030_eventVehicleSpeed m30 : 28|12@1+ (0.08,-40) [-40|287.6] "" Vector__XXX
 SG_ RCM_a030_eventSteeringAngle m30 : 45|14@0+ (0.1,-819.2) [-819.2|819.1] "" Vector__XXX
 SG_ RCM_a030_eventDriverBrakeApply m30 : 46|2@1+ (1,0) [0|3] "" Vector__XXX
 SG_ RCM_a030_eventAccelPedalPos m30 : 56|8@1+ (0.4,0) [0|102] "" Vector__XXX
 SG_ RCM_a031_eventArmStatus m31 : 11|1@1+ (1,0) [0|1] "" Vector__XXX
 SG_ RCM_a031_eventFactoryMode m31 : 12|1@1+ (1,0) [0|1] "" Vector__XXX
 SG_ RCM_a031_eventDiagEnabled m31 : 13|1@1+ (1,0) [0|1] "" Vector__XXX
 SG_ RCM_a031_eventDriveOrientation m31 : 14|1@1+ (1,0) [0|1] "" Vector__XXX
 SG_ RCM_a031_frntCentrABSht2Gnd m31 : 16|1@1+ (1,0) [0|1] "" Vector__XXX
 SG_ RCM_a031_frntCentrABSht2Bat m31 : 17|1@1+ (1,0) [0|1] "" Vector__XXX
 SG_ RCM_a031_frntCentrABOpen m31 : 18|1@1+ (1,0) [0|1] "" Vector__XXX
 SG_ RCM_a031_frntCentrABShort m31 : 19|1@1+ (1,0) [0|1] "" Vector__XXX
 SG_ RCM_a031_frntCentrABCrossCoup m31 : 20|1@1+ (1,0) [0|1] "" Vector__XXX
 SG_ RCM_a031_frntCentrABConfig m31 : 21|1@1+ (1,0) [0|1] "" Vector__XXX
 SG_ RCM_a031_eventIDFsignal m31 : 25|1@1+ (1,0) [0|1] "" Vector__XXX
 SG_ RCM_a031_eventFrontLeftSeatbelt m31 : 26|1@1+ (1,0) [0|1] "" Vector__XXX
 SG_ RCM_a031_eventFrontRightSeatbelt m31 : 27|1@1+ (1,0) [0|1] "" Vector__XXX
 SG_ RCM_a031_eventVehicleSpeed m31 : 28|12@1+ (0.08,-40) [-40|287.6] "" Vector__XXX
 SG_ RCM_a031_eventSteeringAngle m31 : 45|14@0+ (0.1,-819.2) [-819.2|819.1] "" Vector__XXX
 SG_ RCM_a031_eventDriverBrakeApply m31 : 46|2@1+ (1,0) [0|3] "" Vector__XXX
 SG_ RCM_a031_eventAccelPedalPos m31 : 56|8@1+ (0.4,0) [0|102] "" Vector__XXX
 SG_ RCM_a032_eventArmStatus m32 : 11|1@1+ (1,0) [0|1] "" Vector__XXX
 SG_ RCM_a032_eventFactoryMode m32 : 12|1@1+ (1,0) [0|1] "" Vector__XXX
 SG_ RCM_a032_eventDiagEnabled m32 : 13|1@1+ (1,0) [0|1] "" Vector__XXX
 SG_ RCM_a032_eventDriveOrientation m32 : 14|1@1+ (1,0) [0|1] "" Vector__XXX
 SG_ RCM_a032_curABLeftSht2Gnd m32 : 16|1@1+ (1,0) [0|1] "" Vector__XXX
 SG_ RCM_a032_curABLeftSht2Bat m32 : 17|1@1+ (1,0) [0|1] "" Vector__XXX
 SG_ RCM_a032_curABLeftOpen m32 : 18|1@1+ (1,0) [0|1] "" Vector__XXX
 SG_ RCM_a032_curABLeftShort m32 : 19|1@1+ (1,0) [0|1] "" Vector__XXX
 SG_ RCM_a032_curABLeftCrossCoup m32 : 20|1@1+ (1,0) [0|1] "" Vector__XXX
 SG_ RCM_a032_curABLeftConfig m32 : 21|1@1+ (1,0) [0|1] "" Vector__XXX
 SG_ RCM_a032_eventIDFsignal m32 : 25|1@1+ (1,0) [0|1] "" Vector__XXX
 SG_ RCM_a032_eventFrontLeftSeatbelt m32 : 26|1@1+ (1,0) [0|1] "" Vector__XXX
 SG_ RCM_a032_eventFrontRightSeatbelt m32 : 27|1@1+ (1,0) [0|1] "" Vector__XXX
 SG_ RCM_a032_eventVehicleSpeed m32 : 28|12@1+ (0.08,-40) [-40|287.6] "" Vector__XXX
 SG_ RCM_a032_eventSteeringAngle m32 : 45|14@0+ (0.1,-819.2) [-819.2|819.1] "" Vector__XXX
 SG_ RCM_a032_eventDriverBrakeApply m32 : 46|2@1+ (1,0) [0|3] "" Vector__XXX
 SG_ RCM_a032_eventAccelPedalPos m32 : 56|8@1+ (0.4,0) [0|102] "" Vector__XXX
 SG_ RCM_a033_eventArmStatus m33 : 11|1@1+ (1,0) [0|1] "" Vector__XXX
 SG_ RCM_a033_eventFactoryMode m33 : 12|1@1+ (1,0) [0|1] "" Vector__XXX
 SG_ RCM_a033_eventDiagEnabled m33 : 13|1@1+ (1,0) [0|1] "" Vector__XXX
 SG_ RCM_a033_eventDriveOrientation m33 : 14|1@1+ (1,0) [0|1] "" Vector__XXX
 SG_ RCM_a033_curABRightSht2Gnd m33 : 16|1@1+ (1,0) [0|1] "" Vector__XXX
 SG_ RCM_a033_curABRightSht2Bat m33 : 17|1@1+ (1,0) [0|1] "" Vector__XXX
 SG_ RCM_a033_curABRightOpen m33 : 18|1@1+ (1,0) [0|1] "" Vector__XXX
 SG_ RCM_a033_curABRightShort m33 : 19|1@1+ (1,0) [0|1] "" Vector__XXX
 SG_ RCM_a033_curABRightCrossCoup m33 : 20|1@1+ (1,0) [0|1] "" Vector__XXX
 SG_ RCM_a033_curABRightConfig m33 : 21|1@1+ (1,0) [0|1] "" Vector__XXX
 SG_ RCM_a033_eventIDFsignal m33 : 25|1@1+ (1,0) [0|1] "" Vector__XXX
 SG_ RCM_a033_eventFrontLeftSeatbelt m33 : 26|1@1+ (1,0) [0|1] "" Vector__XXX
 SG_ RCM_a033_eventFrontRightSeatbelt m33 : 27|1@1+ (1,0) [0|1] "" Vector__XXX
 SG_ RCM_a033_eventVehicleSpeed m33 : 28|12@1+ (0.08,-40) [-40|287.6] "" Vector__XXX
 SG_ RCM_a033_eventSteeringAngle m33 : 45|14@0+ (0.1,-819.2) [-819.2|819.1] "" Vector__XXX
 SG_ RCM_a033_eventDriverBrakeApply m33 : 46|2@1+ (1,0) [0|3] "" Vector__XXX
 SG_ RCM_a033_eventAccelPedalPos m33 : 56|8@1+ (0.4,0) [0|102] "" Vector__XXX

CM_ BO_ 1009 "RCM2 ECU message: alert matrix";
CM_ SG_ 1009 RCM2_matrixIndex "RCM2 ECU: matrix index";
CM_ SG_ 1009 RCM2_a000_crashDetected "RCM2 ECU: a000 crash detected";
CM_ SG_ 1009 RCM2_a001_nearDeploy "RCM2 ECU: a001 near deploy";
CM_ SG_ 1009 RCM2_a002_airbagsUnArmed "RCM2 ECU: a002 airbags un armed";
CM_ SG_ 1009 RCM2_a003_warningIndicator "RCM2 ECU: a003 warning indicator";
CM_ SG_ 1009 RCM2_a004_crashAlgoWakeup "RCM2 ECU: a004 crash algo wakeup";
CM_ SG_ 1009 RCM2_a005_abuseImmunityThrshold "RCM2 ECU: a005 abuse immunity thrshold";
CM_ SG_ 1009 RCM2_a006_supplierDiagEnabled "RCM2 ECU: a006 supplier diag enabled";
CM_ SG_ 1009 RCM2_a007_pedProCrashDetected "RCM2 ECU: a007 ped pro crash detected";
CM_ SG_ 1009 RCM2_a008_factoryMode "RCM2 ECU: a008 factory mode";
CM_ SG_ 1009 RCM2_a009_edrDataAreaLocked "RCM2 ECU: a009 edr data area locked";
CM_ SG_ 1009 RCM2_a010_pedProEDRDataLocked "RCM2 ECU: a010 ped pro EDR data locked";
CM_ SG_ 1009 RCM2_a011_placeholder0 "RCM2 ECU: a011 placeholder0";
CM_ SG_ 1009 RCM2_a012_placeholder1 "RCM2 ECU: a012 placeholder1";
CM_ SG_ 1009 RCM2_a013_placeholder2 "RCM2 ECU: a013 placeholder2";
CM_ SG_ 1009 RCM2_a014_pedProNearDeploy "RCM2 ECU: a014 ped pro near deploy";
CM_ SG_ 1009 RCM2_a015_noDeployCrashCal "RCM2 ECU: a015 no deploy crash cal";
CM_ SG_ 1009 RCM2_a016_noDeployPedProCal "RCM2 ECU: a016 no deploy ped pro cal";
CM_ SG_ 1009 RCM2_a017_ecuLogAvailable "RCM2 ECU: a017 ecu log available";
CM_ SG_ 1009 RCM2_a047_batteryESRhigh "RCM2 ECU: a047 battery ES rhigh";
CM_ SG_ 1009 RCM2_a048_batteryVoltageTooHigh "RCM2 ECU: a048 battery voltage too high";
CM_ SG_ 1009 RCM2_a049_batteryVoltageTooLow "RCM2 ECU: a049 battery voltage too low";
CM_ SG_ 1009 RCM2_a050_driverABStg1Sht2Gnd "RCM2 ECU: a050 driver AB stg1 sht2 gnd";
CM_ SG_ 1009 RCM2_a051_driverABStg1Sht2Bat "RCM2 ECU: a051 driver AB stg1 sht2 bat";
CM_ SG_ 1009 RCM2_a052_driverABStg1Open "RCM2 ECU: a052 driver AB stg1 open";
CM_ SG_ 1009 RCM2_a053_driverABStg1Short "RCM2 ECU: a053 driver AB stg1 short";
CM_ SG_ 1009 RCM2_a054_driverABStg1CrssCoup "RCM2 ECU: a054 driver AB stg1 crss coup";
CM_ SG_ 1009 RCM2_a055_driverABStg1Config "RCM2 ECU: a055 driver AB stg1 config";
CM_ SG_ 1009 RCM2_a056_driverABStg2Sht2Gnd "RCM2 ECU: a056 driver AB stg2 sht2 gnd";
CM_ SG_ 1009 RCM2_a057_driverABStg2Sht2Bat "RCM2 ECU: a057 driver AB stg2 sht2 bat";
CM_ SG_ 1009 RCM2_a058_driverABStg2Open "RCM2 ECU: a058 driver AB stg2 open";
CM_ SG_ 1009 RCM2_a059_driverABStg2Short "RCM2 ECU: a059 driver AB stg2 short";
CM_ SG_ 1009 RCM2_a060_driverABStg2CrssCoup "RCM2 ECU: a060 driver AB stg2 crss coup";
CM_ SG_ 1009 RCM2_a061_driverABStg2Config "RCM2 ECU: a061 driver AB stg2 config";
CM_ SG_ 1009 RCM2_a062_passABStg1Sht2Gnd "RCM2 ECU: a062 pass AB stg1 sht2 gnd";
CM_ SG_ 1009 RCM2_a063_passABStg1Sht2Bat "RCM2 ECU: a063 pass AB stg1 sht2 bat";
CM_ SG_ 1009 RCM2_a064_passABStg1Open "RCM2 ECU: a064 pass AB stg1 open";
CM_ SG_ 1009 RCM2_a065_passABStg1Short "RCM2 ECU: a065 pass AB stg1 short";
CM_ SG_ 1009 RCM2_a066_passABStg1CrssCoup "RCM2 ECU: a066 pass AB stg1 crss coup";
CM_ SG_ 1009 RCM2_a067_passABStg1Config "RCM2 ECU: a067 pass AB stg1 config";
CM_ SG_ 1009 RCM2_a068_passABStg2Sht2Gnd "RCM2 ECU: a068 pass AB stg2 sht2 gnd";
CM_ SG_ 1009 RCM2_a069_passABStg2Sht2Bat "RCM2 ECU: a069 pass AB stg2 sht2 bat";
CM_ SG_ 1009 RCM2_a070_passABStg2Open "RCM2 ECU: a070 pass AB stg2 open";
CM_ SG_ 1009 RCM2_a071_passABStg2Short "RCM2 ECU: a071 pass AB stg2 short";
CM_ SG_ 1009 RCM2_a072_passABStg2CrssCoup "RCM2 ECU: a072 pass AB stg2 crss coup";
CM_ SG_ 1009 RCM2_a073_passABStg2Config "RCM2 ECU: a073 pass AB stg2 config";
CM_ SG_ 1009 RCM2_a074_passActiveVentSht2Gnd "RCM2 ECU: a074 pass active vent sht2 gnd";
CM_ SG_ 1009 RCM2_a075_passActiveVentSht2Bat "RCM2 ECU: a075 pass active vent sht2 bat";
CM_ SG_ 1009 RCM2_a076_passActiveVentOpen "RCM2 ECU: a076 pass active vent open";
CM_ SG_ 1009 RCM2_a077_passActiveVentShort "RCM2 ECU: a077 pass active vent short";
CM_ SG_ 1009 RCM2_a078_passActiveVentCrssCoup "RCM2 ECU: a078 pass active vent crss coup";
CM_ SG_ 1009 RCM2_a079_passActiveVentConfig "RCM2 ECU: a079 pass active vent config";
CM_ SG_ 1009 RCM2_a080_pretenShldLeftSht2Gnd "RCM2 ECU: a080 preten shld left sht2 gnd";
CM_ SG_ 1009 RCM2_a081_pretenShldLeftSht2Bat "RCM2 ECU: a081 preten shld left sht2 bat";
CM_ SG_ 1009 RCM2_a082_pretenShldLeftOpen "RCM2 ECU: a082 preten shld left open";
CM_ SG_ 1009 RCM2_a083_pretenShldLeftShort "RCM2 ECU: a083 preten shld left short";
CM_ SG_ 1009 RCM2_a084_pretenShldLeftCrossC "RCM2 ECU: a084 preten shld left cross c";
CM_ SG_ 1009 RCM2_a085_pretenShldLeftConfig "RCM2 ECU: a085 preten shld left config";
CM_ SG_ 1009 RCM2_a086_pretenShldRightSht2Gnd "RCM2 ECU: a086 preten shld right sht2 gnd";
CM_ SG_ 1009 RCM2_a087_pretenShldRightSht2Bat "RCM2 ECU: a087 preten shld right sht2 bat";
CM_ SG_ 1009 RCM2_a088_pretenShldRightOpen "RCM2 ECU: a088 preten shld right open";
CM_ SG_ 1009 RCM2_a089_pretenShldRightShort "RCM2 ECU: a089 preten shld right short";
CM_ SG_ 1009 RCM2_a090_pretenShldRightCrssCou "RCM2 ECU: a090 preten shld right crss cou";
CM_ SG_ 1009 RCM2_a091_pretenShldRightConfig "RCM2 ECU: a091 preten shld right config";
CM_ SG_ 1009 RCM2_a092_pretenLapLeftSht2Gnd "RCM2 ECU: a092 preten lap left sht2 gnd";
CM_ SG_ 1009 RCM2_a093_pretenLapLeftSht2Bat "RCM2 ECU: a093 preten lap left sht2 bat";
CM_ SG_ 1009 RCM2_a094_pretenLapLeftOpen "RCM2 ECU: a094 preten lap left open";
CM_ SG_ 1009 RCM2_a095_pretenLapLeftShort "RCM2 ECU: a095 preten lap left short";
CM_ SG_ 1009 RCM2_a096_pretenLapLeftCrssCoup "RCM2 ECU: a096 preten lap left crss coup";
CM_ SG_ 1009 RCM2_a097_pretenLapLeftConfig "RCM2 ECU: a097 preten lap left config";
CM_ SG_ 1009 RCM2_a098_pretenLapRightSht2Gnd "RCM2 ECU: a098 preten lap right sht2 gnd";
CM_ SG_ 1009 RCM2_a099_pretenLapRightSht2Bat "RCM2 ECU: a099 preten lap right sht2 bat";
CM_ SG_ 1009 RCM2_a100_pretenLapRightOpen "RCM2 ECU: a100 preten lap right open";
CM_ SG_ 1009 RCM2_a101_pretenLapRightShort "RCM2 ECU: a101 preten lap right short";
CM_ SG_ 1009 RCM2_a102_pretenLapRightCrssCoup "RCM2 ECU: a102 preten lap right crss coup";
CM_ SG_ 1009 RCM2_a103_pretenLapRightConfig "RCM2 ECU: a103 preten lap right config";
CM_ SG_ 1009 RCM2_a104_loadLimLeftSht2Gnd "RCM2 ECU: a104 load lim left sht2 gnd";
CM_ SG_ 1009 RCM2_a105_loadLimLeftSht2Bat "RCM2 ECU: a105 load lim left sht2 bat";
CM_ SG_ 1009 RCM2_a106_loadLimLeftOpen "RCM2 ECU: a106 load lim left open";
CM_ SG_ 1009 RCM2_a107_loadLimLeftShort "RCM2 ECU: a107 load lim left short";
CM_ SG_ 1009 RCM2_a108_loadLimLeftCrssCoup "RCM2 ECU: a108 load lim left crss coup";
CM_ SG_ 1009 RCM2_a109_loadLimLeftConfig "RCM2 ECU: a109 load lim left config";
CM_ SG_ 1009 RCM2_a110_loadLimRightSht2Gnd "RCM2 ECU: a110 load lim right sht2 gnd";
CM_ SG_ 1009 RCM2_a111_loadLimRightSht2Bat "RCM2 ECU: a111 load lim right sht2 bat";
CM_ SG_ 1009 RCM2_a112_loadLimRightOpen "RCM2 ECU: a112 load lim right open";
CM_ SG_ 1009 RCM2_a113_loadLimRightShort "RCM2 ECU: a113 load lim right short";
CM_ SG_ 1009 RCM2_a114_loadLimRightCrssCoup "RCM2 ECU: a114 load lim right crss coup";
CM_ SG_ 1009 RCM2_a115_loadLimRightConfig "RCM2 ECU: a115 load lim right config";
CM_ SG_ 1009 RCM2_a116_kneeABDrvrSht2Gnd "RCM2 ECU: a116 knee AB drvr sht2 gnd";
CM_ SG_ 1009 RCM2_a117_kneeABDrvrSht2Bat "RCM2 ECU: a117 knee AB drvr sht2 bat";
CM_ SG_ 1009 RCM2_a118_kneeABDrvrOpen "RCM2 ECU: a118 knee AB drvr open";
CM_ SG_ 1009 RCM2_a119_kneeABDrvrShort "RCM2 ECU: a119 knee AB drvr short";
CM_ SG_ 1009 RCM2_a120_kneeABDrvrCrssCoup "RCM2 ECU: a120 knee AB drvr crss coup";
CM_ SG_ 1009 RCM2_a121_kneeABDrvrConfig "RCM2 ECU: a121 knee AB drvr config";
CM_ SG_ 1009 RCM2_a122_kneeABPassSht2Gnd "RCM2 ECU: a122 knee AB pass sht2 gnd";
CM_ SG_ 1009 RCM2_a123_kneeABPassSht2Bat "RCM2 ECU: a123 knee AB pass sht2 bat";
CM_ SG_ 1009 RCM2_a124_kneeABPassOpen "RCM2 ECU: a124 knee AB pass open";
CM_ SG_ 1009 RCM2_a125_kneeABPassShort "RCM2 ECU: a125 knee AB pass short";
CM_ SG_ 1009 RCM2_a126_kneeABPassCrssCoup "RCM2 ECU: a126 knee AB pass crss coup";
CM_ SG_ 1009 RCM2_a127_kneeABPassConfig "RCM2 ECU: a127 knee AB pass config";
CM_ SG_ 1009 RCM2_a128_sideAB1stRowLSht2Gnd "RCM2 ECU: a128 side ab1st row l sht2 gnd";
CM_ SG_ 1009 RCM2_a129_sideAB1stRowLSht2Bat "RCM2 ECU: a129 side ab1st row l sht2 bat";
CM_ SG_ 1009 RCM2_a130_sideAB1stRowLOpen "RCM2 ECU: a130 side ab1st row l open";
CM_ SG_ 1009 RCM2_a131_sideAB1stRowLShort "RCM2 ECU: a131 side ab1st row l short";
CM_ SG_ 1009 RCM2_a132_sideAB1stRowLCrssCoup "RCM2 ECU: a132 side ab1st row l crss coup";
CM_ SG_ 1009 RCM2_a133_sideAB1stRowLConfig "RCM2 ECU: a133 side ab1st row l config";
CM_ SG_ 1009 RCM2_a134_sideAB1stRowRSht2Gnd "RCM2 ECU: a134 side ab1st row r sht2 gnd";
CM_ SG_ 1009 RCM2_a135_sideAB1stRowRSht2Bat "RCM2 ECU: a135 side ab1st row r sht2 bat";
CM_ SG_ 1009 RCM2_a136_sideAB1stRowROpen "RCM2 ECU: a136 side ab1st row r open";
CM_ SG_ 1009 RCM2_a137_sideAB1stRowRShort "RCM2 ECU: a137 side ab1st row r short";
CM_ SG_ 1009 RCM2_a138_sideAB1stRowRCrssCoup "RCM2 ECU: a138 side ab1st row r crss coup";
CM_ SG_ 1009 RCM2_a139_sideAB1stRowRConfig "RCM2 ECU: a139 side ab1st row r config";
CM_ SG_ 1009 RCM2_a140_hvdPyroSht2Gnd "RCM2 ECU: a140 hvd pyro sht2 gnd";
CM_ SG_ 1009 RCM2_a141_hvdPyroSht2Bat "RCM2 ECU: a141 hvd pyro sht2 bat";
CM_ SG_ 1009 RCM2_a142_hvdPyroOpen "RCM2 ECU: a142 hvd pyro open";
CM_ SG_ 1009 RCM2_a143_hvdPyroShort "RCM2 ECU: a143 hvd pyro short";
CM_ SG_ 1009 RCM2_a144_hvdPyroCrssCoup "RCM2 ECU: a144 hvd pyro crss coup";
CM_ SG_ 1009 RCM2_a145_hvdPyroConfig "RCM2 ECU: a145 hvd pyro config";
CM_ SG_ 1009 RCM2_a146_curABLeftSht2Gnd "RCM2 ECU: a146 cur AB left sht2 gnd";
CM_ SG_ 1009 RCM2_a147_curABLeftSht2Bat "RCM2 ECU: a147 cur AB left sht2 bat";
CM_ SG_ 1009 RCM2_a148_curABLeftOpen "RCM2 ECU: a148 cur AB left open";
CM_ SG_ 1009 RCM2_a149_curABLeftShort "RCM2 ECU: a149 cur AB left short";
CM_ SG_ 1009 RCM2_a150_curABLeftCrssCoup "RCM2 ECU: a150 cur AB left crss coup";
CM_ SG_ 1009 RCM2_a151_curABLeftConfig "RCM2 ECU: a151 cur AB left config";
CM_ SG_ 1009 RCM2_a152_curABRightSht2Gnd "RCM2 ECU: a152 cur AB right sht2 gnd";
CM_ SG_ 1009 RCM2_a153_curABRightSht2Bat "RCM2 ECU: a153 cur AB right sht2 bat";
CM_ SG_ 1009 RCM2_a154_curABRightOpen "RCM2 ECU: a154 cur AB right open";
CM_ SG_ 1009 RCM2_a155_curABRightShort "RCM2 ECU: a155 cur AB right short";
CM_ SG_ 1009 RCM2_a156_curABRightCrssCoup "RCM2 ECU: a156 cur AB right crss coup";
CM_ SG_ 1009 RCM2_a157_curABRightConfig "RCM2 ECU: a157 cur AB right config";
CM_ SG_ 1009 RCM2_a158_preten2ndRowLSht2Gnd "RCM2 ECU: a158 preten2nd row l sht2 gnd";
CM_ SG_ 1009 RCM2_a159_preten2ndRowLSht2Bat "RCM2 ECU: a159 preten2nd row l sht2 bat";
CM_ SG_ 1009 RCM2_a160_preten2ndRowLOpen "RCM2 ECU: a160 preten2nd row l open";
CM_ SG_ 1009 RCM2_a161_preten2ndRowLShort "RCM2 ECU: a161 preten2nd row l short";
CM_ SG_ 1009 RCM2_a162_preten2ndRowLCrssCoup "RCM2 ECU: a162 preten2nd row l crss coup";
CM_ SG_ 1009 RCM2_a163_preten2ndRowLCgf "RCM2 ECU: a163 preten2nd row l cgf";
CM_ SG_ 1009 RCM2_a164_preten2ndRowRSht2Gnd "RCM2 ECU: a164 preten2nd row r sht2 gnd";
CM_ SG_ 1009 RCM2_a165_preten2ndRowRSht2Bat "RCM2 ECU: a165 preten2nd row r sht2 bat";
CM_ SG_ 1009 RCM2_a166_preten2ndRowROpen "RCM2 ECU: a166 preten2nd row r open";
CM_ SG_ 1009 RCM2_a167_preten2ndRowRShort "RCM2 ECU: a167 preten2nd row r short";
CM_ SG_ 1009 RCM2_a168_preten2ndRowRCrssCoup "RCM2 ECU: a168 preten2nd row r crss coup";
CM_ SG_ 1009 RCM2_a169_preten2ndRowRCgf "RCM2 ECU: a169 preten2nd row r cgf";
CM_ SG_ 1009 RCM2_a170_curAB2ndRowLSht2Gnd "RCM2 ECU: a170 cur ab2nd row l sht2 gnd";
CM_ SG_ 1009 RCM2_a171_curAB2ndRowLSht2Bat "RCM2 ECU: a171 cur ab2nd row l sht2 bat";
CM_ SG_ 1009 RCM2_a172_curAB2ndRowLOpen "RCM2 ECU: a172 cur ab2nd row l open";
CM_ SG_ 1009 RCM2_a173_curAB2ndRowLShort "RCM2 ECU: a173 cur ab2nd row l short";
CM_ SG_ 1009 RCM2_a174_curAB2ndRowLCrssCoup "RCM2 ECU: a174 cur ab2nd row l crss coup";
CM_ SG_ 1009 RCM2_a175_curAB2ndRowLConfig "RCM2 ECU: a175 cur ab2nd row l config";
CM_ SG_ 1009 RCM2_a176_curAB2ndRowRSht2Gnd "RCM2 ECU: a176 cur ab2nd row r sht2 gnd";
CM_ SG_ 1009 RCM2_a177_curAB2ndRowRSht2Bat "RCM2 ECU: a177 cur ab2nd row r sht2 bat";
CM_ SG_ 1009 RCM2_a178_curAB2ndRowROpen "RCM2 ECU: a178 cur ab2nd row r open";
CM_ SG_ 1009 RCM2_a179_curAB2ndRowRShort "RCM2 ECU: a179 cur ab2nd row r short";
CM_ SG_ 1009 RCM2_a180_curAB2ndRowRCrssCoup "RCM2 ECU: a180 cur ab2nd row r crss coup";
CM_ SG_ 1009 RCM2_a181_curAB2ndRowRConfig "RCM2 ECU: a181 cur ab2nd row r config";
CM_ SG_ 1009 RCM2_a182_hoodActuatorRSht2Gnd "RCM2 ECU: a182 hood actuator r sht2 gnd";
CM_ SG_ 1009 RCM2_a183_hoodActuatorRSht2Bat "RCM2 ECU: a183 hood actuator r sht2 bat";
CM_ SG_ 1009 RCM2_a184_hoodActuatorROpen "RCM2 ECU: a184 hood actuator r open";
CM_ SG_ 1009 RCM2_a185_hoodActuatorRShort "RCM2 ECU: a185 hood actuator r short";
CM_ SG_ 1009 RCM2_a186_hoodActuatorRCrssCoup "RCM2 ECU: a186 hood actuator r crss coup";
CM_ SG_ 1009 RCM2_a187_hoodActuatorRConfig "RCM2 ECU: a187 hood actuator r config";
CM_ SG_ 1009 RCM2_a188_hoodActuatorLSht2Gnd "RCM2 ECU: a188 hood actuator l sht2 gnd";
CM_ SG_ 1009 RCM2_a189_hoodActuatorLSht2Bat "RCM2 ECU: a189 hood actuator l sht2 bat";
CM_ SG_ 1009 RCM2_a190_hoodActuatorLOpen "RCM2 ECU: a190 hood actuator l open";
CM_ SG_ 1009 RCM2_a191_hoodActuatorLShort "RCM2 ECU: a191 hood actuator l short";
CM_ SG_ 1009 RCM2_a192_hoodActuatorLCrssCoup "RCM2 ECU: a192 hood actuator l crss coup";
CM_ SG_ 1009 RCM2_a193_hoodActuatorLConfig "RCM2 ECU: a193 hood actuator l config";
CM_ SG_ 1009 RCM2_a194_driverABAVSht2Gnd "RCM2 ECU: a194 driver ABAV sht2 gnd";
CM_ SG_ 1009 RCM2_a195_driverABAVSht2Bat "RCM2 ECU: a195 driver ABAV sht2 bat";
CM_ SG_ 1009 RCM2_a196_driverABAVOpen "RCM2 ECU: a196 driver ABAV open";
CM_ SG_ 1009 RCM2_a197_driverABAVShort "RCM2 ECU: a197 driver ABAV short";
CM_ SG_ 1009 RCM2_a198_driverABAVCrossCoup "RCM2 ECU: a198 driver ABAV cross coup";
CM_ SG_ 1009 RCM2_a199_driverABAVConfig "RCM2 ECU: a199 driver ABAV config";
CM_ SG_ 1009 RCM2_a200_driverFSABSht2Gnd "RCM2 ECU: a200 driver FSAB sht2 gnd";
CM_ SG_ 1009 RCM2_a201_driverFSABSht2Bat "RCM2 ECU: a201 driver FSAB sht2 bat";
CM_ SG_ 1009 RCM2_a202_driverFSABOpen "RCM2 ECU: a202 driver FSAB open";
CM_ SG_ 1009 RCM2_a203_driverFSABShort "RCM2 ECU: a203 driver FSAB short";
CM_ SG_ 1009 RCM2_a204_driverFSABCrossCoup "RCM2 ECU: a204 driver FSAB cross coup";
CM_ SG_ 1009 RCM2_a205_driverFSABConfig "RCM2 ECU: a205 driver FSAB config";
CM_ SG_ 1009 RCM2_a206_sideAB2ndRowLSht2Gnd "RCM2 ECU: a206 side ab2nd row l sht2 gnd";
CM_ SG_ 1009 RCM2_a207_sideAB2ndRowLSht2Bat "RCM2 ECU: a207 side ab2nd row l sht2 bat";
CM_ SG_ 1009 RCM2_a208_sideAB2ndRowLOpen "RCM2 ECU: a208 side ab2nd row l open";
CM_ SG_ 1009 RCM2_a209_sideAB2ndRowLShort "RCM2 ECU: a209 side ab2nd row l short";
CM_ SG_ 1009 RCM2_a210_sideAB2ndRowLCrssCoup "RCM2 ECU: a210 side ab2nd row l crss coup";
CM_ SG_ 1009 RCM2_a211_sideAB2ndRowLConfig "RCM2 ECU: a211 side ab2nd row l config";
CM_ SG_ 1009 RCM2_a212_sideAB2ndRowRSht2Gnd "RCM2 ECU: a212 side ab2nd row r sht2 gnd";
CM_ SG_ 1009 RCM2_a213_sideAB2ndRowRSht2Bat "RCM2 ECU: a213 side ab2nd row r sht2 bat";
CM_ SG_ 1009 RCM2_a214_sideAB2ndRowROpen "RCM2 ECU: a214 side ab2nd row r open";
CM_ SG_ 1009 RCM2_a215_sideAB2ndRowRShort "RCM2 ECU: a215 side ab2nd row r short";
CM_ SG_ 1009 RCM2_a216_sideAB2ndRowRCrssCoup "RCM2 ECU: a216 side ab2nd row r crss coup";
CM_ SG_ 1009 RCM2_a217_sideAB2ndRowRConfig "RCM2 ECU: a217 side ab2nd row r config";
CM_ SG_ 1009 RCM2_a250_ens1Sht2Bat "RCM2 ECU: a250 ens1 sht2 bat";
CM_ SG_ 1009 RCM2_a251_ens1Sht2Gnd "RCM2 ECU: a251 ens1 sht2 gnd";
CM_ SG_ 1009 RCM2_a252_ens1Config "RCM2 ECU: a252 ens1 config";
CM_ SG_ 1009 RCM2_a253_ens2Sht2Bat "RCM2 ECU: a253 ens2 sht2 bat";
CM_ SG_ 1009 RCM2_a254_ens2Sht2Gnd "RCM2 ECU: a254 ens2 sht2 gnd";
CM_ SG_ 1009 RCM2_a255_ens2Config "RCM2 ECU: a255 ens2 config";
CM_ SG_ 1009 RCM2_a256_ens3Sht2Bat "RCM2 ECU: a256 ens3 sht2 bat";
CM_ SG_ 1009 RCM2_a257_ens3Sht2Gnd "RCM2 ECU: a257 ens3 sht2 gnd";
CM_ SG_ 1009 RCM2_a258_ens3Config "RCM2 ECU: a258 ens3 config";
CM_ SG_ 1009 RCM2_a259_ens4Sht2Bat "RCM2 ECU: a259 ens4 sht2 bat";
CM_ SG_ 1009 RCM2_a260_ens4Sht2Gnd "RCM2 ECU: a260 ens4 sht2 gnd";
CM_ SG_ 1009 RCM2_a261_ens4Config "RCM2 ECU: a261 ens4 config";
CM_ SG_ 1009 RCM2_a264_imuYawR8OffCompPosLife "RCM2 ECU: a264 imu yaw R8 off comp pos life";
CM_ SG_ 1009 RCM2_a265_imuYawR8OffCompNegLife "RCM2 ECU: a265 imu yaw R8 off comp neg life";
CM_ SG_ 1009 RCM2_a266_imuYawR8OffCompPosFLDC "RCM2 ECU: a266 imu yaw R8 off comp pos FLDC";
CM_ SG_ 1009 RCM2_a267_imuYawR8OffCompNegFLDC "RCM2 ECU: a267 imu yaw R8 off comp neg FLDC";
CM_ SG_ 1009 RCM2_a268_imuYawR8OffCompPosSLDC "RCM2 ECU: a268 imu yaw R8 off comp pos SLDC";
CM_ SG_ 1009 RCM2_a269_imuYawR8OffCompNegSLDC "RCM2 ECU: a269 imu yaw R8 off comp neg SLDC";
CM_ SG_ 1009 RCM2_a270_imuPtchR8OffCompPosLif "RCM2 ECU: a270 imu ptch R8 off comp pos life";
CM_ SG_ 1009 RCM2_a271_imuPtchR8OffCompNegLif "RCM2 ECU: a271 imu ptch R8 off comp neg life";
CM_ SG_ 1009 RCM2_a272_imuPtchR8OffCompPosFLD "RCM2 ECU: a272 imu ptch R8 off comp pos FLDC";
CM_ SG_ 1009 RCM2_a273_imuPtchR8OffCompNegFLD "RCM2 ECU: a273 imu ptch R8 off comp neg FLDC";
CM_ SG_ 1009 RCM2_a274_imuPtchR8OffCompPosSLD "RCM2 ECU: a274 imu ptch R8 off comp pos SLDC";
CM_ SG_ 1009 RCM2_a275_imuPtchR8OffCompNegSLD "RCM2 ECU: a275 imu ptch R8 off comp neg SLDC";
CM_ SG_ 1009 RCM2_a276_imuRollR8OffCompPosLif "RCM2 ECU: a276 imu roll R8 off comp pos life";
CM_ SG_ 1009 RCM2_a277_imuRollR8OffCompNegLif "RCM2 ECU: a277 imu roll R8 off comp neg life";
CM_ SG_ 1009 RCM2_a278_imuRollR8OffCompPosFLD "RCM2 ECU: a278 imu roll R8 off comp pos FLDC";
CM_ SG_ 1009 RCM2_a279_imuRollR8OffCompNegFLD "RCM2 ECU: a279 imu roll R8 off comp neg FLDC";
CM_ SG_ 1009 RCM2_a280_imuRollR8OffCompPosSLD "RCM2 ECU: a280 imu roll R8 off comp pos SLDC";
CM_ SG_ 1009 RCM2_a281_imuRollR8OffCompNegSLD "RCM2 ECU: a281 imu roll R8 off comp neg SLDC";
CM_ SG_ 1009 RCM2_a282_imuLongAOffCompPosLife "RCM2 ECU: a282 imu long a off comp pos life";
CM_ SG_ 1009 RCM2_a283_imuLongAOffCompNegLife "RCM2 ECU: a283 imu long a off comp neg life";
CM_ SG_ 1009 RCM2_a284_imuLongAOffCompPosFLDC "RCM2 ECU: a284 imu long a off comp pos FLDC";
CM_ SG_ 1009 RCM2_a285_imuLongAOffCompNegFLDC "RCM2 ECU: a285 imu long a off comp neg FLDC";
CM_ SG_ 1009 RCM2_a286_imuLongAOffCompPosSLDC "RCM2 ECU: a286 imu long a off comp pos SLDC";
CM_ SG_ 1009 RCM2_a287_imuLongAOffCompNegSLDC "RCM2 ECU: a287 imu long a off comp neg SLDC";
CM_ SG_ 1009 RCM2_a288_imuLatAcOffCompPosLife "RCM2 ECU: a288 imu lat ac off comp pos life";
CM_ SG_ 1009 RCM2_a289_imuLatAcOffCompNegLife "RCM2 ECU: a289 imu lat ac off comp neg life";
CM_ SG_ 1009 RCM2_a290_imuLatAcOffCompPosFLDC "RCM2 ECU: a290 imu lat ac off comp pos FLDC";
CM_ SG_ 1009 RCM2_a291_imuLatAcOffCompNegFLDC "RCM2 ECU: a291 imu lat ac off comp neg FLDC";
CM_ SG_ 1009 RCM2_a292_imuLatAcOffCompPosSLDC "RCM2 ECU: a292 imu lat ac off comp pos SLDC";
CM_ SG_ 1009 RCM2_a293_imuLatAcOffCompNegSLDC "RCM2 ECU: a293 imu lat ac off comp neg SLDC";
CM_ SG_ 1009 RCM2_a294_imuVertAOffCompPosLife "RCM2 ECU: a294 imu vert a off comp pos life";
CM_ SG_ 1009 RCM2_a295_imuVertAOffCompNegLife "RCM2 ECU: a295 imu vert a off comp neg life";
CM_ SG_ 1009 RCM2_a296_imuVertAOffCompPosFLDC "RCM2 ECU: a296 imu vert a off comp pos FLDC";
CM_ SG_ 1009 RCM2_a297_imuVertAOffCompNegFLDC "RCM2 ECU: a297 imu vert a off comp neg FLDC";
CM_ SG_ 1009 RCM2_a298_imuVertAOffCompPosSLDC "RCM2 ECU: a298 imu vert a off comp pos SLDC";
CM_ SG_ 1009 RCM2_a299_imuVertAOffCompNegSLDC "RCM2 ECU: a299 imu vert a off comp neg SLDC";
CM_ SG_ 1009 RCM2_a300_imuAccXHgMonChlPerm "RCM2 ECU: a300 imu acc x hg mon chl perm";
CM_ SG_ 1009 RCM2_a301_imuAccXHgMonChlTemp "RCM2 ECU: a301 imu acc x hg mon chl temp";
CM_ SG_ 1009 RCM2_a302_imuAccYHgMonChlPerm "RCM2 ECU: a302 imu acc y hg mon chl perm";
CM_ SG_ 1009 RCM2_a303_imuAccYHgMonChlTemp "RCM2 ECU: a303 imu acc y hg mon chl temp";
CM_ SG_ 1009 RCM2_a304_imuYawR8SnsrPermBG "RCM2 ECU: a304 imu yaw R8 snsr perm BG";
CM_ SG_ 1009 RCM2_a305_imuYawR8SnsrPermInit "RCM2 ECU: a305 imu yaw R8 snsr perm init";
CM_ SG_ 1009 RCM2_a306_imuYawR8SnsrPermLF "RCM2 ECU: a306 imu yaw R8 snsr perm LF";
CM_ SG_ 1009 RCM2_a307_imuYawR8ChnlMonTmpLF "RCM2 ECU: a307 imu yaw R8 chnl mon tmp LF";
CM_ SG_ 1009 RCM2_a308_imuPitchR8SnsrPermBG "RCM2 ECU: a308 imu pitch R8 snsr perm BG";
CM_ SG_ 1009 RCM2_a309_imuPitchR8SnsrPermInit "RCM2 ECU: a309 imu pitch R8 snsr perm init";
CM_ SG_ 1009 RCM2_a310_imuPitchR8SnsrPermLF "RCM2 ECU: a310 imu pitch R8 snsr perm LF";
CM_ SG_ 1009 RCM2_a311_imuPitchR8ChnlMonTmpLF "RCM2 ECU: a311 imu pitch R8 chnl mon tmp LF";
CM_ SG_ 1009 RCM2_a312_imuRollR8SnsrPermBG "RCM2 ECU: a312 imu roll R8 snsr perm BG";
CM_ SG_ 1009 RCM2_a313_imuRollR8SnsrPermInit "RCM2 ECU: a313 imu roll R8 snsr perm init";
CM_ SG_ 1009 RCM2_a314_imuRollR8SnsrPermLF "RCM2 ECU: a314 imu roll R8 snsr perm LF";
CM_ SG_ 1009 RCM2_a315_imuRollR8ChnlMonTmpLF "RCM2 ECU: a315 imu roll R8 chnl mon tmp LF";
CM_ SG_ 1009 RCM2_a316_imuAccXLgMonChlPerm "RCM2 ECU: a316 imu acc x lg mon chl perm";
CM_ SG_ 1009 RCM2_a317_imuAccXLgMonChlTemp "RCM2 ECU: a317 imu acc x lg mon chl temp";
CM_ SG_ 1009 RCM2_a318_imuAccYLgMonChlPerm "RCM2 ECU: a318 imu acc y lg mon chl perm";
CM_ SG_ 1009 RCM2_a319_imuAccYLgMonChlTemp "RCM2 ECU: a319 imu acc y lg mon chl temp";
CM_ SG_ 1009 RCM2_a320_imuAccZLgMonChlPerm "RCM2 ECU: a320 imu acc z lg mon chl perm";
CM_ SG_ 1009 RCM2_a321_imuAccZLgMonChlTemp "RCM2 ECU: a321 imu acc z lg mon chl temp";
CM_ SG_ 1009 RCM2_a322_imuCalibrationFailed "RCM2 ECU: a322 imu calibration failed";
CM_ SG_ 1009 RCM2_a323_imuCalibrationNotDone "RCM2 ECU: a323 imu calibration not done";
CM_ SG_ 1009 RCM2_a350_upFrntSnsrLSht2Gnd "RCM2 ECU: a350 up frnt snsr l sht2 gnd";
CM_ SG_ 1009 RCM2_a351_upFrntSnsrLSht2Bat "RCM2 ECU: a351 up frnt snsr l sht2 bat";
CM_ SG_ 1009 RCM2_a352_upFrntSnsrLOpen "RCM2 ECU: a352 up frnt snsr l open";
CM_ SG_ 1009 RCM2_a353_upFrntSnsrLCrssCoup "RCM2 ECU: a353 up frnt snsr l crss coup";
CM_ SG_ 1009 RCM2_a354_upFrntSnsrLCommErr "RCM2 ECU: a354 up frnt snsr l comm err";
CM_ SG_ 1009 RCM2_a355_upFrntSnsrLInitTyp "RCM2 ECU: a355 up frnt snsr l init typ";
CM_ SG_ 1009 RCM2_a356_upFrntSnsrLConfig "RCM2 ECU: a356 up frnt snsr l config";
CM_ SG_ 1009 RCM2_a357_upFrntSnsrLDefect "RCM2 ECU: a357 up frnt snsr l defect";
CM_ SG_ 1009 RCM2_a358_upFrntSnsrLSigMon "RCM2 ECU: a358 up frnt snsr l sig mon";
CM_ SG_ 1009 RCM2_a360_upFrntSnsrRSht2Gnd "RCM2 ECU: a360 up frnt snsr r sht2 gnd";
CM_ SG_ 1009 RCM2_a361_upFrntSnsrRSht2Bat "RCM2 ECU: a361 up frnt snsr r sht2 bat";
CM_ SG_ 1009 RCM2_a362_upFrntSnsrROpen "RCM2 ECU: a362 up frnt snsr r open";
CM_ SG_ 1009 RCM2_a363_upFrntSnsrRCrssCoup "RCM2 ECU: a363 up frnt snsr r crss coup";
CM_ SG_ 1009 RCM2_a364_upFrntSnsrRCommErr "RCM2 ECU: a364 up frnt snsr r comm err";
CM_ SG_ 1009 RCM2_a365_upFrntSnsrRInitTyp "RCM2 ECU: a365 up frnt snsr r init typ";
CM_ SG_ 1009 RCM2_a366_upFrntSnsrRConfig "RCM2 ECU: a366 up frnt snsr r config";
CM_ SG_ 1009 RCM2_a367_upFrntSnsrRDefect "RCM2 ECU: a367 up frnt snsr r defect";
CM_ SG_ 1009 RCM2_a368_upFrntSnsrRSigMon "RCM2 ECU: a368 up frnt snsr r sig mon";
CM_ SG_ 1009 RCM2_a370_upFrntSnsrMidLSht2Gnd "RCM2 ECU: a370 up frnt snsr mid l sht2 gnd";
CM_ SG_ 1009 RCM2_a371_upFrntSnsrMidLSht2Bat "RCM2 ECU: a371 up frnt snsr mid l sht2 bat";
CM_ SG_ 1009 RCM2_a372_upFrntSnsrMidLOpen "RCM2 ECU: a372 up frnt snsr mid l open";
CM_ SG_ 1009 RCM2_a373_upFrntSnsrMidLCrssCoup "RCM2 ECU: a373 up frnt snsr mid l crss coup";
CM_ SG_ 1009 RCM2_a374_upFrntSnsrMidLCommErr "RCM2 ECU: a374 up frnt snsr mid l comm err";
CM_ SG_ 1009 RCM2_a375_upFrntSnsrMidLInitTyp "RCM2 ECU: a375 up frnt snsr mid l init typ";
CM_ SG_ 1009 RCM2_a376_upFrntSnsrMidLConfig "RCM2 ECU: a376 up frnt snsr mid l config";
CM_ SG_ 1009 RCM2_a377_upFrntSnsrMidLDefect "RCM2 ECU: a377 up frnt snsr mid l defect";
CM_ SG_ 1009 RCM2_a378_upFrntSnsrMidLSigMon "RCM2 ECU: a378 up frnt snsr mid l sig mon";
CM_ SG_ 1009 RCM2_a380_upFrntSnsrMidRSht2Gnd "RCM2 ECU: a380 up frnt snsr mid r sht2 gnd";
CM_ SG_ 1009 RCM2_a381_upFrntSnsrMidRSht2Bat "RCM2 ECU: a381 up frnt snsr mid r sht2 bat";
CM_ SG_ 1009 RCM2_a382_upFrntSnsrMidROpen "RCM2 ECU: a382 up frnt snsr mid r open";
CM_ SG_ 1009 RCM2_a383_upFrntSnsrMidRCrssCoup "RCM2 ECU: a383 up frnt snsr mid r crss coup";
CM_ SG_ 1009 RCM2_a384_upFrntSnsrMidRCommErr "RCM2 ECU: a384 up frnt snsr mid r comm err";
CM_ SG_ 1009 RCM2_a385_upFrntSnsrMidRInitTyp "RCM2 ECU: a385 up frnt snsr mid r init typ";
CM_ SG_ 1009 RCM2_a386_upFrntSnsrMidRConfig "RCM2 ECU: a386 up frnt snsr mid r config";
CM_ SG_ 1009 RCM2_a387_upFrntSnsrMidRDefect "RCM2 ECU: a387 up frnt snsr mid r defect";
CM_ SG_ 1009 RCM2_a388_upFrntSnsrMidRSigMon "RCM2 ECU: a388 up frnt snsr mid r sig mon";
CM_ SG_ 1009 RCM2_a390_sideAccelBPilLSht2Gnd "RCM2 ECU: a390 side accel b pil l sht2 gnd";
CM_ SG_ 1009 RCM2_a391_sideAccelBPilLSht2Bat "RCM2 ECU: a391 side accel b pil l sht2 bat";
CM_ SG_ 1009 RCM2_a392_sideAccelBPilLOpen "RCM2 ECU: a392 side accel b pil l open";
CM_ SG_ 1009 RCM2_a393_sideAccelBPilLCLosCoup "RCM2 ECU: a393 side accel b pil LC los coup";
CM_ SG_ 1009 RCM2_a394_sideAccelBPilLCommErr "RCM2 ECU: a394 side accel b pil l comm err";
CM_ SG_ 1009 RCM2_a395_sideAccelBPilLInitTyp "RCM2 ECU: a395 side accel b pil l init typ";
CM_ SG_ 1009 RCM2_a396_sideAccelBPilLConfig "RCM2 ECU: a396 side accel b pil l config";
CM_ SG_ 1009 RCM2_a397_sideAccelBPilLDefect "RCM2 ECU: a397 side accel b pil l defect";
CM_ SG_ 1009 RCM2_a398_sideAccelBPilLSigMon "RCM2 ECU: a398 side accel b pil l sig mon";
CM_ SG_ 1009 RCM2_a400_sideAccelBPilRSht2Gnd "RCM2 ECU: a400 side accel b pil r sht2 gnd";
CM_ SG_ 1009 RCM2_a401_sideAccelBPilRSht2Bat "RCM2 ECU: a401 side accel b pil r sht2 bat";
CM_ SG_ 1009 RCM2_a402_sideAccelBPilROpen "RCM2 ECU: a402 side accel b pil r open";
CM_ SG_ 1009 RCM2_a403_sideAccelBPilRCrssCoup "RCM2 ECU: a403 side accel b pil r crss coup";
CM_ SG_ 1009 RCM2_a404_sideAccelBPilRCommErr "RCM2 ECU: a404 side accel b pil r comm err";
CM_ SG_ 1009 RCM2_a405_sideAccelBPilRInitTyp "RCM2 ECU: a405 side accel b pil r init typ";
CM_ SG_ 1009 RCM2_a406_sideAccelBPilRConfig "RCM2 ECU: a406 side accel b pil r config";
CM_ SG_ 1009 RCM2_a407_sideAccelBPilRDefect "RCM2 ECU: a407 side accel b pil r defect";
CM_ SG_ 1009 RCM2_a408_sideAccelBPilRSigMon "RCM2 ECU: a408 side accel b pil r sig mon";
CM_ SG_ 1009 RCM2_a410_sideAccelCPilLSht2Gnd "RCM2 ECU: a410 side accel c pil l sht2 gnd";
CM_ SG_ 1009 RCM2_a411_sideAccelCPilLSht2Bat "RCM2 ECU: a411 side accel c pil l sht2 bat";
CM_ SG_ 1009 RCM2_a412_sideAccelCPilLOpen "RCM2 ECU: a412 side accel c pil l open";
CM_ SG_ 1009 RCM2_a413_sideAccelCPilLCrssCoup "RCM2 ECU: a413 side accel c pil l crss coup";
CM_ SG_ 1009 RCM2_a414_sideAccelCPilLCommErr "RCM2 ECU: a414 side accel c pil l comm err";
CM_ SG_ 1009 RCM2_a415_sideAccelCPilLInitTyp "RCM2 ECU: a415 side accel c pil l init typ";
CM_ SG_ 1009 RCM2_a416_sideAccelCPilLConfig "RCM2 ECU: a416 side accel c pil l config";
CM_ SG_ 1009 RCM2_a417_sideAccelCPilLDefect "RCM2 ECU: a417 side accel c pil l defect";
CM_ SG_ 1009 RCM2_a418_sideAccelCPilLSigMon "RCM2 ECU: a418 side accel c pil l sig mon";
CM_ SG_ 1009 RCM2_a420_sideAccelCPilRSht2Gnd "RCM2 ECU: a420 side accel c pil r sht2 gnd";
CM_ SG_ 1009 RCM2_a421_sideAccelCPilRSht2Bat "RCM2 ECU: a421 side accel c pil r sht2 bat";
CM_ SG_ 1009 RCM2_a422_sideAccelCPilROpen "RCM2 ECU: a422 side accel c pil r open";
CM_ SG_ 1009 RCM2_a423_sideAccelCPilRCrssCoup "RCM2 ECU: a423 side accel c pil r crss coup";
CM_ SG_ 1009 RCM2_a424_sideAccelCPilRCommErr "RCM2 ECU: a424 side accel c pil r comm err";
CM_ SG_ 1009 RCM2_a425_sideAccelCPilRInitTyp "RCM2 ECU: a425 side accel c pil r init typ";
CM_ SG_ 1009 RCM2_a426_sideAccelCPilRConfig "RCM2 ECU: a426 side accel c pil r config";
CM_ SG_ 1009 RCM2_a427_sideAccelCPilRDefect "RCM2 ECU: a427 side accel c pil r defect";
CM_ SG_ 1009 RCM2_a428_sideAccelCPilRSigMon "RCM2 ECU: a428 side accel c pil r sig mon";
CM_ SG_ 1009 RCM2_a430_presFrntLDoorSht2Gnd "RCM2 ECU: a430 pres frnt l door sht2 gnd";
CM_ SG_ 1009 RCM2_a431_presFrntLDoorSht2Bat "RCM2 ECU: a431 pres frnt l door sht2 bat";
CM_ SG_ 1009 RCM2_a432_presFrntLDoorOpen "RCM2 ECU: a432 pres frnt l door open";
CM_ SG_ 1009 RCM2_a433_presFrntLDoorCrssCoup "RCM2 ECU: a433 pres frnt l door crss coup";
CM_ SG_ 1009 RCM2_a434_presFrntLDoorCommErr "RCM2 ECU: a434 pres frnt l door comm err";
CM_ SG_ 1009 RCM2_a435_presFrntLDoorInitTyp "RCM2 ECU: a435 pres frnt l door init typ";
CM_ SG_ 1009 RCM2_a436_presFrntLDoorConfig "RCM2 ECU: a436 pres frnt l door config";
CM_ SG_ 1009 RCM2_a437_presFrntLDoorDefect "RCM2 ECU: a437 pres frnt l door defect";
CM_ SG_ 1009 RCM2_a438_presFrntLDoorSigMon "RCM2 ECU: a438 pres frnt l door sig mon";
CM_ SG_ 1009 RCM2_a439_presDoorAbsolute1 "RCM2 ECU: a439 pres door absolute1";
CM_ SG_ 1009 RCM2_a440_presFrntRDoorSht2Gnd "RCM2 ECU: a440 pres frnt r door sht2 gnd";
CM_ SG_ 1009 RCM2_a441_presFrntRDoorSht2Bat "RCM2 ECU: a441 pres frnt r door sht2 bat";
CM_ SG_ 1009 RCM2_a442_presFrntRDoorOpen "RCM2 ECU: a442 pres frnt r door open";
CM_ SG_ 1009 RCM2_a443_presFrntRDoorCrssCoup "RCM2 ECU: a443 pres frnt r door crss coup";
CM_ SG_ 1009 RCM2_a444_presFrntRDoorCommErr "RCM2 ECU: a444 pres frnt r door comm err";
CM_ SG_ 1009 RCM2_a445_presFrntRDoorInitTyp "RCM2 ECU: a445 pres frnt r door init typ";
CM_ SG_ 1009 RCM2_a446_presFrntRDoorConfig "RCM2 ECU: a446 pres frnt r door config";
CM_ SG_ 1009 RCM2_a447_presFrntRDoorDefect "RCM2 ECU: a447 pres frnt r door defect";
CM_ SG_ 1009 RCM2_a448_presFrntRDoorSigMon "RCM2 ECU: a448 pres frnt r door sig mon";
CM_ SG_ 1009 RCM2_a449_presDoorAbsolute2 "RCM2 ECU: a449 pres door absolute2";
CM_ SG_ 1009 RCM2_a450_presPedProLSht2Gnd "RCM2 ECU: a450 pres ped pro l sht2 gnd";
CM_ SG_ 1009 RCM2_a451_presPedProLSht2Bat "RCM2 ECU: a451 pres ped pro l sht2 bat";
CM_ SG_ 1009 RCM2_a452_presPedProLOpen "RCM2 ECU: a452 pres ped pro l open";
CM_ SG_ 1009 RCM2_a453_presPedProLCrssCoup "RCM2 ECU: a453 pres ped pro l crss coup";
CM_ SG_ 1009 RCM2_a454_presPedProLCommErr "RCM2 ECU: a454 pres ped pro l comm err";
CM_ SG_ 1009 RCM2_a455_presPedProLInitTyp "RCM2 ECU: a455 pres ped pro l init typ";
CM_ SG_ 1009 RCM2_a456_presPedProLConfig "RCM2 ECU: a456 pres ped pro l config";
CM_ SG_ 1009 RCM2_a457_presPedProLDefect "RCM2 ECU: a457 pres ped pro l defect";
CM_ SG_ 1009 RCM2_a458_presPedProLSigMon "RCM2 ECU: a458 pres ped pro l sig mon";
CM_ SG_ 1009 RCM2_a460_presPedProRSht2Gnd "RCM2 ECU: a460 pres ped pro r sht2 gnd";
CM_ SG_ 1009 RCM2_a461_presPedProRSht2Bat "RCM2 ECU: a461 pres ped pro r sht2 bat";
CM_ SG_ 1009 RCM2_a462_presPedProROpen "RCM2 ECU: a462 pres ped pro r open";
CM_ SG_ 1009 RCM2_a463_presPedProRCrssCoup "RCM2 ECU: a463 pres ped pro r crss coup";
CM_ SG_ 1009 RCM2_a464_presPedProRCommErr "RCM2 ECU: a464 pres ped pro r comm err";
CM_ SG_ 1009 RCM2_a465_presPedProRInitTyp "RCM2 ECU: a465 pres ped pro r init typ";
CM_ SG_ 1009 RCM2_a466_presPedProRConfig "RCM2 ECU: a466 pres ped pro r config";
CM_ SG_ 1009 RCM2_a467_presPedProRDefect "RCM2 ECU: a467 pres ped pro r defect";
CM_ SG_ 1009 RCM2_a468_presPedProRSigMon "RCM2 ECU: a468 pres ped pro r sig mon";
CM_ SG_ 1009 RCM2_a469_presPedProAbsolute "RCM2 ECU: a469 pres ped pro absolute";
CM_ SG_ 1009 RCM2_a470_upFrntPedProLSht2Gnd "RCM2 ECU: a470 up frnt ped pro l sht2 gnd";
CM_ SG_ 1009 RCM2_a471_upFrntPedProLSht2Bat "RCM2 ECU: a471 up frnt ped pro l sht2 bat";
CM_ SG_ 1009 RCM2_a472_upFrntPedProLOpen "RCM2 ECU: a472 up frnt ped pro l open";
CM_ SG_ 1009 RCM2_a473_upFrntPedProLCrssCoup "RCM2 ECU: a473 up frnt ped pro l crss coup";
CM_ SG_ 1009 RCM2_a474_upFrntPedProLCommErr "RCM2 ECU: a474 up frnt ped pro l comm err";
CM_ SG_ 1009 RCM2_a475_upFrntPedProLIntTyp "RCM2 ECU: a475 up frnt ped pro l int typ";
CM_ SG_ 1009 RCM2_a476_upFrntPedProLConfig "RCM2 ECU: a476 up frnt ped pro l config";
CM_ SG_ 1009 RCM2_a477_upFrntPedProLDefect "RCM2 ECU: a477 up frnt ped pro l defect";
CM_ SG_ 1009 RCM2_a478_upFrntPedProLSigMon "RCM2 ECU: a478 up frnt ped pro l sig mon";
CM_ SG_ 1009 RCM2_a480_upFrntPedProRSht2Gnd "RCM2 ECU: a480 up frnt ped pro r sht2 gnd";
CM_ SG_ 1009 RCM2_a481_upFrntPedProRSht2Bat "RCM2 ECU: a481 up frnt ped pro r sht2 bat";
CM_ SG_ 1009 RCM2_a482_upFrntPedProROpen "RCM2 ECU: a482 up frnt ped pro r open";
CM_ SG_ 1009 RCM2_a483_upFrntPedProRCrssCoup "RCM2 ECU: a483 up frnt ped pro r crss coup";
CM_ SG_ 1009 RCM2_a484_upFrntPedProRCommErr "RCM2 ECU: a484 up frnt ped pro r comm err";
CM_ SG_ 1009 RCM2_a485_upFrntPedProRIntTyp "RCM2 ECU: a485 up frnt ped pro r int typ";
CM_ SG_ 1009 RCM2_a486_upFrntPedProRConfig "RCM2 ECU: a486 up frnt ped pro r config";
CM_ SG_ 1009 RCM2_a487_upFrntPedProRDefect "RCM2 ECU: a487 up frnt ped pro r defect";
CM_ SG_ 1009 RCM2_a488_upFrntPedProRSigMon "RCM2 ECU: a488 up frnt ped pro r sig mon";
CM_ SG_ 1009 RCM2_a490_presRearLDoorSht2Gnd "RCM2 ECU: a490 pres rear l door sht2 gnd";
CM_ SG_ 1009 RCM2_a491_presRearLDoorSht2Bat "RCM2 ECU: a491 pres rear l door sht2 bat";
CM_ SG_ 1009 RCM2_a492_presRearLDoorOpen "RCM2 ECU: a492 pres rear l door open";
CM_ SG_ 1009 RCM2_a493_presRearLDoorCrssCoup "RCM2 ECU: a493 pres rear l door crss coup";
CM_ SG_ 1009 RCM2_a494_presRearLDoorCommErr "RCM2 ECU: a494 pres rear l door comm err";
CM_ SG_ 1009 RCM2_a495_presRearLDoorInitTyp "RCM2 ECU: a495 pres rear l door init typ";
CM_ SG_ 1009 RCM2_a496_presRearLDoorConfig "RCM2 ECU: a496 pres rear l door config";
CM_ SG_ 1009 RCM2_a497_presRearLDoorDefect "RCM2 ECU: a497 pres rear l door defect";
CM_ SG_ 1009 RCM2_a498_presRearLDoorSigMon "RCM2 ECU: a498 pres rear l door sig mon";
CM_ SG_ 1009 RCM2_a500_presRearRDoorSht2Gnd "RCM2 ECU: a500 pres rear r door sht2 gnd";
CM_ SG_ 1009 RCM2_a501_presRearRDoorSht2Bat "RCM2 ECU: a501 pres rear r door sht2 bat";
CM_ SG_ 1009 RCM2_a502_presRearRDoorOpen "RCM2 ECU: a502 pres rear r door open";
CM_ SG_ 1009 RCM2_a503_presRearRDoorCrssCoup "RCM2 ECU: a503 pres rear r door crss coup";
CM_ SG_ 1009 RCM2_a504_presRearRDoorCommErr "RCM2 ECU: a504 pres rear r door comm err";
CM_ SG_ 1009 RCM2_a505_presRearRDoorInitTyp "RCM2 ECU: a505 pres rear r door init typ";
CM_ SG_ 1009 RCM2_a506_presRearRDoorConfig "RCM2 ECU: a506 pres rear r door config";
CM_ SG_ 1009 RCM2_a507_presRearRDoorDefect "RCM2 ECU: a507 pres rear r door defect";
CM_ SG_ 1009 RCM2_a508_presRearRDoorSigMon "RCM2 ECU: a508 pres rear r door sig mon";
CM_ SG_ 1009 RCM2_a509_sideAccelDPilLSht2Gnd "RCM2 ECU: a509 side accel d pil l sht2 gnd";
CM_ SG_ 1009 RCM2_a510_sideAccelDPilLSht2Bat "RCM2 ECU: a510 side accel d pil l sht2 bat";
CM_ SG_ 1009 RCM2_a511_sideAccelDPilLOpen "RCM2 ECU: a511 side accel d pil l open";
CM_ SG_ 1009 RCM2_a512_sideAccelDPilLCrssCoup "RCM2 ECU: a512 side accel d pil l crss coup";
CM_ SG_ 1009 RCM2_a513_sideAccelDPilLCommErr "RCM2 ECU: a513 side accel d pil l comm err";
CM_ SG_ 1009 RCM2_a514_sideAccelDPilLInitTyp "RCM2 ECU: a514 side accel d pil l init typ";
CM_ SG_ 1009 RCM2_a515_sideAccelDPilLConfig "RCM2 ECU: a515 side accel d pil l config";
CM_ SG_ 1009 RCM2_a516_sideAccelDPilLDefect "RCM2 ECU: a516 side accel d pil l defect";
CM_ SG_ 1009 RCM2_a517_sideAccelDPilLSigMon "RCM2 ECU: a517 side accel d pil l sig mon";
CM_ SG_ 1009 RCM2_a518_sideAccelDPilRSht2Gnd "RCM2 ECU: a518 side accel d pil r sht2 gnd";
CM_ SG_ 1009 RCM2_a519_sideAccelDPilRSht2Bat "RCM2 ECU: a519 side accel d pil r sht2 bat";
CM_ SG_ 1009 RCM2_a520_sideAccelDPilROpen "RCM2 ECU: a520 side accel d pil r open";
CM_ SG_ 1009 RCM2_a521_sideAccelDPilRCrssCoup "RCM2 ECU: a521 side accel d pil r crss coup";
CM_ SG_ 1009 RCM2_a522_sideAccelDPilRCommErr "RCM2 ECU: a522 side accel d pil r comm err";
CM_ SG_ 1009 RCM2_a523_sideAccelDPilRInitTyp "RCM2 ECU: a523 side accel d pil r init typ";
CM_ SG_ 1009 RCM2_a524_sideAccelDPilRConfig "RCM2 ECU: a524 side accel d pil r config";
CM_ SG_ 1009 RCM2_a525_sideAccelDPilRDefect "RCM2 ECU: a525 side accel d pil r defect";
CM_ SG_ 1009 RCM2_a526_sideAccelDPilRSigMon "RCM2 ECU: a526 side accel d pil r sig mon";
CM_ SG_ 1009 RCM2_a527_upFrntSnsrCSht2Gnd "RCM2 ECU: a527 up frnt snsr c sht2 gnd";
CM_ SG_ 1009 RCM2_a528_upFrntSnsrCSht2Bat "RCM2 ECU: a528 up frnt snsr c sht2 bat";
CM_ SG_ 1009 RCM2_a529_upFrntSnsrCOpen "RCM2 ECU: a529 up frnt snsr c open";
CM_ SG_ 1009 RCM2_a530_upFrntSnsrCCrssCoup "RCM2 ECU: a530 up frnt snsr c crss coup";
CM_ SG_ 1009 RCM2_a531_upFrntSnsrCCommErr "RCM2 ECU: a531 up frnt snsr c comm err";
CM_ SG_ 1009 RCM2_a532_upFrntSnsrCInitTyp "RCM2 ECU: a532 up frnt snsr c init typ";
CM_ SG_ 1009 RCM2_a533_upFrntSnsrCConfig "RCM2 ECU: a533 up frnt snsr c config";
CM_ SG_ 1009 RCM2_a534_upFrntSnsrCDefect "RCM2 ECU: a534 up frnt snsr c defect";
CM_ SG_ 1009 RCM2_a535_upFrntSnsrCSigMon "RCM2 ECU: a535 up frnt snsr c sig mon";
CM_ SG_ 1009 RCM2_a550_bucklHallLeftSht2Gnd "RCM2 ECU: a550 buckl hall left sht2 gnd";
CM_ SG_ 1009 RCM2_a551_bucklHallLeftSht2Bat "RCM2 ECU: a551 buckl hall left sht2 bat";
CM_ SG_ 1009 RCM2_a552_bucklHallLeftOpen "RCM2 ECU: a552 buckl hall left open";
CM_ SG_ 1009 RCM2_a553_bucklHallLeftUndef "RCM2 ECU: a553 buckl hall left undef";
CM_ SG_ 1009 RCM2_a554_bucklHallLeftCrssCoup "RCM2 ECU: a554 buckl hall left crss coup";
CM_ SG_ 1009 RCM2_a555_bucklHallLeftConfig "RCM2 ECU: a555 buckl hall left config";
CM_ SG_ 1009 RCM2_a556_bucklHallRightSht2Gnd "RCM2 ECU: a556 buckl hall right sht2 gnd";
CM_ SG_ 1009 RCM2_a557_bucklHallRightSht2Bat "RCM2 ECU: a557 buckl hall right sht2 bat";
CM_ SG_ 1009 RCM2_a558_bucklHallRightOpen "RCM2 ECU: a558 buckl hall right open";
CM_ SG_ 1009 RCM2_a559_bucklHallRightUndef "RCM2 ECU: a559 buckl hall right undef";
CM_ SG_ 1009 RCM2_a560_bucklHallRightCrssCoup "RCM2 ECU: a560 buckl hall right crss coup";
CM_ SG_ 1009 RCM2_a561_bucklHallRightConfig "RCM2 ECU: a561 buckl hall right config";
CM_ SG_ 1009 RCM2_a562_seaTrkPosLeftSht2Gnd "RCM2 ECU: a562 sea trk pos left sht2 gnd";
CM_ SG_ 1009 RCM2_a563_seaTrkPosLeftShtBat "RCM2 ECU: a563 sea trk pos left sht bat";
CM_ SG_ 1009 RCM2_a564_seaTrkPosLeftOpen "RCM2 ECU: a564 sea trk pos left open";
CM_ SG_ 1009 RCM2_a565_seaTrkPosLeftUndefined "RCM2 ECU: a565 sea trk pos left undefined";
CM_ SG_ 1009 RCM2_a566_seaTrkPosLeftCrssCoup "RCM2 ECU: a566 sea trk pos left crss coup";
CM_ SG_ 1009 RCM2_a567_seaTrkPosLeftConfig "RCM2 ECU: a567 sea trk pos left config";
CM_ SG_ 1009 RCM2_a568_occPROSSht2Gnd "RCM2 ECU: a568 occ PROS sht2 gnd";
CM_ SG_ 1009 RCM2_a569_occPROSSht2Bat "RCM2 ECU: a569 occ PROS sht2 bat";
CM_ SG_ 1009 RCM2_a570_occPROSOpen "RCM2 ECU: a570 occ PROS open";
CM_ SG_ 1009 RCM2_a571_occPROSUndef "RCM2 ECU: a571 occ PROS undef";
CM_ SG_ 1009 RCM2_a572_occPROSCrssCoup "RCM2 ECU: a572 occ PROS crss coup";
CM_ SG_ 1009 RCM2_a573_occPROSConfig "RCM2 ECU: a573 occ PROS config";
CM_ SG_ 1009 RCM2_a587_sbrRearNetworkSht2Gnd "RCM2 ECU: a587 sbr rear network sht2 gnd";
CM_ SG_ 1009 RCM2_a588_sbrRearNetworkSht2Bat "RCM2 ECU: a588 sbr rear network sht2 bat";
CM_ SG_ 1009 RCM2_a589_sbrRearNetworkOpen "RCM2 ECU: a589 sbr rear network open";
CM_ SG_ 1009 RCM2_a590_sbrRearNetworkUndefine "RCM2 ECU: a590 sbr rear network undefined";
CM_ SG_ 1009 RCM2_a591_sbrRearNetworkCrssCoup "RCM2 ECU: a591 sbr rear network crss coup";
CM_ SG_ 1009 RCM2_a592_sbrRearNetworkConfig "RCM2 ECU: a592 sbr rear network config";
CM_ SG_ 1009 RCM2_a593_driveOrientationSht2Gn "RCM2 ECU: a593 drive orientation sht2 gnd";
CM_ SG_ 1009 RCM2_a594_driveOrientationSht2Ba "RCM2 ECU: a594 drive orientation sht2 bat";
CM_ SG_ 1009 RCM2_a595_driveOrientationOpen "RCM2 ECU: a595 drive orientation open";
CM_ SG_ 1009 RCM2_a596_driveOrientationUndefi "RCM2 ECU: a596 drive orientation undefined";
CM_ SG_ 1009 RCM2_a597_driveOrientationCrssCo "RCM2 ECU: a597 drive orientation crss coup";
CM_ SG_ 1009 RCM2_a598_driveOrientationConfig "RCM2 ECU: a598 drive orientation config";
CM_ SG_ 1009 RCM2_a600_comCANinternalTimeout "RCM2 ECU: a600 com CA ninternal timeout";
CM_ SG_ 1009 RCM2_a601_comChassisCANSilent "RCM2 ECU: a601 com chassis CAN silent";
CM_ SG_ 1009 RCM2_a602_comChassisCANBusOff "RCM2 ECU: a602 com chassis CAN bus off";
CM_ SG_ 1009 RCM2_a603_comPARTYCANSilent "RCM2 ECU: a603 com PARTYCAN silent";
CM_ SG_ 1009 RCM2_a604_comPARTYCANBusOff "RCM2 ECU: a604 com PARTYCAN bus off";
CM_ SG_ 1009 RCM2_a605_comStwAngStatMIA "RCM2 ECU: a605 com stw ang stat MIA";
CM_ SG_ 1009 RCM2_a606_comStwAngStatChkSm "RCM2 ECU: a606 com stw ang stat chk sm";
CM_ SG_ 1009 RCM2_a607_comStwAngStatCntr "RCM2 ECU: a607 com stw ang stat cntr";
CM_ SG_ 1009 RCM2_a608_comDItorque1MIA "RCM2 ECU: a608 com d itorque1 MIA";
CM_ SG_ 1009 RCM2_a609_comDItorque1ChkSm "RCM2 ECU: a609 com d itorque1 chk sm";
CM_ SG_ 1009 RCM2_a610_comDItorque1Cntr "RCM2 ECU: a610 com d itorque1 cntr";
CM_ SG_ 1009 RCM2_a611_comDItorque2MIA "RCM2 ECU: a611 com d itorque2 MIA";
CM_ SG_ 1009 RCM2_a612_comDItorque2ChkSm "RCM2 ECU: a612 com d itorque2 chk sm";
CM_ SG_ 1009 RCM2_a613_comDItorque2Cntr "RCM2 ECU: a613 com d itorque2 cntr";
CM_ SG_ 1009 RCM2_a614_comESP135MIA "RCM2 ECU: a614 com ESP135 MIA";
CM_ SG_ 1009 RCM2_a615_comESP135ChkSm "RCM2 ECU: a615 com ESP135 chk sm";
CM_ SG_ 1009 RCM2_a616_comESP135Cntr "RCM2 ECU: a616 com ESP135 cntr";
CM_ SG_ 1009 RCM2_a617_comESP145MIA "RCM2 ECU: a617 com ESP145 MIA";
CM_ SG_ 1009 RCM2_a618_comESP145ChkSm "RCM2 ECU: a618 com ESP145 chk sm";
CM_ SG_ 1009 RCM2_a619_comESP145Cntr "RCM2 ECU: a619 com ESP145 cntr";
CM_ SG_ 1009 RCM2_a620_comInvalidVehicleSpeed "RCM2 ECU: a620 com invalid vehicle speed";
CM_ SG_ 1009 RCM2_a621_comESPBMIA "RCM2 ECU: a621 com ESPBMIA";
CM_ SG_ 1009 RCM2_a622_comESPBChkSm "RCM2 ECU: a622 com ESPB chk sm";
CM_ SG_ 1009 RCM2_a623_comESPBCntr "RCM2 ECU: a623 com ESPB cntr";
CM_ SG_ 1009 RCM2_a624_comESPCMIA "RCM2 ECU: a624 com ESPCMIA";
CM_ SG_ 1009 RCM2_a625_comESPCChkSm "RCM2 ECU: a625 com ESPC chk sm";
CM_ SG_ 1009 RCM2_a626_comESPCCntr "RCM2 ECU: a626 com ESPC cntr";
CM_ SG_ 1009 RCM2_a627_comEPBStatusMIA "RCM2 ECU: a627 com EPB status MIA";
CM_ SG_ 1009 RCM2_a628_comEPBStatusChkSm "RCM2 ECU: a628 com EPB status chk sm";
CM_ SG_ 1009 RCM2_a629_comEPBStatusCntr "RCM2 ECU: a629 com EPB status cntr";
CM_ SG_ 1009 RCM2_a630_comGTWACSMIA "RCM2 ECU: a630 com GTWACSMIA";
CM_ SG_ 1009 RCM2_a631_comGTWACSChkSm "RCM2 ECU: a631 com GTWACS chk sm";
CM_ SG_ 1009 RCM2_a632_comGTWACSCntr "RCM2 ECU: a632 com GTWACS cntr";
CM_ SG_ 1009 RCM2_a633_comOCS1PMIA "RCM2 ECU: a633 com OCS1 PMIA";
CM_ SG_ 1009 RCM2_a634_comOCS1PChkSm "RCM2 ECU: a634 com OCS1 p chk sm";
CM_ SG_ 1009 RCM2_a635_comOCS1PCntr "RCM2 ECU: a635 com OCS1 p cntr";
CM_ SG_ 1009 RCM2_a636_ocsFaulted "RCM2 ECU: a636 ocs faulted";
CM_ SG_ 1009 RCM2_a637_ocsUnknown "RCM2 ECU: a637 ocs unknown";
CM_ SG_ 1009 RCM2_a638_comGTWodoMIA "RCM2 ECU: a638 com GT wodo MIA";
CM_ SG_ 1009 RCM2_a639_comGTWCarStateMIA "RCM2 ECU: a639 com GTW car state MIA";
CM_ SG_ 1009 RCM2_a640_comTPMSStatusCMIA "RCM2 ECU: a640 com TPMS status CMIA";
CM_ SG_ 1009 RCM2_a641_comGTWCarConfigMIA "RCM2 ECU: a641 com GTW car config MIA";
CM_ SG_ 1009 RCM2_a642_comVINmessageMIA "RCM2 ECU: a642 com VI nmessage MIA";
CM_ SG_ 1009 RCM2_a643_comDASSafetyFrntMIA "RCM2 ECU: a643 com DAS safety frnt MIA";
CM_ SG_ 1009 RCM2_a644_comDASSafetyFrntChkSm "RCM2 ECU: a644 com DAS safety frnt chk sm";
CM_ SG_ 1009 RCM2_a645_comDASSafetyFrntCntr "RCM2 ECU: a645 com DAS safety frnt cntr";
CM_ SG_ 1009 RCM2_a646_comDIstateMIA "RCM2 ECU: a646 com d istate MIA";
CM_ SG_ 1009 RCM2_a647_comDIstateChkSm "RCM2 ECU: a647 com d istate chk sm";
CM_ SG_ 1009 RCM2_a648_comDIstateCntr "RCM2 ECU: a648 com d istate cntr";
CM_ SG_ 1009 RCM2_a649_comDIstate2MIA "RCM2 ECU: a649 com d istate2 MIA";
CM_ SG_ 1009 RCM2_a650_comDIstate2ChkSm "RCM2 ECU: a650 com d istate2 chk sm";
CM_ SG_ 1009 RCM2_a651_comDIstate2Cntr "RCM2 ECU: a651 com d istate2 cntr";
CM_ SG_ 1009 RCM2_a652_ambientTempFaulted "RCM2 ECU: a652 ambient temp faulted";
CM_ SG_ 1009 RCM2_a653_comGTWESP1MIA "RCM2 ECU: a653 com GTWESP1 MIA";
CM_ SG_ 1009 RCM2_a654_comGTWESP1ChkSm "RCM2 ECU: a654 com GTWESP1 chk sm";
CM_ SG_ 1009 RCM2_a655_comGTWESP1Cntr "RCM2 ECU: a655 com GTWESP1 cntr";
CM_ SG_ 1009 RCM2_a656_comVCSEATPrestMIA "RCM2 ECU: a656 com VCSEAT prest MIA";
CM_ SG_ 1009 RCM2_a657_comVCSEATPrestChkSm "RCM2 ECU: a657 com VCSEAT prest chk sm";
CM_ SG_ 1009 RCM2_a658_comVCSEATPrestCntr "RCM2 ECU: a658 com VCSEAT prest cntr";
CM_ SG_ 1009 RCM2_a659_comVCSEATPbuckle "RCM2 ECU: a659 com VCSEAT pbuckle";
CM_ SG_ 1009 RCM2_a660_comVCSEATPOccpy "RCM2 ECU: a660 com VCSEATP occpy";
CM_ SG_ 1009 RCM2_a661_comVCSEATPocs "RCM2 ECU: a661 com VCSEAT pocs";
CM_ SG_ 1009 RCM2_a662_comVCSEATPstps "RCM2 ECU: a662 com VCSEAT pstps";
CM_ SG_ 1009 RCM2_a663_comVCSEATDrestMIA "RCM2 ECU: a663 com VCSEAT drest MIA";
CM_ SG_ 1009 RCM2_a664_comVCSEATDrestChkSm "RCM2 ECU: a664 com VCSEAT drest chk sm";
CM_ SG_ 1009 RCM2_a665_comVCSEATDrestCntr "RCM2 ECU: a665 com VCSEAT drest cntr";
CM_ SG_ 1009 RCM2_a666_comVCSEATDbuckle "RCM2 ECU: a666 com VCSEAT dbuckle";
CM_ SG_ 1009 RCM2_a667_comVCSEATDOccpy "RCM2 ECU: a667 com VCSEATD occpy";
CM_ SG_ 1009 RCM2_a668_comVCSEATDstps "RCM2 ECU: a668 com VCSEAT dstps";
CM_ SG_ 1009 RCM2_a669_comEPBLstatusMIA "RCM2 ECU: a669 com EPB lstatus MIA";
CM_ SG_ 1009 RCM2_a670_comEPBLstatusChkSm "RCM2 ECU: a670 com EPB lstatus chk sm";
CM_ SG_ 1009 RCM2_a671_comEPBLstatusCntr "RCM2 ECU: a671 com EPB lstatus cntr";
CM_ SG_ 1009 RCM2_a672_comEPBRstatusMIA "RCM2 ECU: a672 com EPB rstatus MIA";
CM_ SG_ 1009 RCM2_a673_comEPBRstatusChkSm "RCM2 ECU: a673 com EPB rstatus chk sm";
CM_ SG_ 1009 RCM2_a674_comEPBRstatusCntr "RCM2 ECU: a674 com EPB rstatus cntr";
CM_ SG_ 1009 RCM2_a675_comUIodoMIA "RCM2 ECU: a675 com u iodo MIA";
CM_ SG_ 1009 RCM2_a676_comEPAS3PsysMIA "RCM2 ECU: a676 com EPAS3 psys MIA";
CM_ SG_ 1009 RCM2_a677_comEPAS3PsysChkSm "RCM2 ECU: a677 com EPAS3 psys chk sm";
CM_ SG_ 1009 RCM2_a678_comEPAS3PsysCntr "RCM2 ECU: a678 com EPAS3 psys cntr";
CM_ SG_ 1009 RCM2_a679_comESPwheelSpeedsMIA "RCM2 ECU: a679 com ES pwheel speeds MIA";
CM_ SG_ 1009 RCM2_a680_comESPwheelSpeedsChkSm "RCM2 ECU: a680 com ES pwheel speeds chk sm";
CM_ SG_ 1009 RCM2_a681_comESPwheelSpeedsCntr "RCM2 ECU: a681 com ES pwheel speeds cntr";
CM_ SG_ 1009 RCM2_a682_comDIspeedMIA "RCM2 ECU: a682 com d ispeed MIA";
CM_ SG_ 1009 RCM2_a683_comDIspeedChkSm "RCM2 ECU: a683 com d ispeed chk sm";
CM_ SG_ 1009 RCM2_a684_comDIspeedCntr "RCM2 ECU: a684 com d ispeed cntr";
CM_ SG_ 1009 RCM2_a685_comDIchassControlMIA "RCM2 ECU: a685 com d ichass control MIA";
CM_ SG_ 1009 RCM2_a686_comDIchassControlChkSm "RCM2 ECU: a686 com d ichass control chk sm";
CM_ SG_ 1009 RCM2_a687_comDIchassControlCntr "RCM2 ECU: a687 com d ichass control cntr";
CM_ SG_ 1009 RCM2_a688_comVCLEFTrestMIA "RCM2 ECU: a688 com VCLEF trest MIA";
CM_ SG_ 1009 RCM2_a689_comVCLEFTrestChkSm "RCM2 ECU: a689 com VCLEF trest chk sm";
CM_ SG_ 1009 RCM2_a690_comVCLEFTrestCntr "RCM2 ECU: a690 com VCLEF trest cntr";
CM_ SG_ 1009 RCM2_a691_comVCLEFT1rLBuckle "RCM2 ECU: a691 com vcleft1r l buckle";
CM_ SG_ 1009 RCM2_a692_comVCLEFT2rLBuckle "RCM2 ECU: a692 com vcleft2r l buckle";
CM_ SG_ 1009 RCM2_a693_comVCLEFT1rLSTPS "RCM2 ECU: a693 com vcleft1r LSTPS";
CM_ SG_ 1009 RCM2_a694_comVCRIGHTrestMIA "RCM2 ECU: a694 com VCRIGH trest MIA";
CM_ SG_ 1009 RCM2_a695_comVCRIGHTrestChkSm "RCM2 ECU: a695 com VCRIGH trest chk sm";
CM_ SG_ 1009 RCM2_a696_comVCRIGHTrestCntr "RCM2 ECU: a696 com VCRIGH trest cntr";
CM_ SG_ 1009 RCM2_a697_comVCRIGHT1rRBuckle "RCM2 ECU: a697 com vcright1r r buckle";
CM_ SG_ 1009 RCM2_a698_comVCRIGHT2rRBuckle "RCM2 ECU: a698 com vcright2r r buckle";
CM_ SG_ 1009 RCM2_a699_comVCRIGHTocs "RCM2 ECU: a699 com VCRIGH tocs";
CM_ SG_ 1009 RCM2_a700_comVCRIGHT1rRSTPS "RCM2 ECU: a700 com vcright1r RSTPS";
CM_ SG_ 1009 RCM2_a701_comVCSECtpmsStatusMIA "RCM2 ECU: a701 com VCSE ctpms status MIA";
CM_ SG_ 1009 RCM2_a750_linInternalTimeout "RCM2 ECU: a750 lin internal timeout";
CM_ SG_ 1009 RCM2_a799_internalFault "RCM2 ECU: a799 internal fault";
CM_ SG_ 1009 RCM2_a800_crcFault "RCM2 ECU: a800 crc fault";
CM_ SG_ 1009 RCM2_a801_parameterLayoutID "RCM2 ECU: a801 parameter layout ID";
CM_ SG_ 1009 RCM2_a802_parameterTransferID "RCM2 ECU: a802 parameter transfer ID";
CM_ SG_ 1009 RCM2_a803_algoVerifySensorID "RCM2 ECU: a803 algo verify sensor ID";
CM_ SG_ 1009 RCM2_a804_configDataInconsistent "RCM2 ECU: a804 config data inconsistent";
CM_ SG_ 1009 RCM2_a805_swVersionWrong "RCM2 ECU: a805 sw version wrong";
CM_ SG_ 1009 RCM2_a806_configVINnotLearned "RCM2 ECU: a806 config VI nnot learned";
CM_ SG_ 1009 RCM2_a807_configVINmismatch "RCM2 ECU: a807 config VI nmismatch";
CM_ SG_ 1009 RCM2_a808_configDriveNotLearned "RCM2 ECU: a808 config drive not learned";
CM_ SG_ 1009 RCM2_a809_configDriveMismatch "RCM2 ECU: a809 config drive mismatch";
CM_ SG_ 1009 RCM2_a810_bootUpActionFailure "RCM2 ECU: a810 boot up action failure";
CM_ SG_ 1009 RCM2_a811_comAxleSpeed "RCM2 ECU: a811 com axle speed";
CM_ SG_ 1009 RCM2_a812_idfMisuseMonitoringErr "RCM2 ECU: a812 idf misuse monitoring err";
CM_ SG_ 1009 RCM2_a813_idfEnviMonitoringError "RCM2 ECU: a813 idf envi monitoring error";
CM_ SG_ 1009 RCM2_a814_idfEnviMonitoringEvent "RCM2 ECU: a814 idf envi monitoring event";
CM_ SG_ 1009 RCM2_a815_upFrntPedProMLSht2Gnd "RCM2 ECU: a815 up frnt ped pro ML sht2 gnd";
CM_ SG_ 1009 RCM2_a816_upFrntPedProMLSht2Bat "RCM2 ECU: a816 up frnt ped pro ML sht2 bat";
CM_ SG_ 1009 RCM2_a817_upFrntPedProMLOpen "RCM2 ECU: a817 up frnt ped pro ML open";
CM_ SG_ 1009 RCM2_a818_upFrntPedProMLCrssCoup "RCM2 ECU: a818 up frnt ped pro ML crss coup";
CM_ SG_ 1009 RCM2_a819_upFrntPedProMLCommErr "RCM2 ECU: a819 up frnt ped pro ML comm err";
CM_ SG_ 1009 RCM2_a820_upFrntPedProMLIntTyp "RCM2 ECU: a820 up frnt ped pro ML int typ";
CM_ SG_ 1009 RCM2_a821_upFrntPedProMLConfig "RCM2 ECU: a821 up frnt ped pro ML config";
CM_ SG_ 1009 RCM2_a822_upFrntPedProMLDefect "RCM2 ECU: a822 up frnt ped pro ML defect";
CM_ SG_ 1009 RCM2_a823_upFrntPedProMLSigMon "RCM2 ECU: a823 up frnt ped pro ML sig mon";
CM_ SG_ 1009 RCM2_a824_upFrntPedProMRSht2Gnd "RCM2 ECU: a824 up frnt ped pro MR sht2 gnd";
CM_ SG_ 1009 RCM2_a825_upFrntPedProMRSht2Bat "RCM2 ECU: a825 up frnt ped pro MR sht2 bat";
CM_ SG_ 1009 RCM2_a826_upFrntPedProMROpen "RCM2 ECU: a826 up frnt ped pro MR open";
CM_ SG_ 1009 RCM2_a827_upFrntPedProMRCrssCoup "RCM2 ECU: a827 up frnt ped pro MR crss coup";
CM_ SG_ 1009 RCM2_a828_upFrntPedProMRCommErr "RCM2 ECU: a828 up frnt ped pro MR comm err";
CM_ SG_ 1009 RCM2_a829_upFrntPedProMRIntTyp "RCM2 ECU: a829 up frnt ped pro MR int typ";
CM_ SG_ 1009 RCM2_a830_upFrntPedProMRConfig "RCM2 ECU: a830 up frnt ped pro MR config";
CM_ SG_ 1009 RCM2_a831_upFrntPedProMRDefect "RCM2 ECU: a831 up frnt ped pro MR defect";
CM_ SG_ 1009 RCM2_a832_upFrntPedProMRSigMon "RCM2 ECU: a832 up frnt ped pro MR sig mon";
CM_ SG_ 1009 RCM2_a833_pretenShldCSht2Gnd "RCM2 ECU: a833 preten shld c sht2 gnd";
CM_ SG_ 1009 RCM2_a834_pretenShldCSht2Bat "RCM2 ECU: a834 preten shld c sht2 bat";
CM_ SG_ 1009 RCM2_a835_pretenShldCOpen "RCM2 ECU: a835 preten shld c open";
CM_ SG_ 1009 RCM2_a836_pretenShldCShort "RCM2 ECU: a836 preten shld c short";
CM_ SG_ 1009 RCM2_a837_pretenShldCCrossC "RCM2 ECU: a837 preten shld c cross c";
CM_ SG_ 1009 RCM2_a838_pretenShldCConfig "RCM2 ECU: a838 preten shld c config";
CM_ SG_ 1009 RCM2_a839_preten2ndRowCSht2Gnd "RCM2 ECU: a839 preten2nd row c sht2 gnd";
CM_ SG_ 1009 RCM2_a840_preten2ndRowCSht2Bat "RCM2 ECU: a840 preten2nd row c sht2 bat";
CM_ SG_ 1009 RCM2_a841_preten2ndRowCOpen "RCM2 ECU: a841 preten2nd row c open";
CM_ SG_ 1009 RCM2_a842_preten2ndRowCShort "RCM2 ECU: a842 preten2nd row c short";
CM_ SG_ 1009 RCM2_a843_preten2ndRowCCrssCoup "RCM2 ECU: a843 preten2nd row c crss coup";
CM_ SG_ 1009 RCM2_a844_preten2ndRowCConfig "RCM2 ECU: a844 preten2nd row c config";
CM_ SG_ 1009 RCM2_a845_comUIchassisControlMIA "RCM2 ECU: a845 com u ichassis control MIA";
CM_ SG_ 1009 RCM2_a846_comSCCMstrAnglSnsMIA "RCM2 ECU: a846 com SCC mstr angl sns MIA";
CM_ SG_ 1009 RCM2_a847_comDASctrlMIA "RCM2 ECU: a847 com DA sctrl MIA";
CM_ SG_ 1009 RCM2_a848_comDIlocStatMIA "RCM2 ECU: a848 com d iloc stat MIA";
CM_ SG_ 1009 RCM2_a849_comIBSTparty1MIA "RCM2 ECU: a849 com IBS tparty1 MIA";
CM_ SG_ 1009 RCM2_a850_comVCFRONTlightingMIA "RCM2 ECU: a850 com VCFRON tlighting MIA";
CM_ SG_ 1009 RCM2_a851_internalFaultTemp "RCM2 ECU: a851 internal fault temp";
CM_ SG_ 1009 RCM2_a852_autarkyEvent "RCM2 ECU: a852 autarky event";
CM_ SG_ 1009 RCM2_a853_ConfigParametersIncons "RCM2 ECU: a853 config parameters inconsistent";
CM_ SG_ 1009 RCM2_a854_ConfigParametersNotLea "RCM2 ECU: a854 config parameters not learned";
CM_ SG_ 1009 RCM2_a857_comVCLEFT2rCBuckle "RCM2 ECU: a857 com vcleft2r c buckle";
CM_ SG_ 1009 RCM2_a858_comVCxLVPowerStateMIA "RCM2 ECU: a858 com v cx LV power state MIA";
CM_ SG_ 1009 RCM2_a859_comVCxLVPowerStateChkS "RCM2 ECU: a859 com v cx LV power state chk sm";
CM_ SG_ 1009 RCM2_a860_comVCxLVPowerStateCntr "RCM2 ECU: a860 com v cx LV power state cntr";
CM_ SG_ 1009 RCM2_a861_typeApprovalStringNotL "RCM2 ECU: a861 type approval string not learned";
CM_ SG_ 1009 RCM2_a862_comPCSalertMatrixMIA "RCM2 ECU: a862 com PC salert matrix MIA";
CM_ SG_ 1009 RCM2_a863_comVCFRONTalertMatrixM "RCM2 ECU: a863 com VCFRON talert matrix MIA";
CM_ SG_ 1009 RCM2_a864_comGTWepochTimeMIA "RCM2 ECU: a864 com GT wepoch time MIA";
CM_ SG_ 1009 RCM2_a865_comVCLVBMSstatusHighMI "RCM2 ECU: a865 com VCLVBM sstatus high MIA";
CM_ SG_ 1009 RCM2_a866_comDASstatusMIA "RCM2 ECU: a866 com DA sstatus MIA";
CM_ SG_ 1009 RCM2_a867_comPPBepbc1MIA "RCM2 ECU: a867 com PP bepbc1 MIA";
CM_ SG_ 1009 RCM2_a868_headAB3rdRowRSht2Gnd "RCM2 ECU: a868 head ab3rd row r sht2 gnd";
CM_ SG_ 1009 RCM2_a869_headAB3rdRowRSht2Bat "RCM2 ECU: a869 head ab3rd row r sht2 bat";
CM_ SG_ 1009 RCM2_a870_headAB3rdRowROpen "RCM2 ECU: a870 head ab3rd row r open";
CM_ SG_ 1009 RCM2_a871_headAB3rdRowRShort "RCM2 ECU: a871 head ab3rd row r short";
CM_ SG_ 1009 RCM2_a872_headAB3rdRowRCrossC "RCM2 ECU: a872 head ab3rd row r cross c";
CM_ SG_ 1009 RCM2_a873_headAB3rdRowRConfig "RCM2 ECU: a873 head ab3rd row r config";
CM_ SG_ 1009 RCM2_a874_headAB3rdRowLSht2Gnd "RCM2 ECU: a874 head ab3rd row l sht2 gnd";
CM_ SG_ 1009 RCM2_a875_headAB3rdRowLSht2Bat "RCM2 ECU: a875 head ab3rd row l sht2 bat";
CM_ SG_ 1009 RCM2_a876_headAB3rdRowLOpen "RCM2 ECU: a876 head ab3rd row l open";
CM_ SG_ 1009 RCM2_a877_headAB3rdRowLShort "RCM2 ECU: a877 head ab3rd row l short";
CM_ SG_ 1009 RCM2_a878_headAB3rdRowLCrossC "RCM2 ECU: a878 head ab3rd row l cross c";
CM_ SG_ 1009 RCM2_a879_headAB3rdRowLConfig "RCM2 ECU: a879 head ab3rd row l config";
CM_ SG_ 1009 RCM2_a880_comVCLEFT3rLBuckle "RCM2 ECU: a880 com vcleft3r l buckle";
CM_ SG_ 1009 RCM2_a881_comVCRIGHT3rRBuckle "RCM2 ECU: a881 com vcright3r r buckle";
CM_ SG_ 1009 RCM2_a882_comPEBSbrakeSpeedMIA "RCM2 ECU: a882 com PEB sbrake speed MIA";
CM_ SG_ 1009 RCM2_a883_comPEBSstatus2MIA "RCM2 ECU: a883 com PEB sstatus2 MIA";
CM_ SG_ 1009 RCM2_a884_comPEBSstatus3MIA "RCM2 ECU: a884 com PEB sstatus3 MIA";
CM_ SG_ 1009 RCM2_a885_comPEBSstatus2Counter "RCM2 ECU: a885 com PEB sstatus2 counter";
CM_ SG_ 1009 RCM2_a886_comPEBSstatus2CRC "RCM2 ECU: a886 com PEB sstatus2 CRC";
CM_ BO_ 1252 "RCM3 ECU message: alert log";
CM_ SG_ 1252 RCM3_alertID "RCM3 ECU: alert ID";
CM_ SG_ 1252 RCM3_alertState "RCM3 ECU: alert state";
CM_ BO_ 2020 "RCM3 ECU message: alert matrix";
CM_ SG_ 2020 RCM3_matrixIndex "RCM3 ECU: matrix index";
CM_ SG_ 2020 RCM3_a001_LVPowerLossDetected "RCM3 ECU: a001 LV power loss detected";
CM_ BO_ 1297 "Restraint control module message: alert log";
CM_ SG_ 1297 RCM_alertID "Restraint control module: alert ID";
CM_ SG_ 1297 RCM_alertState "Restraint control module: alert state";
CM_ SG_ 1297 RCM_a000_eventArmStatus "Restraint control module: a000 event arm status";
CM_ SG_ 1297 RCM_a000_eventFactoryMode "Restraint control module: a000 event factory mode";
CM_ SG_ 1297 RCM_a000_eventDiagEnabled "Restraint control module: a000 event diag enabled";
CM_ SG_ 1297 RCM_a000_eventDriveOrientation "Restraint control module: a000 event drive orientation";
CM_ SG_ 1297 RCM_a000_crashDetectedFront "Restraint control module: a000 crash detected front";
CM_ SG_ 1297 RCM_a000_crashDetectedRear "Restraint control module: a000 crash detected rear";
CM_ SG_ 1297 RCM_a000_crashDetectedLeft "Restraint control module: a000 crash detected left";
CM_ SG_ 1297 RCM_a000_crashDetectedRight "Restraint control module: a000 crash detected right";
CM_ SG_ 1297 RCM_a000_crashDetectedRoll "Restraint control module: a000 crash detected roll";
CM_ SG_ 1297 RCM_a000_crashDetectedPreten "Restraint control module: a000 crash detected preten";
CM_ SG_ 1297 RCM_a000_crashDetectedStage1 "Restraint control module: a000 crash detected stage1";
CM_ SG_ 1297 RCM_a000_crashDetectedStage2 "Restraint control module: a000 crash detected stage2";
CM_ SG_ 1297 RCM_a000_crashDetectedHVpyro "Restraint control module: a000 crash detected h vpyro";
CM_ SG_ 1297 RCM_a000_eventIDFsignal "Restraint control module: a000 event ID fsignal";
CM_ SG_ 1297 RCM_a000_eventFrontLeftSeatbelt "Restraint control module: a000 event front left seatbelt";
CM_ SG_ 1297 RCM_a000_eventFrontRightSeatbelt "Restraint control module: a000 event front right seatbelt";
CM_ SG_ 1297 RCM_a000_eventVehicleSpeed "Restraint control module: a000 event vehicle speed";
CM_ SG_ 1297 RCM_a000_eventSteeringAngle "Restraint control module: a000 event steering angle";
CM_ SG_ 1297 RCM_a000_eventDriverBrakeApply "Restraint control module: a000 event driver brake apply";
CM_ SG_ 1297 RCM_a000_eventAccelPedalPos "Restraint control module: a000 event accel pedal pos";
CM_ SG_ 1297 RCM_a001_eventArmStatus "Restraint control module: a001 event arm status";
CM_ SG_ 1297 RCM_a001_eventFactoryMode "Restraint control module: a001 event factory mode";
CM_ SG_ 1297 RCM_a001_eventDiagEnabled "Restraint control module: a001 event diag enabled";
CM_ SG_ 1297 RCM_a001_eventDriveOrientation "Restraint control module: a001 event drive orientation";
CM_ SG_ 1297 RCM_a001_nearDeployFront "Restraint control module: a001 near deploy front";
CM_ SG_ 1297 RCM_a001_nearDeployRear "Restraint control module: a001 near deploy rear";
CM_ SG_ 1297 RCM_a001_nearDeployLeft "Restraint control module: a001 near deploy left";
CM_ SG_ 1297 RCM_a001_nearDeployRight "Restraint control module: a001 near deploy right";
CM_ SG_ 1297 RCM_a001_nearDeployRoll "Restraint control module: a001 near deploy roll";
CM_ SG_ 1297 RCM_a001_nearDeployPretensioner "Restraint control module: a001 near deploy pretensioner";
CM_ SG_ 1297 RCM_a001_eventIDFsignal "Restraint control module: a001 event ID fsignal";
CM_ SG_ 1297 RCM_a001_eventFrontLeftSeatbelt "Restraint control module: a001 event front left seatbelt";
CM_ SG_ 1297 RCM_a001_eventFrontRightSeatbelt "Restraint control module: a001 event front right seatbelt";
CM_ SG_ 1297 RCM_a001_eventVehicleSpeed "Restraint control module: a001 event vehicle speed";
CM_ SG_ 1297 RCM_a001_eventSteeringAngle "Restraint control module: a001 event steering angle";
CM_ SG_ 1297 RCM_a001_eventDriverBrakeApply "Restraint control module: a001 event driver brake apply";
CM_ SG_ 1297 RCM_a001_eventAccelPedalPos "Restraint control module: a001 event accel pedal pos";
CM_ SG_ 1297 RCM_a002_eventArmStatus "Restraint control module: a002 event arm status";
CM_ SG_ 1297 RCM_a002_eventFactoryMode "Restraint control module: a002 event factory mode";
CM_ SG_ 1297 RCM_a002_eventDiagEnabled "Restraint control module: a002 event diag enabled";
CM_ SG_ 1297 RCM_a002_eventDriveOrientation "Restraint control module: a002 event drive orientation";
CM_ SG_ 1297 RCM_a002_airbagsUnArmed "Restraint control module: a002 airbags un armed";
CM_ SG_ 1297 RCM_a002_eventIDFsignal "Restraint control module: a002 event ID fsignal";
CM_ SG_ 1297 RCM_a002_eventFrontLeftSeatbelt "Restraint control module: a002 event front left seatbelt";
CM_ SG_ 1297 RCM_a002_eventFrontRightSeatbelt "Restraint control module: a002 event front right seatbelt";
CM_ SG_ 1297 RCM_a002_eventVehicleSpeed "Restraint control module: a002 event vehicle speed";
CM_ SG_ 1297 RCM_a002_eventSteeringAngle "Restraint control module: a002 event steering angle";
CM_ SG_ 1297 RCM_a002_eventDriverBrakeApply "Restraint control module: a002 event driver brake apply";
CM_ SG_ 1297 RCM_a002_eventAccelPedalPos "Restraint control module: a002 event accel pedal pos";
CM_ SG_ 1297 RCM_a003_eventArmStatus "Restraint control module: a003 event arm status";
CM_ SG_ 1297 RCM_a003_eventFactoryMode "Restraint control module: a003 event factory mode";
CM_ SG_ 1297 RCM_a003_eventDiagEnabled "Restraint control module: a003 event diag enabled";
CM_ SG_ 1297 RCM_a003_eventDriveOrientation "Restraint control module: a003 event drive orientation";
CM_ SG_ 1297 RCM_a003_warningIndicatorOn "Restraint control module: a003 warning indicator on";
CM_ SG_ 1297 RCM_a003_eventIDFsignal "Restraint control module: a003 event ID fsignal";
CM_ SG_ 1297 RCM_a003_eventFrontLeftSeatbelt "Restraint control module: a003 event front left seatbelt";
CM_ SG_ 1297 RCM_a003_eventFrontRightSeatbelt "Restraint control module: a003 event front right seatbelt";
CM_ SG_ 1297 RCM_a003_eventVehicleSpeed "Restraint control module: a003 event vehicle speed";
CM_ SG_ 1297 RCM_a003_eventSteeringAngle "Restraint control module: a003 event steering angle";
CM_ SG_ 1297 RCM_a003_eventDriverBrakeApply "Restraint control module: a003 event driver brake apply";
CM_ SG_ 1297 RCM_a003_eventAccelPedalPos "Restraint control module: a003 event accel pedal pos";
CM_ SG_ 1297 RCM_a004_eventArmStatus "Restraint control module: a004 event arm status";
CM_ SG_ 1297 RCM_a004_eventFactoryMode "Restraint control module: a004 event factory mode";
CM_ SG_ 1297 RCM_a004_eventDiagEnabled "Restraint control module: a004 event diag enabled";
CM_ SG_ 1297 RCM_a004_eventDriveOrientation "Restraint control module: a004 event drive orientation";
CM_ SG_ 1297 RCM_a004_frontAlgoDisabled "Restraint control module: a004 front algo disabled";
CM_ SG_ 1297 RCM_a004_sideAlgoDisabled "Restraint control module: a004 side algo disabled";
CM_ SG_ 1297 RCM_a004_rollAlgoDisabled "Restraint control module: a004 roll algo disabled";
CM_ SG_ 1297 RCM_a004_idleMode "Restraint control module: a004 idle mode";
CM_ SG_ 1297 RCM_a004_internalFaultDetected "Restraint control module: a004 internal fault detected";
CM_ SG_ 1297 RCM_a004_swVersionMismatch "Restraint control module: a004 sw version mismatch";
CM_ SG_ 1297 RCM_a004_paramLayoutIDInv "Restraint control module: a004 param layout ID inv";
CM_ SG_ 1297 RCM_a004_algoPASIDMismatch "Restraint control module: a004 algo PASID mismatch";
CM_ SG_ 1297 RCM_a004_eventIDFsignal "Restraint control module: a004 event ID fsignal";
CM_ SG_ 1297 RCM_a004_eventFrontLeftSeatbelt "Restraint control module: a004 event front left seatbelt";
CM_ SG_ 1297 RCM_a004_eventFrontRightSeatbelt "Restraint control module: a004 event front right seatbelt";
CM_ SG_ 1297 RCM_a004_eventVehicleSpeed "Restraint control module: a004 event vehicle speed";
CM_ SG_ 1297 RCM_a004_eventSteeringAngle "Restraint control module: a004 event steering angle";
CM_ SG_ 1297 RCM_a004_eventDriverBrakeApply "Restraint control module: a004 event driver brake apply";
CM_ SG_ 1297 RCM_a004_eventAccelPedalPos "Restraint control module: a004 event accel pedal pos";
CM_ SG_ 1297 RCM_a005_eventArmStatus "Restraint control module: a005 event arm status";
CM_ SG_ 1297 RCM_a005_eventFactoryMode "Restraint control module: a005 event factory mode";
CM_ SG_ 1297 RCM_a005_eventDiagEnabled "Restraint control module: a005 event diag enabled";
CM_ SG_ 1297 RCM_a005_eventDriveOrientation "Restraint control module: a005 event drive orientation";
CM_ SG_ 1297 RCM_a005_externalCRCError "Restraint control module: a005 external CRC error";
CM_ SG_ 1297 RCM_a005_eventIDFsignal "Restraint control module: a005 event ID fsignal";
CM_ SG_ 1297 RCM_a005_eventFrontLeftSeatbelt "Restraint control module: a005 event front left seatbelt";
CM_ SG_ 1297 RCM_a005_eventFrontRightSeatbelt "Restraint control module: a005 event front right seatbelt";
CM_ SG_ 1297 RCM_a005_eventVehicleSpeed "Restraint control module: a005 event vehicle speed";
CM_ SG_ 1297 RCM_a005_eventSteeringAngle "Restraint control module: a005 event steering angle";
CM_ SG_ 1297 RCM_a005_eventDriverBrakeApply "Restraint control module: a005 event driver brake apply";
CM_ SG_ 1297 RCM_a005_eventAccelPedalPos "Restraint control module: a005 event accel pedal pos";
CM_ SG_ 1297 RCM_a006_eventArmStatus "Restraint control module: a006 event arm status";
CM_ SG_ 1297 RCM_a006_eventFactoryMode "Restraint control module: a006 event factory mode";
CM_ SG_ 1297 RCM_a006_eventDiagEnabled "Restraint control module: a006 event diag enabled";
CM_ SG_ 1297 RCM_a006_eventDriveOrientation "Restraint control module: a006 event drive orientation";
CM_ SG_ 1297 RCM_a006_batteryVoltageTooHigh "Restraint control module: a006 battery voltage too high";
CM_ SG_ 1297 RCM_a006_batteryVoltageTooLow "Restraint control module: a006 battery voltage too low";
CM_ SG_ 1297 RCM_a006_eventIDFsignal "Restraint control module: a006 event ID fsignal";
CM_ SG_ 1297 RCM_a006_eventFrontLeftSeatbelt "Restraint control module: a006 event front left seatbelt";
CM_ SG_ 1297 RCM_a006_eventFrontRightSeatbelt "Restraint control module: a006 event front right seatbelt";
CM_ SG_ 1297 RCM_a006_eventVehicleSpeed "Restraint control module: a006 event vehicle speed";
CM_ SG_ 1297 RCM_a006_eventSteeringAngle "Restraint control module: a006 event steering angle";
CM_ SG_ 1297 RCM_a006_eventDriverBrakeApply "Restraint control module: a006 event driver brake apply";
CM_ SG_ 1297 RCM_a006_eventAccelPedalPos "Restraint control module: a006 event accel pedal pos";
CM_ SG_ 1297 RCM_a008_eventArmStatus "Restraint control module: a008 event arm status";
CM_ SG_ 1297 RCM_a008_eventFactoryMode "Restraint control module: a008 event factory mode";
CM_ SG_ 1297 RCM_a008_eventDiagEnabled "Restraint control module: a008 event diag enabled";
CM_ SG_ 1297 RCM_a008_eventDriveOrientation "Restraint control module: a008 event drive orientation";
CM_ SG_ 1297 RCM_a008_lossOfMainPwrSupMonit "Restraint control module: a008 loss of main pwr sup monit";
CM_ SG_ 1297 RCM_a008_lossOfBckupPwrSupMonit "Restraint control module: a008 loss of bckup pwr sup monit";
CM_ SG_ 1297 RCM_a008_normalShtdwnUnavail "Restraint control module: a008 normal shtdwn unavail";
CM_ SG_ 1297 RCM_a008_eventIDFsignal "Restraint control module: a008 event ID fsignal";
CM_ SG_ 1297 RCM_a008_eventFrontLeftSeatbelt "Restraint control module: a008 event front left seatbelt";
CM_ SG_ 1297 RCM_a008_eventFrontRightSeatbelt "Restraint control module: a008 event front right seatbelt";
CM_ SG_ 1297 RCM_a008_eventVehicleSpeed "Restraint control module: a008 event vehicle speed";
CM_ SG_ 1297 RCM_a008_eventSteeringAngle "Restraint control module: a008 event steering angle";
CM_ SG_ 1297 RCM_a008_eventDriverBrakeApply "Restraint control module: a008 event driver brake apply";
CM_ SG_ 1297 RCM_a008_eventAccelPedalPos "Restraint control module: a008 event accel pedal pos";
CM_ SG_ 1297 RCM_a009_eventArmStatus "Restraint control module: a009 event arm status";
CM_ SG_ 1297 RCM_a009_eventFactoryMode "Restraint control module: a009 event factory mode";
CM_ SG_ 1297 RCM_a009_eventDiagEnabled "Restraint control module: a009 event diag enabled";
CM_ SG_ 1297 RCM_a009_eventDriveOrientation "Restraint control module: a009 event drive orientation";
CM_ SG_ 1297 RCM_a009_reprogramLimitExceeded "Restraint control module: a009 reprogram limit exceeded";
CM_ SG_ 1297 RCM_a009_eventIDFsignal "Restraint control module: a009 event ID fsignal";
CM_ SG_ 1297 RCM_a009_eventFrontLeftSeatbelt "Restraint control module: a009 event front left seatbelt";
CM_ SG_ 1297 RCM_a009_eventFrontRightSeatbelt "Restraint control module: a009 event front right seatbelt";
CM_ SG_ 1297 RCM_a009_eventVehicleSpeed "Restraint control module: a009 event vehicle speed";
CM_ SG_ 1297 RCM_a009_eventSteeringAngle "Restraint control module: a009 event steering angle";
CM_ SG_ 1297 RCM_a009_eventDriverBrakeApply "Restraint control module: a009 event driver brake apply";
CM_ SG_ 1297 RCM_a009_eventAccelPedalPos "Restraint control module: a009 event accel pedal pos";
CM_ SG_ 1297 RCM_a011_eventArmStatus "Restraint control module: a011 event arm status";
CM_ SG_ 1297 RCM_a011_eventFactoryMode "Restraint control module: a011 event factory mode";
CM_ SG_ 1297 RCM_a011_eventDiagEnabled "Restraint control module: a011 event diag enabled";
CM_ SG_ 1297 RCM_a011_eventDriveOrientation "Restraint control module: a011 event drive orientation";
CM_ SG_ 1297 RCM_a011_edrDataAreaLocked "Restraint control module: a011 edr data area locked";
CM_ SG_ 1297 RCM_a011_eventIDFsignal "Restraint control module: a011 event ID fsignal";
CM_ SG_ 1297 RCM_a011_eventFrontLeftSeatbelt "Restraint control module: a011 event front left seatbelt";
CM_ SG_ 1297 RCM_a011_eventFrontRightSeatbelt "Restraint control module: a011 event front right seatbelt";
CM_ SG_ 1297 RCM_a011_eventVehicleSpeed "Restraint control module: a011 event vehicle speed";
CM_ SG_ 1297 RCM_a011_eventSteeringAngle "Restraint control module: a011 event steering angle";
CM_ SG_ 1297 RCM_a011_eventDriverBrakeApply "Restraint control module: a011 event driver brake apply";
CM_ SG_ 1297 RCM_a011_eventAccelPedalPos "Restraint control module: a011 event accel pedal pos";
CM_ SG_ 1297 RCM_a012_eventArmStatus "Restraint control module: a012 event arm status";
CM_ SG_ 1297 RCM_a012_eventFactoryMode "Restraint control module: a012 event factory mode";
CM_ SG_ 1297 RCM_a012_eventDiagEnabled "Restraint control module: a012 event diag enabled";
CM_ SG_ 1297 RCM_a012_eventDriveOrientation "Restraint control module: a012 event drive orientation";
CM_ SG_ 1297 RCM_a012_vinMismatch "Restraint control module: a012 vin mismatch";
CM_ SG_ 1297 RCM_a012_vinNotProgrammed "Restraint control module: a012 vin not programmed";
CM_ SG_ 1297 RCM_a012_eventIDFsignal "Restraint control module: a012 event ID fsignal";
CM_ SG_ 1297 RCM_a012_eventFrontLeftSeatbelt "Restraint control module: a012 event front left seatbelt";
CM_ SG_ 1297 RCM_a012_eventFrontRightSeatbelt "Restraint control module: a012 event front right seatbelt";
CM_ SG_ 1297 RCM_a012_eventVehicleSpeed "Restraint control module: a012 event vehicle speed";
CM_ SG_ 1297 RCM_a012_eventSteeringAngle "Restraint control module: a012 event steering angle";
CM_ SG_ 1297 RCM_a012_eventDriverBrakeApply "Restraint control module: a012 event driver brake apply";
CM_ SG_ 1297 RCM_a012_eventAccelPedalPos "Restraint control module: a012 event accel pedal pos";
CM_ SG_ 1297 RCM_a013_eventArmStatus "Restraint control module: a013 event arm status";
CM_ SG_ 1297 RCM_a013_eventFactoryMode "Restraint control module: a013 event factory mode";
CM_ SG_ 1297 RCM_a013_eventDiagEnabled "Restraint control module: a013 event diag enabled";
CM_ SG_ 1297 RCM_a013_eventDriveOrientation "Restraint control module: a013 event drive orientation";
CM_ SG_ 1297 RCM_a013_driveOrientiInitNotDone "Restraint control module: a013 drive orienti init not done";
CM_ SG_ 1297 RCM_a013_driveOrientPlausiCheck "Restraint control module: a013 drive orient plausi check";
CM_ SG_ 1297 RCM_a013_eventIDFsignal "Restraint control module: a013 event ID fsignal";
CM_ SG_ 1297 RCM_a013_eventFrontLeftSeatbelt "Restraint control module: a013 event front left seatbelt";
CM_ SG_ 1297 RCM_a013_eventFrontRightSeatbelt "Restraint control module: a013 event front right seatbelt";
CM_ SG_ 1297 RCM_a013_eventVehicleSpeed "Restraint control module: a013 event vehicle speed";
CM_ SG_ 1297 RCM_a013_eventSteeringAngle "Restraint control module: a013 event steering angle";
CM_ SG_ 1297 RCM_a013_eventDriverBrakeApply "Restraint control module: a013 event driver brake apply";
CM_ SG_ 1297 RCM_a013_eventAccelPedalPos "Restraint control module: a013 event accel pedal pos";
CM_ SG_ 1297 RCM_a014_eventArmStatus "Restraint control module: a014 event arm status";
CM_ SG_ 1297 RCM_a014_eventFactoryMode "Restraint control module: a014 event factory mode";
CM_ SG_ 1297 RCM_a014_eventDiagEnabled "Restraint control module: a014 event diag enabled";
CM_ SG_ 1297 RCM_a014_eventDriveOrientation "Restraint control module: a014 event drive orientation";
CM_ SG_ 1297 RCM_a014_driverABStg1Sht2Gnd "Restraint control module: a014 driver AB stg1 sht2 gnd";
CM_ SG_ 1297 RCM_a014_driverABStg1Sht2Bat "Restraint control module: a014 driver AB stg1 sht2 bat";
CM_ SG_ 1297 RCM_a014_driverABStg1Open "Restraint control module: a014 driver AB stg1 open";
CM_ SG_ 1297 RCM_a014_driverABStg1Short "Restraint control module: a014 driver AB stg1 short";
CM_ SG_ 1297 RCM_a014_driverABStg1CrossCoup "Restraint control module: a014 driver AB stg1 cross coup";
CM_ SG_ 1297 RCM_a014_driverABStg1Config "Restraint control module: a014 driver AB stg1 config";
CM_ SG_ 1297 RCM_a014_eventIDFsignal "Restraint control module: a014 event ID fsignal";
CM_ SG_ 1297 RCM_a014_eventFrontLeftSeatbelt "Restraint control module: a014 event front left seatbelt";
CM_ SG_ 1297 RCM_a014_eventFrontRightSeatbelt "Restraint control module: a014 event front right seatbelt";
CM_ SG_ 1297 RCM_a014_eventVehicleSpeed "Restraint control module: a014 event vehicle speed";
CM_ SG_ 1297 RCM_a014_eventSteeringAngle "Restraint control module: a014 event steering angle";
CM_ SG_ 1297 RCM_a014_eventDriverBrakeApply "Restraint control module: a014 event driver brake apply";
CM_ SG_ 1297 RCM_a014_eventAccelPedalPos "Restraint control module: a014 event accel pedal pos";
CM_ SG_ 1297 RCM_a015_eventArmStatus "Restraint control module: a015 event arm status";
CM_ SG_ 1297 RCM_a015_eventFactoryMode "Restraint control module: a015 event factory mode";
CM_ SG_ 1297 RCM_a015_eventDiagEnabled "Restraint control module: a015 event diag enabled";
CM_ SG_ 1297 RCM_a015_eventDriveOrientation "Restraint control module: a015 event drive orientation";
CM_ SG_ 1297 RCM_a015_driverABStg2Sht2Gnd "Restraint control module: a015 driver AB stg2 sht2 gnd";
CM_ SG_ 1297 RCM_a015_driverABStg2Sht2Bat "Restraint control module: a015 driver AB stg2 sht2 bat";
CM_ SG_ 1297 RCM_a015_driverABStg2Open "Restraint control module: a015 driver AB stg2 open";
CM_ SG_ 1297 RCM_a015_driverABStg2Short "Restraint control module: a015 driver AB stg2 short";
CM_ SG_ 1297 RCM_a015_driverABStg2CrossCoup "Restraint control module: a015 driver AB stg2 cross coup";
CM_ SG_ 1297 RCM_a015_driverABStg2Config "Restraint control module: a015 driver AB stg2 config";
CM_ SG_ 1297 RCM_a015_eventIDFsignal "Restraint control module: a015 event ID fsignal";
CM_ SG_ 1297 RCM_a015_eventFrontLeftSeatbelt "Restraint control module: a015 event front left seatbelt";
CM_ SG_ 1297 RCM_a015_eventFrontRightSeatbelt "Restraint control module: a015 event front right seatbelt";
CM_ SG_ 1297 RCM_a015_eventVehicleSpeed "Restraint control module: a015 event vehicle speed";
CM_ SG_ 1297 RCM_a015_eventSteeringAngle "Restraint control module: a015 event steering angle";
CM_ SG_ 1297 RCM_a015_eventDriverBrakeApply "Restraint control module: a015 event driver brake apply";
CM_ SG_ 1297 RCM_a015_eventAccelPedalPos "Restraint control module: a015 event accel pedal pos";
CM_ SG_ 1297 RCM_a016_eventArmStatus "Restraint control module: a016 event arm status";
CM_ SG_ 1297 RCM_a016_eventFactoryMode "Restraint control module: a016 event factory mode";
CM_ SG_ 1297 RCM_a016_eventDiagEnabled "Restraint control module: a016 event diag enabled";
CM_ SG_ 1297 RCM_a016_eventDriveOrientation "Restraint control module: a016 event drive orientation";
CM_ SG_ 1297 RCM_a016_passABStg1Sht2Gnd "Restraint control module: a016 pass AB stg1 sht2 gnd";
CM_ SG_ 1297 RCM_a016_passABStg1Sht2Bat "Restraint control module: a016 pass AB stg1 sht2 bat";
CM_ SG_ 1297 RCM_a016_passABStg1Open "Restraint control module: a016 pass AB stg1 open";
CM_ SG_ 1297 RCM_a016_passABStg1Short "Restraint control module: a016 pass AB stg1 short";
CM_ SG_ 1297 RCM_a016_passABStg1CrossCoup "Restraint control module: a016 pass AB stg1 cross coup";
CM_ SG_ 1297 RCM_a016_passABStg1Config "Restraint control module: a016 pass AB stg1 config";
CM_ SG_ 1297 RCM_a016_eventIDFsignal "Restraint control module: a016 event ID fsignal";
CM_ SG_ 1297 RCM_a016_eventFrontLeftSeatbelt "Restraint control module: a016 event front left seatbelt";
CM_ SG_ 1297 RCM_a016_eventFrontRightSeatbelt "Restraint control module: a016 event front right seatbelt";
CM_ SG_ 1297 RCM_a016_eventVehicleSpeed "Restraint control module: a016 event vehicle speed";
CM_ SG_ 1297 RCM_a016_eventSteeringAngle "Restraint control module: a016 event steering angle";
CM_ SG_ 1297 RCM_a016_eventDriverBrakeApply "Restraint control module: a016 event driver brake apply";
CM_ SG_ 1297 RCM_a016_eventAccelPedalPos "Restraint control module: a016 event accel pedal pos";
CM_ SG_ 1297 RCM_a017_eventArmStatus "Restraint control module: a017 event arm status";
CM_ SG_ 1297 RCM_a017_eventFactoryMode "Restraint control module: a017 event factory mode";
CM_ SG_ 1297 RCM_a017_eventDiagEnabled "Restraint control module: a017 event diag enabled";
CM_ SG_ 1297 RCM_a017_eventDriveOrientation "Restraint control module: a017 event drive orientation";
CM_ SG_ 1297 RCM_a017_passABStg2Sht2Gnd "Restraint control module: a017 pass AB stg2 sht2 gnd";
CM_ SG_ 1297 RCM_a017_passABStg2Sht2Bat "Restraint control module: a017 pass AB stg2 sht2 bat";
CM_ SG_ 1297 RCM_a017_passABStg2Open "Restraint control module: a017 pass AB stg2 open";
CM_ SG_ 1297 RCM_a017_passABStg2Short "Restraint control module: a017 pass AB stg2 short";
CM_ SG_ 1297 RCM_a017_passABStg2CrossCoup "Restraint control module: a017 pass AB stg2 cross coup";
CM_ SG_ 1297 RCM_a017_passABStg2Config "Restraint control module: a017 pass AB stg2 config";
CM_ SG_ 1297 RCM_a017_eventIDFsignal "Restraint control module: a017 event ID fsignal";
CM_ SG_ 1297 RCM_a017_eventFrontLeftSeatbelt "Restraint control module: a017 event front left seatbelt";
CM_ SG_ 1297 RCM_a017_eventFrontRightSeatbelt "Restraint control module: a017 event front right seatbelt";
CM_ SG_ 1297 RCM_a017_eventVehicleSpeed "Restraint control module: a017 event vehicle speed";
CM_ SG_ 1297 RCM_a017_eventSteeringAngle "Restraint control module: a017 event steering angle";
CM_ SG_ 1297 RCM_a017_eventDriverBrakeApply "Restraint control module: a017 event driver brake apply";
CM_ SG_ 1297 RCM_a017_eventAccelPedalPos "Restraint control module: a017 event accel pedal pos";
CM_ SG_ 1297 RCM_a018_eventArmStatus "Restraint control module: a018 event arm status";
CM_ SG_ 1297 RCM_a018_eventFactoryMode "Restraint control module: a018 event factory mode";
CM_ SG_ 1297 RCM_a018_eventDiagEnabled "Restraint control module: a018 event diag enabled";
CM_ SG_ 1297 RCM_a018_eventDriveOrientation "Restraint control module: a018 event drive orientation";
CM_ SG_ 1297 RCM_a018_passActiveVentSht2Gnd "Restraint control module: a018 pass active vent sht2 gnd";
CM_ SG_ 1297 RCM_a018_passActiveVentSht2Bat "Restraint control module: a018 pass active vent sht2 bat";
CM_ SG_ 1297 RCM_a018_passActiveVentOpen "Restraint control module: a018 pass active vent open";
CM_ SG_ 1297 RCM_a018_passActiveVentShort "Restraint control module: a018 pass active vent short";
CM_ SG_ 1297 RCM_a018_passActiveVentCrossCoup "Restraint control module: a018 pass active vent cross coup";
CM_ SG_ 1297 RCM_a018_passActiveVentConfig "Restraint control module: a018 pass active vent config";
CM_ SG_ 1297 RCM_a018_eventIDFsignal "Restraint control module: a018 event ID fsignal";
CM_ SG_ 1297 RCM_a018_eventFrontLeftSeatbelt "Restraint control module: a018 event front left seatbelt";
CM_ SG_ 1297 RCM_a018_eventFrontRightSeatbelt "Restraint control module: a018 event front right seatbelt";
CM_ SG_ 1297 RCM_a018_eventVehicleSpeed "Restraint control module: a018 event vehicle speed";
CM_ SG_ 1297 RCM_a018_eventSteeringAngle "Restraint control module: a018 event steering angle";
CM_ SG_ 1297 RCM_a018_eventDriverBrakeApply "Restraint control module: a018 event driver brake apply";
CM_ SG_ 1297 RCM_a018_eventAccelPedalPos "Restraint control module: a018 event accel pedal pos";
CM_ SG_ 1297 RCM_a019_eventArmStatus "Restraint control module: a019 event arm status";
CM_ SG_ 1297 RCM_a019_eventFactoryMode "Restraint control module: a019 event factory mode";
CM_ SG_ 1297 RCM_a019_eventDiagEnabled "Restraint control module: a019 event diag enabled";
CM_ SG_ 1297 RCM_a019_eventDriveOrientation "Restraint control module: a019 event drive orientation";
CM_ SG_ 1297 RCM_a019_pretenShldLeftSht2Gnd "Restraint control module: a019 preten shld left sht2 gnd";
CM_ SG_ 1297 RCM_a019_pretenShldLeftSht2Bat "Restraint control module: a019 preten shld left sht2 bat";
CM_ SG_ 1297 RCM_a019_pretenShldLeftOpen "Restraint control module: a019 preten shld left open";
CM_ SG_ 1297 RCM_a019_pretenShldLeftShort "Restraint control module: a019 preten shld left short";
CM_ SG_ 1297 RCM_a019_pretenShldLeftCrossC "Restraint control module: a019 preten shld left cross c";
CM_ SG_ 1297 RCM_a019_pretenShldLeftConfig "Restraint control module: a019 preten shld left config";
CM_ SG_ 1297 RCM_a019_eventIDFsignal "Restraint control module: a019 event ID fsignal";
CM_ SG_ 1297 RCM_a019_eventFrontLeftSeatbelt "Restraint control module: a019 event front left seatbelt";
CM_ SG_ 1297 RCM_a019_eventFrontRightSeatbelt "Restraint control module: a019 event front right seatbelt";
CM_ SG_ 1297 RCM_a019_eventVehicleSpeed "Restraint control module: a019 event vehicle speed";
CM_ SG_ 1297 RCM_a019_eventSteeringAngle "Restraint control module: a019 event steering angle";
CM_ SG_ 1297 RCM_a019_eventDriverBrakeApply "Restraint control module: a019 event driver brake apply";
CM_ SG_ 1297 RCM_a019_eventAccelPedalPos "Restraint control module: a019 event accel pedal pos";
CM_ SG_ 1297 RCM_a020_eventArmStatus "Restraint control module: a020 event arm status";
CM_ SG_ 1297 RCM_a020_eventFactoryMode "Restraint control module: a020 event factory mode";
CM_ SG_ 1297 RCM_a020_eventDiagEnabled "Restraint control module: a020 event diag enabled";
CM_ SG_ 1297 RCM_a020_eventDriveOrientation "Restraint control module: a020 event drive orientation";
CM_ SG_ 1297 RCM_a020_pretenShldRightSht2Gnd "Restraint control module: a020 preten shld right sht2 gnd";
CM_ SG_ 1297 RCM_a020_pretenShldRightSht2Bat "Restraint control module: a020 preten shld right sht2 bat";
CM_ SG_ 1297 RCM_a020_pretenShldRightOpen "Restraint control module: a020 preten shld right open";
CM_ SG_ 1297 RCM_a020_pretenShldRightShort "Restraint control module: a020 preten shld right short";
CM_ SG_ 1297 RCM_a020_pretenShldRightCrossC "Restraint control module: a020 preten shld right cross c";
CM_ SG_ 1297 RCM_a020_pretenShldRightConfig "Restraint control module: a020 preten shld right config";
CM_ SG_ 1297 RCM_a020_eventIDFsignal "Restraint control module: a020 event ID fsignal";
CM_ SG_ 1297 RCM_a020_eventFrontLeftSeatbelt "Restraint control module: a020 event front left seatbelt";
CM_ SG_ 1297 RCM_a020_eventFrontRightSeatbelt "Restraint control module: a020 event front right seatbelt";
CM_ SG_ 1297 RCM_a020_eventVehicleSpeed "Restraint control module: a020 event vehicle speed";
CM_ SG_ 1297 RCM_a020_eventSteeringAngle "Restraint control module: a020 event steering angle";
CM_ SG_ 1297 RCM_a020_eventDriverBrakeApply "Restraint control module: a020 event driver brake apply";
CM_ SG_ 1297 RCM_a020_eventAccelPedalPos "Restraint control module: a020 event accel pedal pos";
CM_ SG_ 1297 RCM_a021_eventArmStatus "Restraint control module: a021 event arm status";
CM_ SG_ 1297 RCM_a021_eventFactoryMode "Restraint control module: a021 event factory mode";
CM_ SG_ 1297 RCM_a021_eventDiagEnabled "Restraint control module: a021 event diag enabled";
CM_ SG_ 1297 RCM_a021_eventDriveOrientation "Restraint control module: a021 event drive orientation";
CM_ SG_ 1297 RCM_a021_pretenLapLeftSht2Gnd "Restraint control module: a021 preten lap left sht2 gnd";
CM_ SG_ 1297 RCM_a021_pretenLapLeftSht2Bat "Restraint control module: a021 preten lap left sht2 bat";
CM_ SG_ 1297 RCM_a021_pretenLapLeftOpen "Restraint control module: a021 preten lap left open";
CM_ SG_ 1297 RCM_a021_pretenLapLeftShort "Restraint control module: a021 preten lap left short";
CM_ SG_ 1297 RCM_a021_pretenLapLeftCrossCoup "Restraint control module: a021 preten lap left cross coup";
CM_ SG_ 1297 RCM_a021_pretenLapLeftConfig "Restraint control module: a021 preten lap left config";
CM_ SG_ 1297 RCM_a021_eventIDFsignal "Restraint control module: a021 event ID fsignal";
CM_ SG_ 1297 RCM_a021_eventFrontLeftSeatbelt "Restraint control module: a021 event front left seatbelt";
CM_ SG_ 1297 RCM_a021_eventFrontRightSeatbelt "Restraint control module: a021 event front right seatbelt";
CM_ SG_ 1297 RCM_a021_eventVehicleSpeed "Restraint control module: a021 event vehicle speed";
CM_ SG_ 1297 RCM_a021_eventSteeringAngle "Restraint control module: a021 event steering angle";
CM_ SG_ 1297 RCM_a021_eventDriverBrakeApply "Restraint control module: a021 event driver brake apply";
CM_ SG_ 1297 RCM_a021_eventAccelPedalPos "Restraint control module: a021 event accel pedal pos";
CM_ SG_ 1297 RCM_a022_eventArmStatus "Restraint control module: a022 event arm status";
CM_ SG_ 1297 RCM_a022_eventFactoryMode "Restraint control module: a022 event factory mode";
CM_ SG_ 1297 RCM_a022_eventDiagEnabled "Restraint control module: a022 event diag enabled";
CM_ SG_ 1297 RCM_a022_eventDriveOrientation "Restraint control module: a022 event drive orientation";
CM_ SG_ 1297 RCM_a022_pretenLapRightSht2Gnd "Restraint control module: a022 preten lap right sht2 gnd";
CM_ SG_ 1297 RCM_a022_pretenLapRightSht2Bat "Restraint control module: a022 preten lap right sht2 bat";
CM_ SG_ 1297 RCM_a022_pretenLapRightOpen "Restraint control module: a022 preten lap right open";
CM_ SG_ 1297 RCM_a022_pretenLapRightShort "Restraint control module: a022 preten lap right short";
CM_ SG_ 1297 RCM_a022_pretenLapRightCrossCoup "Restraint control module: a022 preten lap right cross coup";
CM_ SG_ 1297 RCM_a022_pretenLapRightConfig "Restraint control module: a022 preten lap right config";
CM_ SG_ 1297 RCM_a022_eventIDFsignal "Restraint control module: a022 event ID fsignal";
CM_ SG_ 1297 RCM_a022_eventFrontLeftSeatbelt "Restraint control module: a022 event front left seatbelt";
CM_ SG_ 1297 RCM_a022_eventFrontRightSeatbelt "Restraint control module: a022 event front right seatbelt";
CM_ SG_ 1297 RCM_a022_eventVehicleSpeed "Restraint control module: a022 event vehicle speed";
CM_ SG_ 1297 RCM_a022_eventSteeringAngle "Restraint control module: a022 event steering angle";
CM_ SG_ 1297 RCM_a022_eventDriverBrakeApply "Restraint control module: a022 event driver brake apply";
CM_ SG_ 1297 RCM_a022_eventAccelPedalPos "Restraint control module: a022 event accel pedal pos";
CM_ SG_ 1297 RCM_a023_eventArmStatus "Restraint control module: a023 event arm status";
CM_ SG_ 1297 RCM_a023_eventFactoryMode "Restraint control module: a023 event factory mode";
CM_ SG_ 1297 RCM_a023_eventDiagEnabled "Restraint control module: a023 event diag enabled";
CM_ SG_ 1297 RCM_a023_eventDriveOrientation "Restraint control module: a023 event drive orientation";
CM_ SG_ 1297 RCM_a023_loadLimLeftSht2Gnd "Restraint control module: a023 load lim left sht2 gnd";
CM_ SG_ 1297 RCM_a023_loadLimLeftSht2Bat "Restraint control module: a023 load lim left sht2 bat";
CM_ SG_ 1297 RCM_a023_loadLimLeftOpen "Restraint control module: a023 load lim left open";
CM_ SG_ 1297 RCM_a023_loadLimLeftShort "Restraint control module: a023 load lim left short";
CM_ SG_ 1297 RCM_a023_loadLimLeftCrossCoup "Restraint control module: a023 load lim left cross coup";
CM_ SG_ 1297 RCM_a023_loadLimLeftConfig "Restraint control module: a023 load lim left config";
CM_ SG_ 1297 RCM_a023_eventIDFsignal "Restraint control module: a023 event ID fsignal";
CM_ SG_ 1297 RCM_a023_eventFrontLeftSeatbelt "Restraint control module: a023 event front left seatbelt";
CM_ SG_ 1297 RCM_a023_eventFrontRightSeatbelt "Restraint control module: a023 event front right seatbelt";
CM_ SG_ 1297 RCM_a023_eventVehicleSpeed "Restraint control module: a023 event vehicle speed";
CM_ SG_ 1297 RCM_a023_eventSteeringAngle "Restraint control module: a023 event steering angle";
CM_ SG_ 1297 RCM_a023_eventDriverBrakeApply "Restraint control module: a023 event driver brake apply";
CM_ SG_ 1297 RCM_a023_eventAccelPedalPos "Restraint control module: a023 event accel pedal pos";
CM_ SG_ 1297 RCM_a024_eventArmStatus "Restraint control module: a024 event arm status";
CM_ SG_ 1297 RCM_a024_eventFactoryMode "Restraint control module: a024 event factory mode";
CM_ SG_ 1297 RCM_a024_eventDiagEnabled "Restraint control module: a024 event diag enabled";
CM_ SG_ 1297 RCM_a024_eventDriveOrientation "Restraint control module: a024 event drive orientation";
CM_ SG_ 1297 RCM_a024_loadLimRightSht2Gnd "Restraint control module: a024 load lim right sht2 gnd";
CM_ SG_ 1297 RCM_a024_loadLimRightSht2Bat "Restraint control module: a024 load lim right sht2 bat";
CM_ SG_ 1297 RCM_a024_loadLimRightOpen "Restraint control module: a024 load lim right open";
CM_ SG_ 1297 RCM_a024_loadLimRightShort "Restraint control module: a024 load lim right short";
CM_ SG_ 1297 RCM_a024_loadLimRightCrossCoup "Restraint control module: a024 load lim right cross coup";
CM_ SG_ 1297 RCM_a024_loadLimRightConfig "Restraint control module: a024 load lim right config";
CM_ SG_ 1297 RCM_a024_eventIDFsignal "Restraint control module: a024 event ID fsignal";
CM_ SG_ 1297 RCM_a024_eventFrontLeftSeatbelt "Restraint control module: a024 event front left seatbelt";
CM_ SG_ 1297 RCM_a024_eventFrontRightSeatbelt "Restraint control module: a024 event front right seatbelt";
CM_ SG_ 1297 RCM_a024_eventVehicleSpeed "Restraint control module: a024 event vehicle speed";
CM_ SG_ 1297 RCM_a024_eventSteeringAngle "Restraint control module: a024 event steering angle";
CM_ SG_ 1297 RCM_a024_eventDriverBrakeApply "Restraint control module: a024 event driver brake apply";
CM_ SG_ 1297 RCM_a024_eventAccelPedalPos "Restraint control module: a024 event accel pedal pos";
CM_ SG_ 1297 RCM_a025_eventArmStatus "Restraint control module: a025 event arm status";
CM_ SG_ 1297 RCM_a025_eventFactoryMode "Restraint control module: a025 event factory mode";
CM_ SG_ 1297 RCM_a025_eventDiagEnabled "Restraint control module: a025 event diag enabled";
CM_ SG_ 1297 RCM_a025_eventDriveOrientation "Restraint control module: a025 event drive orientation";
CM_ SG_ 1297 RCM_a025_kneeABDrvrSht2Gnd "Restraint control module: a025 knee AB drvr sht2 gnd";
CM_ SG_ 1297 RCM_a025_kneeABDrvrSht2Bat "Restraint control module: a025 knee AB drvr sht2 bat";
CM_ SG_ 1297 RCM_a025_kneeABDrvrOpen "Restraint control module: a025 knee AB drvr open";
CM_ SG_ 1297 RCM_a025_kneeABDrvrShort "Restraint control module: a025 knee AB drvr short";
CM_ SG_ 1297 RCM_a025_kneeABDrvrCrossCoup "Restraint control module: a025 knee AB drvr cross coup";
CM_ SG_ 1297 RCM_a025_kneeABDrvrConfig "Restraint control module: a025 knee AB drvr config";
CM_ SG_ 1297 RCM_a025_eventIDFsignal "Restraint control module: a025 event ID fsignal";
CM_ SG_ 1297 RCM_a025_eventFrontLeftSeatbelt "Restraint control module: a025 event front left seatbelt";
CM_ SG_ 1297 RCM_a025_eventFrontRightSeatbelt "Restraint control module: a025 event front right seatbelt";
CM_ SG_ 1297 RCM_a025_eventVehicleSpeed "Restraint control module: a025 event vehicle speed";
CM_ SG_ 1297 RCM_a025_eventSteeringAngle "Restraint control module: a025 event steering angle";
CM_ SG_ 1297 RCM_a025_eventDriverBrakeApply "Restraint control module: a025 event driver brake apply";
CM_ SG_ 1297 RCM_a025_eventAccelPedalPos "Restraint control module: a025 event accel pedal pos";
CM_ SG_ 1297 RCM_a026_eventArmStatus "Restraint control module: a026 event arm status";
CM_ SG_ 1297 RCM_a026_eventFactoryMode "Restraint control module: a026 event factory mode";
CM_ SG_ 1297 RCM_a026_eventDiagEnabled "Restraint control module: a026 event diag enabled";
CM_ SG_ 1297 RCM_a026_eventDriveOrientation "Restraint control module: a026 event drive orientation";
CM_ SG_ 1297 RCM_a026_kneeABPassSht2Gnd "Restraint control module: a026 knee AB pass sht2 gnd";
CM_ SG_ 1297 RCM_a026_kneeABPassSht2Bat "Restraint control module: a026 knee AB pass sht2 bat";
CM_ SG_ 1297 RCM_a026_kneeABPassOpen "Restraint control module: a026 knee AB pass open";
CM_ SG_ 1297 RCM_a026_kneeABPassShort "Restraint control module: a026 knee AB pass short";
CM_ SG_ 1297 RCM_a026_kneeABPassCrossCoup "Restraint control module: a026 knee AB pass cross coup";
CM_ SG_ 1297 RCM_a026_kneeABPassConfig "Restraint control module: a026 knee AB pass config";
CM_ SG_ 1297 RCM_a026_eventIDFsignal "Restraint control module: a026 event ID fsignal";
CM_ SG_ 1297 RCM_a026_eventFrontLeftSeatbelt "Restraint control module: a026 event front left seatbelt";
CM_ SG_ 1297 RCM_a026_eventFrontRightSeatbelt "Restraint control module: a026 event front right seatbelt";
CM_ SG_ 1297 RCM_a026_eventVehicleSpeed "Restraint control module: a026 event vehicle speed";
CM_ SG_ 1297 RCM_a026_eventSteeringAngle "Restraint control module: a026 event steering angle";
CM_ SG_ 1297 RCM_a026_eventDriverBrakeApply "Restraint control module: a026 event driver brake apply";
CM_ SG_ 1297 RCM_a026_eventAccelPedalPos "Restraint control module: a026 event accel pedal pos";
CM_ SG_ 1297 RCM_a027_eventArmStatus "Restraint control module: a027 event arm status";
CM_ SG_ 1297 RCM_a027_eventFactoryMode "Restraint control module: a027 event factory mode";
CM_ SG_ 1297 RCM_a027_eventDiagEnabled "Restraint control module: a027 event diag enabled";
CM_ SG_ 1297 RCM_a027_eventDriveOrientation "Restraint control module: a027 event drive orientation";
CM_ SG_ 1297 RCM_a027_sideAB1stRowLSht2Gnd "Restraint control module: a027 side ab1st row l sht2 gnd";
CM_ SG_ 1297 RCM_a027_sideAB1stRowLSht2Bat "Restraint control module: a027 side ab1st row l sht2 bat";
CM_ SG_ 1297 RCM_a027_sideAB1stRowLOpen "Restraint control module: a027 side ab1st row l open";
CM_ SG_ 1297 RCM_a027_sideAB1stRowLShort "Restraint control module: a027 side ab1st row l short";
CM_ SG_ 1297 RCM_a027_sideAB1stRowLCrossCoup "Restraint control module: a027 side ab1st row l cross coup";
CM_ SG_ 1297 RCM_a027_sideAB1stRowLConfig "Restraint control module: a027 side ab1st row l config";
CM_ SG_ 1297 RCM_a027_eventIDFsignal "Restraint control module: a027 event ID fsignal";
CM_ SG_ 1297 RCM_a027_eventFrontLeftSeatbelt "Restraint control module: a027 event front left seatbelt";
CM_ SG_ 1297 RCM_a027_eventFrontRightSeatbelt "Restraint control module: a027 event front right seatbelt";
CM_ SG_ 1297 RCM_a027_eventVehicleSpeed "Restraint control module: a027 event vehicle speed";
CM_ SG_ 1297 RCM_a027_eventSteeringAngle "Restraint control module: a027 event steering angle";
CM_ SG_ 1297 RCM_a027_eventDriverBrakeApply "Restraint control module: a027 event driver brake apply";
CM_ SG_ 1297 RCM_a027_eventAccelPedalPos "Restraint control module: a027 event accel pedal pos";
CM_ SG_ 1297 RCM_a028_eventArmStatus "Restraint control module: a028 event arm status";
CM_ SG_ 1297 RCM_a028_eventFactoryMode "Restraint control module: a028 event factory mode";
CM_ SG_ 1297 RCM_a028_eventDiagEnabled "Restraint control module: a028 event diag enabled";
CM_ SG_ 1297 RCM_a028_eventDriveOrientation "Restraint control module: a028 event drive orientation";
CM_ SG_ 1297 RCM_a028_sideAB1stRowRSht2Gnd "Restraint control module: a028 side ab1st row r sht2 gnd";
CM_ SG_ 1297 RCM_a028_sideAB1stRowRSht2Bat "Restraint control module: a028 side ab1st row r sht2 bat";
CM_ SG_ 1297 RCM_a028_sideAB1stRowROpen "Restraint control module: a028 side ab1st row r open";
CM_ SG_ 1297 RCM_a028_sideAB1stRowRShort "Restraint control module: a028 side ab1st row r short";
CM_ SG_ 1297 RCM_a028_sideAB1stRowRCrossCoup "Restraint control module: a028 side ab1st row r cross coup";
CM_ SG_ 1297 RCM_a028_sideAB1stRowRConfig "Restraint control module: a028 side ab1st row r config";
CM_ SG_ 1297 RCM_a028_eventIDFsignal "Restraint control module: a028 event ID fsignal";
CM_ SG_ 1297 RCM_a028_eventFrontLeftSeatbelt "Restraint control module: a028 event front left seatbelt";
CM_ SG_ 1297 RCM_a028_eventFrontRightSeatbelt "Restraint control module: a028 event front right seatbelt";
CM_ SG_ 1297 RCM_a028_eventVehicleSpeed "Restraint control module: a028 event vehicle speed";
CM_ SG_ 1297 RCM_a028_eventSteeringAngle "Restraint control module: a028 event steering angle";
CM_ SG_ 1297 RCM_a028_eventDriverBrakeApply "Restraint control module: a028 event driver brake apply";
CM_ SG_ 1297 RCM_a028_eventAccelPedalPos "Restraint control module: a028 event accel pedal pos";
CM_ SG_ 1297 RCM_a029_eventArmStatus "Restraint control module: a029 event arm status";
CM_ SG_ 1297 RCM_a029_eventFactoryMode "Restraint control module: a029 event factory mode";
CM_ SG_ 1297 RCM_a029_eventDiagEnabled "Restraint control module: a029 event diag enabled";
CM_ SG_ 1297 RCM_a029_eventDriveOrientation "Restraint control module: a029 event drive orientation";
CM_ SG_ 1297 RCM_a029_driverABAVSht2Gnd "Restraint control module: a029 driver ABAV sht2 gnd";
CM_ SG_ 1297 RCM_a029_driverABAVSht2Bat "Restraint control module: a029 driver ABAV sht2 bat";
CM_ SG_ 1297 RCM_a029_driverABAVOpen "Restraint control module: a029 driver ABAV open";
CM_ SG_ 1297 RCM_a029_driverABAVShort "Restraint control module: a029 driver ABAV short";
CM_ SG_ 1297 RCM_a029_driverABAVCrossCoup "Restraint control module: a029 driver ABAV cross coup";
CM_ SG_ 1297 RCM_a029_driverABAVConfig "Restraint control module: a029 driver ABAV config";
CM_ SG_ 1297 RCM_a029_eventIDFsignal "Restraint control module: a029 event ID fsignal";
CM_ SG_ 1297 RCM_a029_eventFrontLeftSeatbelt "Restraint control module: a029 event front left seatbelt";
CM_ SG_ 1297 RCM_a029_eventFrontRightSeatbelt "Restraint control module: a029 event front right seatbelt";
CM_ SG_ 1297 RCM_a029_eventVehicleSpeed "Restraint control module: a029 event vehicle speed";
CM_ SG_ 1297 RCM_a029_eventSteeringAngle "Restraint control module: a029 event steering angle";
CM_ SG_ 1297 RCM_a029_eventDriverBrakeApply "Restraint control module: a029 event driver brake apply";
CM_ SG_ 1297 RCM_a029_eventAccelPedalPos "Restraint control module: a029 event accel pedal pos";
CM_ SG_ 1297 RCM_a030_eventArmStatus "Restraint control module: a030 event arm status";
CM_ SG_ 1297 RCM_a030_eventFactoryMode "Restraint control module: a030 event factory mode";
CM_ SG_ 1297 RCM_a030_eventDiagEnabled "Restraint control module: a030 event diag enabled";
CM_ SG_ 1297 RCM_a030_eventDriveOrientation "Restraint control module: a030 event drive orientation";
CM_ SG_ 1297 RCM_a030_farsideABSht2Gnd "Restraint control module: a030 farside AB sht2 gnd";
CM_ SG_ 1297 RCM_a030_farsideABSht2Bat "Restraint control module: a030 farside AB sht2 bat";
CM_ SG_ 1297 RCM_a030_farsideABOpen "Restraint control module: a030 farside AB open";
CM_ SG_ 1297 RCM_a030_farsideABShort "Restraint control module: a030 farside AB short";
CM_ SG_ 1297 RCM_a030_farsideABCrossCoup "Restraint control module: a030 farside AB cross coup";
CM_ SG_ 1297 RCM_a030_farsideABConfig "Restraint control module: a030 farside AB config";
CM_ SG_ 1297 RCM_a030_eventIDFsignal "Restraint control module: a030 event ID fsignal";
CM_ SG_ 1297 RCM_a030_eventFrontLeftSeatbelt "Restraint control module: a030 event front left seatbelt";
CM_ SG_ 1297 RCM_a030_eventFrontRightSeatbelt "Restraint control module: a030 event front right seatbelt";
CM_ SG_ 1297 RCM_a030_eventVehicleSpeed "Restraint control module: a030 event vehicle speed";
CM_ SG_ 1297 RCM_a030_eventSteeringAngle "Restraint control module: a030 event steering angle";
CM_ SG_ 1297 RCM_a030_eventDriverBrakeApply "Restraint control module: a030 event driver brake apply";
CM_ SG_ 1297 RCM_a030_eventAccelPedalPos "Restraint control module: a030 event accel pedal pos";
CM_ SG_ 1297 RCM_a031_eventArmStatus "Restraint control module: a031 event arm status";
CM_ SG_ 1297 RCM_a031_eventFactoryMode "Restraint control module: a031 event factory mode";
CM_ SG_ 1297 RCM_a031_eventDiagEnabled "Restraint control module: a031 event diag enabled";
CM_ SG_ 1297 RCM_a031_eventDriveOrientation "Restraint control module: a031 event drive orientation";
CM_ SG_ 1297 RCM_a031_frntCentrABSht2Gnd "Restraint control module: a031 frnt centr AB sht2 gnd";
CM_ SG_ 1297 RCM_a031_frntCentrABSht2Bat "Restraint control module: a031 frnt centr AB sht2 bat";
CM_ SG_ 1297 RCM_a031_frntCentrABOpen "Restraint control module: a031 frnt centr AB open";
CM_ SG_ 1297 RCM_a031_frntCentrABShort "Restraint control module: a031 frnt centr AB short";
CM_ SG_ 1297 RCM_a031_frntCentrABCrossCoup "Restraint control module: a031 frnt centr AB cross coup";
CM_ SG_ 1297 RCM_a031_frntCentrABConfig "Restraint control module: a031 frnt centr AB config";
CM_ SG_ 1297 RCM_a031_eventIDFsignal "Restraint control module: a031 event ID fsignal";
CM_ SG_ 1297 RCM_a031_eventFrontLeftSeatbelt "Restraint control module: a031 event front left seatbelt";
CM_ SG_ 1297 RCM_a031_eventFrontRightSeatbelt "Restraint control module: a031 event front right seatbelt";
CM_ SG_ 1297 RCM_a031_eventVehicleSpeed "Restraint control module: a031 event vehicle speed";
CM_ SG_ 1297 RCM_a031_eventSteeringAngle "Restraint control module: a031 event steering angle";
CM_ SG_ 1297 RCM_a031_eventDriverBrakeApply "Restraint control module: a031 event driver brake apply";
CM_ SG_ 1297 RCM_a031_eventAccelPedalPos "Restraint control module: a031 event accel pedal pos";
CM_ SG_ 1297 RCM_a032_eventArmStatus "Restraint control module: a032 event arm status";
CM_ SG_ 1297 RCM_a032_eventFactoryMode "Restraint control module: a032 event factory mode";
CM_ SG_ 1297 RCM_a032_eventDiagEnabled "Restraint control module: a032 event diag enabled";
CM_ SG_ 1297 RCM_a032_eventDriveOrientation "Restraint control module: a032 event drive orientation";
CM_ SG_ 1297 RCM_a032_curABLeftSht2Gnd "Restraint control module: a032 cur AB left sht2 gnd";
CM_ SG_ 1297 RCM_a032_curABLeftSht2Bat "Restraint control module: a032 cur AB left sht2 bat";
CM_ SG_ 1297 RCM_a032_curABLeftOpen "Restraint control module: a032 cur AB left open";
CM_ SG_ 1297 RCM_a032_curABLeftShort "Restraint control module: a032 cur AB left short";
CM_ SG_ 1297 RCM_a032_curABLeftCrossCoup "Restraint control module: a032 cur AB left cross coup";
CM_ SG_ 1297 RCM_a032_curABLeftConfig "Restraint control module: a032 cur AB left config";
CM_ SG_ 1297 RCM_a032_eventIDFsignal "Restraint control module: a032 event ID fsignal";
CM_ SG_ 1297 RCM_a032_eventFrontLeftSeatbelt "Restraint control module: a032 event front left seatbelt";
CM_ SG_ 1297 RCM_a032_eventFrontRightSeatbelt "Restraint control module: a032 event front right seatbelt";
CM_ SG_ 1297 RCM_a032_eventVehicleSpeed "Restraint control module: a032 event vehicle speed";
CM_ SG_ 1297 RCM_a032_eventSteeringAngle "Restraint control module: a032 event steering angle";
CM_ SG_ 1297 RCM_a032_eventDriverBrakeApply "Restraint control module: a032 event driver brake apply";
CM_ SG_ 1297 RCM_a032_eventAccelPedalPos "Restraint control module: a032 event accel pedal pos";
CM_ SG_ 1297 RCM_a033_eventArmStatus "Restraint control module: a033 event arm status";
CM_ SG_ 1297 RCM_a033_eventFactoryMode "Restraint control module: a033 event factory mode";
CM_ SG_ 1297 RCM_a033_eventDiagEnabled "Restraint control module: a033 event diag enabled";
CM_ SG_ 1297 RCM_a033_eventDriveOrientation "Restraint control module: a033 event drive orientation";
CM_ SG_ 1297 RCM_a033_curABRightSht2Gnd "Restraint control module: a033 cur AB right sht2 gnd";
CM_ SG_ 1297 RCM_a033_curABRightSht2Bat "Restraint control module: a033 cur AB right sht2 bat";
CM_ SG_ 1297 RCM_a033_curABRightOpen "Restraint control module: a033 cur AB right open";
CM_ SG_ 1297 RCM_a033_curABRightShort "Restraint control module: a033 cur AB right short";
CM_ SG_ 1297 RCM_a033_curABRightCrossCoup "Restraint control module: a033 cur AB right cross coup";
CM_ SG_ 1297 RCM_a033_curABRightConfig "Restraint control module: a033 cur AB right config";
CM_ SG_ 1297 RCM_a033_eventIDFsignal "Restraint control module: a033 event ID fsignal";
CM_ SG_ 1297 RCM_a033_eventFrontLeftSeatbelt "Restraint control module: a033 event front left seatbelt";
CM_ SG_ 1297 RCM_a033_eventFrontRightSeatbelt "Restraint control module: a033 event front right seatbelt";
CM_ SG_ 1297 RCM_a033_eventVehicleSpeed "Restraint control module: a033 event vehicle speed";
CM_ SG_ 1297 RCM_a033_eventSteeringAngle "Restraint control module: a033 event steering angle";
CM_ SG_ 1297 RCM_a033_eventDriverBrakeApply "Restraint control module: a033 event driver brake apply";
CM_ SG_ 1297 RCM_a033_eventAccelPedalPos "Restraint control module: a033 event accel pedal pos";
BA_DEF_ BO_ "GenMsgCycleTime" INT 0 3600000;
BA_DEF_ BO_ "GenMsgSendType" ENUM "Cyclic","NotUsed","NotUsed","NotUsed","NotUsed","NotUsed","NotUsed","IfActive","NoMsgSendType","NotUsed";
BA_DEF_ BO_ "VFrameFormat" ENUM "StandardCAN","ExtendedCAN","reserved","J1939PG","reserved","reserved","reserved","reserved","reserved","reserved","reserved","reserved","reserved","reserved","StandardCAN_FD","ExtendedCAN_FD";
BA_DEF_ BO_ "CANFD_BRS" ENUM "0","1";
BA_DEF_ SG_ "SystemSignalLongSymbol" STRING;
BA_DEF_ SG_ "Confidence" ENUM "layout-only","plausible","validated";
BA_DEF_DEF_ "GenMsgCycleTime" 0;
BA_DEF_DEF_ "GenMsgSendType" "NoMsgSendType";
BA_DEF_DEF_ "VFrameFormat" "StandardCAN";
BA_DEF_DEF_ "CANFD_BRS" "1";
BA_DEF_DEF_ "SystemSignalLongSymbol" "";
BA_DEF_DEF_ "Confidence" "layout-only";
BA_ "SystemSignalLongSymbol" SG_ 1009 RCM2_a270_imuPtchR8OffCompPosLif "RCM2_a270_imuPtchR8OffCompPosLife";
BA_ "SystemSignalLongSymbol" SG_ 1009 RCM2_a271_imuPtchR8OffCompNegLif "RCM2_a271_imuPtchR8OffCompNegLife";
BA_ "SystemSignalLongSymbol" SG_ 1009 RCM2_a272_imuPtchR8OffCompPosFLD "RCM2_a272_imuPtchR8OffCompPosFLDC";
BA_ "SystemSignalLongSymbol" SG_ 1009 RCM2_a273_imuPtchR8OffCompNegFLD "RCM2_a273_imuPtchR8OffCompNegFLDC";
BA_ "SystemSignalLongSymbol" SG_ 1009 RCM2_a274_imuPtchR8OffCompPosSLD "RCM2_a274_imuPtchR8OffCompPosSLDC";
BA_ "SystemSignalLongSymbol" SG_ 1009 RCM2_a275_imuPtchR8OffCompNegSLD "RCM2_a275_imuPtchR8OffCompNegSLDC";
BA_ "SystemSignalLongSymbol" SG_ 1009 RCM2_a276_imuRollR8OffCompPosLif "RCM2_a276_imuRollR8OffCompPosLife";
BA_ "SystemSignalLongSymbol" SG_ 1009 RCM2_a277_imuRollR8OffCompNegLif "RCM2_a277_imuRollR8OffCompNegLife";
BA_ "SystemSignalLongSymbol" SG_ 1009 RCM2_a278_imuRollR8OffCompPosFLD "RCM2_a278_imuRollR8OffCompPosFLDC";
BA_ "SystemSignalLongSymbol" SG_ 1009 RCM2_a279_imuRollR8OffCompNegFLD "RCM2_a279_imuRollR8OffCompNegFLDC";
BA_ "SystemSignalLongSymbol" SG_ 1009 RCM2_a280_imuRollR8OffCompPosSLD "RCM2_a280_imuRollR8OffCompPosSLDC";
BA_ "SystemSignalLongSymbol" SG_ 1009 RCM2_a281_imuRollR8OffCompNegSLD "RCM2_a281_imuRollR8OffCompNegSLDC";
BA_ "SystemSignalLongSymbol" SG_ 1009 RCM2_a590_sbrRearNetworkUndefine "RCM2_a590_sbrRearNetworkUndefined";
BA_ "SystemSignalLongSymbol" SG_ 1009 RCM2_a593_driveOrientationSht2Gn "RCM2_a593_driveOrientationSht2Gnd";
BA_ "SystemSignalLongSymbol" SG_ 1009 RCM2_a594_driveOrientationSht2Ba "RCM2_a594_driveOrientationSht2Bat";
BA_ "SystemSignalLongSymbol" SG_ 1009 RCM2_a596_driveOrientationUndefi "RCM2_a596_driveOrientationUndefined";
BA_ "SystemSignalLongSymbol" SG_ 1009 RCM2_a597_driveOrientationCrssCo "RCM2_a597_driveOrientationCrssCoup";
BA_ "SystemSignalLongSymbol" SG_ 1009 RCM2_a853_ConfigParametersIncons "RCM2_a853_ConfigParametersInconsistent";
BA_ "SystemSignalLongSymbol" SG_ 1009 RCM2_a854_ConfigParametersNotLea "RCM2_a854_ConfigParametersNotLearned";
BA_ "SystemSignalLongSymbol" SG_ 1009 RCM2_a859_comVCxLVPowerStateChkS "RCM2_a859_comVCxLVPowerStateChkSm";
BA_ "SystemSignalLongSymbol" SG_ 1009 RCM2_a861_typeApprovalStringNotL "RCM2_a861_typeApprovalStringNotLearned";
BA_ "SystemSignalLongSymbol" SG_ 1009 RCM2_a863_comVCFRONTalertMatrixM "RCM2_a863_comVCFRONTalertMatrixMIA";
BA_ "SystemSignalLongSymbol" SG_ 1009 RCM2_a865_comVCLVBMSstatusHighMI "RCM2_a865_comVCLVBMSstatusHighMIA";
