VERSION "dbc-export 1 2026.26.6.5"

NS_ :

BS_:

BU_: ADSP APB APP APS APSB BB BMS CC CMP CMPD CP DAS DI DIF DIR DPB EPAS3P EPAS3S EPASTP EPASTS EPBL EPBR ESP EVSE FC GTW HCML HCMR HVP IBST ICR IDB LS OCS1P PARK PCS PCS2 PM PMF PMR PNCD PTC RADC RCM RCM2 RCM3 RCU SCCM SCM SCS SDCR TAS TCU TCU2 TPMS TRCM UI UIS UMC USM V2G VC VCBATT VCBATT0 VCBATT1 VCBATT2 VCCC VCFRONT VCFRONT1 VCFRONT2 VCLEFT VCRIGHT VCSEAT2L VCSEAT2R VCSEC VEH

BO_ 1332 VCFRONT_alertLog: 8 VCFRONT
 SG_ VCFRONT_alertID M : 0|10@1+ (1,0) [0|1023] "" Vector__XXX
 SG_ VCFRONT_a180_IBSVoltage m180 : 48|8@1+ (0.08741903,0) [0|22.29185265] "" Vector__XXX
 SG_ VCFRONT_a180_targetPCSVoltage m180 : 56|8@1+ (0.1,0) [0|25.5] "" Vector__XXX
 SG_ VCFRONT_a181_vehicleState m181 : 16|2@1+ (1,0) [0|3] "" Vector__XXX
 SG_ VCFRONT_a182_deadLV m182 : 16|1@1+ (1,0) [0|1] "" Vector__XXX
 SG_ VCFRONT_a182_voltageDrop m182 : 17|1@1+ (1,0) [0|1] "" Vector__XXX
 SG_ VCFRONT_a182_overcharge m182 : 18|1@1+ (1,0) [0|1] "" Vector__XXX
 SG_ VCFRONT_a182_LVFloorReached m182 : 19|1@1+ (1,0) [0|1] "" Vector__XXX
 SG_ VCFRONT_a182_shortedCell m182 : 20|1@1+ (1,0) [0|1] "" Vector__XXX
 SG_ VCFRONT_a182_postPORExcessiveAh m182 : 21|1@1+ (1,0) [0|1] "" Vector__XXX
 SG_ VCFRONT_a182_resistanceEstimatio m182 : 22|1@1+ (1,0) [0|1] "" Vector__XXX
 SG_ VCFRONT_a182_dcrMilliOhmsAboveTh m182 : 23|1@1+ (1,0) [0|1] "" Vector__XXX
 SG_ VCFRONT_a182_prechargeLVLoadRedu m182 : 24|1@1+ (1,0) [0|1] "" Vector__XXX
 SG_ VCFRONT_a182_factoryMode m182 : 25|1@1+ (1,0) [0|1] "" Vector__XXX
 SG_ VCFRONT_a182_serviceMode m182 : 26|1@1+ (1,0) [0|1] "" Vector__XXX
 SG_ VCFRONT_a182_transportMode m182 : 27|1@1+ (1,0) [0|1] "" Vector__XXX
 SG_ VCFRONT_a182_frunkOpen m182 : 28|1@1+ (1,0) [0|1] "" Vector__XXX
 SG_ VCFRONT_a182_packOverDischarged m182 : 29|1@1+ (1,0) [0|1] "" Vector__XXX
 SG_ VCFRONT_a182_cellImbalance m182 : 30|1@1+ (1,0) [0|1] "" Vector__XXX
 SG_ VCFRONT_a182_instantPrechargeDCR m182 : 31|1@1+ (1,0) [0|1] "" Vector__XXX
 SG_ VCFRONT_a182_ambientTemp m182 : 32|7@1+ (1,-40) [-40|87] "" Vector__XXX
 SG_ VCFRONT_a182_dischargedAmpHours m182 : 39|8@1+ (60,0) [0|15300] "" Vector__XXX
 SG_ VCFRONT_a182_chargedAmpHours m182 : 47|8@1+ (60,0) [0|15300] "" Vector__XXX
 SG_ VCFRONT_a182_calibrationLostFaul m182 : 55|1@1+ (1,0) [0|1] "" Vector__XXX
 SG_ VCFRONT_a182_samplingHWError m182 : 56|1@1+ (1,0) [0|1] "" Vector__XXX
 SG_ VCFRONT_a182_brickOverDischarged m182 : 57|1@1+ (1,0) [0|1] "" Vector__XXX
 SG_ VCFRONT_a182_impedanceGrowth m182 : 58|1@1+ (1,0) [0|1] "" Vector__XXX
 SG_ VCFRONT_a182_batteryType m182 : 59|3@1+ (1,0) [0|7] "" Vector__XXX
 SG_ VCFRONT_a182_bleedFetTestFailure m182 : 62|1@1+ (1,0) [0|1] "" Vector__XXX
 SG_ VCFRONT_a182_weakShort m182 : 63|1@1+ (1,0) [0|1] "" Vector__XXX
 SG_ VCFRONT_a186_noDriveChgCableConX m186 : 16|1@1+ (1,0) [0|1] "" Vector__XXX
 SG_ VCFRONT_a187_vehBusRetryCount m187 : 16|9@1+ (1,0) [0|511] "" Vector__XXX
 SG_ VCFRONT_a187_partyBusRetryCount m187 : 25|9@1+ (1,0) [0|511] "" Vector__XXX
 SG_ VCFRONT_a187_hvsBusRetryCount m187 : 34|9@1+ (1,0) [0|511] "" Vector__XXX
 SG_ VCFRONT_a187_ethBusRetryCount m187 : 43|9@1+ (1,0) [0|511] "" Vector__XXX
 SG_ VCFRONT_a187_chBusRetryCount m187 : 52|9@1+ (1,0) [0|511] "" Vector__XXX
 SG_ VCFRONT_a188_sleepBypassCurrent m188 : 16|8@1+ (0.2,0) [0|51] "" Vector__XXX
 SG_ VCFRONT_a188_IBSCurrent m188 : 24|12@1- (0.02,0) [-40.96|40.94] "" Vector__XXX
 SG_ VCFRONT_a188_vehicleState m188 : 36|5@1+ (1,0) [0|31] "" Vector__XXX
 SG_ VCFRONT_a188_timeNotSleeping m188 : 41|6@1+ (1,0) [0|63] "" Vector__XXX
 SG_ VCFRONT_a188_chargeRequest m188 : 47|1@1+ (1,0) [0|1] "" Vector__XXX
 SG_ VCFRONT_a188_12VSupport m188 : 48|1@1+ (1,0) [0|1] "" Vector__XXX
 SG_ VCFRONT_a188_ThermalSupport m188 : 49|1@1+ (1,0) [0|1] "" Vector__XXX
 SG_ VCFRONT_a188_accessoryRequest m188 : 50|1@1+ (1,0) [0|1] "" Vector__XXX
 SG_ VCFRONT_a188_CANAfterQuiet m188 : 51|1@1+ (1,0) [0|1] "" Vector__XXX
 SG_ VCFRONT_a188_SleepRequestTimeout m188 : 52|1@1+ (1,0) [0|1] "" Vector__XXX
 SG_ VCFRONT_a188_wakeUpMsgID m188 : 53|11@1+ (1,0) [0|2047] "" Vector__XXX
 SG_ VCFRONT_a191_vehiclePowerState m191 : 16|2@1+ (1,0) [0|3] "" Vector__XXX
 SG_ VCFRONT_a191_hvState m191 : 18|3@1+ (1,0) [0|7] "" Vector__XXX
 SG_ VCFRONT_a191_reverseBatteryEFuse m191 : 21|1@1+ (1,0) [0|1] "" Vector__XXX
 SG_ VCFRONT_a191_vehicleLoadShedActi m191 : 22|1@1+ (1,0) [0|1] "" Vector__XXX
 SG_ VCFRONT_a191_vehicleLoadShedHvFa m191 : 23|1@1+ (1,0) [0|1] "" Vector__XXX
 SG_ VCFRONT_a191_vehicleLoadShedPost m191 : 24|1@1+ (1,0) [0|1] "" Vector__XXX
 SG_ VCFRONT_a191_IBSVoltage m191 : 25|8@1+ (0.08741903,0) [0|22.29185265] "" Vector__XXX
 SG_ VCFRONT_a191_a180_DCDCNotSupport m191 : 33|1@1+ (1,0) [0|1] "" Vector__XXX
 SG_ VCFRONT_a191_MOSState m191 : 34|2@1+ (1,0) [0|3] "" Vector__XXX
 SG_ VCFRONT_a191_LVBMSVoltage m191 : 36|8@1+ (0.08741903,0) [0|22.29185265] "" Vector__XXX
 SG_ VCFRONT_a191_ECPAState m191 : 44|2@1+ (1,0) [0|3] "" Vector__XXX
 SG_ VCFRONT_a191_LVBMSCurrentTargetV m191 : 46|1@1+ (1,0) [0|1] "" Vector__XXX
 SG_ VCFRONT_a191_LVBMSVoltageTargetV m191 : 47|1@1+ (1,0) [0|1] "" Vector__XXX
 SG_ VCFRONT_a191_serviceMode m191 : 48|1@1+ (1,0) [0|1] "" Vector__XXX
 SG_ VCFRONT_a191_frunkOpen m191 : 49|1@1+ (1,0) [0|1] "" Vector__XXX
 SG_ VCFRONT_a191_vehicleLoadShedStag m191 : 50|2@1+ (1,0) [0|3] "" Vector__XXX
 SG_ VCFRONT_a191_exitDriveWarningTim m191 : 52|1@1+ (1,0) [0|1] "" Vector__XXX
 SG_ VCFRONT_a191_LVBMSMIA m191 : 53|1@1+ (1,0) [0|1] "" Vector__XXX
 SG_ VCFRONT_a191_PCS_MIA m191 : 54|1@1+ (1,0) [0|1] "" Vector__XXX
 SG_ VCFRONT_a191_NotEnoughPowerForSu m191 : 55|1@1+ (1,0) [0|1] "" Vector__XXX
 SG_ VCFRONT_a191_bmsState m191 : 56|4@1+ (1,0) [0|15] "" Vector__XXX
 SG_ VCFRONT_a192_vehiclePowerState m192 : 16|2@1+ (1,0) [0|3] "" Vector__XXX
 SG_ VCFRONT_a192_hvState m192 : 18|3@1+ (1,0) [0|7] "" Vector__XXX
 SG_ VCFRONT_a192_notEnoughPowerForSu m192 : 21|1@1+ (1,0) [0|1] "" Vector__XXX
 SG_ VCFRONT_a192_pcsEFuseStable m192 : 22|1@1+ (1,0) [0|1] "" Vector__XXX
 SG_ VCFRONT_a192_vcrightEFuseStable m192 : 23|1@1+ (1,0) [0|1] "" Vector__XXX
 SG_ VCFRONT_a192_contactorEFuseStabl m192 : 24|1@1+ (1,0) [0|1] "" Vector__XXX
 SG_ VCFRONT_a192_hvcEFuseStable m192 : 25|1@1+ (1,0) [0|1] "" Vector__XXX
 SG_ VCFRONT_a192_replaceLVBattery m192 : 26|1@1+ (1,0) [0|1] "" Vector__XXX
 SG_ VCFRONT_a192_BMS_MIA m192 : 27|1@1+ (1,0) [0|1] "" Vector__XXX
 SG_ VCFRONT_a192_PCS_MIA m192 : 28|1@1+ (1,0) [0|1] "" Vector__XXX
 SG_ VCFRONT_a192_HVBlockingMismatch m192 : 29|1@1+ (1,0) [0|1] "" Vector__XXX
 SG_ VCFRONT_a192_disconnected12V m192 : 30|1@1+ (1,0) [0|1] "" Vector__XXX
 SG_ VCFRONT_a192_LVBatteryCannotSupp m192 : 31|1@1+ (1,0) [0|1] "" Vector__XXX
 SG_ VCFRONT_a192_DI_gear m192 : 32|3@1+ (1,0) [0|7] "" Vector__XXX
 SG_ VCFRONT_a192_GTW_factoryGated m192 : 35|1@1+ (1,0) [0|1] "" Vector__XXX
 SG_ VCFRONT_a192_GTW_updateStarted m192 : 36|1@1+ (1,0) [0|1] "" Vector__XXX
 SG_ VCFRONT_a192_serviceMode m192 : 37|1@1+ (1,0) [0|1] "" Vector__XXX
 SG_ VCFRONT_a192_frunkOpen m192 : 38|1@1+ (1,0) [0|1] "" Vector__XXX
 SG_ VCFRONT_a192_IBSCurrent m192 : 40|8@1+ (0.5,-63) [-63|64.5] "" Vector__XXX
 SG_ VCFRONT_a192_PCSCurrent m192 : 48|8@1+ (0.5,-127) [-127|0.5] "" Vector__XXX
 SG_ VCFRONT_a192_HVFaultLoadShedActi m192 : 56|1@1+ (1,0) [0|1] "" Vector__XXX
 SG_ VCFRONT_a192_postCrashLoadShedAc m192 : 57|1@1+ (1,0) [0|1] "" Vector__XXX
 SG_ VCFRONT_a195_IBSVoltage m195 : 16|12@1+ (0.005443676,0) [0|22.29185322] "" Vector__XXX
 SG_ VCFRONT_a195_serviceMode m195 : 28|1@1+ (1,0) [0|1] "" Vector__XXX
 SG_ VCFRONT_a195_frunkOpen m195 : 29|1@1+ (1,0) [0|1] "" Vector__XXX
 SG_ VCFRONT_a196_factoryMode m196 : 16|1@1+ (1,0) [0|1] "" Vector__XXX
 SG_ VCFRONT_a196_serviceMode m196 : 17|1@1+ (1,0) [0|1] "" Vector__XXX
 SG_ VCFRONT_a196_transportMode m196 : 18|1@1+ (1,0) [0|1] "" Vector__XXX
 SG_ VCFRONT_a196_frunkOpen m196 : 19|1@1+ (1,0) [0|1] "" Vector__XXX
 SG_ VCFRONT_a196_vehiclePowerState m196 : 20|2@1+ (1,0) [0|3] "" Vector__XXX
 SG_ VCFRONT_a196_batterySMState m196 : 24|4@1+ (1,0) [0|15] "" Vector__XXX
 SG_ VCFRONT_a196_disconnectedBattery m196 : 28|12@1+ (0.004884005,-10) [-10|10.000000475] "" Vector__XXX
 SG_ VCFRONT_a196_disconnectedBa_0002 m196 : 40|8@1+ (0.0392156876624,6) [6|16.0000003539] "" Vector__XXX
 SG_ VCFRONT_a196_disconnectedBa_0001 m196 : 48|8@1+ (0.0392156876624,6) [6|16.0000003539] "" Vector__XXX
 SG_ VCFRONT_a196_ECPAState m196 : 56|2@1+ (1,0) [0|3] "" Vector__XXX
 SG_ VCFRONT_a198_outputState m198 : 16|1@1+ (1,0) [0|1] "" Vector__XXX
 SG_ VCFRONT_a198_NVRAMState m198 : 17|1@1+ (1,0) [0|1] "" Vector__XXX
 SG_ VCFRONT_a198_lockoutState m198 : 18|1@1+ (1,0) [0|1] "" Vector__XXX
 SG_ VCFRONT_a199_outputState m199 : 16|1@1+ (1,0) [0|1] "" Vector__XXX
 SG_ VCFRONT_a199_NVRAMState m199 : 17|1@1+ (1,0) [0|1] "" Vector__XXX
 SG_ VCFRONT_a199_lockoutState m199 : 18|1@1+ (1,0) [0|1] "" Vector__XXX
 SG_ VCFRONT_a200_vcleftSelfTest m200 : 16|4@1+ (1,0) [0|15] "" Vector__XXX
 SG_ VCFRONT_a201_vcrightSelfTest m201 : 16|4@1+ (1,0) [0|15] "" Vector__XXX
 SG_ VCFRONT_a202_pcsSelfTest m202 : 16|4@1+ (1,0) [0|15] "" Vector__XXX
 SG_ VCFRONT_a207_vbatFusedSelfTest m207 : 16|4@1+ (1,0) [0|15] "" Vector__XXX
 SG_ VCFRONT_a210_valveUnderTravel m210 : 16|1@1+ (1,0) [0|1] "" Vector__XXX
 SG_ VCFRONT_a210_valveOverTravel m210 : 17|1@1+ (1,0) [0|1] "" Vector__XXX
 SG_ VCFRONT_a210_valveNoTravel m210 : 18|1@1+ (1,0) [0|1] "" Vector__XXX
 SG_ VCFRONT_a212_IBSTemp m212 : 16|16@1- (0.01,0) [-327.68|327.67] "" Vector__XXX
 SG_ VCFRONT_a213_IBSVolts m213 : 16|12@1+ (0.005443676,0) [0|22.29185322] "" Vector__XXX
 SG_ VCFRONT_a213_IBSAh m213 : 32|14@1- (0.01,0) [-81.92|81.91] "" Vector__XXX
 SG_ VCFRONT_a213_LVBatteryTemp m213 : 48|16@1- (0.01,0) [-327.68|327.67] "" Vector__XXX
 SG_ VCFRONT_a214_motorFaulted m214 : 16|1@1+ (1,0) [0|1] "" Vector__XXX
 SG_ VCFRONT_a214_motorLocked m214 : 17|1@1+ (1,0) [0|1] "" Vector__XXX
 SG_ VCFRONT_a214_ecuReset m214 : 18|1@1+ (1,0) [0|1] "" Vector__XXX
 SG_ VCFRONT_a214_fetTempIrrational m214 : 19|1@1+ (1,0) [0|1] "" Vector__XXX
 SG_ VCFRONT_a214_motorControlError m214 : 20|1@1+ (1,0) [0|1] "" Vector__XXX
 SG_ VCFRONT_a214_underVoltage m214 : 21|1@1+ (1,0) [0|1] "" Vector__XXX
 SG_ VCFRONT_a214_overVoltage m214 : 22|1@1+ (1,0) [0|1] "" Vector__XXX
 SG_ VCFRONT_a214_hardwareOvercurrent m214 : 23|1@1+ (1,0) [0|1] "" Vector__XXX
 SG_ VCFRONT_a214_motorOpenPhase m214 : 24|1@1+ (1,0) [0|1] "" Vector__XXX
 SG_ VCFRONT_a214_motorSoftOpenPhase m214 : 25|1@1+ (1,0) [0|1] "" Vector__XXX
 SG_ VCFRONT_a214_motorOvertemp m214 : 26|1@1+ (1,0) [0|1] "" Vector__XXX
 SG_ VCFRONT_a214_dcOvercurrent m214 : 27|1@1+ (1,0) [0|1] "" Vector__XXX
 SG_ VCFRONT_a214_motorStalled m214 : 28|1@1+ (1,0) [0|1] "" Vector__XXX
 SG_ VCFRONT_a214_selfTestFailed m214 : 29|1@1+ (1,0) [0|1] "" Vector__XXX
 SG_ VCFRONT_a214_selfTestResult m214 : 32|3@1+ (1,0) [0|7] "" Vector__XXX
 SG_ VCFRONT_a214_linChecksumError m214 : 35|1@1+ (1,0) [0|1] "" Vector__XXX
 SG_ VCFRONT_a214_linFramingError m214 : 36|1@1+ (1,0) [0|1] "" Vector__XXX
 SG_ VCFRONT_a214_phaseShorted m214 : 37|1@1+ (1,0) [0|1] "" Vector__XXX
 SG_ VCFRONT_a214_busVoltageIrrationa m214 : 38|1@1+ (1,0) [0|1] "" Vector__XXX
 SG_ VCFRONT_a214_dcCurrentIrrational m214 : 39|1@1+ (1,0) [0|1] "" Vector__XXX
 SG_ VCFRONT_a214_motorSpeedIrrationa m214 : 40|1@1+ (1,0) [0|1] "" Vector__XXX
 SG_ VCFRONT_a214_supplyVoltageIrrati m214 : 41|1@1+ (1,0) [0|1] "" Vector__XXX
 SG_ VCFRONT_a214_motorPhaseCurrentIr m214 : 42|1@1+ (1,0) [0|1] "" Vector__XXX
 SG_ VCFRONT_a214_chipOvertemp m214 : 43|1@1+ (1,0) [0|1] "" Vector__XXX
 SG_ VCFRONT_a214_motorSpeedTooHigh m214 : 44|1@1+ (1,0) [0|1] "" Vector__XXX
 SG_ VCFRONT_a214_phaseOvercurrent m214 : 45|1@1+ (1,0) [0|1] "" Vector__XXX
 SG_ VCFRONT_a214_vddaOvercurrent m214 : 46|1@1+ (1,0) [0|1] "" Vector__XXX
 SG_ VCFRONT_a214_busVoltageUnhealthy m214 : 47|1@1+ (1,0) [0|1] "" Vector__XXX
 SG_ VCFRONT_a214_hsVdsOvervoltage m214 : 48|1@1+ (1,0) [0|1] "" Vector__XXX
 SG_ VCFRONT_a214_hsVdsOvervoltageMas m214 : 49|3@1+ (1,0) [0|7] "" Vector__XXX
 SG_ VCFRONT_a214_lsVdsOvervoltage m214 : 52|1@1+ (1,0) [0|1] "" Vector__XXX
 SG_ VCFRONT_a214_lsVdsOvervoltageMas m214 : 53|3@1+ (1,0) [0|7] "" Vector__XXX
 SG_ VCFRONT_a214_payloadBitsNotSet m214 : 56|1@1+ (1,0) [0|1] "" Vector__XXX
 SG_ VCFRONT_a216_inDrive m216 : 16|1@1+ (1,0) [0|1] "" Vector__XXX
 SG_ VCFRONT_a216_hvState m216 : 17|3@1+ (1,0) [0|7] "" Vector__XXX
 SG_ VCFRONT_a216_vcleftFastBlowImmin m216 : 20|1@1+ (1,0) [0|1] "" Vector__XXX
 SG_ VCFRONT_a216_vcleftFastBlowDebou m216 : 21|1@1+ (1,0) [0|1] "" Vector__XXX
 SG_ VCFRONT_a216_vcleftStaticImminen m216 : 22|1@1+ (1,0) [0|1] "" Vector__XXX
 SG_ VCFRONT_a216_vcleftDynamicImmine m216 : 23|1@1+ (1,0) [0|1] "" Vector__XXX
 SG_ VCFRONT_a216_vcrightFastBlowImmi m216 : 24|1@1+ (1,0) [0|1] "" Vector__XXX
 SG_ VCFRONT_a216_vcrightFastBlowDebo m216 : 25|1@1+ (1,0) [0|1] "" Vector__XXX
 SG_ VCFRONT_a216_vcrightStaticImmine m216 : 26|1@1+ (1,0) [0|1] "" Vector__XXX
 SG_ VCFRONT_a216_vcrightDynamicImmin m216 : 27|1@1+ (1,0) [0|1] "" Vector__XXX
 SG_ VCFRONT_a217_motorFaulted m217 : 16|1@1+ (1,0) [0|1] "" Vector__XXX
 SG_ VCFRONT_a217_motorLocked m217 : 17|1@1+ (1,0) [0|1] "" Vector__XXX
 SG_ VCFRONT_a217_ecuReset m217 : 18|1@1+ (1,0) [0|1] "" Vector__XXX
 SG_ VCFRONT_a217_fetTempIrrational m217 : 19|1@1+ (1,0) [0|1] "" Vector__XXX
 SG_ VCFRONT_a217_motorControlError m217 : 20|1@1+ (1,0) [0|1] "" Vector__XXX
 SG_ VCFRONT_a217_underVoltage m217 : 21|1@1+ (1,0) [0|1] "" Vector__XXX
 SG_ VCFRONT_a217_overVoltage m217 : 22|1@1+ (1,0) [0|1] "" Vector__XXX
 SG_ VCFRONT_a217_hardwareOvercurrent m217 : 23|1@1+ (1,0) [0|1] "" Vector__XXX
 SG_ VCFRONT_a217_motorOpenPhase m217 : 24|1@1+ (1,0) [0|1] "" Vector__XXX
 SG_ VCFRONT_a217_motorSoftOpenPhase m217 : 25|1@1+ (1,0) [0|1] "" Vector__XXX
 SG_ VCFRONT_a217_motorOvertemp m217 : 26|1@1+ (1,0) [0|1] "" Vector__XXX
 SG_ VCFRONT_a217_dcOvercurrent m217 : 27|1@1+ (1,0) [0|1] "" Vector__XXX
 SG_ VCFRONT_a217_motorStalled m217 : 28|1@1+ (1,0) [0|1] "" Vector__XXX
 SG_ VCFRONT_a217_selfTestFailed m217 : 29|1@1+ (1,0) [0|1] "" Vector__XXX
 SG_ VCFRONT_a217_selfTestResult m217 : 32|3@1+ (1,0) [0|7] "" Vector__XXX
 SG_ VCFRONT_a217_linChecksumError m217 : 35|1@1+ (1,0) [0|1] "" Vector__XXX
 SG_ VCFRONT_a217_linFramingError m217 : 36|1@1+ (1,0) [0|1] "" Vector__XXX
 SG_ VCFRONT_a217_phaseShorted m217 : 37|1@1+ (1,0) [0|1] "" Vector__XXX
 SG_ VCFRONT_a217_busVoltageIrrationa m217 : 38|1@1+ (1,0) [0|1] "" Vector__XXX
 SG_ VCFRONT_a217_dcCurrentIrrational m217 : 39|1@1+ (1,0) [0|1] "" Vector__XXX
 SG_ VCFRONT_a217_motorSpeedIrrationa m217 : 40|1@1+ (1,0) [0|1] "" Vector__XXX
 SG_ VCFRONT_a217_supplyVoltageIrrati m217 : 41|1@1+ (1,0) [0|1] "" Vector__XXX
 SG_ VCFRONT_a217_motorPhaseCurrentIr m217 : 42|1@1+ (1,0) [0|1] "" Vector__XXX
 SG_ VCFRONT_a217_chipOvertemp m217 : 43|1@1+ (1,0) [0|1] "" Vector__XXX
 SG_ VCFRONT_a217_motorSpeedTooHigh m217 : 44|1@1+ (1,0) [0|1] "" Vector__XXX
 SG_ VCFRONT_a217_phaseOvercurrent m217 : 45|1@1+ (1,0) [0|1] "" Vector__XXX
 SG_ VCFRONT_a217_vddaOvercurrent m217 : 46|1@1+ (1,0) [0|1] "" Vector__XXX
 SG_ VCFRONT_a217_busVoltageUnhealthy m217 : 47|1@1+ (1,0) [0|1] "" Vector__XXX
 SG_ VCFRONT_a217_hsVdsOvervoltage m217 : 48|1@1+ (1,0) [0|1] "" Vector__XXX
 SG_ VCFRONT_a217_hsVdsOvervoltageMas m217 : 49|3@1+ (1,0) [0|7] "" Vector__XXX
 SG_ VCFRONT_a217_lsVdsOvervoltage m217 : 52|1@1+ (1,0) [0|1] "" Vector__XXX
 SG_ VCFRONT_a217_lsVdsOvervoltageMas m217 : 53|3@1+ (1,0) [0|7] "" Vector__XXX
 SG_ VCFRONT_a217_payloadBitsNotSet m217 : 56|1@1+ (1,0) [0|1] "" Vector__XXX
 SG_ VCFRONT_a219_IBSVolts m219 : 16|12@1+ (0.005443676,0) [0|22.29185322] "" Vector__XXX
 SG_ VCFRONT_a219_IBSAh m219 : 32|14@1- (0.01,0) [-81.92|81.91] "" Vector__XXX
 SG_ VCFRONT_a219_IBSCurrent m219 : 48|16@1- (0.005,0) [-163.84|163.835] "" Vector__XXX
 SG_ VCFRONT_a220_IBSCurrent m220 : 16|16@1- (0.005,0) [-163.84|163.835] "" Vector__XXX
 SG_ VCFRONT_a220_PCSCurrent m220 : 32|8@1+ (0.5,-127) [-127|0.5] "" Vector__XXX
 SG_ VCFRONT_a220_serviceMode m220 : 40|1@1+ (1,0) [0|1] "" Vector__XXX
 SG_ VCFRONT_a220_frunkOpen m220 : 41|1@1+ (1,0) [0|1] "" Vector__XXX
 SG_ VCFRONT_a221_outputFaulted m221 : 16|1@1+ (1,0) [0|1] "" Vector__XXX
 SG_ VCFRONT_a221_currentSenseFaulted m221 : 17|1@1+ (1,0) [0|1] "" Vector__XXX
 SG_ VCFRONT_a221_tempSenseFaulted m221 : 18|1@1+ (1,0) [0|1] "" Vector__XXX
 SG_ VCFRONT_a221_underCurrent m221 : 19|1@1+ (1,0) [0|1] "" Vector__XXX
 SG_ VCFRONT_a221_overCurrent m221 : 20|1@1+ (1,0) [0|1] "" Vector__XXX
 SG_ VCFRONT_a221_overTemperature m221 : 21|1@1+ (1,0) [0|1] "" Vector__XXX
 SG_ VCFRONT_a222_outputFaulted m222 : 16|1@1+ (1,0) [0|1] "" Vector__XXX
 SG_ VCFRONT_a222_currentSenseFaulted m222 : 17|1@1+ (1,0) [0|1] "" Vector__XXX
 SG_ VCFRONT_a222_tempSenseFaulted m222 : 18|1@1+ (1,0) [0|1] "" Vector__XXX
 SG_ VCFRONT_a222_underCurrent m222 : 19|1@1+ (1,0) [0|1] "" Vector__XXX
 SG_ VCFRONT_a222_overCurrent m222 : 20|1@1+ (1,0) [0|1] "" Vector__XXX
 SG_ VCFRONT_a222_overTemperature m222 : 21|1@1+ (1,0) [0|1] "" Vector__XXX
 SG_ VCFRONT_a223_12VTemperature m223 : 16|16@1- (0.1,0) [-3276.8|3276.7] "" Vector__XXX
 SG_ VCFRONT_a227_motorFaulted m227 : 16|1@1+ (1,0) [0|1] "" Vector__XXX
 SG_ VCFRONT_a227_motorLocked m227 : 17|1@1+ (1,0) [0|1] "" Vector__XXX
 SG_ VCFRONT_a227_ecuReset m227 : 18|1@1+ (1,0) [0|1] "" Vector__XXX
 SG_ VCFRONT_a227_fetTempIrrational m227 : 19|1@1+ (1,0) [0|1] "" Vector__XXX
 SG_ VCFRONT_a227_motorControlError m227 : 20|1@1+ (1,0) [0|1] "" Vector__XXX
 SG_ VCFRONT_a227_underVoltage m227 : 21|1@1+ (1,0) [0|1] "" Vector__XXX
 SG_ VCFRONT_a227_overVoltage m227 : 22|1@1+ (1,0) [0|1] "" Vector__XXX
 SG_ VCFRONT_a227_hardwareOvercurrent m227 : 23|1@1+ (1,0) [0|1] "" Vector__XXX
 SG_ VCFRONT_a227_motorOpenPhase m227 : 24|1@1+ (1,0) [0|1] "" Vector__XXX
 SG_ VCFRONT_a227_motorSoftOpenPhase m227 : 25|1@1+ (1,0) [0|1] "" Vector__XXX
 SG_ VCFRONT_a227_motorOvertemp m227 : 26|1@1+ (1,0) [0|1] "" Vector__XXX
 SG_ VCFRONT_a227_dcOvercurrent m227 : 27|1@1+ (1,0) [0|1] "" Vector__XXX
 SG_ VCFRONT_a227_motorStalled m227 : 28|1@1+ (1,0) [0|1] "" Vector__XXX
 SG_ VCFRONT_a227_selfTestFailed m227 : 29|1@1+ (1,0) [0|1] "" Vector__XXX
 SG_ VCFRONT_a227_selfTestResult m227 : 32|3@1+ (1,0) [0|7] "" Vector__XXX
 SG_ VCFRONT_a227_linChecksumError m227 : 35|1@1+ (1,0) [0|1] "" Vector__XXX
 SG_ VCFRONT_a227_linFramingError m227 : 36|1@1+ (1,0) [0|1] "" Vector__XXX
 SG_ VCFRONT_a227_phaseShorted m227 : 37|1@1+ (1,0) [0|1] "" Vector__XXX
 SG_ VCFRONT_a227_busVoltageIrrationa m227 : 38|1@1+ (1,0) [0|1] "" Vector__XXX
 SG_ VCFRONT_a227_dcCurrentIrrational m227 : 39|1@1+ (1,0) [0|1] "" Vector__XXX
 SG_ VCFRONT_a227_motorSpeedIrrationa m227 : 40|1@1+ (1,0) [0|1] "" Vector__XXX
 SG_ VCFRONT_a227_supplyVoltageIrrati m227 : 41|1@1+ (1,0) [0|1] "" Vector__XXX
 SG_ VCFRONT_a227_motorPhaseCurrentIr m227 : 42|1@1+ (1,0) [0|1] "" Vector__XXX
 SG_ VCFRONT_a227_chipOvertemp m227 : 43|1@1+ (1,0) [0|1] "" Vector__XXX
 SG_ VCFRONT_a227_motorSpeedTooHigh m227 : 44|1@1+ (1,0) [0|1] "" Vector__XXX
 SG_ VCFRONT_a227_phaseOvercurrent m227 : 45|1@1+ (1,0) [0|1] "" Vector__XXX
 SG_ VCFRONT_a227_vddaOvercurrent m227 : 46|1@1+ (1,0) [0|1] "" Vector__XXX
 SG_ VCFRONT_a227_busVoltageUnhealthy m227 : 47|1@1+ (1,0) [0|1] "" Vector__XXX
 SG_ VCFRONT_a227_hsVdsOvervoltage m227 : 48|1@1+ (1,0) [0|1] "" Vector__XXX
 SG_ VCFRONT_a227_hsVdsOvervoltageMas m227 : 49|3@1+ (1,0) [0|7] "" Vector__XXX
 SG_ VCFRONT_a227_lsVdsOvervoltage m227 : 52|1@1+ (1,0) [0|1] "" Vector__XXX
 SG_ VCFRONT_a227_lsVdsOvervoltageMas m227 : 53|3@1+ (1,0) [0|7] "" Vector__XXX
 SG_ VCFRONT_a227_payloadBitsNotSet m227 : 56|1@1+ (1,0) [0|1] "" Vector__XXX
 SG_ VCFRONT_a231_12VTemperature m231 : 16|16@1- (0.1,0) [-3276.8|3276.7] "" Vector__XXX
 SG_ VCFRONT_a233_current m233 : 16|10@1+ (0.1,0) [0|102.3] "" Vector__XXX
 SG_ VCFRONT_a234_current m234 : 16|10@1+ (0.1,0) [0|102.3] "" Vector__XXX
 SG_ VCFRONT_a235_ptSensorTemp m235 : 16|11@1+ (0.125,-40) [-40|215.875] "" Vector__XXX
 SG_ VCFRONT_a236_batSensorTemp m236 : 16|11@1+ (0.125,-40) [-40|215.875] "" Vector__XXX
 SG_ VCFRONT_a242_LVBatteryTemp m242 : 16|7@1+ (1,-40) [-40|87] "" Vector__XXX
 SG_ VCFRONT_a242_IBSCurrent m242 : 24|12@1- (0.1,0) [-204.8|204.7] "" Vector__XXX
 SG_ VCFRONT_a242_IBSVoltage m242 : 36|11@1+ (0.0108873518184,0) [0|22.2864091723] "" Vector__XXX
 SG_ VCFRONT_a242_IBSAmpHours m242 : 48|8@1+ (0.01,-2.55) [-2.55|4.4408920985e-16] "" Vector__XXX
 SG_ VCFRONT_a242_vehiclePowerState m242 : 56|2@1+ (1,0) [0|3] "" Vector__XXX
 SG_ VCFRONT_a243_IBSVolts m243 : 16|12@1+ (0.005443676,0) [0|22.29185322] "" Vector__XXX
 SG_ VCFRONT_a243_IBSCurrent m243 : 32|16@1- (0.005,0) [-163.84|163.835] "" Vector__XXX
 SG_ VCFRONT_a243_LVBatteryTemp m243 : 48|16@1- (0.01,0) [-327.68|327.67] "" Vector__XXX
 SG_ VCFRONT_a244_current m244 : 16|16@1+ (0.1,0) [0|6553.5] "" Vector__XXX
 SG_ VCFRONT_a244_voltage m244 : 32|16@1+ (0.1,0) [0|6553.5] "" Vector__XXX
 SG_ VCFRONT_a244_vbatProtVoltage m244 : 48|16@1+ (0.1,0) [0|6553.5] "" Vector__XXX
 SG_ VCFRONT_a245_current m245 : 16|16@1+ (0.1,0) [0|6553.5] "" Vector__XXX
 SG_ VCFRONT_a245_voltage m245 : 32|16@1+ (0.1,0) [0|6553.5] "" Vector__XXX
 SG_ VCFRONT_a245_eFuseRemainingRetri m245 : 48|4@1+ (1,0) [0|15] "" Vector__XXX
 SG_ VCFRONT_a246_current m246 : 16|16@1+ (0.1,0) [0|6553.5] "" Vector__XXX
 SG_ VCFRONT_a246_voltage m246 : 32|16@1+ (0.1,0) [0|6553.5] "" Vector__XXX
 SG_ VCFRONT_a246_eFuseRemainingRetri m246 : 48|4@1+ (1,0) [0|15] "" Vector__XXX
 SG_ VCFRONT_a247_solenoidISense m247 : 16|8@1- (0.01,0) [-1.28|1.27] "" Vector__XXX
 SG_ VCFRONT_a248_AS8510Voltage m248 : 16|12@1+ (0.005443676,0) [0|22.29185322] "" Vector__XXX
 SG_ VCFRONT_a248_IBSVoltage m248 : 28|12@1+ (0.005443676,0) [0|22.29185322] "" Vector__XXX
 SG_ VCFRONT_a248_vbatMonitor m248 : 40|12@1+ (0.005443676,0) [0|22.29185322] "" Vector__XXX
 SG_ VCFRONT_a248_voltageCalScaling m248 : 52|12@1+ (0.025,0) [0|102.375] "" Vector__XXX
 SG_ VCFRONT_a249_tempCoolantBatInlet m249 : 16|10@1+ (0.125,-40) [-40|87.875] "" Vector__XXX
 SG_ VCFRONT_a249_tempCoolantPTInlet m249 : 26|11@1+ (0.125,-40) [-40|215.875] "" Vector__XXX
 SG_ VCFRONT_a250_isGlobalHeadlamps m250 : 16|1@1+ (1,0) [0|1] "" Vector__XXX
 SG_ VCFRONT_a250_isVirtualPitchSenso m250 : 17|1@1+ (1,0) [0|1] "" Vector__XXX
 SG_ VCFRONT_a250_isAimedHCML m250 : 18|1@1+ (1,0) [0|1] "" Vector__XXX
 SG_ VCFRONT_a250_isAimedHCMR m250 : 19|1@1+ (1,0) [0|1] "" Vector__XXX
 SG_ VCFRONT_a250_calibratedVerticalP m250 : 20|10@1+ (1,0) [0|1023] "" Vector__XXX
 SG_ VCFRONT_a250_calibratedVert_0001 m250 : 30|10@1+ (1,0) [0|1023] "" Vector__XXX
 SG_ VCFRONT_a250_calibratedHorizonta m250 : 40|10@1+ (1,0) [0|1023] "" Vector__XXX
 SG_ VCFRONT_a250_calibratedHori_0001 m250 : 50|10@1+ (1,0) [0|1023] "" Vector__XXX
 SG_ VCFRONT_a253_currentNotTapered m253 : 16|1@1+ (1,0) [0|1] "" Vector__XXX
 SG_ VCFRONT_a253_ampHourTargetNotRea m253 : 17|1@1+ (1,0) [0|1] "" Vector__XXX
 SG_ VCFRONT_a253_IBSCurrent m253 : 18|16@1- (0.005,0) [-163.84|163.835] "" Vector__XXX
 SG_ VCFRONT_a253_IBSAmpHours m253 : 34|14@1- (0.01,0) [-81.92|81.91] "" Vector__XXX
 SG_ VCFRONT_a253_LVBatteryTemp m253 : 48|7@1+ (1,-40) [-40|87] "" Vector__XXX
 SG_ VCFRONT_a253_firstChargeOTA m253 : 55|1@1+ (1,0) [0|1] "" Vector__XXX
 SG_ VCFRONT_a253_firstChargePOR m253 : 56|1@1+ (1,0) [0|1] "" Vector__XXX
 SG_ VCFRONT_a253_serviceMode m253 : 57|1@1+ (1,0) [0|1] "" Vector__XXX
 SG_ VCFRONT_a253_frunkOpen m253 : 58|1@1+ (1,0) [0|1] "" Vector__XXX
 SG_ VCFRONT_a254_RPMActual m254 : 16|10@1+ (10,0) [0|10230] "" Vector__XXX
 SG_ VCFRONT_a254_RPMTarget m254 : 26|10@1+ (10,0) [0|10230] "" Vector__XXX
 SG_ VCFRONT_a255_RPMActual m255 : 16|10@1+ (10,0) [0|10230] "" Vector__XXX
 SG_ VCFRONT_a255_RPMTarget m255 : 26|10@1+ (10,0) [0|10230] "" Vector__XXX
 SG_ VCFRONT_a257_lockoutVoltage m257 : 16|16@1+ (0.1,0) [0|6553.5] "" Vector__XXX
 SG_ VCFRONT_a257_vcrightLockoutStatu m257 : 32|2@1+ (1,0) [0|3] "" Vector__XXX
 SG_ VCFRONT_a257_vcleftFault m257 : 34|1@1+ (1,0) [0|1] "" Vector__XXX
 SG_ VCFRONT_a257_vcrightFault m257 : 35|1@1+ (1,0) [0|1] "" Vector__XXX
 SG_ VCFRONT_a257_pcsFault m257 : 36|1@1+ (1,0) [0|1] "" Vector__XXX
 SG_ VCFRONT_a257_vbatFusedFault m257 : 37|1@1+ (1,0) [0|1] "" Vector__XXX
 SG_ VCFRONT_a257_iBoosterFault m257 : 38|1@1+ (1,0) [0|1] "" Vector__XXX
 SG_ VCFRONT_a257_espFault m257 : 39|1@1+ (1,0) [0|1] "" Vector__XXX
 SG_ VCFRONT_a257_epas3pFault m257 : 40|1@1+ (1,0) [0|1] "" Vector__XXX
 SG_ VCFRONT_a257_epas3sFault m257 : 41|1@1+ (1,0) [0|1] "" Vector__XXX
 SG_ VCFRONT_a257_revBattFault m257 : 42|1@1+ (1,0) [0|1] "" Vector__XXX
 SG_ VCFRONT_a257_vehicleState m257 : 43|5@1+ (1,0) [0|31] "" Vector__XXX
 SG_ VCFRONT_a259_serviceMode m259 : 16|1@1+ (1,0) [0|1] "" Vector__XXX
 SG_ VCFRONT_a259_voltageDropCounter m259 : 17|3@1+ (2,0) [0|14] "" Vector__XXX
 SG_ VCFRONT_a259_minVoltageReached m259 : 20|12@1+ (0.005443676,0) [0|22.29185322] "" Vector__XXX
 SG_ VCFRONT_a259_IBSTemp m259 : 32|16@1- (0.01,0) [-327.68|327.67] "" Vector__XXX
 SG_ VCFRONT_a259_maxCurrentReached m259 : 48|16@1- (0.005,0) [-163.84|163.835] "" Vector__XXX
 SG_ VCFRONT_a260_IBSVolts m260 : 16|12@1+ (0.005443676,0) [0|22.29185322] "" Vector__XXX
 SG_ VCFRONT_a260_IBSAh m260 : 28|12@1- (0.1,0) [-204.8|204.7] "" Vector__XXX
 SG_ VCFRONT_a260_vehiclePowerState m260 : 40|2@1+ (1,0) [0|3] "" Vector__XXX
 SG_ VCFRONT_a260_batterySMState m260 : 42|4@1+ (1,0) [0|15] "" Vector__XXX
 SG_ VCFRONT_a260_HV_UP m260 : 46|1@1+ (1,0) [0|1] "" Vector__XXX
 SG_ VCFRONT_a260_notEnoughPowerForSu m260 : 47|1@1+ (1,0) [0|1] "" Vector__XXX
 SG_ VCFRONT_a260_coolantHasBeenFille m260 : 48|1@1+ (1,0) [0|1] "" Vector__XXX
 SG_ VCFRONT_a260_ampHourTrigger m260 : 49|1@1+ (1,0) [0|1] "" Vector__XXX
 SG_ VCFRONT_a260_voltageTrigger m260 : 50|1@1+ (1,0) [0|1] "" Vector__XXX
 SG_ VCFRONT_a260_crashDetected m260 : 51|1@1+ (1,0) [0|1] "" Vector__XXX
 SG_ VCFRONT_a260_BMS_MIA m260 : 52|1@1+ (1,0) [0|1] "" Vector__XXX
 SG_ VCFRONT_a260_PCS_MIA m260 : 53|1@1+ (1,0) [0|1] "" Vector__XXX
 SG_ VCFRONT_a260_HVBlockingMismatch m260 : 54|1@1+ (1,0) [0|1] "" Vector__XXX
 SG_ VCFRONT_a260_serviceMode m260 : 55|1@1+ (1,0) [0|1] "" Vector__XXX
 SG_ VCFRONT_a260_dcdcLVSupportStatus m260 : 56|2@1+ (1,0) [0|3] "" Vector__XXX
 SG_ VCFRONT_a260_PCSAndVCREFuseStabl m260 : 58|1@1+ (1,0) [0|1] "" Vector__XXX
 SG_ VCFRONT_a260_bmsState m260 : 59|4@1+ (1,0) [0|15] "" Vector__XXX
 SG_ VCFRONT_a261_eFuseVoltage m261 : 16|16@1+ (0.1,0) [0|6553.5] "" Vector__XXX
 SG_ VCFRONT_a261_vbatProtVoltage m261 : 32|16@1+ (0.1,0) [0|6553.5] "" Vector__XXX
 SG_ VCFRONT_a262_eFuseVoltage m262 : 16|16@1+ (0.1,0) [0|6553.5] "" Vector__XXX
 SG_ VCFRONT_a262_vbatProtVoltage m262 : 32|16@1+ (0.1,0) [0|6553.5] "" Vector__XXX
 SG_ VCFRONT_a263_eFuseVoltage m263 : 16|16@1+ (0.1,0) [0|6553.5] "" Vector__XXX
 SG_ VCFRONT_a263_vbatProtVoltage m263 : 32|16@1+ (0.1,0) [0|6553.5] "" Vector__XXX
 SG_ VCFRONT_a264_eFuseVoltage m264 : 16|16@1+ (0.1,0) [0|6553.5] "" Vector__XXX
 SG_ VCFRONT_a264_vbatProtVoltage m264 : 32|16@1+ (0.1,0) [0|6553.5] "" Vector__XXX
 SG_ VCFRONT_a265_eFuseVoltage m265 : 16|16@1+ (0.1,0) [0|6553.5] "" Vector__XXX
 SG_ VCFRONT_a265_vbatProtVoltage m265 : 32|16@1+ (0.1,0) [0|6553.5] "" Vector__XXX
 SG_ VCFRONT_a266_eFuseVoltage m266 : 16|16@1+ (0.1,0) [0|6553.5] "" Vector__XXX
 SG_ VCFRONT_a266_vbatProtVoltage m266 : 32|16@1+ (0.1,0) [0|6553.5] "" Vector__XXX
 SG_ VCFRONT_a267_eFuseVoltage m267 : 16|16@1+ (0.1,0) [0|6553.5] "" Vector__XXX
 SG_ VCFRONT_a267_vbatProtVoltage m267 : 32|16@1+ (0.1,0) [0|6553.5] "" Vector__XXX
 SG_ VCFRONT_a268_eFuseVoltage m268 : 16|16@1+ (0.1,0) [0|6553.5] "" Vector__XXX
 SG_ VCFRONT_a268_vbatProtVoltage m268 : 32|16@1+ (0.1,0) [0|6553.5] "" Vector__XXX
 SG_ VCFRONT_a269_LVBatteryTemp m269 : 16|7@1+ (1,-40) [-40|87] "" Vector__XXX
 SG_ VCFRONT_a269_IBSCurrent m269 : 24|12@1- (0.1,0) [-204.8|204.7] "" Vector__XXX
 SG_ VCFRONT_a269_IBSVoltage m269 : 36|11@1+ (0.0108873518184,0) [0|22.2864091723] "" Vector__XXX
 SG_ VCFRONT_a269_IBSAmpHours m269 : 48|8@1+ (0.01,-2.55) [-2.55|4.4408920985e-16] "" Vector__XXX
 SG_ VCFRONT_a269_vehiclePowerState m269 : 56|2@1+ (1,0) [0|3] "" Vector__XXX
 SG_ VCFRONT_a270_prechargeChannel m270 : 16|3@1+ (1,0) [0|7] "" Vector__XXX
 SG_ VCFRONT_a270_sourceVoltage m270 : 19|10@1+ (0.1,0) [0|102.3] "" Vector__XXX
 SG_ VCFRONT_a270_loadVoltage m270 : 29|10@1+ (0.1,0) [0|102.3] "" Vector__XXX
 SG_ VCFRONT_a270_timeout m270 : 40|12@1+ (1,0) [0|4095] "" Vector__XXX
 SG_ VCFRONT_a271_shortedCellTestTrig m271 : 16|1@1+ (1,0) [0|1] "" Vector__XXX
 SG_ VCFRONT_a271_voltDropOnHighCurre m271 : 17|1@1+ (1,0) [0|1] "" Vector__XXX
 SG_ VCFRONT_a271_deadLVMinimalAhDisc m271 : 18|1@1+ (1,0) [0|1] "" Vector__XXX
 SG_ VCFRONT_a271_resistanceEstimatio m271 : 19|1@1+ (1,0) [0|1] "" Vector__XXX
 SG_ VCFRONT_a271_dcrMilliOhmsAboveTh m271 : 20|1@1+ (1,0) [0|1] "" Vector__XXX
 SG_ VCFRONT_a271_prechargeLVLoadRedu m271 : 21|1@1+ (1,0) [0|1] "" Vector__XXX
 SG_ VCFRONT_a271_instantPrechargeDCR m271 : 22|1@1+ (1,0) [0|1] "" Vector__XXX
 SG_ VCFRONT_a279_snsShortCircuit m279 : 16|1@1+ (1,0) [0|1] "" Vector__XXX
 SG_ VCFRONT_a279_snsDisconnect m279 : 17|1@1+ (1,0) [0|1] "" Vector__XXX
 SG_ VCFRONT_a279_snsRateChangeUp m279 : 18|1@1+ (1,0) [0|1] "" Vector__XXX
 SG_ VCFRONT_a279_snsRateChangeDown m279 : 19|1@1+ (1,0) [0|1] "" Vector__XXX
 SG_ VCFRONT_a280_snsShortCircuit m280 : 16|1@1+ (1,0) [0|1] "" Vector__XXX
 SG_ VCFRONT_a280_snsDisconnect m280 : 17|1@1+ (1,0) [0|1] "" Vector__XXX
 SG_ VCFRONT_a280_snsRateChangeUp m280 : 18|1@1+ (1,0) [0|1] "" Vector__XXX
 SG_ VCFRONT_a280_snsRateChangeDown m280 : 19|1@1+ (1,0) [0|1] "" Vector__XXX
 SG_ VCFRONT_a283_thmlFanDisabled m283 : 16|1@1+ (1,0) [0|1] "" Vector__XXX
 SG_ VCFRONT_a283_thmlFanLimited m283 : 17|1@1+ (1,0) [0|1] "" Vector__XXX
 SG_ VCFRONT_a283_thmlFanDemand m283 : 24|7@1+ (1,0) [0|127] "" Vector__XXX
 SG_ VCFRONT_a283_thmlFanDemandLimit m283 : 32|7@1+ (1,0) [0|127] "" Vector__XXX
 SG_ VCFRONT_a283_thmlFanPhaseI m283 : 40|7@1+ (0.25,0) [0|31.75] "" Vector__XXX
 SG_ VCFRONT_a283_thmlFanPhaseILimit m283 : 48|7@1+ (0.25,0) [0|31.75] "" Vector__XXX
 SG_ VCFRONT_a284_driverState m284 : 16|4@1+ (1,0) [0|15] "" Vector__XXX
 SG_ VCFRONT_a284_driverThermWarn m284 : 20|1@1+ (1,0) [0|1] "" Vector__XXX
 SG_ VCFRONT_a284_driverThermShutdown m284 : 21|1@1+ (1,0) [0|1] "" Vector__XXX
 SG_ VCFRONT_a284_undervoltage m284 : 22|1@1+ (1,0) [0|1] "" Vector__XXX
 SG_ VCFRONT_a284_chargePumpUndervolt m284 : 23|1@1+ (1,0) [0|1] "" Vector__XXX
 SG_ VCFRONT_a284_isCoilOpenX m284 : 24|1@1+ (1,0) [0|1] "" Vector__XXX
 SG_ VCFRONT_a284_isCoilOpenY m284 : 25|1@1+ (1,0) [0|1] "" Vector__XXX
 SG_ VCFRONT_a284_isCoilShortXPGnd m284 : 26|1@1+ (1,0) [0|1] "" Vector__XXX
 SG_ VCFRONT_a284_isCoilShortXPVbb m284 : 27|1@1+ (1,0) [0|1] "" Vector__XXX
 SG_ VCFRONT_a284_isCoilShortXNGnd m284 : 28|1@1+ (1,0) [0|1] "" Vector__XXX
 SG_ VCFRONT_a284_isCoilShortXNVbb m284 : 29|1@1+ (1,0) [0|1] "" Vector__XXX
 SG_ VCFRONT_a284_isCoilShortYPGnd m284 : 30|1@1+ (1,0) [0|1] "" Vector__XXX
 SG_ VCFRONT_a284_isCoilShortYPVbb m284 : 31|1@1+ (1,0) [0|1] "" Vector__XXX
 SG_ VCFRONT_a284_isCoilShortYNGnd m284 : 32|1@1+ (1,0) [0|1] "" Vector__XXX
 SG_ VCFRONT_a284_isCoilShortYNVbb m284 : 33|1@1+ (1,0) [0|1] "" Vector__XXX
 SG_ VCFRONT_a284_driverHasCommError m284 : 34|1@1+ (1,0) [0|1] "" Vector__XXX
 SG_ VCFRONT_a285_driverState m285 : 16|4@1+ (1,0) [0|15] "" Vector__XXX
 SG_ VCFRONT_a285_driverThermWarn m285 : 20|1@1+ (1,0) [0|1] "" Vector__XXX
 SG_ VCFRONT_a285_driverThermShutdown m285 : 21|1@1+ (1,0) [0|1] "" Vector__XXX
 SG_ VCFRONT_a285_undervoltage m285 : 22|1@1+ (1,0) [0|1] "" Vector__XXX
 SG_ VCFRONT_a285_chargePumpUndervolt m285 : 23|1@1+ (1,0) [0|1] "" Vector__XXX
 SG_ VCFRONT_a285_isCoilOpenX m285 : 24|1@1+ (1,0) [0|1] "" Vector__XXX
 SG_ VCFRONT_a285_isCoilOpenY m285 : 25|1@1+ (1,0) [0|1] "" Vector__XXX
 SG_ VCFRONT_a285_isCoilShortXPGnd m285 : 26|1@1+ (1,0) [0|1] "" Vector__XXX
 SG_ VCFRONT_a285_isCoilShortXPVbb m285 : 27|1@1+ (1,0) [0|1] "" Vector__XXX
 SG_ VCFRONT_a285_isCoilShortXNGnd m285 : 28|1@1+ (1,0) [0|1] "" Vector__XXX
 SG_ VCFRONT_a285_isCoilShortXNVbb m285 : 29|1@1+ (1,0) [0|1] "" Vector__XXX
 SG_ VCFRONT_a285_isCoilShortYPGnd m285 : 30|1@1+ (1,0) [0|1] "" Vector__XXX
 SG_ VCFRONT_a285_isCoilShortYPVbb m285 : 31|1@1+ (1,0) [0|1] "" Vector__XXX
 SG_ VCFRONT_a285_isCoilShortYNGnd m285 : 32|1@1+ (1,0) [0|1] "" Vector__XXX
 SG_ VCFRONT_a285_isCoilShortYNVbb m285 : 33|1@1+ (1,0) [0|1] "" Vector__XXX
 SG_ VCFRONT_a285_driverHasCommError m285 : 34|1@1+ (1,0) [0|1] "" Vector__XXX
 SG_ VCFRONT_a286_driverState m286 : 16|4@1+ (1,0) [0|15] "" Vector__XXX
 SG_ VCFRONT_a286_driverThermWarn m286 : 20|1@1+ (1,0) [0|1] "" Vector__XXX
 SG_ VCFRONT_a286_driverThermShutdown m286 : 21|1@1+ (1,0) [0|1] "" Vector__XXX
 SG_ VCFRONT_a286_undervoltage m286 : 22|1@1+ (1,0) [0|1] "" Vector__XXX
 SG_ VCFRONT_a286_chargePumpUndervolt m286 : 23|1@1+ (1,0) [0|1] "" Vector__XXX
 SG_ VCFRONT_a286_isCoilOpenX m286 : 24|1@1+ (1,0) [0|1] "" Vector__XXX
 SG_ VCFRONT_a286_isCoilOpenY m286 : 25|1@1+ (1,0) [0|1] "" Vector__XXX
 SG_ VCFRONT_a286_isCoilShortXPGnd m286 : 26|1@1+ (1,0) [0|1] "" Vector__XXX
 SG_ VCFRONT_a286_isCoilShortXPVbb m286 : 27|1@1+ (1,0) [0|1] "" Vector__XXX
 SG_ VCFRONT_a286_isCoilShortXNGnd m286 : 28|1@1+ (1,0) [0|1] "" Vector__XXX
 SG_ VCFRONT_a286_isCoilShortXNVbb m286 : 29|1@1+ (1,0) [0|1] "" Vector__XXX
 SG_ VCFRONT_a286_isCoilShortYPGnd m286 : 30|1@1+ (1,0) [0|1] "" Vector__XXX
 SG_ VCFRONT_a286_isCoilShortYPVbb m286 : 31|1@1+ (1,0) [0|1] "" Vector__XXX
 SG_ VCFRONT_a286_isCoilShortYNGnd m286 : 32|1@1+ (1,0) [0|1] "" Vector__XXX
 SG_ VCFRONT_a286_isCoilShortYNVbb m286 : 33|1@1+ (1,0) [0|1] "" Vector__XXX
 SG_ VCFRONT_a286_driverHasCommError m286 : 34|1@1+ (1,0) [0|1] "" Vector__XXX
 SG_ VCFRONT_a287_driverState m287 : 16|4@1+ (1,0) [0|15] "" Vector__XXX
 SG_ VCFRONT_a287_driverThermWarn m287 : 20|1@1+ (1,0) [0|1] "" Vector__XXX
 SG_ VCFRONT_a287_driverThermShutdown m287 : 21|1@1+ (1,0) [0|1] "" Vector__XXX
 SG_ VCFRONT_a287_undervoltage m287 : 22|1@1+ (1,0) [0|1] "" Vector__XXX
 SG_ VCFRONT_a287_chargePumpUndervolt m287 : 23|1@1+ (1,0) [0|1] "" Vector__XXX
 SG_ VCFRONT_a287_isCoilOpenX m287 : 24|1@1+ (1,0) [0|1] "" Vector__XXX
 SG_ VCFRONT_a287_isCoilOpenY m287 : 25|1@1+ (1,0) [0|1] "" Vector__XXX
 SG_ VCFRONT_a287_isCoilShortXPGnd m287 : 26|1@1+ (1,0) [0|1] "" Vector__XXX
 SG_ VCFRONT_a287_isCoilShortXPVbb m287 : 27|1@1+ (1,0) [0|1] "" Vector__XXX
 SG_ VCFRONT_a287_isCoilShortXNGnd m287 : 28|1@1+ (1,0) [0|1] "" Vector__XXX
 SG_ VCFRONT_a287_isCoilShortXNVbb m287 : 29|1@1+ (1,0) [0|1] "" Vector__XXX
 SG_ VCFRONT_a287_isCoilShortYPGnd m287 : 30|1@1+ (1,0) [0|1] "" Vector__XXX
 SG_ VCFRONT_a287_isCoilShortYPVbb m287 : 31|1@1+ (1,0) [0|1] "" Vector__XXX
 SG_ VCFRONT_a287_isCoilShortYNGnd m287 : 32|1@1+ (1,0) [0|1] "" Vector__XXX
 SG_ VCFRONT_a287_isCoilShortYNVbb m287 : 33|1@1+ (1,0) [0|1] "" Vector__XXX
 SG_ VCFRONT_a287_driverHasCommError m287 : 34|1@1+ (1,0) [0|1] "" Vector__XXX
 SG_ VCFRONT_a288_driverState m288 : 16|4@1+ (1,0) [0|15] "" Vector__XXX
 SG_ VCFRONT_a288_driverThermWarn m288 : 20|1@1+ (1,0) [0|1] "" Vector__XXX
 SG_ VCFRONT_a288_driverThermShutdown m288 : 21|1@1+ (1,0) [0|1] "" Vector__XXX
 SG_ VCFRONT_a288_undervoltage m288 : 22|1@1+ (1,0) [0|1] "" Vector__XXX
 SG_ VCFRONT_a288_chargePumpUndervolt m288 : 23|1@1+ (1,0) [0|1] "" Vector__XXX
 SG_ VCFRONT_a288_isCoilOpenX m288 : 24|1@1+ (1,0) [0|1] "" Vector__XXX
 SG_ VCFRONT_a288_isCoilOpenY m288 : 25|1@1+ (1,0) [0|1] "" Vector__XXX
 SG_ VCFRONT_a288_isCoilShortXPGnd m288 : 26|1@1+ (1,0) [0|1] "" Vector__XXX
 SG_ VCFRONT_a288_isCoilShortXPVbb m288 : 27|1@1+ (1,0) [0|1] "" Vector__XXX
 SG_ VCFRONT_a288_isCoilShortXNGnd m288 : 28|1@1+ (1,0) [0|1] "" Vector__XXX
 SG_ VCFRONT_a288_isCoilShortXNVbb m288 : 29|1@1+ (1,0) [0|1] "" Vector__XXX
 SG_ VCFRONT_a288_isCoilShortYPGnd m288 : 30|1@1+ (1,0) [0|1] "" Vector__XXX
 SG_ VCFRONT_a288_isCoilShortYPVbb m288 : 31|1@1+ (1,0) [0|1] "" Vector__XXX
 SG_ VCFRONT_a288_isCoilShortYNGnd m288 : 32|1@1+ (1,0) [0|1] "" Vector__XXX
 SG_ VCFRONT_a288_isCoilShortYNVbb m288 : 33|1@1+ (1,0) [0|1] "" Vector__XXX
 SG_ VCFRONT_a288_driverHasCommError m288 : 34|1@1+ (1,0) [0|1] "" Vector__XXX
 SG_ VCFRONT_a289_driverState m289 : 16|4@1+ (1,0) [0|15] "" Vector__XXX
 SG_ VCFRONT_a289_driverThermWarn m289 : 20|1@1+ (1,0) [0|1] "" Vector__XXX
 SG_ VCFRONT_a289_driverThermShutdown m289 : 21|1@1+ (1,0) [0|1] "" Vector__XXX
 SG_ VCFRONT_a289_undervoltage m289 : 22|1@1+ (1,0) [0|1] "" Vector__XXX
 SG_ VCFRONT_a289_chargePumpUndervolt m289 : 23|1@1+ (1,0) [0|1] "" Vector__XXX
 SG_ VCFRONT_a289_isCoilOpenX m289 : 24|1@1+ (1,0) [0|1] "" Vector__XXX
 SG_ VCFRONT_a289_isCoilOpenY m289 : 25|1@1+ (1,0) [0|1] "" Vector__XXX
 SG_ VCFRONT_a289_isCoilShortXPGnd m289 : 26|1@1+ (1,0) [0|1] "" Vector__XXX
 SG_ VCFRONT_a289_isCoilShortXPVbb m289 : 27|1@1+ (1,0) [0|1] "" Vector__XXX
 SG_ VCFRONT_a289_isCoilShortXNGnd m289 : 28|1@1+ (1,0) [0|1] "" Vector__XXX
 SG_ VCFRONT_a289_isCoilShortXNVbb m289 : 29|1@1+ (1,0) [0|1] "" Vector__XXX
 SG_ VCFRONT_a289_isCoilShortYPGnd m289 : 30|1@1+ (1,0) [0|1] "" Vector__XXX
 SG_ VCFRONT_a289_isCoilShortYPVbb m289 : 31|1@1+ (1,0) [0|1] "" Vector__XXX
 SG_ VCFRONT_a289_isCoilShortYNGnd m289 : 32|1@1+ (1,0) [0|1] "" Vector__XXX
 SG_ VCFRONT_a289_isCoilShortYNVbb m289 : 33|1@1+ (1,0) [0|1] "" Vector__XXX
 SG_ VCFRONT_a289_driverHasCommError m289 : 34|1@1+ (1,0) [0|1] "" Vector__XXX
 SG_ VCFRONT_a290_outputFaulted m290 : 16|1@1+ (1,0) [0|1] "" Vector__XXX
 SG_ VCFRONT_a290_currentSenseFaulted m290 : 17|1@1+ (1,0) [0|1] "" Vector__XXX
 SG_ VCFRONT_a290_tempSenseFaulted m290 : 18|1@1+ (1,0) [0|1] "" Vector__XXX
 SG_ VCFRONT_a290_underCurrent m290 : 19|1@1+ (1,0) [0|1] "" Vector__XXX
 SG_ VCFRONT_a290_overCurrent m290 : 20|1@1+ (1,0) [0|1] "" Vector__XXX
 SG_ VCFRONT_a290_overTemperature m290 : 21|1@1+ (1,0) [0|1] "" Vector__XXX
 SG_ VCFRONT_a291_outputFaulted m291 : 16|1@1+ (1,0) [0|1] "" Vector__XXX
 SG_ VCFRONT_a291_currentSenseFaulted m291 : 17|1@1+ (1,0) [0|1] "" Vector__XXX
 SG_ VCFRONT_a291_tempSenseFaulted m291 : 18|1@1+ (1,0) [0|1] "" Vector__XXX
 SG_ VCFRONT_a291_underCurrent m291 : 19|1@1+ (1,0) [0|1] "" Vector__XXX
 SG_ VCFRONT_a291_overCurrent m291 : 20|1@1+ (1,0) [0|1] "" Vector__XXX
 SG_ VCFRONT_a291_overTemperature m291 : 21|1@1+ (1,0) [0|1] "" Vector__XXX
 SG_ VCFRONT_a292_outputFaulted m292 : 16|1@1+ (1,0) [0|1] "" Vector__XXX
 SG_ VCFRONT_a292_currentSenseFaulted m292 : 17|1@1+ (1,0) [0|1] "" Vector__XXX
 SG_ VCFRONT_a292_tempSenseFaulted m292 : 18|1@1+ (1,0) [0|1] "" Vector__XXX
 SG_ VCFRONT_a292_underCurrent m292 : 19|1@1+ (1,0) [0|1] "" Vector__XXX
 SG_ VCFRONT_a292_overCurrent m292 : 20|1@1+ (1,0) [0|1] "" Vector__XXX
 SG_ VCFRONT_a292_overTemperature m292 : 21|1@1+ (1,0) [0|1] "" Vector__XXX
 SG_ VCFRONT_a293_outputFaulted m293 : 16|1@1+ (1,0) [0|1] "" Vector__XXX
 SG_ VCFRONT_a293_currentSenseFaulted m293 : 17|1@1+ (1,0) [0|1] "" Vector__XXX
 SG_ VCFRONT_a293_tempSenseFaulted m293 : 18|1@1+ (1,0) [0|1] "" Vector__XXX
 SG_ VCFRONT_a293_underCurrent m293 : 19|1@1+ (1,0) [0|1] "" Vector__XXX
 SG_ VCFRONT_a293_overCurrent m293 : 20|1@1+ (1,0) [0|1] "" Vector__XXX
 SG_ VCFRONT_a293_overTemperature m293 : 21|1@1+ (1,0) [0|1] "" Vector__XXX
 SG_ VCFRONT_a294_outputFaulted m294 : 16|1@1+ (1,0) [0|1] "" Vector__XXX
 SG_ VCFRONT_a294_currentSenseFaulted m294 : 17|1@1+ (1,0) [0|1] "" Vector__XXX
 SG_ VCFRONT_a294_tempSenseFaulted m294 : 18|1@1+ (1,0) [0|1] "" Vector__XXX
 SG_ VCFRONT_a294_underCurrent m294 : 19|1@1+ (1,0) [0|1] "" Vector__XXX
 SG_ VCFRONT_a294_overCurrent m294 : 20|1@1+ (1,0) [0|1] "" Vector__XXX
 SG_ VCFRONT_a294_overTemperature m294 : 21|1@1+ (1,0) [0|1] "" Vector__XXX
 SG_ VCFRONT_a295_outputFaulted m295 : 16|1@1+ (1,0) [0|1] "" Vector__XXX
 SG_ VCFRONT_a295_currentSenseFaulted m295 : 17|1@1+ (1,0) [0|1] "" Vector__XXX
 SG_ VCFRONT_a295_tempSenseFaulted m295 : 18|1@1+ (1,0) [0|1] "" Vector__XXX
 SG_ VCFRONT_a295_underCurrent m295 : 19|1@1+ (1,0) [0|1] "" Vector__XXX
 SG_ VCFRONT_a295_overCurrent m295 : 20|1@1+ (1,0) [0|1] "" Vector__XXX
 SG_ VCFRONT_a295_overTemperature m295 : 21|1@1+ (1,0) [0|1] "" Vector__XXX
 SG_ VCFRONT_a297_bmbDeviceId m297 : 16|4@1+ (1,1) [1|16] "" Vector__XXX
 SG_ VCFRONT_a297_bmbDeviceFaultTempM m297 : 24|8@1+ (1,0) [0|255] "" Vector__XXX
 SG_ VCFRONT_a300_oldType m300 : 16|2@1+ (1,0) [0|3] "" Vector__XXX
 SG_ VCFRONT_a300_newType m300 : 18|2@1+ (1,0) [0|3] "" Vector__XXX
 SG_ VCFRONT_a302_LINFrameStatus m302 : 16|3@1+ (1,0) [0|7] "" Vector__XXX
 SG_ VCFRONT_a303_vehicleSpeed m303 : 16|12@1+ (0.08,-40) [-40|287.6] "" Vector__XXX
 SG_ VCFRONT_a303_postVoltage m303 : 32|16@1+ (0.1,0) [0|6553.5] "" Vector__XXX
 SG_ VCFRONT_a303_lockStatus m303 : 48|2@1+ (1,0) [0|3] "" Vector__XXX
 SG_ VCFRONT_a304_voltage m304 : 16|7@1+ (0.15,0) [0|19.05] "" Vector__XXX
 SG_ VCFRONT_a304_temperature m304 : 24|8@1+ (0.5,-40) [-40|87.5] "" Vector__XXX
 SG_ VCFRONT_a305_voltage m305 : 16|7@1+ (0.15,0) [0|19.05] "" Vector__XXX
 SG_ VCFRONT_a305_temperature m305 : 24|8@1+ (0.5,-40) [-40|87.5] "" Vector__XXX
 SG_ VCFRONT_a305_actuatorCurrent m305 : 32|8@1+ (0.1,0) [0|25.5] "" Vector__XXX
 SG_ VCFRONT_a306_voltage m306 : 16|7@1+ (0.15,0) [0|19.05] "" Vector__XXX
 SG_ VCFRONT_a306_temperature m306 : 24|8@1+ (0.5,-40) [-40|87.5] "" Vector__XXX
 SG_ VCFRONT_a306_actuatorCurrent m306 : 32|8@1+ (0.1,0) [0|25.5] "" Vector__XXX
 SG_ VCFRONT_a307_voltage m307 : 16|7@1+ (0.15,0) [0|19.05] "" Vector__XXX
 SG_ VCFRONT_a307_temperature m307 : 24|8@1+ (0.5,-40) [-40|87.5] "" Vector__XXX
 SG_ VCFRONT_a307_actuatorCurrent m307 : 32|8@1+ (0.1,0) [0|25.5] "" Vector__XXX
 SG_ VCFRONT_a308_voltage m308 : 16|7@1+ (0.15,0) [0|19.05] "" Vector__XXX
 SG_ VCFRONT_a308_temperature m308 : 24|8@1+ (0.5,-40) [-40|87.5] "" Vector__XXX
 SG_ VCFRONT_a308_actuatorCurrent m308 : 32|8@1+ (0.1,0) [0|25.5] "" Vector__XXX
 SG_ VCFRONT_a309_vehicleSpeed m309 : 16|12@1+ (0.08,-40) [-40|287.6] "" Vector__XXX
 SG_ VCFRONT_a309_switchVoltage m309 : 32|16@1+ (0.1,0) [0|6553.5] "" Vector__XXX
 SG_ VCFRONT_a309_lockStatus m309 : 48|2@1+ (1,0) [0|3] "" Vector__XXX
 SG_ VCFRONT_a334_maxSlope m334 : 16|12@1+ (0.1,0) [0|409.5] "" Vector__XXX
 SG_ VCFRONT_a334_avgCurrent m334 : 28|12@1+ (0.1,0) [0|409.5] "" Vector__XXX
 SG_ VCFRONT_a334_maxCurrent m334 : 40|12@1+ (0.1,0) [0|409.5] "" Vector__XXX
 SG_ VCFRONT_a334_vehicleState m334 : 52|2@1+ (1,0) [0|3] "" Vector__XXX
 SG_ VCFRONT_a335_maxSlope m335 : 16|12@1+ (0.1,0) [0|409.5] "" Vector__XXX
 SG_ VCFRONT_a335_avgCurrent m335 : 28|12@1+ (0.1,0) [0|409.5] "" Vector__XXX
 SG_ VCFRONT_a335_maxCurrent m335 : 40|12@1+ (0.1,0) [0|409.5] "" Vector__XXX
 SG_ VCFRONT_a335_vehicleState m335 : 52|2@1+ (1,0) [0|3] "" Vector__XXX
 SG_ VCFRONT_a336_maxSlope m336 : 16|12@1+ (0.1,0) [0|409.5] "" Vector__XXX
 SG_ VCFRONT_a336_avgCurrent m336 : 28|12@1+ (0.1,0) [0|409.5] "" Vector__XXX
 SG_ VCFRONT_a336_maxCurrent m336 : 40|12@1+ (0.1,0) [0|409.5] "" Vector__XXX
 SG_ VCFRONT_a336_vehicleState m336 : 52|2@1+ (1,0) [0|3] "" Vector__XXX
 SG_ VCFRONT_a337_maxSlope m337 : 16|12@1+ (0.1,0) [0|409.5] "" Vector__XXX
 SG_ VCFRONT_a337_avgCurrent m337 : 28|12@1+ (0.1,0) [0|409.5] "" Vector__XXX
 SG_ VCFRONT_a337_maxCurrent m337 : 40|12@1+ (0.1,0) [0|409.5] "" Vector__XXX
 SG_ VCFRONT_a337_vehicleState m337 : 52|2@1+ (1,0) [0|3] "" Vector__XXX
 SG_ VCFRONT_a338_maxSlope m338 : 16|12@1+ (0.1,0) [0|409.5] "" Vector__XXX
 SG_ VCFRONT_a338_avgCurrent m338 : 28|12@1+ (0.1,0) [0|409.5] "" Vector__XXX
 SG_ VCFRONT_a338_maxCurrent m338 : 40|12@1+ (0.1,0) [0|409.5] "" Vector__XXX
 SG_ VCFRONT_a338_vehicleState m338 : 52|2@1+ (1,0) [0|3] "" Vector__XXX
 SG_ VCFRONT_a339_maxSlope m339 : 16|12@1+ (0.1,0) [0|409.5] "" Vector__XXX
 SG_ VCFRONT_a339_avgCurrent m339 : 28|12@1+ (0.1,0) [0|409.5] "" Vector__XXX
 SG_ VCFRONT_a339_maxCurrent m339 : 40|12@1+ (0.1,0) [0|409.5] "" Vector__XXX
 SG_ VCFRONT_a339_vehicleState m339 : 52|2@1+ (1,0) [0|3] "" Vector__XXX
 SG_ VCFRONT_a340_maxSlope m340 : 16|12@1+ (0.1,0) [0|409.5] "" Vector__XXX
 SG_ VCFRONT_a340_avgCurrent m340 : 28|12@1+ (0.1,0) [0|409.5] "" Vector__XXX
 SG_ VCFRONT_a340_maxCurrent m340 : 40|12@1+ (0.1,0) [0|409.5] "" Vector__XXX
 SG_ VCFRONT_a340_vehicleState m340 : 52|2@1+ (1,0) [0|3] "" Vector__XXX
 SG_ VCFRONT_a341_maxSlope m341 : 16|12@1+ (0.1,0) [0|409.5] "" Vector__XXX
 SG_ VCFRONT_a341_avgCurrent m341 : 28|12@1+ (0.1,0) [0|409.5] "" Vector__XXX
 SG_ VCFRONT_a341_maxCurrent m341 : 40|12@1+ (0.1,0) [0|409.5] "" Vector__XXX
 SG_ VCFRONT_a341_vehicleState m341 : 52|2@1+ (1,0) [0|3] "" Vector__XXX
 SG_ VCFRONT_a342_maxSlope m342 : 16|12@1+ (0.1,0) [0|409.5] "" Vector__XXX
 SG_ VCFRONT_a342_avgCurrent m342 : 28|12@1+ (0.1,0) [0|409.5] "" Vector__XXX
 SG_ VCFRONT_a342_maxCurrent m342 : 40|12@1+ (0.1,0) [0|409.5] "" Vector__XXX
 SG_ VCFRONT_a342_vehicleState m342 : 52|2@1+ (1,0) [0|3] "" Vector__XXX
 SG_ VCFRONT_a343_maxSlope m343 : 16|12@1+ (0.1,0) [0|409.5] "" Vector__XXX
 SG_ VCFRONT_a343_avgCurrent m343 : 28|12@1+ (0.1,0) [0|409.5] "" Vector__XXX
 SG_ VCFRONT_a343_maxCurrent m343 : 40|12@1+ (0.1,0) [0|409.5] "" Vector__XXX
 SG_ VCFRONT_a343_vehicleState m343 : 52|2@1+ (1,0) [0|3] "" Vector__XXX
 SG_ VCFRONT_a344_maxSlope m344 : 16|12@1+ (0.1,0) [0|409.5] "" Vector__XXX
 SG_ VCFRONT_a344_avgCurrent m344 : 28|12@1+ (0.1,0) [0|409.5] "" Vector__XXX
 SG_ VCFRONT_a344_maxCurrent m344 : 40|12@1+ (0.1,0) [0|409.5] "" Vector__XXX
 SG_ VCFRONT_a344_vehicleState m344 : 52|2@1+ (1,0) [0|3] "" Vector__XXX
 SG_ VCFRONT_a345_maxSlope m345 : 16|12@1+ (0.1,0) [0|409.5] "" Vector__XXX
 SG_ VCFRONT_a345_avgCurrent m345 : 28|12@1+ (0.1,0) [0|409.5] "" Vector__XXX
 SG_ VCFRONT_a345_maxCurrent m345 : 40|12@1+ (0.1,0) [0|409.5] "" Vector__XXX
 SG_ VCFRONT_a345_vehicleState m345 : 52|2@1+ (1,0) [0|3] "" Vector__XXX
 SG_ VCFRONT_a346_maxSlope m346 : 16|12@1+ (0.1,0) [0|409.5] "" Vector__XXX
 SG_ VCFRONT_a346_avgCurrent m346 : 28|12@1+ (0.1,0) [0|409.5] "" Vector__XXX
 SG_ VCFRONT_a346_maxCurrent m346 : 40|12@1+ (0.1,0) [0|409.5] "" Vector__XXX
 SG_ VCFRONT_a346_vehicleState m346 : 52|2@1+ (1,0) [0|3] "" Vector__XXX
 SG_ VCFRONT_a347_maxSlope m347 : 16|12@1+ (0.1,0) [0|409.5] "" Vector__XXX
 SG_ VCFRONT_a347_avgCurrent m347 : 28|12@1+ (0.1,0) [0|409.5] "" Vector__XXX
 SG_ VCFRONT_a347_maxCurrent m347 : 40|12@1+ (0.1,0) [0|409.5] "" Vector__XXX
 SG_ VCFRONT_a347_vehicleState m347 : 52|2@1+ (1,0) [0|3] "" Vector__XXX
 SG_ VCFRONT_a348_maxSlope m348 : 16|12@1+ (0.1,0) [0|409.5] "" Vector__XXX
 SG_ VCFRONT_a348_avgCurrent m348 : 28|12@1+ (0.1,0) [0|409.5] "" Vector__XXX
 SG_ VCFRONT_a348_maxCurrent m348 : 40|12@1+ (0.1,0) [0|409.5] "" Vector__XXX
 SG_ VCFRONT_a348_vehicleState m348 : 52|2@1+ (1,0) [0|3] "" Vector__XXX
 SG_ VCFRONT_a349_maxSlope m349 : 16|12@1+ (0.1,0) [0|409.5] "" Vector__XXX
 SG_ VCFRONT_a349_avgCurrent m349 : 28|12@1+ (0.1,0) [0|409.5] "" Vector__XXX
 SG_ VCFRONT_a349_maxCurrent m349 : 40|12@1+ (0.1,0) [0|409.5] "" Vector__XXX
 SG_ VCFRONT_a349_vehicleState m349 : 52|2@1+ (1,0) [0|3] "" Vector__XXX
 SG_ VCFRONT_a350_espValveCurrent m350 : 16|10@1+ (0.1,0) [0|102.3] "" Vector__XXX
 SG_ VCFRONT_a353_wiperHeaterCurrent m353 : 16|8@1+ (0.1,0) [0|25.5] "" Vector__XXX
 SG_ VCFRONT_a353_batteryVoltage m353 : 24|7@1+ (0.15,0) [0|19.05] "" Vector__XXX
 SG_ VCFRONT_a353_ambientTemperature m353 : 32|8@1+ (0.5,-40) [-40|87.5] "" Vector__XXX
 SG_ VCFRONT_a354_windshieldCameraHea m354 : 16|8@1+ (0.1,0) [0|25.5] "" Vector__XXX
 SG_ VCFRONT_a354_batteryVoltage m354 : 24|7@1+ (0.15,0) [0|19.05] "" Vector__XXX
 SG_ VCFRONT_a354_ambientTemperature m354 : 32|8@1+ (0.5,-40) [-40|87.5] "" Vector__XXX
 SG_ VCFRONT_a355_fluidNotFilled m355 : 16|1@1+ (1,0) [0|1] "" Vector__XXX
 SG_ VCFRONT_a355_systemNotCommission m355 : 17|1@1+ (1,0) [0|1] "" Vector__XXX
 SG_ VCFRONT_a355_serviceLockout m355 : 18|1@1+ (1,0) [0|1] "" Vector__XXX
 SG_ VCFRONT_a355_factoryGated m355 : 19|1@1+ (1,0) [0|1] "" Vector__XXX
 SG_ VCFRONT_a356_fluidNotFilled m356 : 16|1@1+ (1,0) [0|1] "" Vector__XXX
 SG_ VCFRONT_a356_systemNotCommission m356 : 17|1@1+ (1,0) [0|1] "" Vector__XXX
 SG_ VCFRONT_a356_serviceLockout m356 : 18|1@1+ (1,0) [0|1] "" Vector__XXX
 SG_ VCFRONT_a356_factoryGated m356 : 19|1@1+ (1,0) [0|1] "" Vector__XXX
 SG_ VCFRONT_a356_refCommissionStatus m356 : 20|1@1+ (1,0) [0|1] "" Vector__XXX
 SG_ VCFRONT_a357_maxTransientCurrent m357 : 16|10@1+ (0.02,0) [0|20.46] "" Vector__XXX
 SG_ VCFRONT_a358_maxTransientCurrent m358 : 16|10@1+ (0.05,0) [0|51.15] "" Vector__XXX
 SG_ VCFRONT_a359_IBSVolts m359 : 16|12@1+ (0.005443676,0) [0|22.29185322] "" Vector__XXX
 SG_ VCFRONT_a359_IBSAh m359 : 28|12@1- (0.1,0) [-204.8|204.7] "" Vector__XXX
 SG_ VCFRONT_a359_vehiclePowerState m359 : 40|2@1+ (1,0) [0|3] "" Vector__XXX
 SG_ VCFRONT_a359_batterySMState m359 : 42|4@1+ (1,0) [0|15] "" Vector__XXX
 SG_ VCFRONT_a359_hvState m359 : 48|3@1+ (1,0) [0|7] "" Vector__XXX
 SG_ VCFRONT_a359_coolantHasBeenFille m359 : 51|1@1+ (1,0) [0|1] "" Vector__XXX
 SG_ VCFRONT_a359_crashDetected m359 : 52|1@1+ (1,0) [0|1] "" Vector__XXX
 SG_ VCFRONT_a359_BMS_MIA m359 : 53|1@1+ (1,0) [0|1] "" Vector__XXX
 SG_ VCFRONT_a359_PCS_MIA m359 : 54|1@1+ (1,0) [0|1] "" Vector__XXX
 SG_ VCFRONT_a359_serviceMode m359 : 55|1@1+ (1,0) [0|1] "" Vector__XXX
 SG_ VCFRONT_a359_dcdcLVSupportStatus m359 : 56|2@1+ (1,0) [0|3] "" Vector__XXX
 SG_ VCFRONT_a359_bmsState m359 : 58|4@1+ (1,0) [0|15] "" Vector__XXX
 SG_ VCFRONT_a360_vehicleLoadShedActi m360 : 16|1@1+ (1,0) [0|1] "" Vector__XXX
 SG_ VCFRONT_a360_notEnoughPowerForSu m360 : 17|1@1+ (1,0) [0|1] "" Vector__XXX
 SG_ VCFRONT_a363_minBleedCharge m363 : 16|15@1+ (0.001,0) [0|32.767] "" Vector__XXX
 SG_ VCFRONT_a363_avgBleedCharge m363 : 32|15@1+ (0.001,0) [0|32.767] "" Vector__XXX
 SG_ VCFRONT_a363_checkIntervalDays m363 : 48|5@1+ (1,0) [0|31] "" Vector__XXX
 SG_ VCFRONT_a363_minBleedChargeBrick m363 : 56|5@1+ (1,1) [1|32] "" Vector__XXX
 SG_ VCFRONT_a363_setFromNvm m363 : 61|1@1+ (1,0) [0|1] "" Vector__XXX
 SG_ VCFRONT_a367_bmsSoc m367 : 16|8@1+ (0.5,0) [0|127.5] "" Vector__XXX
 SG_ VCFRONT_a368_bmsRequestRemoved m368 : 16|1@1+ (1,0) [0|1] "" Vector__XXX
 SG_ VCFRONT_a368_enteringState m368 : 17|3@1+ (1,0) [0|7] "" Vector__XXX
 SG_ VCFRONT_a368_exitingState m368 : 20|3@1+ (1,0) [0|7] "" Vector__XXX
 SG_ VCFRONT_a368_bmsSoc m368 : 24|8@1+ (0.5,0) [0|127.5] "" Vector__XXX
 SG_ VCFRONT_a368_systemFaulted m368 : 32|1@1+ (1,0) [0|1] "" Vector__XXX
 SG_ VCFRONT_a368_coolantTempSensorsF m368 : 33|1@1+ (1,0) [0|1] "" Vector__XXX
 SG_ VCFRONT_a368_coolantValveFaulted m368 : 34|1@1+ (1,0) [0|1] "" Vector__XXX
 SG_ VCFRONT_a368_louverFaulted m368 : 35|1@1+ (1,0) [0|1] "" Vector__XXX
 SG_ VCFRONT_a368_fansFaulted m368 : 36|1@1+ (1,0) [0|1] "" Vector__XXX
 SG_ VCFRONT_a368_coolantNotFilled m368 : 37|1@1+ (1,0) [0|1] "" Vector__XXX
 SG_ VCFRONT_a368_coolantPumpsFaulted m368 : 38|1@1+ (1,0) [0|1] "" Vector__XXX
 SG_ VCFRONT_a368_preconditionsNotMet m368 : 39|1@1+ (1,0) [0|1] "" Vector__XXX
 SG_ VCFRONT_a368_belowSocMin m368 : 40|1@1+ (1,0) [0|1] "" Vector__XXX
 SG_ VCFRONT_a369_powerGenerationLimi m369 : 16|1@1+ (1,0) [0|1] "" Vector__XXX
 SG_ VCFRONT_a369_heatRejectionLimite m369 : 17|1@1+ (1,0) [0|1] "" Vector__XXX
 SG_ VCFRONT_a369_bmsSoc m369 : 24|8@1+ (0.5,0) [0|127.5] "" Vector__XXX
 SG_ VCFRONT_a369_wasteHeatPower m369 : 32|7@1+ (100,0) [0|12700] "" Vector__XXX
 SG_ VCFRONT_a370_IBSVolts m370 : 16|12@1+ (0.005443676,0) [0|22.29185322] "" Vector__XXX
 SG_ VCFRONT_a370_IBSAh m370 : 28|12@1- (0.1,0) [-204.8|204.7] "" Vector__XXX
 SG_ VCFRONT_a370_notEnoughPowerForSu m370 : 40|1@1+ (1,0) [0|1] "" Vector__XXX
 SG_ VCFRONT_a370_serviceMode m370 : 41|1@1+ (1,0) [0|1] "" Vector__XXX
 SG_ VCFRONT_a370_sleepCurrent m370 : 42|10@1+ (0.1,0) [0|102.3] "" Vector__XXX
 SG_ VCFRONT_a370_SOC m370 : 52|3@1+ (2.5,5) [5|22.5] "" Vector__XXX
 SG_ VCFRONT_a371_shortedCellTestTrig m371 : 16|1@1+ (1,0) [0|1] "" Vector__XXX
 SG_ VCFRONT_a371_voltDropOnHighCurre m371 : 17|1@1+ (1,0) [0|1] "" Vector__XXX
 SG_ VCFRONT_a371_deadLVMinimalAhDisc m371 : 18|1@1+ (1,0) [0|1] "" Vector__XXX
 SG_ VCFRONT_a371_resistanceEstimatio m371 : 19|1@1+ (1,0) [0|1] "" Vector__XXX
 SG_ VCFRONT_a371_dcrMilliOhmsAboveTh m371 : 20|1@1+ (1,0) [0|1] "" Vector__XXX
 SG_ VCFRONT_a371_prechargeLVLoadRedu m371 : 21|1@1+ (1,0) [0|1] "" Vector__XXX
 SG_ VCFRONT_a371_instantPrechargeDCR m371 : 22|1@1+ (1,0) [0|1] "" Vector__XXX
 SG_ VCFRONT_a372_bmbDeviceId m372 : 16|4@1+ (1,1) [1|16] "" Vector__XXX
 SG_ VCFRONT_a372_bmbDeviceFaultBrick m372 : 24|16@1+ (1,0) [0|65535] "" Vector__XXX
 SG_ VCFRONT_a373_tempSuperheatActual m373 : 16|10@1+ (0.1,-20) [-20|82.3] "" Vector__XXX
 SG_ VCFRONT_a373_tempSuperheatTarget m373 : 26|10@1+ (0.1,0) [0|102.3] "" Vector__XXX
 SG_ VCFRONT_a373_compDemandChiller m373 : 40|7@1+ (1,0) [0|127] "" Vector__XXX
 SG_ VCFRONT_a374_lccInletSolenoidISe m374 : 16|8@1- (0.01,0) [-1.28|1.27] "" Vector__XXX
 SG_ VCFRONT_a377_wiperStuckOutOfPark m377 : 16|1@1+ (1,0) [0|1] "" Vector__XXX
 SG_ VCFRONT_a377_wiperStuckInPark m377 : 17|1@1+ (1,0) [0|1] "" Vector__XXX
 SG_ VCFRONT_a387_shortedCellFaultCou m387 : 16|3@1+ (1,0) [0|7] "" Vector__XXX
 SG_ VCFRONT_a387_minVoltageReached m387 : 19|12@1+ (0.005443676,0) [0|22.29185322] "" Vector__XXX
 SG_ VCFRONT_a387_opportunisticTest m387 : 31|1@1+ (1,0) [0|1] "" Vector__XXX
 SG_ VCFRONT_a387_IBSTemp m387 : 32|16@1- (0.01,0) [-327.68|327.67] "" Vector__XXX
 SG_ VCFRONT_a387_maxCurrentReached m387 : 48|16@1- (0.005,0) [-163.84|163.835] "" Vector__XXX
 SG_ VCFRONT_a388_shortedCellFaultCou m388 : 16|3@1+ (1,0) [0|7] "" Vector__XXX
 SG_ VCFRONT_a388_minVoltageReached m388 : 19|12@1+ (0.005443676,0) [0|22.29185322] "" Vector__XXX
 SG_ VCFRONT_a388_opportunisticTest m388 : 31|1@1+ (1,0) [0|1] "" Vector__XXX
 SG_ VCFRONT_a388_IBSTemp m388 : 32|16@1- (0.01,0) [-327.68|327.67] "" Vector__XXX
 SG_ VCFRONT_a388_maxCurrentReached m388 : 48|16@1- (0.005,0) [-163.84|163.835] "" Vector__XXX
 SG_ VCFRONT_a389_closedAtSpeed m389 : 16|1@1+ (1,0) [0|1] "" Vector__XXX
 SG_ VCFRONT_a389_faultedWhileOpenAtS m389 : 17|1@1+ (1,0) [0|1] "" Vector__XXX
 SG_ VCFRONT_a389_possiblyStuckClosed m389 : 18|1@1+ (1,0) [0|1] "" Vector__XXX
 SG_ VCFRONT_a389_vehicleSpeed m389 : 19|12@1+ (0.08,-40) [-40|287.6] "" Vector__XXX
 SG_ VCFRONT_a389_temperature m389 : 32|8@1+ (0.5,-40) [-40|87.5] "" Vector__XXX
 SG_ VCFRONT_a389_latchStatus m389 : 40|4@1+ (1,0) [0|15] "" Vector__XXX
 SG_ VCFRONT_a391_switchMismatch m391 : 16|1@1+ (1,0) [0|1] "" Vector__XXX
 SG_ VCFRONT_a391_switch1Shorted m391 : 17|1@1+ (1,0) [0|1] "" Vector__XXX
 SG_ VCFRONT_a391_switch1Disconnected m391 : 18|1@1+ (1,0) [0|1] "" Vector__XXX
 SG_ VCFRONT_a391_switch2Shorted m391 : 19|1@1+ (1,0) [0|1] "" Vector__XXX
 SG_ VCFRONT_a391_switch2Disconnected m391 : 20|1@1+ (1,0) [0|1] "" Vector__XXX
 SG_ VCFRONT_a391_switch1VoltageAvera m391 : 21|10@1+ (5,0) [0|5115] "" Vector__XXX
 SG_ VCFRONT_a391_switch1VoltageInsta m391 : 32|10@1+ (5,0) [0|5115] "" Vector__XXX
 SG_ VCFRONT_a391_switch2VoltageAvera m391 : 42|10@1+ (5,0) [0|5115] "" Vector__XXX
 SG_ VCFRONT_a391_switch2VoltageInsta m391 : 52|10@1+ (5,0) [0|5115] "" Vector__XXX
 SG_ VCFRONT_a392_bmbDeviceId m392 : 16|4@1+ (1,1) [1|16] "" Vector__XXX
 SG_ VCFRONT_a392_bmbDeviceFaultBrick m392 : 24|16@1+ (1,0) [0|65535] "" Vector__XXX
 SG_ VCFRONT_a397_discharge m397 : 16|1@1+ (1,0) [0|1] "" Vector__XXX
 SG_ VCFRONT_a397_suction m397 : 17|1@1+ (1,0) [0|1] "" Vector__XXX
 SG_ VCFRONT_a397_liquid m397 : 18|1@1+ (1,0) [0|1] "" Vector__XXX
 SG_ VCFRONT_a397_offsetError m397 : 19|10@1- (0.2,0) [-102.4|102.2] "" Vector__XXX
 SG_ VCFRONT_a397_runTimeOffSetDetect m397 : 29|1@1+ (1,0) [0|1] "" Vector__XXX
 SG_ VCFRONT_a401_LVBatteryTemp m401 : 16|7@1+ (1,-40) [-40|87] "" Vector__XXX
 SG_ VCFRONT_a401_IBSCurrent m401 : 24|12@1- (0.1,0) [-204.8|204.7] "" Vector__XXX
 SG_ VCFRONT_a401_IBSVoltage m401 : 36|11@1+ (0.0108873518184,0) [0|22.2864091723] "" Vector__XXX
 SG_ VCFRONT_a401_IBSAmpHours m401 : 48|8@1+ (0.01,-2.55) [-2.55|4.4408920985e-16] "" Vector__XXX
 SG_ VCFRONT_a402_LVBatteryTemp m402 : 16|7@1+ (1,-40) [-40|87] "" Vector__XXX
 SG_ VCFRONT_a402_batterySMState m402 : 24|4@1+ (1,0) [0|15] "" Vector__XXX
 SG_ VCFRONT_a402_failureToPrechargeR m402 : 28|1@1+ (1,0) [0|1] "" Vector__XXX
 SG_ VCFRONT_a402_electricalDisconnec m402 : 29|1@1+ (1,0) [0|1] "" Vector__XXX
 SG_ VCFRONT_a402_communicationDiscon m402 : 30|1@1+ (1,0) [0|1] "" Vector__XXX
 SG_ VCFRONT_a402_reverseBatteryFault m402 : 31|1@1+ (1,0) [0|1] "" Vector__XXX
 SG_ VCFRONT_a402_MOSOpen m402 : 32|1@1+ (1,0) [0|1] "" Vector__XXX
 SG_ VCFRONT_a402_serviceMode m402 : 33|1@1+ (1,0) [0|1] "" Vector__XXX
 SG_ VCFRONT_a402_frunkOpen m402 : 34|1@1+ (1,0) [0|1] "" Vector__XXX
 SG_ VCFRONT_a404_minVoltageReached m404 : 16|12@1+ (0.005443676,0) [0|22.29185322] "" Vector__XXX
 SG_ VCFRONT_a404_IBSTemp m404 : 32|16@1- (0.01,0) [-327.68|327.67] "" Vector__XXX
 SG_ VCFRONT_a404_maxCurrentReached m404 : 48|16@1- (0.005,0) [-163.84|163.835] "" Vector__XXX
 SG_ VCFRONT_a407_dcrMilliOhms m407 : 16|8@1+ (0.2,0) [0|51] "" Vector__XXX
 SG_ VCFRONT_a407_dcr12VThreshold m407 : 24|4@1+ (1,0) [0|15] "" Vector__XXX
 SG_ VCFRONT_a407_avgIntervalCurrent m407 : 28|5@1+ (1,-31) [-31|0] "" Vector__XXX
 SG_ VCFRONT_a407_intervalCurrentVari m407 : 33|6@1+ (0.1,0) [0|6.3] "" Vector__XXX
 SG_ VCFRONT_a407_avgPulseCurrent m407 : 39|7@1+ (1,-127) [-127|0] "" Vector__XXX
 SG_ VCFRONT_a407_pulseCurrentVarianc m407 : 46|6@1+ (0.25,0) [0|15.75] "" Vector__XXX
 SG_ VCFRONT_a407_IBSTemperature m407 : 52|8@1+ (0.5,-30) [-30|97.5] "" Vector__XXX
 SG_ VCFRONT_a407_testCounter m407 : 60|2@1+ (1,0) [0|3] "" Vector__XXX
 SG_ VCFRONT_a407_testingExpended m407 : 62|1@1+ (1,0) [0|1] "" Vector__XXX
 SG_ VCFRONT_a407_opportunisticTest m407 : 63|1@1+ (1,0) [0|1] "" Vector__XXX
 SG_ VCFRONT_a409_brushlessMotorConfi m409 : 16|1@1+ (1,0) [0|1] "" Vector__XXX
 SG_ VCFRONT_a414_dcrMilliOhms m414 : 16|6@1+ (1,0) [0|63] "" Vector__XXX
 SG_ VCFRONT_a414_LVBatteryTemp m414 : 24|7@1+ (1,-40) [-40|87] "" Vector__XXX
 SG_ VCFRONT_a414_IBSCurrent m414 : 31|12@1- (0.1,0) [-204.8|204.7] "" Vector__XXX
 SG_ VCFRONT_a414_IBSVoltage m414 : 43|11@1+ (0.0108873518184,0) [0|22.2864091723] "" Vector__XXX
 SG_ VCFRONT_a414_IBSAmpHours m414 : 54|8@1+ (0.01,-2.55) [-2.55|4.4408920985e-16] "" Vector__XXX
 SG_ VCFRONT_a414_vehiclePowerState m414 : 62|2@1+ (1,0) [0|3] "" Vector__XXX
 SG_ VCFRONT_a415_dcrMilliOhms m415 : 16|6@1+ (1,0) [0|63] "" Vector__XXX
 SG_ VCFRONT_a415_LVBatteryTemp m415 : 22|7@1+ (1,-40) [-40|87] "" Vector__XXX
 SG_ VCFRONT_a415_IBSCurrent m415 : 29|9@1- (0.5,0) [-128|127.5] "" Vector__XXX
 SG_ VCFRONT_a415_IBSVoltage m415 : 38|9@1+ (0.04,0) [0|20.44] "" Vector__XXX
 SG_ VCFRONT_a415_IBSAmpHours m415 : 47|7@1+ (0.02,-2.55) [-2.55|-0.01] "" Vector__XXX
 SG_ VCFRONT_a415_vehiclePowerState m415 : 54|2@1+ (1,0) [0|3] "" Vector__XXX
 SG_ VCFRONT_a415_HV_UP m415 : 56|1@1+ (1,0) [0|1] "" Vector__XXX
 SG_ VCFRONT_a415_hvUpFirstTrigger m415 : 57|1@1+ (1,0) [0|1] "" Vector__XXX
 SG_ VCFRONT_a415_hvUpAnyTrigger m415 : 58|1@1+ (1,0) [0|1] "" Vector__XXX
 SG_ VCFRONT_a415_pcsEFuseUnstable m415 : 59|1@1+ (1,0) [0|1] "" Vector__XXX
 SG_ VCFRONT_a415_vcrightEfuseUnstabl m415 : 60|1@1+ (1,0) [0|1] "" Vector__XXX
 SG_ VCFRONT_a415_vcleftEfuseUnstable m415 : 61|1@1+ (1,0) [0|1] "" Vector__XXX
 SG_ VCFRONT_a415_contactorEFuseUnsta m415 : 62|1@1+ (1,0) [0|1] "" Vector__XXX
 SG_ VCFRONT_a415_hvcEFuseUnstable m415 : 63|1@1+ (1,0) [0|1] "" Vector__XXX
 SG_ VCFRONT_a416_brickVoltageMin m416 : 16|10@1+ (0.005,0) [0|5.115] "" Vector__XXX
 SG_ VCFRONT_a416_brickVoltageMax m416 : 26|10@1+ (0.005,0) [0|5.115] "" Vector__XXX
 SG_ VCFRONT_a416_packCurrent m416 : 36|10@1- (5,0) [-2560|2555] "" Vector__XXX
 SG_ VCFRONT_a416_socMin m416 : 46|8@1+ (0.5,0) [0|127.5] "" Vector__XXX
 SG_ VCFRONT_a416_brickId m416 : 54|8@1+ (1,1) [1|256] "" Vector__XXX
 SG_ VCFRONT_a417_brickVoltageMin m417 : 16|10@1+ (0.005,0) [0|5.115] "" Vector__XXX
 SG_ VCFRONT_a417_brickVoltageMax m417 : 26|10@1+ (0.005,0) [0|5.115] "" Vector__XXX
 SG_ VCFRONT_a417_packCurrent m417 : 36|10@1- (5,0) [-2560|2555] "" Vector__XXX
 SG_ VCFRONT_a417_socMax m417 : 46|8@1+ (0.5,0) [0|127.5] "" Vector__XXX
 SG_ VCFRONT_a417_brickId m417 : 54|8@1+ (1,1) [1|256] "" Vector__XXX
 SG_ VCFRONT_a418_brickVoltageMin m418 : 16|10@1+ (0.005,0) [0|5.115] "" Vector__XXX
 SG_ VCFRONT_a418_brickVoltageMax m418 : 26|10@1+ (0.005,0) [0|5.115] "" Vector__XXX
 SG_ VCFRONT_a418_packCurrent m418 : 36|10@1- (5,0) [-2560|2555] "" Vector__XXX
 SG_ VCFRONT_a418_socMax m418 : 46|8@1+ (0.5,0) [0|127.5] "" Vector__XXX
 SG_ VCFRONT_a418_brickId m418 : 54|8@1+ (1,1) [1|256] "" Vector__XXX
 SG_ VCFRONT_a419_brickVoltageMin m419 : 16|10@1+ (0.005,0) [0|5.115] "" Vector__XXX
 SG_ VCFRONT_a419_brickVoltageMax m419 : 26|10@1+ (0.005,0) [0|5.115] "" Vector__XXX
 SG_ VCFRONT_a419_packCurrent m419 : 36|10@1- (5,0) [-2560|2555] "" Vector__XXX
 SG_ VCFRONT_a419_socMin m419 : 46|8@1+ (0.5,0) [0|127.5] "" Vector__XXX
 SG_ VCFRONT_a419_brickId m419 : 54|8@1+ (1,1) [1|256] "" Vector__XXX
 SG_ VCFRONT_a423_brickVoltageMin m423 : 16|10@1+ (0.005,0) [0|5.115] "" Vector__XXX
 SG_ VCFRONT_a423_brickVoltageMax m423 : 26|10@1+ (0.005,0) [0|5.115] "" Vector__XXX
 SG_ VCFRONT_a423_packCurrent m423 : 36|10@1- (5,0) [-2560|2555] "" Vector__XXX
 SG_ VCFRONT_a423_socMin m423 : 46|8@1+ (0.5,0) [0|127.5] "" Vector__XXX
 SG_ VCFRONT_a423_brickId m423 : 54|8@1+ (1,1) [1|256] "" Vector__XXX
 SG_ VCFRONT_a424_brickVoltageMin m424 : 16|10@1+ (0.005,0) [0|5.115] "" Vector__XXX
 SG_ VCFRONT_a424_brickVoltageMax m424 : 26|10@1+ (0.005,0) [0|5.115] "" Vector__XXX
 SG_ VCFRONT_a424_packCurrent m424 : 36|10@1- (5,0) [-2560|2555] "" Vector__XXX
 SG_ VCFRONT_a424_socMin m424 : 46|8@1+ (0.5,0) [0|127.5] "" Vector__XXX
 SG_ VCFRONT_a424_brickId m424 : 54|8@1+ (1,1) [1|256] "" Vector__XXX
 SG_ VCFRONT_a431_netPackCurrent m431 : 16|16@1- (0.1,0) [-3276.8|3276.7] "" Vector__XXX
 SG_ VCFRONT_a431_maxChargeCurrentLim m431 : 32|16@1- (0.1,0) [-3276.8|3276.7] "" Vector__XXX
 SG_ VCFRONT_a431_hvjbCurrentLimit m431 : 48|16@1- (0.1,0) [-3276.8|3276.7] "" Vector__XXX
 SG_ VCFRONT_a432_targetCurrent m432 : 16|16@1- (0.1,0) [-3276.8|3276.7] "" Vector__XXX
 SG_ VCFRONT_a432_packCurrent m432 : 32|16@1- (0.1,0) [-3276.8|3276.7] "" Vector__XXX
 SG_ VCFRONT_a433_bmbModuleId m433 : 16|16@1+ (1,0) [0|65535] "" Vector__XXX
 SG_ VCFRONT_a433_packTypeData m433 : 32|8@1+ (1,0) [0|255] "" Vector__XXX
 SG_ VCFRONT_a433_cellTypeData m433 : 40|8@1+ (1,0) [0|255] "" Vector__XXX
 SG_ VCFRONT_a433_bmbModuleIdValid m433 : 48|1@1+ (1,0) [0|1] "" Vector__XXX
 SG_ VCFRONT_a433_useBmbModuleId m433 : 49|1@1+ (1,0) [0|1] "" Vector__XXX
 SG_ VCFRONT_a434_bmbModuleId m434 : 16|16@1+ (1,0) [0|65535] "" Vector__XXX
 SG_ VCFRONT_a434_packTypeData m434 : 32|8@1+ (1,0) [0|255] "" Vector__XXX
 SG_ VCFRONT_a434_cellTypeData m434 : 40|8@1+ (1,0) [0|255] "" Vector__XXX
 SG_ VCFRONT_a434_bmbModuleIdValid m434 : 48|1@1+ (1,0) [0|1] "" Vector__XXX
 SG_ VCFRONT_a434_useBmbModuleId m434 : 49|1@1+ (1,0) [0|1] "" Vector__XXX
 SG_ VCFRONT_a436_netPackCurrent m436 : 16|16@1- (0.1,0) [-3276.8|3276.7] "" Vector__XXX
 SG_ VCFRONT_a436_maxDischargeCurrent m436 : 32|16@1- (0.1,0) [-3276.8|3276.7] "" Vector__XXX
 SG_ VCFRONT_a436_hvjbCurrentLimit m436 : 48|16@1- (0.1,0) [-3276.8|3276.7] "" Vector__XXX
 SG_ VCFRONT_a437_nvmDataMissingA m437 : 16|1@1+ (1,0) [0|1] "" Vector__XXX
 SG_ VCFRONT_a437_nvmDataMissingB m437 : 17|1@1+ (1,0) [0|1] "" Vector__XXX
 SG_ VCFRONT_a438_temperature m438 : 16|16@1+ (0.01,0) [0|655.35] "" Vector__XXX
 SG_ VCFRONT_a438_sensorId m438 : 32|6@1+ (1,1) [1|64] "" Vector__XXX
 SG_ VCFRONT_a439_temperature m439 : 16|16@1+ (0.01,0) [0|655.35] "" Vector__XXX
 SG_ VCFRONT_a439_sensorId m439 : 32|6@1+ (1,1) [1|64] "" Vector__XXX
 SG_ VCFRONT_a441_bmbModuleId m441 : 16|16@1+ (1,0) [0|65535] "" Vector__XXX
 SG_ VCFRONT_a441_bmbModuleIdPrev m441 : 32|16@1+ (1,0) [0|65535] "" Vector__XXX
 SG_ VCFRONT_a444_retriesAvailable m444 : 16|8@1+ (1,0) [0|255] "" Vector__XXX
 SG_ VCFRONT_a444_channel m444 : 24|8@1+ (1,0) [0|255] "" Vector__XXX
 SG_ VCFRONT_a444_watchdog m444 : 32|1@1+ (1,0) [0|1] "" Vector__XXX
 SG_ VCFRONT_a444_gateDriver m444 : 33|1@1+ (1,0) [0|1] "" Vector__XXX
 SG_ VCFRONT_a444_overcurrent m444 : 34|1@1+ (1,0) [0|1] "" Vector__XXX
 SG_ VCFRONT_a444_supplyUndervoltage m444 : 35|1@1+ (1,0) [0|1] "" Vector__XXX
 SG_ VCFRONT_a444_cpUndervoltage m444 : 36|1@1+ (1,0) [0|1] "" Vector__XXX
 SG_ VCFRONT_a444_overTempShutdown m444 : 37|1@1+ (1,0) [0|1] "" Vector__XXX
 SG_ VCFRONT_a444_overTempWarning m444 : 38|1@1+ (1,0) [0|1] "" Vector__XXX
 SG_ VCFRONT_a444_highSide2GateDriver m444 : 39|1@1+ (1,0) [0|1] "" Vector__XXX
 SG_ VCFRONT_a444_lowSide2GateDriver m444 : 40|1@1+ (1,0) [0|1] "" Vector__XXX
 SG_ VCFRONT_a444_highSide1GateDriver m444 : 41|1@1+ (1,0) [0|1] "" Vector__XXX
 SG_ VCFRONT_a444_lowSide1GateDriver m444 : 42|1@1+ (1,0) [0|1] "" Vector__XXX
 SG_ VCFRONT_a444_highSide2OverCurent m444 : 43|1@1+ (1,0) [0|1] "" Vector__XXX
 SG_ VCFRONT_a444_lowSide2OverCurent m444 : 44|1@1+ (1,0) [0|1] "" Vector__XXX
 SG_ VCFRONT_a444_highSide1OverCurent m444 : 45|1@1+ (1,0) [0|1] "" Vector__XXX
 SG_ VCFRONT_a444_lowSide1OverCurent m444 : 46|1@1+ (1,0) [0|1] "" Vector__XXX
 SG_ VCFRONT_a444_spiInit m444 : 47|1@1+ (1,0) [0|1] "" Vector__XXX
 SG_ VCFRONT_a444_spiPeriodicCheck m444 : 48|1@1+ (1,0) [0|1] "" Vector__XXX
 SG_ VCFRONT_a444_spiFault m444 : 49|1@1+ (1,0) [0|1] "" Vector__XXX
 SG_ VCFRONT_a444_voltageMonitor m444 : 50|1@1+ (1,0) [0|1] "" Vector__XXX
 SG_ VCFRONT_a444_enableLow m444 : 51|1@1+ (1,0) [0|1] "" Vector__XXX
 SG_ VCFRONT_a446_compFaultRefrigeran m446 : 16|1@1+ (1,0) [0|1] "" Vector__XXX
 SG_ VCFRONT_a446_compFaultTdHigh m446 : 17|1@1+ (1,0) [0|1] "" Vector__XXX
 SG_ VCFRONT_a446_compFaultPdLow m446 : 18|1@1+ (1,0) [0|1] "" Vector__XXX
 SG_ VCFRONT_a446_compFaultPdHigh m446 : 19|1@1+ (1,0) [0|1] "" Vector__XXX
 SG_ VCFRONT_a446_compFaultPsLow m446 : 20|1@1+ (1,0) [0|1] "" Vector__XXX
 SG_ VCFRONT_a446_compStandbyLowAmbie m446 : 21|1@1+ (1,0) [0|1] "" Vector__XXX
 SG_ VCFRONT_a446_compStandbyLowDisch m446 : 22|1@1+ (1,0) [0|1] "" Vector__XXX
 SG_ VCFRONT_a446_compStandbyHVNotRea m446 : 23|1@1+ (1,0) [0|1] "" Vector__XXX
 SG_ VCFRONT_a446_compStandbyCommunic m446 : 24|1@1+ (1,0) [0|1] "" Vector__XXX
 SG_ VCFRONT_a446_compStandbySelfNotR m446 : 25|1@1+ (1,0) [0|1] "" Vector__XXX
 SG_ VCFRONT_a446_compStandbyRefrigNo m446 : 26|1@1+ (1,0) [0|1] "" Vector__XXX
 SG_ VCFRONT_a446_compStandbyCoastDow m446 : 27|1@1+ (1,0) [0|1] "" Vector__XXX
 SG_ VCFRONT_a446_compStandbyMultiple m446 : 28|1@1+ (1,0) [0|1] "" Vector__XXX
 SG_ VCFRONT_a446_compStandbyShowroom m446 : 29|1@1+ (1,0) [0|1] "" Vector__XXX
 SG_ VCFRONT_a446_compStandbyMul_0001 m446 : 30|1@1+ (1,0) [0|1] "" Vector__XXX
 SG_ VCFRONT_a446_hpCabinLoadType m446 : 31|2@1+ (1,0) [0|3] "" Vector__XXX
 SG_ VCFRONT_a446_hpBatteryLoadType m446 : 33|2@1+ (1,0) [0|3] "" Vector__XXX
 SG_ VCFRONT_a446_usingModeledPs m446 : 35|1@1+ (1,0) [0|1] "" Vector__XXX
 SG_ VCFRONT_a446_usingModeledPd m446 : 36|1@1+ (1,0) [0|1] "" Vector__XXX
 SG_ VCFRONT_a446_usingModeledPl m446 : 37|1@1+ (1,0) [0|1] "" Vector__XXX
 SG_ VCFRONT_a446_usingModeledTs m446 : 38|1@1+ (1,0) [0|1] "" Vector__XXX
 SG_ VCFRONT_a446_usingModeledTd m446 : 39|1@1+ (1,0) [0|1] "" Vector__XXX
 SG_ VCFRONT_a446_usingModeledTl m446 : 40|1@1+ (1,0) [0|1] "" Vector__XXX
 SG_ VCFRONT_a446_sensorHasOffsetTd m446 : 41|1@1+ (1,0) [0|1] "" Vector__XXX
 SG_ VCFRONT_a446_sensorHasOffsetPd m446 : 42|1@1+ (1,0) [0|1] "" Vector__XXX
 SG_ VCFRONT_a446_sensorDroopPd m446 : 43|1@1+ (1,0) [0|1] "" Vector__XXX
 SG_ VCFRONT_a446_sensorHasOffsetTl m446 : 44|1@1+ (1,0) [0|1] "" Vector__XXX
 SG_ VCFRONT_a446_sensorIntermit_0002 m446 : 45|1@1+ (1,0) [0|1] "" Vector__XXX
 SG_ VCFRONT_a446_sensorIntermittentP m446 : 46|1@1+ (1,0) [0|1] "" Vector__XXX
 SG_ VCFRONT_a446_sensorIntermit_0001 m446 : 47|1@1+ (1,0) [0|1] "" Vector__XXX
 SG_ VCFRONT_a446_sensorIntermit_0004 m446 : 48|1@1+ (1,0) [0|1] "" Vector__XXX
 SG_ VCFRONT_a446_sensorIntermittentT m446 : 49|1@1+ (1,0) [0|1] "" Vector__XXX
 SG_ VCFRONT_a446_sensorIntermit_0003 m446 : 50|1@1+ (1,0) [0|1] "" Vector__XXX
 SG_ VCFRONT_a446_highSuctionSuperhea m446 : 51|1@1+ (1,0) [0|1] "" Vector__XXX
 SG_ VCFRONT_a446_evapLowPsCutout m446 : 52|1@1+ (1,0) [0|1] "" Vector__XXX
 SG_ VCFRONT_a446_batteryOverTemp m446 : 53|1@1+ (1,0) [0|1] "" Vector__XXX
 SG_ VCFRONT_a446_hvacSystemFault m446 : 54|1@1+ (1,0) [0|1] "" Vector__XXX
 SG_ VCFRONT_a446_coolantSysLockedOut m446 : 55|1@1+ (1,0) [0|1] "" Vector__XXX
 SG_ VCFRONT_a446_refSysLockedOut m446 : 56|1@1+ (1,0) [0|1] "" Vector__XXX
 SG_ VCFRONT_a446_chillerEXVNotReady m446 : 57|1@1+ (1,0) [0|1] "" Vector__XXX
 SG_ VCFRONT_a446_CCLEXVNotReady m446 : 58|1@1+ (1,0) [0|1] "" Vector__XXX
 SG_ VCFRONT_a446_CCREXVNotReady m446 : 59|1@1+ (1,0) [0|1] "" Vector__XXX
 SG_ VCFRONT_a446_LCCEXVNotReady m446 : 60|1@1+ (1,0) [0|1] "" Vector__XXX
 SG_ VCFRONT_a446_evapEXVNotReady m446 : 61|1@1+ (1,0) [0|1] "" Vector__XXX
 SG_ VCFRONT_a446_recircEXVNotReady m446 : 62|1@1+ (1,0) [0|1] "" Vector__XXX
 SG_ VCFRONT_a446_checkA447Alert m446 : 63|1@1+ (1,0) [0|1] "" Vector__XXX
 SG_ VCFRONT_a447_caseHVACUnavailable m447 : 16|1@1+ (1,0) [0|1] "" Vector__XXX
 SG_ VCFRONT_a447_heatPumpHVACUnavail m447 : 17|1@1+ (1,0) [0|1] "" Vector__XXX
 SG_ VCFRONT_a447_activeLouverComprom m447 : 18|1@1+ (1,0) [0|1] "" Vector__XXX
 SG_ VCFRONT_a447_coolantValveComprom m447 : 19|1@1+ (1,0) [0|1] "" Vector__XXX
 SG_ VCFRONT_a447_ambientSourcingComp m447 : 20|1@1+ (1,0) [0|1] "" Vector__XXX
 SG_ VCFRONT_a447_scavengeLoopComprom m447 : 21|1@1+ (1,0) [0|1] "" Vector__XXX
 SG_ VCFRONT_a447_coolantSystemCompro m447 : 22|1@1+ (1,0) [0|1] "" Vector__XXX
 SG_ VCFRONT_a447_hvBattActiveDischgC m447 : 23|1@1+ (1,0) [0|1] "" Vector__XXX
 SG_ VCFRONT_a447_hvBatteryDischargin m447 : 24|1@1+ (1,0) [0|1] "" Vector__XXX
 SG_ VCFRONT_a447_lccSolenoidCompromi m447 : 25|1@1+ (1,0) [0|1] "" Vector__XXX
 SG_ VCFRONT_a447_refrigerantSystemCo m447 : 26|1@1+ (1,0) [0|1] "" Vector__XXX
 SG_ VCFRONT_a447_powertrainThermalFa m447 : 27|1@1+ (1,0) [0|1] "" Vector__XXX
 SG_ VCFRONT_a447_refrigDischargePres m447 : 28|1@1+ (1,0) [0|1] "" Vector__XXX
 SG_ VCFRONT_a447_refrigeDischargeTem m447 : 29|1@1+ (1,0) [0|1] "" Vector__XXX
 SG_ VCFRONT_a447_refrigSuctionPressC m447 : 30|1@1+ (1,0) [0|1] "" Vector__XXX
 SG_ VCFRONT_a447_refrigSuctionTempCo m447 : 31|1@1+ (1,0) [0|1] "" Vector__XXX
 SG_ VCFRONT_a447_refrigLiquidPressCo m447 : 32|1@1+ (1,0) [0|1] "" Vector__XXX
 SG_ VCFRONT_a447_refrigLiquidTempCom m447 : 33|1@1+ (1,0) [0|1] "" Vector__XXX
 SG_ VCFRONT_a459_coolantFillActive m459 : 16|1@1+ (1,0) [0|1] "" Vector__XXX
 SG_ VCFRONT_a459_refrigerantFillActi m459 : 17|1@1+ (1,0) [0|1] "" Vector__XXX
 SG_ VCFRONT_a462_CellOVLevel1 m462 : 16|1@1+ (1,0) [0|1] "" Vector__XXX
 SG_ VCFRONT_a462_CellOVLevel2 m462 : 17|1@1+ (1,0) [0|1] "" Vector__XXX
 SG_ VCFRONT_a462_CellOVLevel3 m462 : 18|1@1+ (1,0) [0|1] "" Vector__XXX
 SG_ VCFRONT_a462_CellUVLevel1 m462 : 19|1@1+ (1,0) [0|1] "" Vector__XXX
 SG_ VCFRONT_a462_CellUVLevel2 m462 : 20|1@1+ (1,0) [0|1] "" Vector__XXX
 SG_ VCFRONT_a462_ModuleOTLevel1 m462 : 21|1@1+ (1,0) [0|1] "" Vector__XXX
 SG_ VCFRONT_a462_PackOVLevel1 m462 : 22|1@1+ (1,0) [0|1] "" Vector__XXX
 SG_ VCFRONT_a462_PackOVLevel2 m462 : 23|1@1+ (1,0) [0|1] "" Vector__XXX
 SG_ VCFRONT_a462_DischrgOCLevel1 m462 : 24|1@1+ (1,0) [0|1] "" Vector__XXX
 SG_ VCFRONT_a462_HardwareOCLevel2 m462 : 25|1@1+ (1,0) [0|1] "" Vector__XXX
 SG_ VCFRONT_a462_ChrgOCLevel1 m462 : 26|1@1+ (1,0) [0|1] "" Vector__XXX
 SG_ VCFRONT_a462_ChrgOCLevel2 m462 : 27|1@1+ (1,0) [0|1] "" Vector__XXX
 SG_ VCFRONT_a462_MOSFETOTLevel1 m462 : 28|1@1+ (1,0) [0|1] "" Vector__XXX
 SG_ VCFRONT_a462_CPA_State m462 : 29|1@1+ (1,0) [0|1] "" Vector__XXX
 SG_ VCFRONT_a462_NTCTempDiffWarnLeve m462 : 30|1@1+ (1,0) [0|1] "" Vector__XXX
 SG_ VCFRONT_a462_KBValueLostFault m462 : 31|1@1+ (1,0) [0|1] "" Vector__XXX
 SG_ VCFRONT_a462_BalanceCircuitFault m462 : 32|1@1+ (1,0) [0|1] "" Vector__XXX
 SG_ VCFRONT_a462_MOSOpenFault m462 : 33|1@1+ (1,0) [0|1] "" Vector__XXX
 SG_ VCFRONT_a462_DeepDischarge m462 : 34|1@1+ (1,0) [0|1] "" Vector__XXX
 SG_ VCFRONT_a462_SamplingError m462 : 35|1@1+ (1,0) [0|1] "" Vector__XXX
 SG_ VCFRONT_a462_MOSFETStuckClose m462 : 36|1@1+ (1,0) [0|1] "" Vector__XXX
 SG_ VCFRONT_a462_MOSFETStuckOpen m462 : 37|1@1+ (1,0) [0|1] "" Vector__XXX
 SG_ VCFRONT_a462_Imbalance m462 : 38|1@1+ (1,0) [0|1] "" Vector__XXX
 SG_ VCFRONT_a462_serviceMode m462 : 39|1@1+ (1,0) [0|1] "" Vector__XXX
 SG_ VCFRONT_a462_frunkOpen m462 : 40|1@1+ (1,0) [0|1] "" Vector__XXX
 SG_ VCFRONT_a463_switchMismatch m463 : 16|1@1+ (1,0) [0|1] "" Vector__XXX
 SG_ VCFRONT_a463_switch1Shorted m463 : 17|1@1+ (1,0) [0|1] "" Vector__XXX
 SG_ VCFRONT_a463_switch1Disconnected m463 : 18|1@1+ (1,0) [0|1] "" Vector__XXX
 SG_ VCFRONT_a463_switch2Shorted m463 : 19|1@1+ (1,0) [0|1] "" Vector__XXX
 SG_ VCFRONT_a463_switch2Disconnected m463 : 20|1@1+ (1,0) [0|1] "" Vector__XXX
 SG_ VCFRONT_a463_switch1VoltageAvera m463 : 21|10@1+ (5,0) [0|5115] "" Vector__XXX
 SG_ VCFRONT_a463_switch1VoltageInsta m463 : 32|10@1+ (5,0) [0|5115] "" Vector__XXX
 SG_ VCFRONT_a463_switch2VoltageAvera m463 : 42|10@1+ (5,0) [0|5115] "" Vector__XXX
 SG_ VCFRONT_a463_switch2VoltageInsta m463 : 52|10@1+ (5,0) [0|5115] "" Vector__XXX
 SG_ VCFRONT_a464_flowIndex m464 : 16|8@1+ (1,0) [0|255] "" Vector__XXX
 SG_ VCFRONT_a464_flowIndexFiltered m464 : 24|8@1+ (1,0) [0|255] "" Vector__XXX
 SG_ VCFRONT_a464_subcool m464 : 32|7@1+ (0.4,-10) [-10|40.8] "" Vector__XXX
 SG_ VCFRONT_a464_subcoolFiltered m464 : 40|7@1+ (0.4,-10) [-10|40.8] "" Vector__XXX
 SG_ VCFRONT_a465_flowIndex m465 : 16|8@1+ (1,0) [0|255] "" Vector__XXX
 SG_ VCFRONT_a465_flowIndexFiltered m465 : 24|8@1+ (1,0) [0|255] "" Vector__XXX
 SG_ VCFRONT_a465_subcool m465 : 32|7@1+ (0.4,-10) [-10|40.8] "" Vector__XXX
 SG_ VCFRONT_a465_subcoolFiltered m465 : 40|7@1+ (0.4,-10) [-10|40.8] "" Vector__XXX
 SG_ VCFRONT_a465_flaggedAtSteadyStat m465 : 47|1@1+ (1,0) [0|1] "" Vector__XXX
 SG_ VCFRONT_a465_flaggedAtUnsteadySt m465 : 48|1@1+ (1,0) [0|1] "" Vector__XXX
 SG_ VCFRONT_a466_flowIndex m466 : 16|8@1+ (1,0) [0|255] "" Vector__XXX
 SG_ VCFRONT_a466_flowIndexFiltered m466 : 24|8@1+ (1,0) [0|255] "" Vector__XXX
 SG_ VCFRONT_a466_subcool m466 : 32|7@1+ (0.4,-10) [-10|40.8] "" Vector__XXX
 SG_ VCFRONT_a466_subcoolFiltered m466 : 40|7@1+ (0.4,-10) [-10|40.8] "" Vector__XXX
 SG_ VCFRONT_a467_powerIndexFiltered m467 : 16|7@1+ (1,0) [0|127] "" Vector__XXX
 SG_ VCFRONT_a470_pressureLiquid m470 : 16|8@1+ (0.2,0) [0|51] "" Vector__XXX
 SG_ VCFRONT_a470_pressureDischarge m470 : 24|8@1+ (0.2,0) [0|51] "" Vector__XXX
 SG_ VCFRONT_a474_ssl100Bank1Status m474 : 16|2@1+ (1,0) [0|3] "" Vector__XXX
 SG_ VCFRONT_a474_ssl100Bank2Status m474 : 18|2@1+ (1,0) [0|3] "" Vector__XXX
 SG_ VCFRONT_a474_ssl100Bank3Status m474 : 20|2@1+ (1,0) [0|3] "" Vector__XXX
 SG_ VCFRONT_a474_ssl100Bank4Status m474 : 22|2@1+ (1,0) [0|3] "" Vector__XXX
 SG_ VCFRONT_a474_ssl100Bank5Status m474 : 24|2@1+ (1,0) [0|3] "" Vector__XXX
 SG_ VCFRONT_a474_ssl100Bank6Status m474 : 26|2@1+ (1,0) [0|3] "" Vector__XXX
 SG_ VCFRONT_a474_ssl100Bank7Status m474 : 28|2@1+ (1,0) [0|3] "" Vector__XXX
 SG_ VCFRONT_a474_ssl100Bank8Status m474 : 30|2@1+ (1,0) [0|3] "" Vector__XXX
 SG_ VCFRONT_a474_ssl100Bank9Status m474 : 32|2@1+ (1,0) [0|3] "" Vector__XXX
 SG_ VCFRONT_a474_lowBeamPrefieldStat m474 : 34|3@1+ (1,0) [0|7] "" Vector__XXX
 SG_ VCFRONT_a474_drl1Status m474 : 37|3@1+ (1,0) [0|7] "" Vector__XXX
 SG_ VCFRONT_a474_drl2Status m474 : 40|3@1+ (1,0) [0|7] "" Vector__XXX
 SG_ VCFRONT_a474_drl3Status m474 : 43|3@1+ (1,0) [0|7] "" Vector__XXX
 SG_ VCFRONT_a474_turnStatus m474 : 48|3@1+ (1,0) [0|7] "" Vector__XXX
 SG_ VCFRONT_a474_fanStatus m474 : 51|1@1+ (1,0) [0|1] "" Vector__XXX
 SG_ VCFRONT_a474_TPS92520_COMPOV m474 : 52|1@1+ (1,0) [0|1] "" Vector__XXX
 SG_ VCFRONT_a474_TPS92520_HSILIM m474 : 53|1@1+ (1,0) [0|1] "" Vector__XXX
 SG_ VCFRONT_a474_TPS92520_BSTUV m474 : 54|1@1+ (1,0) [0|1] "" Vector__XXX
 SG_ VCFRONT_a474_BoostRailStatus m474 : 55|1@1+ (1,0) [0|1] "" Vector__XXX
 SG_ VCFRONT_a474_EEPROM_DataStatus m474 : 56|1@1+ (1,0) [0|1] "" Vector__XXX
 SG_ VCFRONT_a474_LMMVariant m474 : 57|2@1+ (1,0) [0|3] "" Vector__XXX
 SG_ VCFRONT_a474_headlampECURevision m474 : 59|4@1+ (1,0) [0|15] "" Vector__XXX
 SG_ VCFRONT_a475_ssl100Bank1Status m475 : 16|2@1+ (1,0) [0|3] "" Vector__XXX
 SG_ VCFRONT_a475_ssl100Bank2Status m475 : 18|2@1+ (1,0) [0|3] "" Vector__XXX
 SG_ VCFRONT_a475_ssl100Bank3Status m475 : 20|2@1+ (1,0) [0|3] "" Vector__XXX
 SG_ VCFRONT_a475_ssl100Bank4Status m475 : 22|2@1+ (1,0) [0|3] "" Vector__XXX
 SG_ VCFRONT_a475_ssl100Bank5Status m475 : 24|2@1+ (1,0) [0|3] "" Vector__XXX
 SG_ VCFRONT_a475_ssl100Bank6Status m475 : 26|2@1+ (1,0) [0|3] "" Vector__XXX
 SG_ VCFRONT_a475_ssl100Bank7Status m475 : 28|2@1+ (1,0) [0|3] "" Vector__XXX
 SG_ VCFRONT_a475_ssl100Bank8Status m475 : 30|2@1+ (1,0) [0|3] "" Vector__XXX
 SG_ VCFRONT_a475_ssl100Bank9Status m475 : 32|2@1+ (1,0) [0|3] "" Vector__XXX
 SG_ VCFRONT_a475_lowBeamPrefieldStat m475 : 34|3@1+ (1,0) [0|7] "" Vector__XXX
 SG_ VCFRONT_a475_drl1Status m475 : 37|3@1+ (1,0) [0|7] "" Vector__XXX
 SG_ VCFRONT_a475_drl2Status m475 : 40|3@1+ (1,0) [0|7] "" Vector__XXX
 SG_ VCFRONT_a475_drl3Status m475 : 43|3@1+ (1,0) [0|7] "" Vector__XXX
 SG_ VCFRONT_a475_turnStatus m475 : 48|3@1+ (1,0) [0|7] "" Vector__XXX
 SG_ VCFRONT_a475_fanStatus m475 : 51|1@1+ (1,0) [0|1] "" Vector__XXX
 SG_ VCFRONT_a475_TPS92520_COMPOV m475 : 52|1@1+ (1,0) [0|1] "" Vector__XXX
 SG_ VCFRONT_a475_TPS92520_HSILIM m475 : 53|1@1+ (1,0) [0|1] "" Vector__XXX
 SG_ VCFRONT_a475_TPS92520_BSTUV m475 : 54|1@1+ (1,0) [0|1] "" Vector__XXX
 SG_ VCFRONT_a475_BoostRailStatus m475 : 55|1@1+ (1,0) [0|1] "" Vector__XXX
 SG_ VCFRONT_a475_EEPROM_DataStatus m475 : 56|1@1+ (1,0) [0|1] "" Vector__XXX
 SG_ VCFRONT_a475_LMMVariant m475 : 57|2@1+ (1,0) [0|3] "" Vector__XXX
 SG_ VCFRONT_a475_headlampECURevision m475 : 59|4@1+ (1,0) [0|15] "" Vector__XXX
 SG_ VCFRONT_a476_FRM1_timedOut m476 : 16|1@1+ (1,0) [0|1] "" Vector__XXX
 SG_ VCFRONT_a476_FRM2_timedOut m476 : 17|1@1+ (1,0) [0|1] "" Vector__XXX
 SG_ VCFRONT_a476_FRM3_timedOut m476 : 18|1@1+ (1,0) [0|1] "" Vector__XXX
 SG_ VCFRONT_a476_FRM4_timedOut m476 : 19|1@1+ (1,0) [0|1] "" Vector__XXX
 SG_ VCFRONT_a476_FRM5_timedOut m476 : 20|1@1+ (1,0) [0|1] "" Vector__XXX
 SG_ VCFRONT_a476_FRM6_timedOut m476 : 21|1@1+ (1,0) [0|1] "" Vector__XXX
 SG_ VCFRONT_a476_FRM7_timedOut m476 : 22|1@1+ (1,0) [0|1] "" Vector__XXX
 SG_ VCFRONT_a476_FRM8_timedOut m476 : 23|1@1+ (1,0) [0|1] "" Vector__XXX
 SG_ VCFRONT_a476_FRM9_timedOut m476 : 24|1@1+ (1,0) [0|1] "" Vector__XXX
 SG_ VCFRONT_a476_FRM10_timedOut m476 : 25|1@1+ (1,0) [0|1] "" Vector__XXX
 SG_ VCFRONT_a476_FRM11_timedOut m476 : 26|1@1+ (1,0) [0|1] "" Vector__XXX
 SG_ VCFRONT_a476_FRM12_timedOut m476 : 27|1@1+ (1,0) [0|1] "" Vector__XXX
 SG_ VCFRONT_a476_factoryMode m476 : 28|1@1+ (1,0) [0|1] "" Vector__XXX
 SG_ VCFRONT_a476_serviceMode m476 : 29|1@1+ (1,0) [0|1] "" Vector__XXX
 SG_ VCFRONT_a476_transportMode m476 : 30|1@1+ (1,0) [0|1] "" Vector__XXX
 SG_ VCFRONT_a476_frunkOpen m476 : 31|1@1+ (1,0) [0|1] "" Vector__XXX
 SG_ VCFRONT_a476_vehiclePowerState m476 : 32|2@1+ (1,0) [0|3] "" Vector__XXX
 SG_ VCFRONT_a476_batterySMState m476 : 34|4@1+ (1,0) [0|15] "" Vector__XXX
 SG_ VCFRONT_a476_ECPAState m476 : 38|2@1+ (1,0) [0|3] "" Vector__XXX
 SG_ VCFRONT_a477_cell1Voltage m477 : 16|9@1+ (0.01,0) [0|5.11] "" Vector__XXX
 SG_ VCFRONT_a477_cell2Voltage m477 : 25|9@1+ (0.01,0) [0|5.11] "" Vector__XXX
 SG_ VCFRONT_a477_cell3Voltage m477 : 34|9@1+ (0.01,0) [0|5.11] "" Vector__XXX
 SG_ VCFRONT_a477_cell4Voltage m477 : 43|9@1+ (0.01,0) [0|5.11] "" Vector__XXX
 SG_ VCFRONT_a477_sumCellVoltage m477 : 52|8@1+ (0.1,0) [0|25.5] "" Vector__XXX
 SG_ VCFRONT_a477_deepDischargeFlag m477 : 60|1@1+ (1,0) [0|1] "" Vector__XXX
 SG_ VCFRONT_a477_serviceMode m477 : 61|1@1+ (1,0) [0|1] "" Vector__XXX
 SG_ VCFRONT_a477_frunkOpen m477 : 62|1@1+ (1,0) [0|1] "" Vector__XXX
 SG_ VCFRONT_a478_battFaultPackOverVo m478 : 16|1@1+ (1,0) [0|1] "" Vector__XXX
 SG_ VCFRONT_a478_battFaultHardwareOv m478 : 17|1@1+ (1,0) [0|1] "" Vector__XXX
 SG_ VCFRONT_a478_battFaultChargeOver m478 : 18|1@1+ (1,0) [0|1] "" Vector__XXX
 SG_ VCFRONT_a478_battFaultCellUnderV m478 : 19|1@1+ (1,0) [0|1] "" Vector__XXX
 SG_ VCFRONT_a478_battFaultCellOverVo m478 : 20|1@1+ (1,0) [0|1] "" Vector__XXX
 SG_ VCFRONT_a478_vehiclePowerState m478 : 21|2@1+ (1,0) [0|3] "" Vector__XXX
 SG_ VCFRONT_a478_batterySMState m478 : 24|4@1+ (1,0) [0|15] "" Vector__XXX
 SG_ VCFRONT_a478_bmsState m478 : 28|4@1+ (1,0) [0|15] "" Vector__XXX
 SG_ VCFRONT_a478_dcdcLVSupportStatus m478 : 32|2@1+ (1,0) [0|3] "" Vector__XXX
 SG_ VCFRONT_a478_factoryMode m478 : 34|1@1+ (1,0) [0|1] "" Vector__XXX
 SG_ VCFRONT_a478_serviceMode m478 : 35|1@1+ (1,0) [0|1] "" Vector__XXX
 SG_ VCFRONT_a478_transportMode m478 : 36|1@1+ (1,0) [0|1] "" Vector__XXX
 SG_ VCFRONT_a478_notEnoughPowerForSu m478 : 37|1@1+ (1,0) [0|1] "" Vector__XXX
 SG_ VCFRONT_a478_crashDetected m478 : 38|1@1+ (1,0) [0|1] "" Vector__XXX
 SG_ VCFRONT_a478_BMS_MIA m478 : 39|1@1+ (1,0) [0|1] "" Vector__XXX
 SG_ VCFRONT_a478_PCS_MIA m478 : 40|1@1+ (1,0) [0|1] "" Vector__XXX
 SG_ VCFRONT_a478_HVBlockingMismatch m478 : 41|1@1+ (1,0) [0|1] "" Vector__XXX
 SG_ VCFRONT_a478_HV_UP m478 : 42|1@1+ (1,0) [0|1] "" Vector__XXX
 SG_ VCFRONT_a478_pcsEFuseStable m478 : 43|1@1+ (1,0) [0|1] "" Vector__XXX
 SG_ VCFRONT_a478_vcrightEFuseStable m478 : 44|1@1+ (1,0) [0|1] "" Vector__XXX
 SG_ VCFRONT_a478_contactorEFuseStabl m478 : 45|1@1+ (1,0) [0|1] "" Vector__XXX
 SG_ VCFRONT_a478_hvcEFuseStable m478 : 46|1@1+ (1,0) [0|1] "" Vector__XXX
 SG_ VCFRONT_a478_frunkOpen m478 : 47|1@1+ (1,0) [0|1] "" Vector__XXX
 SG_ VCFRONT_a479_FRM3_timedOut m479 : 16|1@1+ (1,0) [0|1] "" Vector__XXX
 SG_ VCFRONT_a479_ECPAState m479 : 17|2@1+ (1,0) [0|3] "" Vector__XXX
 SG_ VCFRONT_a479_factoryMode m479 : 19|1@1+ (1,0) [0|1] "" Vector__XXX
 SG_ VCFRONT_a479_serviceMode m479 : 20|1@1+ (1,0) [0|1] "" Vector__XXX
 SG_ VCFRONT_a479_transportMode m479 : 21|1@1+ (1,0) [0|1] "" Vector__XXX
 SG_ VCFRONT_a479_frunkLatchStatus m479 : 24|4@1+ (1,0) [0|15] "" Vector__XXX
 SG_ VCFRONT_a479_vehiclePowerState m479 : 28|2@1+ (1,0) [0|3] "" Vector__XXX
 SG_ VCFRONT_a479_batterySMState m479 : 32|4@1+ (1,0) [0|15] "" Vector__XXX
 SG_ VCFRONT_a480_channel m480 : 16|3@1+ (1,0) [0|7] "" Vector__XXX
 SG_ VCFRONT_a480_reset m480 : 19|1@1+ (1,0) [0|1] "" Vector__XXX
 SG_ VCFRONT_a480_spiError m480 : 20|1@1+ (1,0) [0|1] "" Vector__XXX
 SG_ VCFRONT_a480_autoOn m480 : 21|1@1+ (1,0) [0|1] "" Vector__XXX
 SG_ VCFRONT_a480_diagnosticBit m480 : 22|1@1+ (1,0) [0|1] "" Vector__XXX
 SG_ VCFRONT_a480_deviceError m480 : 23|1@1+ (1,0) [0|1] "" Vector__XXX
 SG_ VCFRONT_a480_overcurrent m480 : 24|1@1+ (1,0) [0|1] "" Vector__XXX
 SG_ VCFRONT_a480_unexpectedLock m480 : 25|1@1+ (1,0) [0|1] "" Vector__XXX

CM_ SG_ 1332 VCFRONT_a180_IBSVoltage "Front body controller: a180 IBS voltage";
CM_ SG_ 1332 VCFRONT_a180_targetPCSVoltage "Front body controller: a180 target PCS voltage";
CM_ SG_ 1332 VCFRONT_a181_vehicleState "Front body controller: a181 vehicle state";
CM_ SG_ 1332 VCFRONT_a182_deadLV "Front body controller: a182 dead LV";
CM_ SG_ 1332 VCFRONT_a182_voltageDrop "Front body controller: a182 voltage drop";
CM_ SG_ 1332 VCFRONT_a182_overcharge "Front body controller: a182 overcharge";
CM_ SG_ 1332 VCFRONT_a182_LVFloorReached "Front body controller: a182 LV floor reached";
CM_ SG_ 1332 VCFRONT_a182_shortedCell "Front body controller: a182 shorted cell";
CM_ SG_ 1332 VCFRONT_a182_postPORExcessiveAh "Front body controller: a182 post POR excessive ah";
CM_ SG_ 1332 VCFRONT_a182_resistanceEstimatio "Front body controller: a182 resistance estimation hard failure";
CM_ SG_ 1332 VCFRONT_a182_dcrMilliOhmsAboveTh "Front body controller: a182 dcr milli ohms above threshold";
CM_ SG_ 1332 VCFRONT_a182_prechargeLVLoadRedu "Front body controller: a182 precharge LV load reduction";
CM_ SG_ 1332 VCFRONT_a182_factoryMode "Front body controller: a182 factory mode";
CM_ SG_ 1332 VCFRONT_a182_serviceMode "Signal reported by Front body controller";
CM_ SG_ 1332 VCFRONT_a182_transportMode "Front body controller: a182 transport mode";
CM_ SG_ 1332 VCFRONT_a182_frunkOpen "Front body controller: a182 frunk open";
CM_ SG_ 1332 VCFRONT_a182_packOverDischarged "Front body controller: a182 pack over discharged";
CM_ SG_ 1332 VCFRONT_a182_cellImbalance "Front body controller: a182 cell imbalance";
CM_ SG_ 1332 VCFRONT_a182_instantPrechargeDCR "Front body controller: a182 instant precharge DCR too high";
CM_ SG_ 1332 VCFRONT_a182_ambientTemp "Front body controller: a182 ambient temp";
CM_ SG_ 1332 VCFRONT_a182_dischargedAmpHours "Front body controller: a182 discharged amp hours";
CM_ SG_ 1332 VCFRONT_a182_chargedAmpHours "Front body controller: a182 charged amp hours";
CM_ SG_ 1332 VCFRONT_a182_calibrationLostFaul "Front body controller: a182 calibration lost fault";
CM_ SG_ 1332 VCFRONT_a182_samplingHWError "Front body controller: a182 sampling HW error";
CM_ SG_ 1332 VCFRONT_a182_brickOverDischarged "Front body controller: a182 brick over discharged";
CM_ SG_ 1332 VCFRONT_a182_impedanceGrowth "Front body controller: a182 impedance growth";
CM_ SG_ 1332 VCFRONT_a182_batteryType "Front body controller: a182 battery type";
CM_ SG_ 1332 VCFRONT_a182_bleedFetTestFailure "Front body controller: a182 bleed fet test failure";
CM_ SG_ 1332 VCFRONT_a182_weakShort "Front body controller: a182 weak short";
CM_ SG_ 1332 VCFRONT_a186_noDriveChgCableConX "Front body controller: a186 no drive chg cable con x";
CM_ SG_ 1332 VCFRONT_a187_vehBusRetryCount "Front body controller: a187 veh bus retry count";
CM_ SG_ 1332 VCFRONT_a187_partyBusRetryCount "Front body controller: a187 party bus retry count";
CM_ SG_ 1332 VCFRONT_a187_hvsBusRetryCount "Front body controller: a187 hvs bus retry count";
CM_ SG_ 1332 VCFRONT_a187_ethBusRetryCount "Front body controller: a187 eth bus retry count";
CM_ SG_ 1332 VCFRONT_a187_chBusRetryCount "Front body controller: a187 ch bus retry count";
CM_ SG_ 1332 VCFRONT_a188_sleepBypassCurrent "Front body controller: a188 sleep bypass current";
CM_ SG_ 1332 VCFRONT_a188_IBSCurrent "Front body controller: a188 IBS current";
CM_ SG_ 1332 VCFRONT_a188_vehicleState "Front body controller: a188 vehicle state";
CM_ SG_ 1332 VCFRONT_a188_timeNotSleeping "Front body controller: a188 time not sleeping";
CM_ SG_ 1332 VCFRONT_a188_chargeRequest "Front body controller: a188 charge request";
CM_ SG_ 1332 VCFRONT_a188_12VSupport "Front body controller: a188 12 v support";
CM_ SG_ 1332 VCFRONT_a188_ThermalSupport "Front body controller: a188 thermal support";
CM_ SG_ 1332 VCFRONT_a188_accessoryRequest "Front body controller: a188 accessory request";
CM_ SG_ 1332 VCFRONT_a188_CANAfterQuiet "Front body controller: a188 CAN after quiet";
CM_ SG_ 1332 VCFRONT_a188_SleepRequestTimeout "Front body controller: a188 sleep request timeout";
CM_ SG_ 1332 VCFRONT_a188_wakeUpMsgID "Front body controller: a188 wake up msg ID";
CM_ SG_ 1332 VCFRONT_a191_vehiclePowerState "Front body controller: a191 vehicle power state";
CM_ SG_ 1332 VCFRONT_a191_hvState "Front body controller: a191 hv state";
CM_ SG_ 1332 VCFRONT_a191_reverseBatteryEFuse "Front body controller: a191 reverse battery e fuse fault";
CM_ SG_ 1332 VCFRONT_a191_vehicleLoadShedActi "Front body controller: a191 vehicle load shed active";
CM_ SG_ 1332 VCFRONT_a191_vehicleLoadShedHvFa "Front body controller: a191 vehicle load shed hv fault active";
CM_ SG_ 1332 VCFRONT_a191_vehicleLoadShedPost "Front body controller: a191 vehicle load shed post crash active";
CM_ SG_ 1332 VCFRONT_a191_IBSVoltage "Front body controller: a191 IBS voltage";
CM_ SG_ 1332 VCFRONT_a191_a180_DCDCNotSupport "Front body controller: a191 a180 DCDC not supporting LV bus";
CM_ SG_ 1332 VCFRONT_a191_MOSState "Front body controller: a191 MOS state";
CM_ SG_ 1332 VCFRONT_a191_LVBMSVoltage "Front body controller: a191 LVBMS voltage";
CM_ SG_ 1332 VCFRONT_a191_ECPAState "Front body controller: a191 ECPA state";
CM_ SG_ 1332 VCFRONT_a191_LVBMSCurrentTargetV "Front body controller: a191 LVBMS current target valid";
CM_ SG_ 1332 VCFRONT_a191_LVBMSVoltageTargetV "Front body controller: a191 LVBMS voltage target valid";
CM_ SG_ 1332 VCFRONT_a191_serviceMode "Signal reported by Front body controller";
CM_ SG_ 1332 VCFRONT_a191_frunkOpen "Front body controller: a191 frunk open";
CM_ SG_ 1332 VCFRONT_a191_vehicleLoadShedStag "Front body controller: a191 vehicle load shed stage";
CM_ SG_ 1332 VCFRONT_a191_exitDriveWarningTim "Front body controller: a191 exit drive warning timer expired";
CM_ SG_ 1332 VCFRONT_a191_LVBMSMIA "Front body controller: a191 LVBMSMIA";
CM_ SG_ 1332 VCFRONT_a191_PCS_MIA "Front body controller: a191 PCS MIA";
CM_ SG_ 1332 VCFRONT_a191_NotEnoughPowerForSu "Front body controller: a191 not enough power for support";
CM_ SG_ 1332 VCFRONT_a191_bmsState "Front body controller: a191 bms state";
CM_ SG_ 1332 VCFRONT_a192_vehiclePowerState "Front body controller: a192 vehicle power state";
CM_ SG_ 1332 VCFRONT_a192_hvState "Front body controller: a192 hv state";
CM_ SG_ 1332 VCFRONT_a192_notEnoughPowerForSu "Front body controller: a192 not enough power for support";
CM_ SG_ 1332 VCFRONT_a192_pcsEFuseStable "Front body controller: a192 pcs e fuse stable";
CM_ SG_ 1332 VCFRONT_a192_vcrightEFuseStable "Front body controller: a192 vcright e fuse stable";
CM_ SG_ 1332 VCFRONT_a192_contactorEFuseStabl "Front body controller: a192 contactor e fuse stable";
CM_ SG_ 1332 VCFRONT_a192_hvcEFuseStable "Front body controller: a192 hvc e fuse stable";
CM_ SG_ 1332 VCFRONT_a192_replaceLVBattery "Front body controller: a192 replace LV battery";
CM_ SG_ 1332 VCFRONT_a192_BMS_MIA "Front body controller: a192 BMS MIA";
CM_ SG_ 1332 VCFRONT_a192_PCS_MIA "Front body controller: a192 PCS MIA";
CM_ SG_ 1332 VCFRONT_a192_HVBlockingMismatch "Front body controller: a192 HV blocking mismatch";
CM_ SG_ 1332 VCFRONT_a192_disconnected12V "Front body controller: a192 disconnected12 v";
CM_ SG_ 1332 VCFRONT_a192_LVBatteryCannotSupp "Front body controller: a192 LV battery cannot support vehicle";
CM_ SG_ 1332 VCFRONT_a192_DI_gear "Front body controller: a192 DI gear";
CM_ SG_ 1332 VCFRONT_a192_GTW_factoryGated "Front body controller: a192 GTW factory gated";
CM_ SG_ 1332 VCFRONT_a192_GTW_updateStarted "Front body controller: a192 GTW update started";
CM_ SG_ 1332 VCFRONT_a192_serviceMode "Signal reported by Front body controller";
CM_ SG_ 1332 VCFRONT_a192_frunkOpen "Front body controller: a192 frunk open";
CM_ SG_ 1332 VCFRONT_a192_IBSCurrent "Front body controller: a192 IBS current";
CM_ SG_ 1332 VCFRONT_a192_PCSCurrent "Front body controller: a192 PCS current";
CM_ SG_ 1332 VCFRONT_a192_HVFaultLoadShedActi "Front body controller: a192 HV fault load shed active";
CM_ SG_ 1332 VCFRONT_a192_postCrashLoadShedAc "Front body controller: a192 post crash load shed active";
CM_ SG_ 1332 VCFRONT_a195_IBSVoltage "Front body controller: a195 IBS voltage";
CM_ SG_ 1332 VCFRONT_a195_serviceMode "Signal reported by Front body controller";
CM_ SG_ 1332 VCFRONT_a195_frunkOpen "Front body controller: a195 frunk open";
CM_ SG_ 1332 VCFRONT_a196_factoryMode "Front body controller: a196 factory mode";
CM_ SG_ 1332 VCFRONT_a196_serviceMode "Signal reported by Front body controller";
CM_ SG_ 1332 VCFRONT_a196_transportMode "Front body controller: a196 transport mode";
CM_ SG_ 1332 VCFRONT_a196_frunkOpen "Front body controller: a196 frunk open";
CM_ SG_ 1332 VCFRONT_a196_vehiclePowerState "Front body controller: a196 vehicle power state";
CM_ SG_ 1332 VCFRONT_a196_batterySMState "Front body controller: a196 battery SM state";
CM_ SG_ 1332 VCFRONT_a196_disconnectedBattery "Front body controller: a196 disconnected battery test current";
CM_ SG_ 1332 VCFRONT_a196_disconnectedBa_0002 "Front body controller: a196 disconnected battery test voltage";
CM_ SG_ 1332 VCFRONT_a196_disconnectedBa_0001 "Front body controller: a196 disconnected battery test prev voltage";
CM_ SG_ 1332 VCFRONT_a196_ECPAState "Front body controller: a196 ECPA state";
CM_ SG_ 1332 VCFRONT_a198_outputState "Front body controller: a198 output state";
CM_ SG_ 1332 VCFRONT_a198_NVRAMState "Front body controller: a198 NVRAM state";
CM_ SG_ 1332 VCFRONT_a198_lockoutState "Front body controller: a198 lockout state";
CM_ SG_ 1332 VCFRONT_a199_outputState "Front body controller: a199 output state";
CM_ SG_ 1332 VCFRONT_a199_NVRAMState "Front body controller: a199 NVRAM state";
CM_ SG_ 1332 VCFRONT_a199_lockoutState "Front body controller: a199 lockout state";
CM_ SG_ 1332 VCFRONT_a200_vcleftSelfTest "Front body controller: a200 vcleft self test";
CM_ SG_ 1332 VCFRONT_a201_vcrightSelfTest "Front body controller: a201 vcright self test";
CM_ SG_ 1332 VCFRONT_a202_pcsSelfTest "Front body controller: a202 pcs self test";
CM_ SG_ 1332 VCFRONT_a207_vbatFusedSelfTest "Front body controller: a207 vbat fused self test";
CM_ SG_ 1332 VCFRONT_a210_valveUnderTravel "Front body controller: a210 valve under travel";
CM_ SG_ 1332 VCFRONT_a210_valveOverTravel "Front body controller: a210 valve over travel";
CM_ SG_ 1332 VCFRONT_a210_valveNoTravel "Front body controller: a210 valve no travel";
CM_ SG_ 1332 VCFRONT_a212_IBSTemp "Front body controller: a212 IBS temp";
CM_ SG_ 1332 VCFRONT_a213_IBSVolts "Front body controller: a213 IBS volts";
CM_ SG_ 1332 VCFRONT_a213_IBSAh "Front body controller: a213 IBS ah";
CM_ SG_ 1332 VCFRONT_a213_LVBatteryTemp "Front body controller: a213 LV battery temp";
CM_ SG_ 1332 VCFRONT_a214_motorFaulted "Front body controller: a214 motor faulted";
CM_ SG_ 1332 VCFRONT_a214_motorLocked "Front body controller: a214 motor locked";
CM_ SG_ 1332 VCFRONT_a214_ecuReset "Front body controller: a214 ecu reset";
CM_ SG_ 1332 VCFRONT_a214_fetTempIrrational "Front body controller: a214 fet temp irrational";
CM_ SG_ 1332 VCFRONT_a214_motorControlError "Front body controller: a214 motor control error";
CM_ SG_ 1332 VCFRONT_a214_underVoltage "Front body controller: a214 under voltage";
CM_ SG_ 1332 VCFRONT_a214_overVoltage "Front body controller: a214 over voltage";
CM_ SG_ 1332 VCFRONT_a214_hardwareOvercurrent "Front body controller: a214 hardware overcurrent";
CM_ SG_ 1332 VCFRONT_a214_motorOpenPhase "Front body controller: a214 motor open phase";
CM_ SG_ 1332 VCFRONT_a214_motorSoftOpenPhase "Front body controller: a214 motor soft open phase";
CM_ SG_ 1332 VCFRONT_a214_motorOvertemp "Front body controller: a214 motor overtemp";
CM_ SG_ 1332 VCFRONT_a214_dcOvercurrent "Front body controller: a214 dc overcurrent";
CM_ SG_ 1332 VCFRONT_a214_motorStalled "Front body controller: a214 motor stalled";
CM_ SG_ 1332 VCFRONT_a214_selfTestFailed "Front body controller: a214 self test failed";
CM_ SG_ 1332 VCFRONT_a214_selfTestResult "Front body controller: a214 self test result";
CM_ SG_ 1332 VCFRONT_a214_linChecksumError "Front body controller: a214 lin checksum error";
CM_ SG_ 1332 VCFRONT_a214_linFramingError "Front body controller: a214 lin framing error";
CM_ SG_ 1332 VCFRONT_a214_phaseShorted "Front body controller: a214 phase shorted";
CM_ SG_ 1332 VCFRONT_a214_busVoltageIrrationa "Front body controller: a214 bus voltage irrational";
CM_ SG_ 1332 VCFRONT_a214_dcCurrentIrrational "Front body controller: a214 dc current irrational";
CM_ SG_ 1332 VCFRONT_a214_motorSpeedIrrationa "Front body controller: a214 motor speed irrational";
CM_ SG_ 1332 VCFRONT_a214_supplyVoltageIrrati "Front body controller: a214 supply voltage irrational";
CM_ SG_ 1332 VCFRONT_a214_motorPhaseCurrentIr "Front body controller: a214 motor phase current irrational";
CM_ SG_ 1332 VCFRONT_a214_chipOvertemp "Front body controller: a214 chip overtemp";
CM_ SG_ 1332 VCFRONT_a214_motorSpeedTooHigh "Front body controller: a214 motor speed too high";
CM_ SG_ 1332 VCFRONT_a214_phaseOvercurrent "Front body controller: a214 phase overcurrent";
CM_ SG_ 1332 VCFRONT_a214_vddaOvercurrent "Front body controller: a214 vdda overcurrent";
CM_ SG_ 1332 VCFRONT_a214_busVoltageUnhealthy "Front body controller: a214 bus voltage unhealthy";
CM_ SG_ 1332 VCFRONT_a214_hsVdsOvervoltage "Front body controller: a214 hs vds overvoltage";
CM_ SG_ 1332 VCFRONT_a214_hsVdsOvervoltageMas "Front body controller: a214 hs vds overvoltage mask";
CM_ SG_ 1332 VCFRONT_a214_lsVdsOvervoltage "Front body controller: a214 ls vds overvoltage";
CM_ SG_ 1332 VCFRONT_a214_lsVdsOvervoltageMas "Front body controller: a214 ls vds overvoltage mask";
CM_ SG_ 1332 VCFRONT_a214_payloadBitsNotSet "Front body controller: a214 payload bits not set";
CM_ SG_ 1332 VCFRONT_a216_inDrive "Front body controller: a216 in drive";
CM_ SG_ 1332 VCFRONT_a216_hvState "Front body controller: a216 hv state";
CM_ SG_ 1332 VCFRONT_a216_vcleftFastBlowImmin "Front body controller: a216 vcleft fast blow imminent";
CM_ SG_ 1332 VCFRONT_a216_vcleftFastBlowDebou "Front body controller: a216 vcleft fast blow debounce imminent";
CM_ SG_ 1332 VCFRONT_a216_vcleftStaticImminen "Front body controller: a216 vcleft static imminent";
CM_ SG_ 1332 VCFRONT_a216_vcleftDynamicImmine "Front body controller: a216 vcleft dynamic imminent";
CM_ SG_ 1332 VCFRONT_a216_vcrightFastBlowImmi "Front body controller: a216 vcright fast blow imminent";
CM_ SG_ 1332 VCFRONT_a216_vcrightFastBlowDebo "Front body controller: a216 vcright fast blow debounce imminent";
CM_ SG_ 1332 VCFRONT_a216_vcrightStaticImmine "Front body controller: a216 vcright static imminent";
CM_ SG_ 1332 VCFRONT_a216_vcrightDynamicImmin "Front body controller: a216 vcright dynamic imminent";
CM_ SG_ 1332 VCFRONT_a217_motorFaulted "Front body controller: a217 motor faulted";
CM_ SG_ 1332 VCFRONT_a217_motorLocked "Front body controller: a217 motor locked";
CM_ SG_ 1332 VCFRONT_a217_ecuReset "Front body controller: a217 ecu reset";
CM_ SG_ 1332 VCFRONT_a217_fetTempIrrational "Front body controller: a217 fet temp irrational";
CM_ SG_ 1332 VCFRONT_a217_motorControlError "Front body controller: a217 motor control error";
CM_ SG_ 1332 VCFRONT_a217_underVoltage "Front body controller: a217 under voltage";
CM_ SG_ 1332 VCFRONT_a217_overVoltage "Front body controller: a217 over voltage";
CM_ SG_ 1332 VCFRONT_a217_hardwareOvercurrent "Front body controller: a217 hardware overcurrent";
CM_ SG_ 1332 VCFRONT_a217_motorOpenPhase "Front body controller: a217 motor open phase";
CM_ SG_ 1332 VCFRONT_a217_motorSoftOpenPhase "Front body controller: a217 motor soft open phase";
CM_ SG_ 1332 VCFRONT_a217_motorOvertemp "Front body controller: a217 motor overtemp";
CM_ SG_ 1332 VCFRONT_a217_dcOvercurrent "Front body controller: a217 dc overcurrent";
CM_ SG_ 1332 VCFRONT_a217_motorStalled "Front body controller: a217 motor stalled";
CM_ SG_ 1332 VCFRONT_a217_selfTestFailed "Front body controller: a217 self test failed";
CM_ SG_ 1332 VCFRONT_a217_selfTestResult "Front body controller: a217 self test result";
CM_ SG_ 1332 VCFRONT_a217_linChecksumError "Front body controller: a217 lin checksum error";
CM_ SG_ 1332 VCFRONT_a217_linFramingError "Front body controller: a217 lin framing error";
CM_ SG_ 1332 VCFRONT_a217_phaseShorted "Front body controller: a217 phase shorted";
CM_ SG_ 1332 VCFRONT_a217_busVoltageIrrationa "Front body controller: a217 bus voltage irrational";
CM_ SG_ 1332 VCFRONT_a217_dcCurrentIrrational "Front body controller: a217 dc current irrational";
CM_ SG_ 1332 VCFRONT_a217_motorSpeedIrrationa "Front body controller: a217 motor speed irrational";
CM_ SG_ 1332 VCFRONT_a217_supplyVoltageIrrati "Front body controller: a217 supply voltage irrational";
CM_ SG_ 1332 VCFRONT_a217_motorPhaseCurrentIr "Front body controller: a217 motor phase current irrational";
CM_ SG_ 1332 VCFRONT_a217_chipOvertemp "Front body controller: a217 chip overtemp";
CM_ SG_ 1332 VCFRONT_a217_motorSpeedTooHigh "Front body controller: a217 motor speed too high";
CM_ SG_ 1332 VCFRONT_a217_phaseOvercurrent "Front body controller: a217 phase overcurrent";
CM_ SG_ 1332 VCFRONT_a217_vddaOvercurrent "Front body controller: a217 vdda overcurrent";
CM_ SG_ 1332 VCFRONT_a217_busVoltageUnhealthy "Front body controller: a217 bus voltage unhealthy";
CM_ SG_ 1332 VCFRONT_a217_hsVdsOvervoltage "Front body controller: a217 hs vds overvoltage";
CM_ SG_ 1332 VCFRONT_a217_hsVdsOvervoltageMas "Front body controller: a217 hs vds overvoltage mask";
CM_ SG_ 1332 VCFRONT_a217_lsVdsOvervoltage "Front body controller: a217 ls vds overvoltage";
CM_ SG_ 1332 VCFRONT_a217_lsVdsOvervoltageMas "Front body controller: a217 ls vds overvoltage mask";
CM_ SG_ 1332 VCFRONT_a217_payloadBitsNotSet "Front body controller: a217 payload bits not set";
CM_ SG_ 1332 VCFRONT_a219_IBSVolts "Front body controller: a219 IBS volts";
CM_ SG_ 1332 VCFRONT_a219_IBSAh "Front body controller: a219 IBS ah";
CM_ SG_ 1332 VCFRONT_a219_IBSCurrent "Front body controller: a219 IBS current";
CM_ SG_ 1332 VCFRONT_a220_IBSCurrent "Front body controller: a220 IBS current";
CM_ SG_ 1332 VCFRONT_a220_PCSCurrent "Front body controller: a220 PCS current";
CM_ SG_ 1332 VCFRONT_a220_serviceMode "Signal reported by Front body controller";
CM_ SG_ 1332 VCFRONT_a220_frunkOpen "Front body controller: a220 frunk open";
CM_ SG_ 1332 VCFRONT_a221_outputFaulted "Front body controller: a221 output faulted";
CM_ SG_ 1332 VCFRONT_a221_currentSenseFaulted "Front body controller: a221 current sense faulted";
CM_ SG_ 1332 VCFRONT_a221_tempSenseFaulted "Front body controller: a221 temp sense faulted";
CM_ SG_ 1332 VCFRONT_a221_underCurrent "Front body controller: a221 under current";
CM_ SG_ 1332 VCFRONT_a221_overCurrent "Front body controller: a221 over current";
CM_ SG_ 1332 VCFRONT_a221_overTemperature "Front body controller: a221 over temperature";
CM_ SG_ 1332 VCFRONT_a222_outputFaulted "Front body controller: a222 output faulted";
CM_ SG_ 1332 VCFRONT_a222_currentSenseFaulted "Front body controller: a222 current sense faulted";
CM_ SG_ 1332 VCFRONT_a222_tempSenseFaulted "Front body controller: a222 temp sense faulted";
CM_ SG_ 1332 VCFRONT_a222_underCurrent "Front body controller: a222 under current";
CM_ SG_ 1332 VCFRONT_a222_overCurrent "Front body controller: a222 over current";
CM_ SG_ 1332 VCFRONT_a222_overTemperature "Front body controller: a222 over temperature";
CM_ SG_ 1332 VCFRONT_a223_12VTemperature "Front body controller: a223 12 v temperature";
CM_ SG_ 1332 VCFRONT_a227_motorFaulted "Front body controller: a227 motor faulted";
CM_ SG_ 1332 VCFRONT_a227_motorLocked "Front body controller: a227 motor locked";
CM_ SG_ 1332 VCFRONT_a227_ecuReset "Front body controller: a227 ecu reset";
CM_ SG_ 1332 VCFRONT_a227_fetTempIrrational "Front body controller: a227 fet temp irrational";
CM_ SG_ 1332 VCFRONT_a227_motorControlError "Front body controller: a227 motor control error";
CM_ SG_ 1332 VCFRONT_a227_underVoltage "Front body controller: a227 under voltage";
CM_ SG_ 1332 VCFRONT_a227_overVoltage "Front body controller: a227 over voltage";
CM_ SG_ 1332 VCFRONT_a227_hardwareOvercurrent "Front body controller: a227 hardware overcurrent";
CM_ SG_ 1332 VCFRONT_a227_motorOpenPhase "Front body controller: a227 motor open phase";
CM_ SG_ 1332 VCFRONT_a227_motorSoftOpenPhase "Front body controller: a227 motor soft open phase";
CM_ SG_ 1332 VCFRONT_a227_motorOvertemp "Front body controller: a227 motor overtemp";
CM_ SG_ 1332 VCFRONT_a227_dcOvercurrent "Front body controller: a227 dc overcurrent";
CM_ SG_ 1332 VCFRONT_a227_motorStalled "Front body controller: a227 motor stalled";
CM_ SG_ 1332 VCFRONT_a227_selfTestFailed "Front body controller: a227 self test failed";
CM_ SG_ 1332 VCFRONT_a227_selfTestResult "Front body controller: a227 self test result";
CM_ SG_ 1332 VCFRONT_a227_linChecksumError "Front body controller: a227 lin checksum error";
CM_ SG_ 1332 VCFRONT_a227_linFramingError "Front body controller: a227 lin framing error";
CM_ SG_ 1332 VCFRONT_a227_phaseShorted "Front body controller: a227 phase shorted";
CM_ SG_ 1332 VCFRONT_a227_busVoltageIrrationa "Front body controller: a227 bus voltage irrational";
CM_ SG_ 1332 VCFRONT_a227_dcCurrentIrrational "Front body controller: a227 dc current irrational";
CM_ SG_ 1332 VCFRONT_a227_motorSpeedIrrationa "Front body controller: a227 motor speed irrational";
CM_ SG_ 1332 VCFRONT_a227_supplyVoltageIrrati "Front body controller: a227 supply voltage irrational";
CM_ SG_ 1332 VCFRONT_a227_motorPhaseCurrentIr "Front body controller: a227 motor phase current irrational";
CM_ SG_ 1332 VCFRONT_a227_chipOvertemp "Front body controller: a227 chip overtemp";
CM_ SG_ 1332 VCFRONT_a227_motorSpeedTooHigh "Front body controller: a227 motor speed too high";
CM_ SG_ 1332 VCFRONT_a227_phaseOvercurrent "Front body controller: a227 phase overcurrent";
CM_ SG_ 1332 VCFRONT_a227_vddaOvercurrent "Front body controller: a227 vdda overcurrent";
CM_ SG_ 1332 VCFRONT_a227_busVoltageUnhealthy "Front body controller: a227 bus voltage unhealthy";
CM_ SG_ 1332 VCFRONT_a227_hsVdsOvervoltage "Front body controller: a227 hs vds overvoltage";
CM_ SG_ 1332 VCFRONT_a227_hsVdsOvervoltageMas "Front body controller: a227 hs vds overvoltage mask";
CM_ SG_ 1332 VCFRONT_a227_lsVdsOvervoltage "Front body controller: a227 ls vds overvoltage";
CM_ SG_ 1332 VCFRONT_a227_lsVdsOvervoltageMas "Front body controller: a227 ls vds overvoltage mask";
CM_ SG_ 1332 VCFRONT_a227_payloadBitsNotSet "Front body controller: a227 payload bits not set";
CM_ SG_ 1332 VCFRONT_a231_12VTemperature "Front body controller: a231 12 v temperature";
CM_ SG_ 1332 VCFRONT_a233_current "Front body controller: a233 current";
CM_ SG_ 1332 VCFRONT_a234_current "Front body controller: a234 current";
CM_ SG_ 1332 VCFRONT_a235_ptSensorTemp "Front body controller: a235 pt sensor temp";
CM_ SG_ 1332 VCFRONT_a236_batSensorTemp "Front body controller: a236 bat sensor temp";
CM_ SG_ 1332 VCFRONT_a242_LVBatteryTemp "Front body controller: a242 LV battery temp";
CM_ SG_ 1332 VCFRONT_a242_IBSCurrent "Front body controller: a242 IBS current";
CM_ SG_ 1332 VCFRONT_a242_IBSVoltage "Front body controller: a242 IBS voltage";
CM_ SG_ 1332 VCFRONT_a242_IBSAmpHours "Front body controller: a242 IBS amp hours";
CM_ SG_ 1332 VCFRONT_a242_vehiclePowerState "Front body controller: a242 vehicle power state";
CM_ SG_ 1332 VCFRONT_a243_IBSVolts "Front body controller: a243 IBS volts";
CM_ SG_ 1332 VCFRONT_a243_IBSCurrent "Front body controller: a243 IBS current";
CM_ SG_ 1332 VCFRONT_a243_LVBatteryTemp "Front body controller: a243 LV battery temp";
CM_ SG_ 1332 VCFRONT_a244_current "Front body controller: a244 current";
CM_ SG_ 1332 VCFRONT_a244_voltage "Front body controller: a244 voltage";
CM_ SG_ 1332 VCFRONT_a244_vbatProtVoltage "Front body controller: a244 vbat prot voltage";
CM_ SG_ 1332 VCFRONT_a245_current "Front body controller: a245 current";
CM_ SG_ 1332 VCFRONT_a245_voltage "Front body controller: a245 voltage";
CM_ SG_ 1332 VCFRONT_a245_eFuseRemainingRetri "Front body controller: a245 e fuse remaining retries";
CM_ SG_ 1332 VCFRONT_a246_current "Front body controller: a246 current";
CM_ SG_ 1332 VCFRONT_a246_voltage "Front body controller: a246 voltage";
CM_ SG_ 1332 VCFRONT_a246_eFuseRemainingRetri "Front body controller: a246 e fuse remaining retries";
CM_ SG_ 1332 VCFRONT_a247_solenoidISense "Front body controller: a247 solenoid i sense";
CM_ SG_ 1332 VCFRONT_a248_AS8510Voltage "Front body controller: a248 AS8510 voltage";
CM_ SG_ 1332 VCFRONT_a248_IBSVoltage "Front body controller: a248 IBS voltage";
CM_ SG_ 1332 VCFRONT_a248_vbatMonitor "Front body controller: a248 vbat monitor";
CM_ SG_ 1332 VCFRONT_a248_voltageCalScaling "Front body controller: a248 voltage cal scaling";
CM_ SG_ 1332 VCFRONT_a249_tempCoolantBatInlet "Front body controller: a249 temp coolant bat inlet";
CM_ SG_ 1332 VCFRONT_a249_tempCoolantPTInlet "Front body controller: a249 temp coolant PT inlet";
CM_ SG_ 1332 VCFRONT_a250_isGlobalHeadlamps "Front body controller: a250 is global headlamps";
CM_ SG_ 1332 VCFRONT_a250_isVirtualPitchSenso "Front body controller: a250 is virtual pitch sensor";
CM_ SG_ 1332 VCFRONT_a250_isAimedHCML "Front body controller: a250 is aimed HCML";
CM_ SG_ 1332 VCFRONT_a250_isAimedHCMR "Front body controller: a250 is aimed HCMR";
CM_ SG_ 1332 VCFRONT_a250_calibratedVerticalP "Front body controller: a250 calibrated vertical position HCML";
CM_ SG_ 1332 VCFRONT_a250_calibratedVert_0001 "Front body controller: a250 calibrated vertical position HCMR";
CM_ SG_ 1332 VCFRONT_a250_calibratedHorizonta "Front body controller: a250 calibrated horizontal position HCML";
CM_ SG_ 1332 VCFRONT_a250_calibratedHori_0001 "Front body controller: a250 calibrated horizontal position HCMR";
CM_ SG_ 1332 VCFRONT_a253_currentNotTapered "Front body controller: a253 current not tapered";
CM_ SG_ 1332 VCFRONT_a253_ampHourTargetNotRea "Front body controller: a253 amp hour target not reached";
CM_ SG_ 1332 VCFRONT_a253_IBSCurrent "Front body controller: a253 IBS current";
CM_ SG_ 1332 VCFRONT_a253_IBSAmpHours "Front body controller: a253 IBS amp hours";
CM_ SG_ 1332 VCFRONT_a253_LVBatteryTemp "Front body controller: a253 LV battery temp";
CM_ SG_ 1332 VCFRONT_a253_firstChargeOTA "Front body controller: a253 first charge OTA";
CM_ SG_ 1332 VCFRONT_a253_firstChargePOR "Front body controller: a253 first charge POR";
CM_ SG_ 1332 VCFRONT_a253_serviceMode "Signal reported by Front body controller";
CM_ SG_ 1332 VCFRONT_a253_frunkOpen "Front body controller: a253 frunk open";
CM_ SG_ 1332 VCFRONT_a254_RPMActual "Front body controller: a254 RPM actual";
CM_ SG_ 1332 VCFRONT_a254_RPMTarget "Front body controller: a254 RPM target";
CM_ SG_ 1332 VCFRONT_a255_RPMActual "Front body controller: a255 RPM actual";
CM_ SG_ 1332 VCFRONT_a255_RPMTarget "Front body controller: a255 RPM target";
CM_ SG_ 1332 VCFRONT_a257_lockoutVoltage "Front body controller: a257 lockout voltage";
CM_ SG_ 1332 VCFRONT_a257_vcrightLockoutStatu "Front body controller: a257 vcright lockout status";
CM_ SG_ 1332 VCFRONT_a257_vcleftFault "Front body controller: a257 vcleft fault";
CM_ SG_ 1332 VCFRONT_a257_vcrightFault "Front body controller: a257 vcright fault";
CM_ SG_ 1332 VCFRONT_a257_pcsFault "Front body controller: a257 pcs fault";
CM_ SG_ 1332 VCFRONT_a257_vbatFusedFault "Front body controller: a257 vbat fused fault";
CM_ SG_ 1332 VCFRONT_a257_iBoosterFault "Front body controller: a257 i booster fault";
CM_ SG_ 1332 VCFRONT_a257_espFault "Front body controller: a257 esp fault";
CM_ SG_ 1332 VCFRONT_a257_epas3pFault "Front body controller: a257 epas3p fault";
CM_ SG_ 1332 VCFRONT_a257_epas3sFault "Front body controller: a257 epas3s fault";
CM_ SG_ 1332 VCFRONT_a257_revBattFault "Front body controller: a257 rev batt fault";
CM_ SG_ 1332 VCFRONT_a257_vehicleState "Front body controller: a257 vehicle state";
CM_ SG_ 1332 VCFRONT_a259_serviceMode "Signal reported by Front body controller";
CM_ SG_ 1332 VCFRONT_a259_voltageDropCounter "Front body controller: a259 voltage drop counter";
CM_ SG_ 1332 VCFRONT_a259_minVoltageReached "Front body controller: a259 min voltage reached";
CM_ SG_ 1332 VCFRONT_a259_IBSTemp "Front body controller: a259 IBS temp";
CM_ SG_ 1332 VCFRONT_a259_maxCurrentReached "Front body controller: a259 max current reached";
CM_ SG_ 1332 VCFRONT_a260_IBSVolts "Front body controller: a260 IBS volts";
CM_ SG_ 1332 VCFRONT_a260_IBSAh "Front body controller: a260 IBS ah";
CM_ SG_ 1332 VCFRONT_a260_vehiclePowerState "Front body controller: a260 vehicle power state";
CM_ SG_ 1332 VCFRONT_a260_batterySMState "Front body controller: a260 battery SM state";
CM_ SG_ 1332 VCFRONT_a260_HV_UP "Front body controller: a260 HV UP";
CM_ SG_ 1332 VCFRONT_a260_notEnoughPowerForSu "Front body controller: a260 not enough power for support";
CM_ SG_ 1332 VCFRONT_a260_coolantHasBeenFille "Front body controller: a260 coolant has been filled";
CM_ SG_ 1332 VCFRONT_a260_ampHourTrigger "Front body controller: a260 amp hour trigger";
CM_ SG_ 1332 VCFRONT_a260_voltageTrigger "Front body controller: a260 voltage trigger";
CM_ SG_ 1332 VCFRONT_a260_crashDetected "Front body controller: a260 crash detected";
CM_ SG_ 1332 VCFRONT_a260_BMS_MIA "Front body controller: a260 BMS MIA";
CM_ SG_ 1332 VCFRONT_a260_PCS_MIA "Front body controller: a260 PCS MIA";
CM_ SG_ 1332 VCFRONT_a260_HVBlockingMismatch "Front body controller: a260 HV blocking mismatch";
CM_ SG_ 1332 VCFRONT_a260_serviceMode "Signal reported by Front body controller";
CM_ SG_ 1332 VCFRONT_a260_dcdcLVSupportStatus "Front body controller: a260 dcdc LV support status";
CM_ SG_ 1332 VCFRONT_a260_PCSAndVCREFuseStabl "Front body controller: a260 PCS and VCRE fuse stable";
CM_ SG_ 1332 VCFRONT_a260_bmsState "Front body controller: a260 bms state";
CM_ SG_ 1332 VCFRONT_a261_eFuseVoltage "Front body controller: a261 e fuse voltage";
CM_ SG_ 1332 VCFRONT_a261_vbatProtVoltage "Front body controller: a261 vbat prot voltage";
CM_ SG_ 1332 VCFRONT_a262_eFuseVoltage "Front body controller: a262 e fuse voltage";
CM_ SG_ 1332 VCFRONT_a262_vbatProtVoltage "Front body controller: a262 vbat prot voltage";
CM_ SG_ 1332 VCFRONT_a263_eFuseVoltage "Front body controller: a263 e fuse voltage";
CM_ SG_ 1332 VCFRONT_a263_vbatProtVoltage "Front body controller: a263 vbat prot voltage";
CM_ SG_ 1332 VCFRONT_a264_eFuseVoltage "Front body controller: a264 e fuse voltage";
CM_ SG_ 1332 VCFRONT_a264_vbatProtVoltage "Front body controller: a264 vbat prot voltage";
CM_ SG_ 1332 VCFRONT_a265_eFuseVoltage "Front body controller: a265 e fuse voltage";
CM_ SG_ 1332 VCFRONT_a265_vbatProtVoltage "Front body controller: a265 vbat prot voltage";
CM_ SG_ 1332 VCFRONT_a266_eFuseVoltage "Front body controller: a266 e fuse voltage";
CM_ SG_ 1332 VCFRONT_a266_vbatProtVoltage "Front body controller: a266 vbat prot voltage";
CM_ SG_ 1332 VCFRONT_a267_eFuseVoltage "Front body controller: a267 e fuse voltage";
CM_ SG_ 1332 VCFRONT_a267_vbatProtVoltage "Front body controller: a267 vbat prot voltage";
CM_ SG_ 1332 VCFRONT_a268_eFuseVoltage "Front body controller: a268 e fuse voltage";
CM_ SG_ 1332 VCFRONT_a268_vbatProtVoltage "Front body controller: a268 vbat prot voltage";
CM_ SG_ 1332 VCFRONT_a269_LVBatteryTemp "Front body controller: a269 LV battery temp";
CM_ SG_ 1332 VCFRONT_a269_IBSCurrent "Front body controller: a269 IBS current";
CM_ SG_ 1332 VCFRONT_a269_IBSVoltage "Front body controller: a269 IBS voltage";
CM_ SG_ 1332 VCFRONT_a269_IBSAmpHours "Front body controller: a269 IBS amp hours";
CM_ SG_ 1332 VCFRONT_a269_vehiclePowerState "Front body controller: a269 vehicle power state";
CM_ SG_ 1332 VCFRONT_a270_prechargeChannel "Front body controller: a270 precharge channel";
CM_ SG_ 1332 VCFRONT_a270_sourceVoltage "Front body controller: a270 source voltage";
CM_ SG_ 1332 VCFRONT_a270_loadVoltage "Front body controller: a270 load voltage";
CM_ SG_ 1332 VCFRONT_a270_timeout "Front body controller: a270 timeout";
CM_ SG_ 1332 VCFRONT_a271_shortedCellTestTrig "Front body controller: a271 shorted cell test trigger";
CM_ SG_ 1332 VCFRONT_a271_voltDropOnHighCurre "Front body controller: a271 volt drop on high current trigger";
CM_ SG_ 1332 VCFRONT_a271_deadLVMinimalAhDisc "Front body controller: a271 dead LV minimal ah discharged trigger";
CM_ SG_ 1332 VCFRONT_a271_resistanceEstimatio "Front body controller: a271 resistance estimation hard fail trigger";
CM_ SG_ 1332 VCFRONT_a271_dcrMilliOhmsAboveTh "Front body controller: a271 dcr milli ohms above threshold trigger";
CM_ SG_ 1332 VCFRONT_a271_prechargeLVLoadRedu "Front body controller: a271 precharge LV load reduction trigger";
CM_ SG_ 1332 VCFRONT_a271_instantPrechargeDCR "Front body controller: a271 instant precharge DCR too high trigger";
CM_ SG_ 1332 VCFRONT_a279_snsShortCircuit "Front body controller: a279 sns short circuit";
CM_ SG_ 1332 VCFRONT_a279_snsDisconnect "Front body controller: a279 sns disconnect";
CM_ SG_ 1332 VCFRONT_a279_snsRateChangeUp "Front body controller: a279 sns rate change up";
CM_ SG_ 1332 VCFRONT_a279_snsRateChangeDown "Front body controller: a279 sns rate change down";
CM_ SG_ 1332 VCFRONT_a280_snsShortCircuit "Front body controller: a280 sns short circuit";
CM_ SG_ 1332 VCFRONT_a280_snsDisconnect "Front body controller: a280 sns disconnect";
CM_ SG_ 1332 VCFRONT_a280_snsRateChangeUp "Front body controller: a280 sns rate change up";
CM_ SG_ 1332 VCFRONT_a280_snsRateChangeDown "Front body controller: a280 sns rate change down";
CM_ SG_ 1332 VCFRONT_a283_thmlFanDisabled "Front body controller: a283 thml fan disabled";
CM_ SG_ 1332 VCFRONT_a283_thmlFanLimited "Front body controller: a283 thml fan limited";
CM_ SG_ 1332 VCFRONT_a283_thmlFanDemand "Front body controller: a283 thml fan demand";
CM_ SG_ 1332 VCFRONT_a283_thmlFanDemandLimit "Front body controller: a283 thml fan demand limit";
CM_ SG_ 1332 VCFRONT_a283_thmlFanPhaseI "Front body controller: a283 thml fan phase i";
CM_ SG_ 1332 VCFRONT_a283_thmlFanPhaseILimit "Front body controller: a283 thml fan phase i limit";
CM_ SG_ 1332 VCFRONT_a284_driverState "Front body controller: a284 driver state";
CM_ SG_ 1332 VCFRONT_a284_driverThermWarn "Front body controller: a284 driver therm warn";
CM_ SG_ 1332 VCFRONT_a284_driverThermShutdown "Front body controller: a284 driver therm shutdown";
CM_ SG_ 1332 VCFRONT_a284_undervoltage "Front body controller: a284 undervoltage";
CM_ SG_ 1332 VCFRONT_a284_chargePumpUndervolt "Front body controller: a284 charge pump undervoltage";
CM_ SG_ 1332 VCFRONT_a284_isCoilOpenX "Front body controller: a284 is coil open x";
CM_ SG_ 1332 VCFRONT_a284_isCoilOpenY "Front body controller: a284 is coil open y";
CM_ SG_ 1332 VCFRONT_a284_isCoilShortXPGnd "Front body controller: a284 is coil short XP gnd";
CM_ SG_ 1332 VCFRONT_a284_isCoilShortXPVbb "Front body controller: a284 is coil short XP vbb";
CM_ SG_ 1332 VCFRONT_a284_isCoilShortXNGnd "Front body controller: a284 is coil short XN gnd";
CM_ SG_ 1332 VCFRONT_a284_isCoilShortXNVbb "Front body controller: a284 is coil short XN vbb";
CM_ SG_ 1332 VCFRONT_a284_isCoilShortYPGnd "Front body controller: a284 is coil short YP gnd";
CM_ SG_ 1332 VCFRONT_a284_isCoilShortYPVbb "Front body controller: a284 is coil short YP vbb";
CM_ SG_ 1332 VCFRONT_a284_isCoilShortYNGnd "Front body controller: a284 is coil short YN gnd";
CM_ SG_ 1332 VCFRONT_a284_isCoilShortYNVbb "Front body controller: a284 is coil short YN vbb";
CM_ SG_ 1332 VCFRONT_a284_driverHasCommError "Front body controller: a284 driver has comm error";
CM_ SG_ 1332 VCFRONT_a285_driverState "Front body controller: a285 driver state";
CM_ SG_ 1332 VCFRONT_a285_driverThermWarn "Front body controller: a285 driver therm warn";
CM_ SG_ 1332 VCFRONT_a285_driverThermShutdown "Front body controller: a285 driver therm shutdown";
CM_ SG_ 1332 VCFRONT_a285_undervoltage "Front body controller: a285 undervoltage";
CM_ SG_ 1332 VCFRONT_a285_chargePumpUndervolt "Front body controller: a285 charge pump undervoltage";
CM_ SG_ 1332 VCFRONT_a285_isCoilOpenX "Front body controller: a285 is coil open x";
CM_ SG_ 1332 VCFRONT_a285_isCoilOpenY "Front body controller: a285 is coil open y";
CM_ SG_ 1332 VCFRONT_a285_isCoilShortXPGnd "Front body controller: a285 is coil short XP gnd";
CM_ SG_ 1332 VCFRONT_a285_isCoilShortXPVbb "Front body controller: a285 is coil short XP vbb";
CM_ SG_ 1332 VCFRONT_a285_isCoilShortXNGnd "Front body controller: a285 is coil short XN gnd";
CM_ SG_ 1332 VCFRONT_a285_isCoilShortXNVbb "Front body controller: a285 is coil short XN vbb";
CM_ SG_ 1332 VCFRONT_a285_isCoilShortYPGnd "Front body controller: a285 is coil short YP gnd";
CM_ SG_ 1332 VCFRONT_a285_isCoilShortYPVbb "Front body controller: a285 is coil short YP vbb";
CM_ SG_ 1332 VCFRONT_a285_isCoilShortYNGnd "Front body controller: a285 is coil short YN gnd";
CM_ SG_ 1332 VCFRONT_a285_isCoilShortYNVbb "Front body controller: a285 is coil short YN vbb";
CM_ SG_ 1332 VCFRONT_a285_driverHasCommError "Front body controller: a285 driver has comm error";
CM_ SG_ 1332 VCFRONT_a286_driverState "Front body controller: a286 driver state";
CM_ SG_ 1332 VCFRONT_a286_driverThermWarn "Front body controller: a286 driver therm warn";
CM_ SG_ 1332 VCFRONT_a286_driverThermShutdown "Front body controller: a286 driver therm shutdown";
CM_ SG_ 1332 VCFRONT_a286_undervoltage "Front body controller: a286 undervoltage";
CM_ SG_ 1332 VCFRONT_a286_chargePumpUndervolt "Front body controller: a286 charge pump undervoltage";
CM_ SG_ 1332 VCFRONT_a286_isCoilOpenX "Front body controller: a286 is coil open x";
CM_ SG_ 1332 VCFRONT_a286_isCoilOpenY "Front body controller: a286 is coil open y";
CM_ SG_ 1332 VCFRONT_a286_isCoilShortXPGnd "Front body controller: a286 is coil short XP gnd";
CM_ SG_ 1332 VCFRONT_a286_isCoilShortXPVbb "Front body controller: a286 is coil short XP vbb";
CM_ SG_ 1332 VCFRONT_a286_isCoilShortXNGnd "Front body controller: a286 is coil short XN gnd";
CM_ SG_ 1332 VCFRONT_a286_isCoilShortXNVbb "Front body controller: a286 is coil short XN vbb";
CM_ SG_ 1332 VCFRONT_a286_isCoilShortYPGnd "Front body controller: a286 is coil short YP gnd";
CM_ SG_ 1332 VCFRONT_a286_isCoilShortYPVbb "Front body controller: a286 is coil short YP vbb";
CM_ SG_ 1332 VCFRONT_a286_isCoilShortYNGnd "Front body controller: a286 is coil short YN gnd";
CM_ SG_ 1332 VCFRONT_a286_isCoilShortYNVbb "Front body controller: a286 is coil short YN vbb";
CM_ SG_ 1332 VCFRONT_a286_driverHasCommError "Front body controller: a286 driver has comm error";
CM_ SG_ 1332 VCFRONT_a287_driverState "Front body controller: a287 driver state";
CM_ SG_ 1332 VCFRONT_a287_driverThermWarn "Front body controller: a287 driver therm warn";
CM_ SG_ 1332 VCFRONT_a287_driverThermShutdown "Front body controller: a287 driver therm shutdown";
CM_ SG_ 1332 VCFRONT_a287_undervoltage "Front body controller: a287 undervoltage";
CM_ SG_ 1332 VCFRONT_a287_chargePumpUndervolt "Front body controller: a287 charge pump undervoltage";
CM_ SG_ 1332 VCFRONT_a287_isCoilOpenX "Front body controller: a287 is coil open x";
CM_ SG_ 1332 VCFRONT_a287_isCoilOpenY "Front body controller: a287 is coil open y";
CM_ SG_ 1332 VCFRONT_a287_isCoilShortXPGnd "Front body controller: a287 is coil short XP gnd";
CM_ SG_ 1332 VCFRONT_a287_isCoilShortXPVbb "Front body controller: a287 is coil short XP vbb";
CM_ SG_ 1332 VCFRONT_a287_isCoilShortXNGnd "Front body controller: a287 is coil short XN gnd";
CM_ SG_ 1332 VCFRONT_a287_isCoilShortXNVbb "Front body controller: a287 is coil short XN vbb";
CM_ SG_ 1332 VCFRONT_a287_isCoilShortYPGnd "Front body controller: a287 is coil short YP gnd";
CM_ SG_ 1332 VCFRONT_a287_isCoilShortYPVbb "Front body controller: a287 is coil short YP vbb";
CM_ SG_ 1332 VCFRONT_a287_isCoilShortYNGnd "Front body controller: a287 is coil short YN gnd";
CM_ SG_ 1332 VCFRONT_a287_isCoilShortYNVbb "Front body controller: a287 is coil short YN vbb";
CM_ SG_ 1332 VCFRONT_a287_driverHasCommError "Front body controller: a287 driver has comm error";
CM_ SG_ 1332 VCFRONT_a288_driverState "Front body controller: a288 driver state";
CM_ SG_ 1332 VCFRONT_a288_driverThermWarn "Front body controller: a288 driver therm warn";
CM_ SG_ 1332 VCFRONT_a288_driverThermShutdown "Front body controller: a288 driver therm shutdown";
CM_ SG_ 1332 VCFRONT_a288_undervoltage "Front body controller: a288 undervoltage";
CM_ SG_ 1332 VCFRONT_a288_chargePumpUndervolt "Front body controller: a288 charge pump undervoltage";
CM_ SG_ 1332 VCFRONT_a288_isCoilOpenX "Front body controller: a288 is coil open x";
CM_ SG_ 1332 VCFRONT_a288_isCoilOpenY "Front body controller: a288 is coil open y";
CM_ SG_ 1332 VCFRONT_a288_isCoilShortXPGnd "Front body controller: a288 is coil short XP gnd";
CM_ SG_ 1332 VCFRONT_a288_isCoilShortXPVbb "Front body controller: a288 is coil short XP vbb";
CM_ SG_ 1332 VCFRONT_a288_isCoilShortXNGnd "Front body controller: a288 is coil short XN gnd";
CM_ SG_ 1332 VCFRONT_a288_isCoilShortXNVbb "Front body controller: a288 is coil short XN vbb";
CM_ SG_ 1332 VCFRONT_a288_isCoilShortYPGnd "Front body controller: a288 is coil short YP gnd";
CM_ SG_ 1332 VCFRONT_a288_isCoilShortYPVbb "Front body controller: a288 is coil short YP vbb";
CM_ SG_ 1332 VCFRONT_a288_isCoilShortYNGnd "Front body controller: a288 is coil short YN gnd";
CM_ SG_ 1332 VCFRONT_a288_isCoilShortYNVbb "Front body controller: a288 is coil short YN vbb";
CM_ SG_ 1332 VCFRONT_a288_driverHasCommError "Front body controller: a288 driver has comm error";
CM_ SG_ 1332 VCFRONT_a289_driverState "Front body controller: a289 driver state";
CM_ SG_ 1332 VCFRONT_a289_driverThermWarn "Front body controller: a289 driver therm warn";
CM_ SG_ 1332 VCFRONT_a289_driverThermShutdown "Front body controller: a289 driver therm shutdown";
CM_ SG_ 1332 VCFRONT_a289_undervoltage "Front body controller: a289 undervoltage";
CM_ SG_ 1332 VCFRONT_a289_chargePumpUndervolt "Front body controller: a289 charge pump undervoltage";
CM_ SG_ 1332 VCFRONT_a289_isCoilOpenX "Front body controller: a289 is coil open x";
CM_ SG_ 1332 VCFRONT_a289_isCoilOpenY "Front body controller: a289 is coil open y";
CM_ SG_ 1332 VCFRONT_a289_isCoilShortXPGnd "Front body controller: a289 is coil short XP gnd";
CM_ SG_ 1332 VCFRONT_a289_isCoilShortXPVbb "Front body controller: a289 is coil short XP vbb";
CM_ SG_ 1332 VCFRONT_a289_isCoilShortXNGnd "Front body controller: a289 is coil short XN gnd";
CM_ SG_ 1332 VCFRONT_a289_isCoilShortXNVbb "Front body controller: a289 is coil short XN vbb";
CM_ SG_ 1332 VCFRONT_a289_isCoilShortYPGnd "Front body controller: a289 is coil short YP gnd";
CM_ SG_ 1332 VCFRONT_a289_isCoilShortYPVbb "Front body controller: a289 is coil short YP vbb";
CM_ SG_ 1332 VCFRONT_a289_isCoilShortYNGnd "Front body controller: a289 is coil short YN gnd";
CM_ SG_ 1332 VCFRONT_a289_isCoilShortYNVbb "Front body controller: a289 is coil short YN vbb";
CM_ SG_ 1332 VCFRONT_a289_driverHasCommError "Front body controller: a289 driver has comm error";
CM_ SG_ 1332 VCFRONT_a290_outputFaulted "Front body controller: a290 output faulted";
CM_ SG_ 1332 VCFRONT_a290_currentSenseFaulted "Front body controller: a290 current sense faulted";
CM_ SG_ 1332 VCFRONT_a290_tempSenseFaulted "Front body controller: a290 temp sense faulted";
CM_ SG_ 1332 VCFRONT_a290_underCurrent "Front body controller: a290 under current";
CM_ SG_ 1332 VCFRONT_a290_overCurrent "Front body controller: a290 over current";
CM_ SG_ 1332 VCFRONT_a290_overTemperature "Front body controller: a290 over temperature";
CM_ SG_ 1332 VCFRONT_a291_outputFaulted "Front body controller: a291 output faulted";
CM_ SG_ 1332 VCFRONT_a291_currentSenseFaulted "Front body controller: a291 current sense faulted";
CM_ SG_ 1332 VCFRONT_a291_tempSenseFaulted "Front body controller: a291 temp sense faulted";
CM_ SG_ 1332 VCFRONT_a291_underCurrent "Front body controller: a291 under current";
CM_ SG_ 1332 VCFRONT_a291_overCurrent "Front body controller: a291 over current";
CM_ SG_ 1332 VCFRONT_a291_overTemperature "Front body controller: a291 over temperature";
CM_ SG_ 1332 VCFRONT_a292_outputFaulted "Front body controller: a292 output faulted";
CM_ SG_ 1332 VCFRONT_a292_currentSenseFaulted "Front body controller: a292 current sense faulted";
CM_ SG_ 1332 VCFRONT_a292_tempSenseFaulted "Front body controller: a292 temp sense faulted";
CM_ SG_ 1332 VCFRONT_a292_underCurrent "Front body controller: a292 under current";
CM_ SG_ 1332 VCFRONT_a292_overCurrent "Front body controller: a292 over current";
CM_ SG_ 1332 VCFRONT_a292_overTemperature "Front body controller: a292 over temperature";
CM_ SG_ 1332 VCFRONT_a293_outputFaulted "Front body controller: a293 output faulted";
CM_ SG_ 1332 VCFRONT_a293_currentSenseFaulted "Front body controller: a293 current sense faulted";
CM_ SG_ 1332 VCFRONT_a293_tempSenseFaulted "Front body controller: a293 temp sense faulted";
CM_ SG_ 1332 VCFRONT_a293_underCurrent "Front body controller: a293 under current";
CM_ SG_ 1332 VCFRONT_a293_overCurrent "Front body controller: a293 over current";
CM_ SG_ 1332 VCFRONT_a293_overTemperature "Front body controller: a293 over temperature";
CM_ SG_ 1332 VCFRONT_a294_outputFaulted "Front body controller: a294 output faulted";
CM_ SG_ 1332 VCFRONT_a294_currentSenseFaulted "Front body controller: a294 current sense faulted";
CM_ SG_ 1332 VCFRONT_a294_tempSenseFaulted "Front body controller: a294 temp sense faulted";
CM_ SG_ 1332 VCFRONT_a294_underCurrent "Front body controller: a294 under current";
CM_ SG_ 1332 VCFRONT_a294_overCurrent "Front body controller: a294 over current";
CM_ SG_ 1332 VCFRONT_a294_overTemperature "Front body controller: a294 over temperature";
CM_ SG_ 1332 VCFRONT_a295_outputFaulted "Front body controller: a295 output faulted";
CM_ SG_ 1332 VCFRONT_a295_currentSenseFaulted "Front body controller: a295 current sense faulted";
CM_ SG_ 1332 VCFRONT_a295_tempSenseFaulted "Front body controller: a295 temp sense faulted";
CM_ SG_ 1332 VCFRONT_a295_underCurrent "Front body controller: a295 under current";
CM_ SG_ 1332 VCFRONT_a295_overCurrent "Front body controller: a295 over current";
CM_ SG_ 1332 VCFRONT_a295_overTemperature "Front body controller: a295 over temperature";
CM_ SG_ 1332 VCFRONT_a297_bmbDeviceId "Front body controller: a297 bmb device id";
CM_ SG_ 1332 VCFRONT_a297_bmbDeviceFaultTempM "Front body controller: a297 bmb device fault temp mask";
CM_ SG_ 1332 VCFRONT_a300_oldType "Front body controller: a300 old type";
CM_ SG_ 1332 VCFRONT_a300_newType "Front body controller: a300 new type";
CM_ SG_ 1332 VCFRONT_a302_LINFrameStatus "Front body controller: a302 LIN frame status";
CM_ SG_ 1332 VCFRONT_a303_vehicleSpeed "Front body controller: a303 vehicle speed";
CM_ SG_ 1332 VCFRONT_a303_postVoltage "Front body controller: a303 post voltage";
CM_ SG_ 1332 VCFRONT_a303_lockStatus "Front body controller: a303 lock status";
CM_ SG_ 1332 VCFRONT_a304_voltage "Front body controller: a304 voltage";
CM_ SG_ 1332 VCFRONT_a304_temperature "Front body controller: a304 temperature";
CM_ SG_ 1332 VCFRONT_a305_voltage "Front body controller: a305 voltage";
CM_ SG_ 1332 VCFRONT_a305_temperature "Front body controller: a305 temperature";
CM_ SG_ 1332 VCFRONT_a305_actuatorCurrent "Front body controller: a305 actuator current";
CM_ SG_ 1332 VCFRONT_a306_voltage "Front body controller: a306 voltage";
CM_ SG_ 1332 VCFRONT_a306_temperature "Front body controller: a306 temperature";
CM_ SG_ 1332 VCFRONT_a306_actuatorCurrent "Front body controller: a306 actuator current";
CM_ SG_ 1332 VCFRONT_a307_voltage "Front body controller: a307 voltage";
CM_ SG_ 1332 VCFRONT_a307_temperature "Front body controller: a307 temperature";
CM_ SG_ 1332 VCFRONT_a307_actuatorCurrent "Front body controller: a307 actuator current";
CM_ SG_ 1332 VCFRONT_a308_voltage "Front body controller: a308 voltage";
CM_ SG_ 1332 VCFRONT_a308_temperature "Front body controller: a308 temperature";
CM_ SG_ 1332 VCFRONT_a308_actuatorCurrent "Front body controller: a308 actuator current";
CM_ SG_ 1332 VCFRONT_a309_vehicleSpeed "Front body controller: a309 vehicle speed";
CM_ SG_ 1332 VCFRONT_a309_switchVoltage "Front body controller: a309 switch voltage";
CM_ SG_ 1332 VCFRONT_a309_lockStatus "Front body controller: a309 lock status";
CM_ SG_ 1332 VCFRONT_a334_maxSlope "Front body controller: a334 max slope";
CM_ SG_ 1332 VCFRONT_a334_avgCurrent "Front body controller: a334 avg current";
CM_ SG_ 1332 VCFRONT_a334_maxCurrent "Front body controller: a334 max current";
CM_ SG_ 1332 VCFRONT_a334_vehicleState "Front body controller: a334 vehicle state";
CM_ SG_ 1332 VCFRONT_a335_maxSlope "Front body controller: a335 max slope";
CM_ SG_ 1332 VCFRONT_a335_avgCurrent "Front body controller: a335 avg current";
CM_ SG_ 1332 VCFRONT_a335_maxCurrent "Front body controller: a335 max current";
CM_ SG_ 1332 VCFRONT_a335_vehicleState "Front body controller: a335 vehicle state";
CM_ SG_ 1332 VCFRONT_a336_maxSlope "Front body controller: a336 max slope";
CM_ SG_ 1332 VCFRONT_a336_avgCurrent "Front body controller: a336 avg current";
CM_ SG_ 1332 VCFRONT_a336_maxCurrent "Front body controller: a336 max current";
CM_ SG_ 1332 VCFRONT_a336_vehicleState "Front body controller: a336 vehicle state";
CM_ SG_ 1332 VCFRONT_a337_maxSlope "Front body controller: a337 max slope";
CM_ SG_ 1332 VCFRONT_a337_avgCurrent "Front body controller: a337 avg current";
CM_ SG_ 1332 VCFRONT_a337_maxCurrent "Front body controller: a337 max current";
CM_ SG_ 1332 VCFRONT_a337_vehicleState "Front body controller: a337 vehicle state";
CM_ SG_ 1332 VCFRONT_a338_maxSlope "Front body controller: a338 max slope";
CM_ SG_ 1332 VCFRONT_a338_avgCurrent "Front body controller: a338 avg current";
CM_ SG_ 1332 VCFRONT_a338_maxCurrent "Front body controller: a338 max current";
CM_ SG_ 1332 VCFRONT_a338_vehicleState "Front body controller: a338 vehicle state";
CM_ SG_ 1332 VCFRONT_a339_maxSlope "Front body controller: a339 max slope";
CM_ SG_ 1332 VCFRONT_a339_avgCurrent "Front body controller: a339 avg current";
CM_ SG_ 1332 VCFRONT_a339_maxCurrent "Front body controller: a339 max current";
CM_ SG_ 1332 VCFRONT_a339_vehicleState "Front body controller: a339 vehicle state";
CM_ SG_ 1332 VCFRONT_a340_maxSlope "Front body controller: a340 max slope";
CM_ SG_ 1332 VCFRONT_a340_avgCurrent "Front body controller: a340 avg current";
CM_ SG_ 1332 VCFRONT_a340_maxCurrent "Front body controller: a340 max current";
CM_ SG_ 1332 VCFRONT_a340_vehicleState "Front body controller: a340 vehicle state";
CM_ SG_ 1332 VCFRONT_a341_maxSlope "Front body controller: a341 max slope";
CM_ SG_ 1332 VCFRONT_a341_avgCurrent "Front body controller: a341 avg current";
CM_ SG_ 1332 VCFRONT_a341_maxCurrent "Front body controller: a341 max current";
CM_ SG_ 1332 VCFRONT_a341_vehicleState "Front body controller: a341 vehicle state";
CM_ SG_ 1332 VCFRONT_a342_maxSlope "Front body controller: a342 max slope";
CM_ SG_ 1332 VCFRONT_a342_avgCurrent "Front body controller: a342 avg current";
CM_ SG_ 1332 VCFRONT_a342_maxCurrent "Front body controller: a342 max current";
CM_ SG_ 1332 VCFRONT_a342_vehicleState "Front body controller: a342 vehicle state";
CM_ SG_ 1332 VCFRONT_a343_maxSlope "Front body controller: a343 max slope";
CM_ SG_ 1332 VCFRONT_a343_avgCurrent "Front body controller: a343 avg current";
CM_ SG_ 1332 VCFRONT_a343_maxCurrent "Front body controller: a343 max current";
CM_ SG_ 1332 VCFRONT_a343_vehicleState "Front body controller: a343 vehicle state";
CM_ SG_ 1332 VCFRONT_a344_maxSlope "Front body controller: a344 max slope";
CM_ SG_ 1332 VCFRONT_a344_avgCurrent "Front body controller: a344 avg current";
CM_ SG_ 1332 VCFRONT_a344_maxCurrent "Front body controller: a344 max current";
CM_ SG_ 1332 VCFRONT_a344_vehicleState "Front body controller: a344 vehicle state";
CM_ SG_ 1332 VCFRONT_a345_maxSlope "Front body controller: a345 max slope";
CM_ SG_ 1332 VCFRONT_a345_avgCurrent "Front body controller: a345 avg current";
CM_ SG_ 1332 VCFRONT_a345_maxCurrent "Front body controller: a345 max current";
CM_ SG_ 1332 VCFRONT_a345_vehicleState "Front body controller: a345 vehicle state";
CM_ SG_ 1332 VCFRONT_a346_maxSlope "Front body controller: a346 max slope";
CM_ SG_ 1332 VCFRONT_a346_avgCurrent "Front body controller: a346 avg current";
CM_ SG_ 1332 VCFRONT_a346_maxCurrent "Front body controller: a346 max current";
CM_ SG_ 1332 VCFRONT_a346_vehicleState "Front body controller: a346 vehicle state";
CM_ SG_ 1332 VCFRONT_a347_maxSlope "Front body controller: a347 max slope";
CM_ SG_ 1332 VCFRONT_a347_avgCurrent "Front body controller: a347 avg current";
CM_ SG_ 1332 VCFRONT_a347_maxCurrent "Front body controller: a347 max current";
CM_ SG_ 1332 VCFRONT_a347_vehicleState "Front body controller: a347 vehicle state";
CM_ SG_ 1332 VCFRONT_a348_maxSlope "Front body controller: a348 max slope";
CM_ SG_ 1332 VCFRONT_a348_avgCurrent "Front body controller: a348 avg current";
CM_ SG_ 1332 VCFRONT_a348_maxCurrent "Front body controller: a348 max current";
CM_ SG_ 1332 VCFRONT_a348_vehicleState "Front body controller: a348 vehicle state";
CM_ SG_ 1332 VCFRONT_a349_maxSlope "Front body controller: a349 max slope";
CM_ SG_ 1332 VCFRONT_a349_avgCurrent "Front body controller: a349 avg current";
CM_ SG_ 1332 VCFRONT_a349_maxCurrent "Front body controller: a349 max current";
CM_ SG_ 1332 VCFRONT_a349_vehicleState "Front body controller: a349 vehicle state";
CM_ SG_ 1332 VCFRONT_a350_espValveCurrent "Front body controller: a350 esp valve current";
CM_ SG_ 1332 VCFRONT_a353_wiperHeaterCurrent "Front body controller: a353 wiper heater current";
CM_ SG_ 1332 VCFRONT_a353_batteryVoltage "Front body controller: a353 battery voltage";
CM_ SG_ 1332 VCFRONT_a353_ambientTemperature "Front body controller: a353 ambient temperature";
CM_ SG_ 1332 VCFRONT_a354_windshieldCameraHea "Front body controller: a354 windshield camera heater current";
CM_ SG_ 1332 VCFRONT_a354_batteryVoltage "Front body controller: a354 battery voltage";
CM_ SG_ 1332 VCFRONT_a354_ambientTemperature "Front body controller: a354 ambient temperature";
CM_ SG_ 1332 VCFRONT_a355_fluidNotFilled "Front body controller: a355 fluid not filled";
CM_ SG_ 1332 VCFRONT_a355_systemNotCommission "Front body controller: a355 system not commissioned";
CM_ SG_ 1332 VCFRONT_a355_serviceLockout "Front body controller: a355 service lockout";
CM_ SG_ 1332 VCFRONT_a355_factoryGated "Front body controller: a355 factory gated";
CM_ SG_ 1332 VCFRONT_a356_fluidNotFilled "Front body controller: a356 fluid not filled";
CM_ SG_ 1332 VCFRONT_a356_systemNotCommission "Front body controller: a356 system not commissioned";
CM_ SG_ 1332 VCFRONT_a356_serviceLockout "Front body controller: a356 service lockout";
CM_ SG_ 1332 VCFRONT_a356_factoryGated "Front body controller: a356 factory gated";
CM_ SG_ 1332 VCFRONT_a356_refCommissionStatus "Front body controller: a356 ref commission status";
CM_ SG_ 1332 VCFRONT_a357_maxTransientCurrent "Front body controller: a357 max transient current";
CM_ SG_ 1332 VCFRONT_a358_maxTransientCurrent "Front body controller: a358 max transient current";
CM_ SG_ 1332 VCFRONT_a359_IBSVolts "Front body controller: a359 IBS volts";
CM_ SG_ 1332 VCFRONT_a359_IBSAh "Front body controller: a359 IBS ah";
CM_ SG_ 1332 VCFRONT_a359_vehiclePowerState "Front body controller: a359 vehicle power state";
CM_ SG_ 1332 VCFRONT_a359_batterySMState "Front body controller: a359 battery SM state";
CM_ SG_ 1332 VCFRONT_a359_hvState "Front body controller: a359 hv state";
CM_ SG_ 1332 VCFRONT_a359_coolantHasBeenFille "Front body controller: a359 coolant has been filled";
CM_ SG_ 1332 VCFRONT_a359_crashDetected "Front body controller: a359 crash detected";
CM_ SG_ 1332 VCFRONT_a359_BMS_MIA "Front body controller: a359 BMS MIA";
CM_ SG_ 1332 VCFRONT_a359_PCS_MIA "Front body controller: a359 PCS MIA";
CM_ SG_ 1332 VCFRONT_a359_serviceMode "Signal reported by Front body controller";
CM_ SG_ 1332 VCFRONT_a359_dcdcLVSupportStatus "Front body controller: a359 dcdc LV support status";
CM_ SG_ 1332 VCFRONT_a359_bmsState "Front body controller: a359 bms state";
CM_ SG_ 1332 VCFRONT_a360_vehicleLoadShedActi "Front body controller: a360 vehicle load shed active";
CM_ SG_ 1332 VCFRONT_a360_notEnoughPowerForSu "Front body controller: a360 not enough power for support";
CM_ SG_ 1332 VCFRONT_a363_minBleedCharge "Front body controller: a363 min bleed charge";
CM_ SG_ 1332 VCFRONT_a363_avgBleedCharge "Front body controller: a363 avg bleed charge";
CM_ SG_ 1332 VCFRONT_a363_checkIntervalDays "Front body controller: a363 check interval days";
CM_ SG_ 1332 VCFRONT_a363_minBleedChargeBrick "Front body controller: a363 min bleed charge brick id";
CM_ SG_ 1332 VCFRONT_a363_setFromNvm "Front body controller: a363 set from nvm";
CM_ SG_ 1332 VCFRONT_a367_bmsSoc "Front body controller: a367 bms soc";
CM_ SG_ 1332 VCFRONT_a368_bmsRequestRemoved "Front body controller: a368 bms request removed";
CM_ SG_ 1332 VCFRONT_a368_enteringState "Front body controller: a368 entering state";
CM_ SG_ 1332 VCFRONT_a368_exitingState "Front body controller: a368 exiting state";
CM_ SG_ 1332 VCFRONT_a368_bmsSoc "Front body controller: a368 bms soc";
CM_ SG_ 1332 VCFRONT_a368_systemFaulted "Front body controller: a368 system faulted";
CM_ SG_ 1332 VCFRONT_a368_coolantTempSensorsF "Front body controller: a368 coolant temp sensors faulted";
CM_ SG_ 1332 VCFRONT_a368_coolantValveFaulted "Front body controller: a368 coolant valve faulted";
CM_ SG_ 1332 VCFRONT_a368_louverFaulted "Front body controller: a368 louver faulted";
CM_ SG_ 1332 VCFRONT_a368_fansFaulted "Front body controller: a368 fans faulted";
CM_ SG_ 1332 VCFRONT_a368_coolantNotFilled "Front body controller: a368 coolant not filled";
CM_ SG_ 1332 VCFRONT_a368_coolantPumpsFaulted "Front body controller: a368 coolant pumps faulted";
CM_ SG_ 1332 VCFRONT_a368_preconditionsNotMet "Front body controller: a368 preconditions not met";
CM_ SG_ 1332 VCFRONT_a368_belowSocMin "Front body controller: a368 below soc min";
CM_ SG_ 1332 VCFRONT_a369_powerGenerationLimi "Front body controller: a369 power generation limited";
CM_ SG_ 1332 VCFRONT_a369_heatRejectionLimite "Front body controller: a369 heat rejection limited";
CM_ SG_ 1332 VCFRONT_a369_bmsSoc "Front body controller: a369 bms soc";
CM_ SG_ 1332 VCFRONT_a369_wasteHeatPower "Front body controller: a369 waste heat power";
CM_ SG_ 1332 VCFRONT_a370_IBSVolts "Front body controller: a370 IBS volts";
CM_ SG_ 1332 VCFRONT_a370_IBSAh "Front body controller: a370 IBS ah";
CM_ SG_ 1332 VCFRONT_a370_notEnoughPowerForSu "Front body controller: a370 not enough power for support";
CM_ SG_ 1332 VCFRONT_a370_serviceMode "Signal reported by Front body controller";
CM_ SG_ 1332 VCFRONT_a370_sleepCurrent "Front body controller: a370 sleep current";
CM_ SG_ 1332 VCFRONT_a370_SOC "Front body controller: a370 SOC";
CM_ SG_ 1332 VCFRONT_a371_shortedCellTestTrig "Front body controller: a371 shorted cell test trigger";
CM_ SG_ 1332 VCFRONT_a371_voltDropOnHighCurre "Front body controller: a371 volt drop on high current trigger";
CM_ SG_ 1332 VCFRONT_a371_deadLVMinimalAhDisc "Front body controller: a371 dead LV minimal ah discharged trigger";
CM_ SG_ 1332 VCFRONT_a371_resistanceEstimatio "Front body controller: a371 resistance estimation hard fail trigger";
CM_ SG_ 1332 VCFRONT_a371_dcrMilliOhmsAboveTh "Front body controller: a371 dcr milli ohms above threshold trigger";
CM_ SG_ 1332 VCFRONT_a371_prechargeLVLoadRedu "Front body controller: a371 precharge LV load reduction trigger";
CM_ SG_ 1332 VCFRONT_a371_instantPrechargeDCR "Front body controller: a371 instant precharge DCR too high trigger";
CM_ SG_ 1332 VCFRONT_a372_bmbDeviceId "Front body controller: a372 bmb device id";
CM_ SG_ 1332 VCFRONT_a372_bmbDeviceFaultBrick "Front body controller: a372 bmb device fault brick mask";
CM_ SG_ 1332 VCFRONT_a373_tempSuperheatActual "Front body controller: a373 temp superheat actual";
CM_ SG_ 1332 VCFRONT_a373_tempSuperheatTarget "Front body controller: a373 temp superheat target";
CM_ SG_ 1332 VCFRONT_a373_compDemandChiller "Front body controller: a373 comp demand chiller";
CM_ SG_ 1332 VCFRONT_a374_lccInletSolenoidISe "Front body controller: a374 lcc inlet solenoid i sense";
CM_ SG_ 1332 VCFRONT_a377_wiperStuckOutOfPark "Front body controller: a377 wiper stuck out of park";
CM_ SG_ 1332 VCFRONT_a377_wiperStuckInPark "Front body controller: a377 wiper stuck in park";
CM_ SG_ 1332 VCFRONT_a387_shortedCellFaultCou "Front body controller: a387 shorted cell fault counter";
CM_ SG_ 1332 VCFRONT_a387_minVoltageReached "Front body controller: a387 min voltage reached";
CM_ SG_ 1332 VCFRONT_a387_opportunisticTest "Front body controller: a387 opportunistic test";
CM_ SG_ 1332 VCFRONT_a387_IBSTemp "Front body controller: a387 IBS temp";
CM_ SG_ 1332 VCFRONT_a387_maxCurrentReached "Front body controller: a387 max current reached";
CM_ SG_ 1332 VCFRONT_a388_shortedCellFaultCou "Front body controller: a388 shorted cell fault counter";
CM_ SG_ 1332 VCFRONT_a388_minVoltageReached "Front body controller: a388 min voltage reached";
CM_ SG_ 1332 VCFRONT_a388_opportunisticTest "Front body controller: a388 opportunistic test";
CM_ SG_ 1332 VCFRONT_a388_IBSTemp "Front body controller: a388 IBS temp";
CM_ SG_ 1332 VCFRONT_a388_maxCurrentReached "Front body controller: a388 max current reached";
CM_ SG_ 1332 VCFRONT_a389_closedAtSpeed "Front body controller: a389 closed at speed";
CM_ SG_ 1332 VCFRONT_a389_faultedWhileOpenAtS "Front body controller: a389 faulted while open at speed";
CM_ SG_ 1332 VCFRONT_a389_possiblyStuckClosed "Front body controller: a389 possibly stuck closed";
CM_ SG_ 1332 VCFRONT_a389_vehicleSpeed "Front body controller: a389 vehicle speed";
CM_ SG_ 1332 VCFRONT_a389_temperature "Front body controller: a389 temperature";
CM_ SG_ 1332 VCFRONT_a389_latchStatus "Front body controller: a389 latch status";
CM_ SG_ 1332 VCFRONT_a391_switchMismatch "Front body controller: a391 switch mismatch";
CM_ SG_ 1332 VCFRONT_a391_switch1Shorted "Front body controller: a391 switch1 shorted";
CM_ SG_ 1332 VCFRONT_a391_switch1Disconnected "Front body controller: a391 switch1 disconnected";
CM_ SG_ 1332 VCFRONT_a391_switch2Shorted "Front body controller: a391 switch2 shorted";
CM_ SG_ 1332 VCFRONT_a391_switch2Disconnected "Front body controller: a391 switch2 disconnected";
CM_ SG_ 1332 VCFRONT_a391_switch1VoltageAvera "Front body controller: a391 switch1 voltage average";
CM_ SG_ 1332 VCFRONT_a391_switch1VoltageInsta "Front body controller: a391 switch1 voltage instant";
CM_ SG_ 1332 VCFRONT_a391_switch2VoltageAvera "Front body controller: a391 switch2 voltage average";
CM_ SG_ 1332 VCFRONT_a391_switch2VoltageInsta "Front body controller: a391 switch2 voltage instant";
CM_ SG_ 1332 VCFRONT_a392_bmbDeviceId "Front body controller: a392 bmb device id";
CM_ SG_ 1332 VCFRONT_a392_bmbDeviceFaultBrick "Front body controller: a392 bmb device fault brick mask";
CM_ SG_ 1332 VCFRONT_a397_discharge "Front body controller: a397 discharge";
CM_ SG_ 1332 VCFRONT_a397_suction "Front body controller: a397 suction";
CM_ SG_ 1332 VCFRONT_a397_liquid "Front body controller: a397 liquid";
CM_ SG_ 1332 VCFRONT_a397_offsetError "Front body controller: a397 offset error";
CM_ SG_ 1332 VCFRONT_a397_runTimeOffSetDetect "Front body controller: a397 run time off set detected";
CM_ SG_ 1332 VCFRONT_a401_LVBatteryTemp "Front body controller: a401 LV battery temp";
CM_ SG_ 1332 VCFRONT_a401_IBSCurrent "Front body controller: a401 IBS current";
CM_ SG_ 1332 VCFRONT_a401_IBSVoltage "Front body controller: a401 IBS voltage";
CM_ SG_ 1332 VCFRONT_a401_IBSAmpHours "Front body controller: a401 IBS amp hours";
CM_ SG_ 1332 VCFRONT_a402_LVBatteryTemp "Front body controller: a402 LV battery temp";
CM_ SG_ 1332 VCFRONT_a402_batterySMState "Front body controller: a402 battery SM state";
CM_ SG_ 1332 VCFRONT_a402_failureToPrechargeR "Front body controller: a402 failure to precharge risk";
CM_ SG_ 1332 VCFRONT_a402_electricalDisconnec "Front body controller: a402 electrical disconnect LV battery";
CM_ SG_ 1332 VCFRONT_a402_communicationDiscon "Front body controller: a402 communication disconnect LV battery";
CM_ SG_ 1332 VCFRONT_a402_reverseBatteryFault "Front body controller: a402 reverse battery fault";
CM_ SG_ 1332 VCFRONT_a402_MOSOpen "Front body controller: a402 MOS open";
CM_ SG_ 1332 VCFRONT_a402_serviceMode "Signal reported by Front body controller";
CM_ SG_ 1332 VCFRONT_a402_frunkOpen "Front body controller: a402 frunk open";
CM_ SG_ 1332 VCFRONT_a404_minVoltageReached "Front body controller: a404 min voltage reached";
CM_ SG_ 1332 VCFRONT_a404_IBSTemp "Front body controller: a404 IBS temp";
CM_ SG_ 1332 VCFRONT_a404_maxCurrentReached "Front body controller: a404 max current reached";
CM_ SG_ 1332 VCFRONT_a407_dcrMilliOhms "Front body controller: a407 dcr milli ohms";
CM_ SG_ 1332 VCFRONT_a407_dcr12VThreshold "Front body controller: a407 dcr12 v threshold";
CM_ SG_ 1332 VCFRONT_a407_avgIntervalCurrent "Front body controller: a407 avg interval current";
CM_ SG_ 1332 VCFRONT_a407_intervalCurrentVari "Front body controller: a407 interval current variance";
CM_ SG_ 1332 VCFRONT_a407_avgPulseCurrent "Front body controller: a407 avg pulse current";
CM_ SG_ 1332 VCFRONT_a407_pulseCurrentVarianc "Front body controller: a407 pulse current variance shifted";
CM_ SG_ 1332 VCFRONT_a407_IBSTemperature "Front body controller: a407 IBS temperature";
CM_ SG_ 1332 VCFRONT_a407_testCounter "Front body controller: a407 test counter";
CM_ SG_ 1332 VCFRONT_a407_testingExpended "Front body controller: a407 testing expended";
CM_ SG_ 1332 VCFRONT_a407_opportunisticTest "Front body controller: a407 opportunistic test";
CM_ SG_ 1332 VCFRONT_a409_brushlessMotorConfi "Front body controller: a409 brushless motor configuration invalid";
CM_ SG_ 1332 VCFRONT_a414_dcrMilliOhms "Front body controller: a414 dcr milli ohms";
CM_ SG_ 1332 VCFRONT_a414_LVBatteryTemp "Front body controller: a414 LV battery temp";
CM_ SG_ 1332 VCFRONT_a414_IBSCurrent "Front body controller: a414 IBS current";
CM_ SG_ 1332 VCFRONT_a414_IBSVoltage "Front body controller: a414 IBS voltage";
CM_ SG_ 1332 VCFRONT_a414_IBSAmpHours "Front body controller: a414 IBS amp hours";
CM_ SG_ 1332 VCFRONT_a414_vehiclePowerState "Front body controller: a414 vehicle power state";
CM_ SG_ 1332 VCFRONT_a415_dcrMilliOhms "Front body controller: a415 dcr milli ohms";
CM_ SG_ 1332 VCFRONT_a415_LVBatteryTemp "Front body controller: a415 LV battery temp";
CM_ SG_ 1332 VCFRONT_a415_IBSCurrent "Front body controller: a415 IBS current";
CM_ SG_ 1332 VCFRONT_a415_IBSVoltage "Front body controller: a415 IBS voltage";
CM_ SG_ 1332 VCFRONT_a415_IBSAmpHours "Front body controller: a415 IBS amp hours";
CM_ SG_ 1332 VCFRONT_a415_vehiclePowerState "Front body controller: a415 vehicle power state";
CM_ SG_ 1332 VCFRONT_a415_HV_UP "Front body controller: a415 HV UP";
CM_ SG_ 1332 VCFRONT_a415_hvUpFirstTrigger "Front body controller: a415 hv up first trigger";
CM_ SG_ 1332 VCFRONT_a415_hvUpAnyTrigger "Front body controller: a415 hv up any trigger";
CM_ SG_ 1332 VCFRONT_a415_pcsEFuseUnstable "Front body controller: a415 pcs e fuse unstable";
CM_ SG_ 1332 VCFRONT_a415_vcrightEfuseUnstabl "Front body controller: a415 vcright efuse unstable";
CM_ SG_ 1332 VCFRONT_a415_vcleftEfuseUnstable "Front body controller: a415 vcleft efuse unstable";
CM_ SG_ 1332 VCFRONT_a415_contactorEFuseUnsta "Front body controller: a415 contactor e fuse unstable";
CM_ SG_ 1332 VCFRONT_a415_hvcEFuseUnstable "Front body controller: a415 hvc e fuse unstable";
CM_ SG_ 1332 VCFRONT_a416_brickVoltageMin "Front body controller: a416 brick voltage min";
CM_ SG_ 1332 VCFRONT_a416_brickVoltageMax "Front body controller: a416 brick voltage max";
CM_ SG_ 1332 VCFRONT_a416_packCurrent "Front body controller: a416 pack current";
CM_ SG_ 1332 VCFRONT_a416_socMin "Front body controller: a416 soc min";
CM_ SG_ 1332 VCFRONT_a416_brickId "Front body controller: a416 brick id";
CM_ SG_ 1332 VCFRONT_a417_brickVoltageMin "Front body controller: a417 brick voltage min";
CM_ SG_ 1332 VCFRONT_a417_brickVoltageMax "Front body controller: a417 brick voltage max";
CM_ SG_ 1332 VCFRONT_a417_packCurrent "Front body controller: a417 pack current";
CM_ SG_ 1332 VCFRONT_a417_socMax "Front body controller: a417 soc max";
CM_ SG_ 1332 VCFRONT_a417_brickId "Front body controller: a417 brick id";
CM_ SG_ 1332 VCFRONT_a418_brickVoltageMin "Front body controller: a418 brick voltage min";
CM_ SG_ 1332 VCFRONT_a418_brickVoltageMax "Front body controller: a418 brick voltage max";
CM_ SG_ 1332 VCFRONT_a418_packCurrent "Front body controller: a418 pack current";
CM_ SG_ 1332 VCFRONT_a418_socMax "Front body controller: a418 soc max";
CM_ SG_ 1332 VCFRONT_a418_brickId "Front body controller: a418 brick id";
CM_ SG_ 1332 VCFRONT_a419_brickVoltageMin "Front body controller: a419 brick voltage min";
CM_ SG_ 1332 VCFRONT_a419_brickVoltageMax "Front body controller: a419 brick voltage max";
CM_ SG_ 1332 VCFRONT_a419_packCurrent "Front body controller: a419 pack current";
CM_ SG_ 1332 VCFRONT_a419_socMin "Front body controller: a419 soc min";
CM_ SG_ 1332 VCFRONT_a419_brickId "Front body controller: a419 brick id";
CM_ SG_ 1332 VCFRONT_a423_brickVoltageMin "Front body controller: a423 brick voltage min";
CM_ SG_ 1332 VCFRONT_a423_brickVoltageMax "Front body controller: a423 brick voltage max";
CM_ SG_ 1332 VCFRONT_a423_packCurrent "Front body controller: a423 pack current";
CM_ SG_ 1332 VCFRONT_a423_socMin "Front body controller: a423 soc min";
CM_ SG_ 1332 VCFRONT_a423_brickId "Front body controller: a423 brick id";
CM_ SG_ 1332 VCFRONT_a424_brickVoltageMin "Front body controller: a424 brick voltage min";
CM_ SG_ 1332 VCFRONT_a424_brickVoltageMax "Front body controller: a424 brick voltage max";
CM_ SG_ 1332 VCFRONT_a424_packCurrent "Front body controller: a424 pack current";
CM_ SG_ 1332 VCFRONT_a424_socMin "Front body controller: a424 soc min";
CM_ SG_ 1332 VCFRONT_a424_brickId "Front body controller: a424 brick id";
CM_ SG_ 1332 VCFRONT_a431_netPackCurrent "Front body controller: a431 net pack current";
CM_ SG_ 1332 VCFRONT_a431_maxChargeCurrentLim "Front body controller: a431 max charge current limit";
CM_ SG_ 1332 VCFRONT_a431_hvjbCurrentLimit "Front body controller: a431 hvjb current limit";
CM_ SG_ 1332 VCFRONT_a432_targetCurrent "Front body controller: a432 target current";
CM_ SG_ 1332 VCFRONT_a432_packCurrent "Front body controller: a432 pack current";
CM_ SG_ 1332 VCFRONT_a433_bmbModuleId "Front body controller: a433 bmb module id";
CM_ SG_ 1332 VCFRONT_a433_packTypeData "Front body controller: a433 pack type data";
CM_ SG_ 1332 VCFRONT_a433_cellTypeData "Front body controller: a433 cell type data";
CM_ SG_ 1332 VCFRONT_a433_bmbModuleIdValid "Front body controller: a433 bmb module id valid";
CM_ SG_ 1332 VCFRONT_a433_useBmbModuleId "Front body controller: a433 use bmb module id";
CM_ SG_ 1332 VCFRONT_a434_bmbModuleId "Front body controller: a434 bmb module id";
CM_ SG_ 1332 VCFRONT_a434_packTypeData "Front body controller: a434 pack type data";
CM_ SG_ 1332 VCFRONT_a434_cellTypeData "Front body controller: a434 cell type data";
CM_ SG_ 1332 VCFRONT_a434_bmbModuleIdValid "Front body controller: a434 bmb module id valid";
CM_ SG_ 1332 VCFRONT_a434_useBmbModuleId "Front body controller: a434 use bmb module id";
CM_ SG_ 1332 VCFRONT_a436_netPackCurrent "Front body controller: a436 net pack current";
CM_ SG_ 1332 VCFRONT_a436_maxDischargeCurrent "Front body controller: a436 max discharge current limit";
CM_ SG_ 1332 VCFRONT_a436_hvjbCurrentLimit "Front body controller: a436 hvjb current limit";
CM_ SG_ 1332 VCFRONT_a437_nvmDataMissingA "Front body controller: a437 nvm data missing a";
CM_ SG_ 1332 VCFRONT_a437_nvmDataMissingB "Front body controller: a437 nvm data missing b";
CM_ SG_ 1332 VCFRONT_a438_temperature "Front body controller: a438 temperature";
CM_ SG_ 1332 VCFRONT_a438_sensorId "Front body controller: a438 sensor id";
CM_ SG_ 1332 VCFRONT_a439_temperature "Front body controller: a439 temperature";
CM_ SG_ 1332 VCFRONT_a439_sensorId "Front body controller: a439 sensor id";
CM_ SG_ 1332 VCFRONT_a441_bmbModuleId "Front body controller: a441 bmb module id";
CM_ SG_ 1332 VCFRONT_a441_bmbModuleIdPrev "Front body controller: a441 bmb module id prev";
CM_ SG_ 1332 VCFRONT_a444_retriesAvailable "Front body controller: a444 retries available";
CM_ SG_ 1332 VCFRONT_a444_channel "Front body controller: a444 channel";
CM_ SG_ 1332 VCFRONT_a444_watchdog "Front body controller: a444 watchdog";
CM_ SG_ 1332 VCFRONT_a444_gateDriver "Front body controller: a444 gate driver";
CM_ SG_ 1332 VCFRONT_a444_overcurrent "Front body controller: a444 overcurrent";
CM_ SG_ 1332 VCFRONT_a444_supplyUndervoltage "Front body controller: a444 supply undervoltage";
CM_ SG_ 1332 VCFRONT_a444_cpUndervoltage "Front body controller: a444 cp undervoltage";
CM_ SG_ 1332 VCFRONT_a444_overTempShutdown "Front body controller: a444 over temp shutdown";
CM_ SG_ 1332 VCFRONT_a444_overTempWarning "Front body controller: a444 over temp warning";
CM_ SG_ 1332 VCFRONT_a444_highSide2GateDriver "Front body controller: a444 high side2 gate driver";
CM_ SG_ 1332 VCFRONT_a444_lowSide2GateDriver "Front body controller: a444 low side2 gate driver";
CM_ SG_ 1332 VCFRONT_a444_highSide1GateDriver "Front body controller: a444 high side1 gate driver";
CM_ SG_ 1332 VCFRONT_a444_lowSide1GateDriver "Front body controller: a444 low side1 gate driver";
CM_ SG_ 1332 VCFRONT_a444_highSide2OverCurent "Front body controller: a444 high side2 over curent";
CM_ SG_ 1332 VCFRONT_a444_lowSide2OverCurent "Front body controller: a444 low side2 over curent";
CM_ SG_ 1332 VCFRONT_a444_highSide1OverCurent "Front body controller: a444 high side1 over curent";
CM_ SG_ 1332 VCFRONT_a444_lowSide1OverCurent "Front body controller: a444 low side1 over curent";
CM_ SG_ 1332 VCFRONT_a444_spiInit "Front body controller: a444 spi init";
CM_ SG_ 1332 VCFRONT_a444_spiPeriodicCheck "Front body controller: a444 spi periodic check";
CM_ SG_ 1332 VCFRONT_a444_spiFault "Front body controller: a444 spi fault";
CM_ SG_ 1332 VCFRONT_a444_voltageMonitor "Front body controller: a444 voltage monitor";
CM_ SG_ 1332 VCFRONT_a444_enableLow "Front body controller: a444 enable low";
CM_ SG_ 1332 VCFRONT_a446_compFaultRefrigeran "Front body controller: a446 comp fault refrigerant";
CM_ SG_ 1332 VCFRONT_a446_compFaultTdHigh "Front body controller: a446 comp fault td high";
CM_ SG_ 1332 VCFRONT_a446_compFaultPdLow "Front body controller: a446 comp fault pd low";
CM_ SG_ 1332 VCFRONT_a446_compFaultPdHigh "Front body controller: a446 comp fault pd high";
CM_ SG_ 1332 VCFRONT_a446_compFaultPsLow "Front body controller: a446 comp fault ps low";
CM_ SG_ 1332 VCFRONT_a446_compStandbyLowAmbie "Front body controller: a446 comp standby low ambient";
CM_ SG_ 1332 VCFRONT_a446_compStandbyLowDisch "Front body controller: a446 comp standby low disch press";
CM_ SG_ 1332 VCFRONT_a446_compStandbyHVNotRea "Front body controller: a446 comp standby HV not ready";
CM_ SG_ 1332 VCFRONT_a446_compStandbyCommunic "Front body controller: a446 comp standby communication";
CM_ SG_ 1332 VCFRONT_a446_compStandbySelfNotR "Front body controller: a446 comp standby self not ready";
CM_ SG_ 1332 VCFRONT_a446_compStandbyRefrigNo "Front body controller: a446 comp standby refrig not ok";
CM_ SG_ 1332 VCFRONT_a446_compStandbyCoastDow "Front body controller: a446 comp standby coast down mode";
CM_ SG_ 1332 VCFRONT_a446_compStandbyMultiple "Front body controller: a446 comp standby multiple pd cutouts";
CM_ SG_ 1332 VCFRONT_a446_compStandbyShowroom "Front body controller: a446 comp standby showroom mode";
CM_ SG_ 1332 VCFRONT_a446_compStandbyMul_0001 "Front body controller: a446 comp standby multiple td cutouts";
CM_ SG_ 1332 VCFRONT_a446_hpCabinLoadType "Front body controller: a446 hp cabin load type";
CM_ SG_ 1332 VCFRONT_a446_hpBatteryLoadType "Front body controller: a446 hp battery load type";
CM_ SG_ 1332 VCFRONT_a446_usingModeledPs "Front body controller: a446 using modeled ps";
CM_ SG_ 1332 VCFRONT_a446_usingModeledPd "Front body controller: a446 using modeled pd";
CM_ SG_ 1332 VCFRONT_a446_usingModeledPl "Front body controller: a446 using modeled pl";
CM_ SG_ 1332 VCFRONT_a446_usingModeledTs "Front body controller: a446 using modeled ts";
CM_ SG_ 1332 VCFRONT_a446_usingModeledTd "Front body controller: a446 using modeled td";
CM_ SG_ 1332 VCFRONT_a446_usingModeledTl "Front body controller: a446 using modeled tl";
CM_ SG_ 1332 VCFRONT_a446_sensorHasOffsetTd "Front body controller: a446 sensor has offset td";
CM_ SG_ 1332 VCFRONT_a446_sensorHasOffsetPd "Front body controller: a446 sensor has offset pd";
CM_ SG_ 1332 VCFRONT_a446_sensorDroopPd "Front body controller: a446 sensor droop pd";
CM_ SG_ 1332 VCFRONT_a446_sensorHasOffsetTl "Front body controller: a446 sensor has offset tl";
CM_ SG_ 1332 VCFRONT_a446_sensorIntermit_0002 "Front body controller: a446 sensor intermittent ps";
CM_ SG_ 1332 VCFRONT_a446_sensorIntermittentP "Front body controller: a446 sensor intermittent pd";
CM_ SG_ 1332 VCFRONT_a446_sensorIntermit_0001 "Front body controller: a446 sensor intermittent pl";
CM_ SG_ 1332 VCFRONT_a446_sensorIntermit_0004 "Front body controller: a446 sensor intermittent ts";
CM_ SG_ 1332 VCFRONT_a446_sensorIntermittentT "Front body controller: a446 sensor intermittent td";
CM_ SG_ 1332 VCFRONT_a446_sensorIntermit_0003 "Front body controller: a446 sensor intermittent tl";
CM_ SG_ 1332 VCFRONT_a446_highSuctionSuperhea "Front body controller: a446 high suction superheat";
CM_ SG_ 1332 VCFRONT_a446_evapLowPsCutout "Front body controller: a446 evap low ps cutout";
CM_ SG_ 1332 VCFRONT_a446_batteryOverTemp "Front body controller: a446 battery over temp";
CM_ SG_ 1332 VCFRONT_a446_hvacSystemFault "Front body controller: a446 hvac system fault";
CM_ SG_ 1332 VCFRONT_a446_coolantSysLockedOut "Front body controller: a446 coolant sys locked out";
CM_ SG_ 1332 VCFRONT_a446_refSysLockedOut "Front body controller: a446 ref sys locked out";
CM_ SG_ 1332 VCFRONT_a446_chillerEXVNotReady "Front body controller: a446 chiller EXV not ready";
CM_ SG_ 1332 VCFRONT_a446_CCLEXVNotReady "Front body controller: a446 CCLEXV not ready";
CM_ SG_ 1332 VCFRONT_a446_CCREXVNotReady "Front body controller: a446 CCREXV not ready";
CM_ SG_ 1332 VCFRONT_a446_LCCEXVNotReady "Front body controller: a446 LCCEXV not ready";
CM_ SG_ 1332 VCFRONT_a446_evapEXVNotReady "Front body controller: a446 evap EXV not ready";
CM_ SG_ 1332 VCFRONT_a446_recircEXVNotReady "Front body controller: a446 recirc EXV not ready";
CM_ SG_ 1332 VCFRONT_a446_checkA447Alert "Front body controller: a446 check A447 alert";
CM_ SG_ 1332 VCFRONT_a447_caseHVACUnavailable "Front body controller: a447 case HVAC unavailable";
CM_ SG_ 1332 VCFRONT_a447_heatPumpHVACUnavail "Front body controller: a447 heat pump HVAC unavailable";
CM_ SG_ 1332 VCFRONT_a447_activeLouverComprom "Front body controller: a447 active louver compromised";
CM_ SG_ 1332 VCFRONT_a447_coolantValveComprom "Front body controller: a447 coolant valve compromised";
CM_ SG_ 1332 VCFRONT_a447_ambientSourcingComp "Front body controller: a447 ambient sourcing compromised";
CM_ SG_ 1332 VCFRONT_a447_scavengeLoopComprom "Front body controller: a447 scavenge loop compromised";
CM_ SG_ 1332 VCFRONT_a447_coolantSystemCompro "Front body controller: a447 coolant system compromised";
CM_ SG_ 1332 VCFRONT_a447_hvBattActiveDischgC "Front body controller: a447 hv batt active dischg compromised";
CM_ SG_ 1332 VCFRONT_a447_hvBatteryDischargin "Front body controller: a447 hv battery discharging compromised";
CM_ SG_ 1332 VCFRONT_a447_lccSolenoidCompromi "Front body controller: a447 lcc solenoid compromised";
CM_ SG_ 1332 VCFRONT_a447_refrigerantSystemCo "Front body controller: a447 refrigerant system compromised";
CM_ SG_ 1332 VCFRONT_a447_powertrainThermalFa "Front body controller: a447 powertrain thermal fans compromised";
CM_ SG_ 1332 VCFRONT_a447_refrigDischargePres "Front body controller: a447 refrig discharge press compromised";
CM_ SG_ 1332 VCFRONT_a447_refrigeDischargeTem "Front body controller: a447 refrige discharge temp compromised";
CM_ SG_ 1332 VCFRONT_a447_refrigSuctionPressC "Front body controller: a447 refrig suction press compromised";
CM_ SG_ 1332 VCFRONT_a447_refrigSuctionTempCo "Front body controller: a447 refrig suction temp compromised";
CM_ SG_ 1332 VCFRONT_a447_refrigLiquidPressCo "Front body controller: a447 refrig liquid press compromised";
CM_ SG_ 1332 VCFRONT_a447_refrigLiquidTempCom "Front body controller: a447 refrig liquid temp compromised";
CM_ SG_ 1332 VCFRONT_a459_coolantFillActive "Front body controller: a459 coolant fill active";
CM_ SG_ 1332 VCFRONT_a459_refrigerantFillActi "Front body controller: a459 refrigerant fill active";
CM_ SG_ 1332 VCFRONT_a462_CellOVLevel1 "Front body controller: a462 cell OV level1";
CM_ SG_ 1332 VCFRONT_a462_CellOVLevel2 "Front body controller: a462 cell OV level2";
CM_ SG_ 1332 VCFRONT_a462_CellOVLevel3 "Front body controller: a462 cell OV level3";
CM_ SG_ 1332 VCFRONT_a462_CellUVLevel1 "Front body controller: a462 cell UV level1";
CM_ SG_ 1332 VCFRONT_a462_CellUVLevel2 "Front body controller: a462 cell UV level2";
CM_ SG_ 1332 VCFRONT_a462_ModuleOTLevel1 "Front body controller: a462 module OT level1";
CM_ SG_ 1332 VCFRONT_a462_PackOVLevel1 "Front body controller: a462 pack OV level1";
CM_ SG_ 1332 VCFRONT_a462_PackOVLevel2 "Front body controller: a462 pack OV level2";
CM_ SG_ 1332 VCFRONT_a462_DischrgOCLevel1 "Front body controller: a462 dischrg OC level1";
CM_ SG_ 1332 VCFRONT_a462_HardwareOCLevel2 "Front body controller: a462 hardware OC level2";
CM_ SG_ 1332 VCFRONT_a462_ChrgOCLevel1 "Front body controller: a462 chrg OC level1";
CM_ SG_ 1332 VCFRONT_a462_ChrgOCLevel2 "Front body controller: a462 chrg OC level2";
CM_ SG_ 1332 VCFRONT_a462_MOSFETOTLevel1 "Front body controller: a462 MOSFETOT level1";
CM_ SG_ 1332 VCFRONT_a462_CPA_State "Front body controller: a462 CPA state";
CM_ SG_ 1332 VCFRONT_a462_NTCTempDiffWarnLeve "Front body controller: a462 NTC temp diff warn level1";
CM_ SG_ 1332 VCFRONT_a462_KBValueLostFault "Front body controller: a462 KB value lost fault";
CM_ SG_ 1332 VCFRONT_a462_BalanceCircuitFault "Front body controller: a462 balance circuit fault";
CM_ SG_ 1332 VCFRONT_a462_MOSOpenFault "Front body controller: a462 MOS open fault";
CM_ SG_ 1332 VCFRONT_a462_DeepDischarge "Front body controller: a462 deep discharge";
CM_ SG_ 1332 VCFRONT_a462_SamplingError "Front body controller: a462 sampling error";
CM_ SG_ 1332 VCFRONT_a462_MOSFETStuckClose "Front body controller: a462 MOSFET stuck close";
CM_ SG_ 1332 VCFRONT_a462_MOSFETStuckOpen "Front body controller: a462 MOSFET stuck open";
CM_ SG_ 1332 VCFRONT_a462_Imbalance "Front body controller: a462 imbalance";
CM_ SG_ 1332 VCFRONT_a462_serviceMode "Signal reported by Front body controller";
CM_ SG_ 1332 VCFRONT_a462_frunkOpen "Front body controller: a462 frunk open";
CM_ SG_ 1332 VCFRONT_a463_switchMismatch "Front body controller: a463 switch mismatch";
CM_ SG_ 1332 VCFRONT_a463_switch1Shorted "Front body controller: a463 switch1 shorted";
CM_ SG_ 1332 VCFRONT_a463_switch1Disconnected "Front body controller: a463 switch1 disconnected";
CM_ SG_ 1332 VCFRONT_a463_switch2Shorted "Front body controller: a463 switch2 shorted";
CM_ SG_ 1332 VCFRONT_a463_switch2Disconnected "Front body controller: a463 switch2 disconnected";
CM_ SG_ 1332 VCFRONT_a463_switch1VoltageAvera "Front body controller: a463 switch1 voltage average";
CM_ SG_ 1332 VCFRONT_a463_switch1VoltageInsta "Front body controller: a463 switch1 voltage instant";
CM_ SG_ 1332 VCFRONT_a463_switch2VoltageAvera "Front body controller: a463 switch2 voltage average";
CM_ SG_ 1332 VCFRONT_a463_switch2VoltageInsta "Front body controller: a463 switch2 voltage instant";
CM_ SG_ 1332 VCFRONT_a464_flowIndex "Front body controller: a464 flow index";
CM_ SG_ 1332 VCFRONT_a464_flowIndexFiltered "Front body controller: a464 flow index filtered";
CM_ SG_ 1332 VCFRONT_a464_subcool "Front body controller: a464 subcool";
CM_ SG_ 1332 VCFRONT_a464_subcoolFiltered "Front body controller: a464 subcool filtered";
CM_ SG_ 1332 VCFRONT_a465_flowIndex "Front body controller: a465 flow index";
CM_ SG_ 1332 VCFRONT_a465_flowIndexFiltered "Front body controller: a465 flow index filtered";
CM_ SG_ 1332 VCFRONT_a465_subcool "Front body controller: a465 subcool";
CM_ SG_ 1332 VCFRONT_a465_subcoolFiltered "Front body controller: a465 subcool filtered";
CM_ SG_ 1332 VCFRONT_a465_flaggedAtSteadyStat "Front body controller: a465 flagged at steady state";
CM_ SG_ 1332 VCFRONT_a465_flaggedAtUnsteadySt "Front body controller: a465 flagged at unsteady state";
CM_ SG_ 1332 VCFRONT_a466_flowIndex "Front body controller: a466 flow index";
CM_ SG_ 1332 VCFRONT_a466_flowIndexFiltered "Front body controller: a466 flow index filtered";
CM_ SG_ 1332 VCFRONT_a466_subcool "Front body controller: a466 subcool";
CM_ SG_ 1332 VCFRONT_a466_subcoolFiltered "Front body controller: a466 subcool filtered";
CM_ SG_ 1332 VCFRONT_a467_powerIndexFiltered "Front body controller: a467 power index filtered";
CM_ SG_ 1332 VCFRONT_a470_pressureLiquid "Front body controller: a470 pressure liquid";
CM_ SG_ 1332 VCFRONT_a470_pressureDischarge "Front body controller: a470 pressure discharge";
CM_ SG_ 1332 VCFRONT_a474_ssl100Bank1Status "Front body controller: a474 ssl100 bank1 status";
CM_ SG_ 1332 VCFRONT_a474_ssl100Bank2Status "Front body controller: a474 ssl100 bank2 status";
CM_ SG_ 1332 VCFRONT_a474_ssl100Bank3Status "Front body controller: a474 ssl100 bank3 status";
CM_ SG_ 1332 VCFRONT_a474_ssl100Bank4Status "Front body controller: a474 ssl100 bank4 status";
CM_ SG_ 1332 VCFRONT_a474_ssl100Bank5Status "Front body controller: a474 ssl100 bank5 status";
CM_ SG_ 1332 VCFRONT_a474_ssl100Bank6Status "Front body controller: a474 ssl100 bank6 status";
CM_ SG_ 1332 VCFRONT_a474_ssl100Bank7Status "Front body controller: a474 ssl100 bank7 status";
CM_ SG_ 1332 VCFRONT_a474_ssl100Bank8Status "Front body controller: a474 ssl100 bank8 status";
CM_ SG_ 1332 VCFRONT_a474_ssl100Bank9Status "Front body controller: a474 ssl100 bank9 status";
CM_ SG_ 1332 VCFRONT_a474_lowBeamPrefieldStat "Front body controller: a474 low beam prefield status";
CM_ SG_ 1332 VCFRONT_a474_drl1Status "Front body controller: a474 drl1 status";
CM_ SG_ 1332 VCFRONT_a474_drl2Status "Front body controller: a474 drl2 status";
CM_ SG_ 1332 VCFRONT_a474_drl3Status "Front body controller: a474 drl3 status";
CM_ SG_ 1332 VCFRONT_a474_turnStatus "Front body controller: a474 turn status";
CM_ SG_ 1332 VCFRONT_a474_fanStatus "Front body controller: a474 fan status";
CM_ SG_ 1332 VCFRONT_a474_TPS92520_COMPOV "Front body controller: a474 TPS92520 COMPOV";
CM_ SG_ 1332 VCFRONT_a474_TPS92520_HSILIM "Front body controller: a474 TPS92520 HSILIM";
CM_ SG_ 1332 VCFRONT_a474_TPS92520_BSTUV "Front body controller: a474 TPS92520 BSTUV";
CM_ SG_ 1332 VCFRONT_a474_BoostRailStatus "Front body controller: a474 boost rail status";
CM_ SG_ 1332 VCFRONT_a474_EEPROM_DataStatus "Front body controller: a474 EEPROM data status";
CM_ SG_ 1332 VCFRONT_a474_LMMVariant "Front body controller: a474 LMM variant";
CM_ SG_ 1332 VCFRONT_a474_headlampECURevision "Front body controller: a474 headlamp ECU revision";
CM_ SG_ 1332 VCFRONT_a475_ssl100Bank1Status "Front body controller: a475 ssl100 bank1 status";
CM_ SG_ 1332 VCFRONT_a475_ssl100Bank2Status "Front body controller: a475 ssl100 bank2 status";
CM_ SG_ 1332 VCFRONT_a475_ssl100Bank3Status "Front body controller: a475 ssl100 bank3 status";
CM_ SG_ 1332 VCFRONT_a475_ssl100Bank4Status "Front body controller: a475 ssl100 bank4 status";
CM_ SG_ 1332 VCFRONT_a475_ssl100Bank5Status "Front body controller: a475 ssl100 bank5 status";
CM_ SG_ 1332 VCFRONT_a475_ssl100Bank6Status "Front body controller: a475 ssl100 bank6 status";
CM_ SG_ 1332 VCFRONT_a475_ssl100Bank7Status "Front body controller: a475 ssl100 bank7 status";
CM_ SG_ 1332 VCFRONT_a475_ssl100Bank8Status "Front body controller: a475 ssl100 bank8 status";
CM_ SG_ 1332 VCFRONT_a475_ssl100Bank9Status "Front body controller: a475 ssl100 bank9 status";
CM_ SG_ 1332 VCFRONT_a475_lowBeamPrefieldStat "Front body controller: a475 low beam prefield status";
CM_ SG_ 1332 VCFRONT_a475_drl1Status "Front body controller: a475 drl1 status";
CM_ SG_ 1332 VCFRONT_a475_drl2Status "Front body controller: a475 drl2 status";
CM_ SG_ 1332 VCFRONT_a475_drl3Status "Front body controller: a475 drl3 status";
CM_ SG_ 1332 VCFRONT_a475_turnStatus "Front body controller: a475 turn status";
CM_ SG_ 1332 VCFRONT_a475_fanStatus "Front body controller: a475 fan status";
CM_ SG_ 1332 VCFRONT_a475_TPS92520_COMPOV "Front body controller: a475 TPS92520 COMPOV";
CM_ SG_ 1332 VCFRONT_a475_TPS92520_HSILIM "Front body controller: a475 TPS92520 HSILIM";
CM_ SG_ 1332 VCFRONT_a475_TPS92520_BSTUV "Front body controller: a475 TPS92520 BSTUV";
CM_ SG_ 1332 VCFRONT_a475_BoostRailStatus "Front body controller: a475 boost rail status";
CM_ SG_ 1332 VCFRONT_a475_EEPROM_DataStatus "Front body controller: a475 EEPROM data status";
CM_ SG_ 1332 VCFRONT_a475_LMMVariant "Front body controller: a475 LMM variant";
CM_ SG_ 1332 VCFRONT_a475_headlampECURevision "Front body controller: a475 headlamp ECU revision";
CM_ SG_ 1332 VCFRONT_a476_FRM1_timedOut "Front body controller: a476 FRM1 timed out";
CM_ SG_ 1332 VCFRONT_a476_FRM2_timedOut "Front body controller: a476 FRM2 timed out";
CM_ SG_ 1332 VCFRONT_a476_FRM3_timedOut "Front body controller: a476 FRM3 timed out";
CM_ SG_ 1332 VCFRONT_a476_FRM4_timedOut "Front body controller: a476 FRM4 timed out";
CM_ SG_ 1332 VCFRONT_a476_FRM5_timedOut "Front body controller: a476 FRM5 timed out";
CM_ SG_ 1332 VCFRONT_a476_FRM6_timedOut "Front body controller: a476 FRM6 timed out";
CM_ SG_ 1332 VCFRONT_a476_FRM7_timedOut "Front body controller: a476 FRM7 timed out";
CM_ SG_ 1332 VCFRONT_a476_FRM8_timedOut "Front body controller: a476 FRM8 timed out";
CM_ SG_ 1332 VCFRONT_a476_FRM9_timedOut "Front body controller: a476 FRM9 timed out";
CM_ SG_ 1332 VCFRONT_a476_FRM10_timedOut "Front body controller: a476 FRM10 timed out";
CM_ SG_ 1332 VCFRONT_a476_FRM11_timedOut "Front body controller: a476 FRM11 timed out";
CM_ SG_ 1332 VCFRONT_a476_FRM12_timedOut "Front body controller: a476 FRM12 timed out";
CM_ SG_ 1332 VCFRONT_a476_factoryMode "Front body controller: a476 factory mode";
CM_ SG_ 1332 VCFRONT_a476_serviceMode "Signal reported by Front body controller";
CM_ SG_ 1332 VCFRONT_a476_transportMode "Front body controller: a476 transport mode";
CM_ SG_ 1332 VCFRONT_a476_frunkOpen "Front body controller: a476 frunk open";
CM_ SG_ 1332 VCFRONT_a476_vehiclePowerState "Front body controller: a476 vehicle power state";
CM_ SG_ 1332 VCFRONT_a476_batterySMState "Front body controller: a476 battery SM state";
CM_ SG_ 1332 VCFRONT_a476_ECPAState "Front body controller: a476 ECPA state";
CM_ SG_ 1332 VCFRONT_a477_cell1Voltage "Front body controller: a477 cell1 voltage";
CM_ SG_ 1332 VCFRONT_a477_cell2Voltage "Front body controller: a477 cell2 voltage";
CM_ SG_ 1332 VCFRONT_a477_cell3Voltage "Front body controller: a477 cell3 voltage";
CM_ SG_ 1332 VCFRONT_a477_cell4Voltage "Front body controller: a477 cell4 voltage";
CM_ SG_ 1332 VCFRONT_a477_sumCellVoltage "Front body controller: a477 sum cell voltage";
CM_ SG_ 1332 VCFRONT_a477_deepDischargeFlag "Front body controller: a477 deep discharge flag";
CM_ SG_ 1332 VCFRONT_a477_serviceMode "Signal reported by Front body controller";
CM_ SG_ 1332 VCFRONT_a477_frunkOpen "Front body controller: a477 frunk open";
CM_ SG_ 1332 VCFRONT_a478_battFaultPackOverVo "Front body controller: a478 batt fault pack over voltage";
CM_ SG_ 1332 VCFRONT_a478_battFaultHardwareOv "Front body controller: a478 batt fault hardware over current";
CM_ SG_ 1332 VCFRONT_a478_battFaultChargeOver "Front body controller: a478 batt fault charge over current";
CM_ SG_ 1332 VCFRONT_a478_battFaultCellUnderV "Front body controller: a478 batt fault cell under voltage";
CM_ SG_ 1332 VCFRONT_a478_battFaultCellOverVo "Front body controller: a478 batt fault cell over voltage";
CM_ SG_ 1332 VCFRONT_a478_vehiclePowerState "Front body controller: a478 vehicle power state";
CM_ SG_ 1332 VCFRONT_a478_batterySMState "Front body controller: a478 battery SM state";
CM_ SG_ 1332 VCFRONT_a478_bmsState "Front body controller: a478 bms state";
CM_ SG_ 1332 VCFRONT_a478_dcdcLVSupportStatus "Front body controller: a478 dcdc LV support status";
CM_ SG_ 1332 VCFRONT_a478_factoryMode "Front body controller: a478 factory mode";
CM_ SG_ 1332 VCFRONT_a478_serviceMode "Signal reported by Front body controller";
CM_ SG_ 1332 VCFRONT_a478_transportMode "Front body controller: a478 transport mode";
CM_ SG_ 1332 VCFRONT_a478_notEnoughPowerForSu "Front body controller: a478 not enough power for support";
CM_ SG_ 1332 VCFRONT_a478_crashDetected "Front body controller: a478 crash detected";
CM_ SG_ 1332 VCFRONT_a478_BMS_MIA "Front body controller: a478 BMS MIA";
CM_ SG_ 1332 VCFRONT_a478_PCS_MIA "Front body controller: a478 PCS MIA";
CM_ SG_ 1332 VCFRONT_a478_HVBlockingMismatch "Front body controller: a478 HV blocking mismatch";
CM_ SG_ 1332 VCFRONT_a478_HV_UP "Front body controller: a478 HV UP";
CM_ SG_ 1332 VCFRONT_a478_pcsEFuseStable "Front body controller: a478 pcs e fuse stable";
CM_ SG_ 1332 VCFRONT_a478_vcrightEFuseStable "Front body controller: a478 vcright e fuse stable";
CM_ SG_ 1332 VCFRONT_a478_contactorEFuseStabl "Front body controller: a478 contactor e fuse stable";
CM_ SG_ 1332 VCFRONT_a478_hvcEFuseStable "Front body controller: a478 hvc e fuse stable";
CM_ SG_ 1332 VCFRONT_a478_frunkOpen "Front body controller: a478 frunk open";
CM_ SG_ 1332 VCFRONT_a479_FRM3_timedOut "Front body controller: a479 FRM3 timed out";
CM_ SG_ 1332 VCFRONT_a479_ECPAState "Front body controller: a479 ECPA state";
CM_ SG_ 1332 VCFRONT_a479_factoryMode "Front body controller: a479 factory mode";
CM_ SG_ 1332 VCFRONT_a479_serviceMode "Signal reported by Front body controller";
CM_ SG_ 1332 VCFRONT_a479_transportMode "Front body controller: a479 transport mode";
CM_ SG_ 1332 VCFRONT_a479_frunkLatchStatus "Front body controller: a479 frunk latch status";
CM_ SG_ 1332 VCFRONT_a479_vehiclePowerState "Front body controller: a479 vehicle power state";
CM_ SG_ 1332 VCFRONT_a479_batterySMState "Front body controller: a479 battery SM state";
CM_ SG_ 1332 VCFRONT_a480_channel "Front body controller: a480 channel";
CM_ SG_ 1332 VCFRONT_a480_reset "Front body controller: a480 reset";
CM_ SG_ 1332 VCFRONT_a480_spiError "Front body controller: a480 spi error";
CM_ SG_ 1332 VCFRONT_a480_autoOn "Front body controller: a480 auto on";
CM_ SG_ 1332 VCFRONT_a480_diagnosticBit "Front body controller: a480 diagnostic bit";
CM_ SG_ 1332 VCFRONT_a480_deviceError "Front body controller: a480 device error";
CM_ SG_ 1332 VCFRONT_a480_overcurrent "Front body controller: a480 overcurrent";
CM_ SG_ 1332 VCFRONT_a480_unexpectedLock "Front body controller: a480 unexpected lock";
BA_DEF_ BO_ "GenMsgCycleTime" INT 0 3600000;
BA_DEF_ BO_ "GenMsgSendType" ENUM "Cyclic","NotUsed","NotUsed","NotUsed","NotUsed","NotUsed","NotUsed","IfActive","NoMsgSendType","NotUsed";
BA_DEF_ BO_ "VFrameFormat" ENUM "StandardCAN","ExtendedCAN","reserved","J1939PG","reserved","reserved","reserved","reserved","reserved","reserved","reserved","reserved","reserved","reserved","StandardCAN_FD","ExtendedCAN_FD";
BA_DEF_ BO_ "CANFD_BRS" ENUM "0","1";
BA_DEF_ SG_ "SystemSignalLongSymbol" STRING;
BA_DEF_ SG_ "Confidence" ENUM "layout-only","plausible","validated";
BA_DEF_DEF_ "GenMsgCycleTime" 0;
BA_DEF_DEF_ "GenMsgSendType" "NoMsgSendType";
BA_DEF_DEF_ "VFrameFormat" "StandardCAN";
BA_DEF_DEF_ "CANFD_BRS" "1";
BA_DEF_DEF_ "SystemSignalLongSymbol" "";
BA_DEF_DEF_ "Confidence" "layout-only";
BA_ "SystemSignalLongSymbol" SG_ 1332 VCFRONT_a182_resistanceEstimatio "VCFRONT_a182_resistanceEstimationHardFailure";
BA_ "SystemSignalLongSymbol" SG_ 1332 VCFRONT_a182_dcrMilliOhmsAboveTh "VCFRONT_a182_dcrMilliOhmsAboveThreshold";
BA_ "SystemSignalLongSymbol" SG_ 1332 VCFRONT_a182_prechargeLVLoadRedu "VCFRONT_a182_prechargeLVLoadReduction";
BA_ "SystemSignalLongSymbol" SG_ 1332 VCFRONT_a182_instantPrechargeDCR "VCFRONT_a182_instantPrechargeDCRTooHigh";
BA_ "SystemSignalLongSymbol" SG_ 1332 VCFRONT_a182_calibrationLostFaul "VCFRONT_a182_calibrationLostFault";
BA_ "SystemSignalLongSymbol" SG_ 1332 VCFRONT_a191_reverseBatteryEFuse "VCFRONT_a191_reverseBatteryEFuseFault";
BA_ "SystemSignalLongSymbol" SG_ 1332 VCFRONT_a191_vehicleLoadShedActi "VCFRONT_a191_vehicleLoadShedActive";
BA_ "SystemSignalLongSymbol" SG_ 1332 VCFRONT_a191_vehicleLoadShedHvFa "VCFRONT_a191_vehicleLoadShedHvFaultActive";
BA_ "SystemSignalLongSymbol" SG_ 1332 VCFRONT_a191_vehicleLoadShedPost "VCFRONT_a191_vehicleLoadShedPostCrashActive";
BA_ "SystemSignalLongSymbol" SG_ 1332 VCFRONT_a191_a180_DCDCNotSupport "VCFRONT_a191_a180_DCDCNotSupportingLVBus";
BA_ "SystemSignalLongSymbol" SG_ 1332 VCFRONT_a191_LVBMSCurrentTargetV "VCFRONT_a191_LVBMSCurrentTargetValid";
BA_ "SystemSignalLongSymbol" SG_ 1332 VCFRONT_a191_LVBMSVoltageTargetV "VCFRONT_a191_LVBMSVoltageTargetValid";
BA_ "SystemSignalLongSymbol" SG_ 1332 VCFRONT_a191_vehicleLoadShedStag "VCFRONT_a191_vehicleLoadShedStage";
BA_ "SystemSignalLongSymbol" SG_ 1332 VCFRONT_a191_exitDriveWarningTim "VCFRONT_a191_exitDriveWarningTimerExpired";
BA_ "SystemSignalLongSymbol" SG_ 1332 VCFRONT_a191_NotEnoughPowerForSu "VCFRONT_a191_NotEnoughPowerForSupport";
BA_ "SystemSignalLongSymbol" SG_ 1332 VCFRONT_a192_notEnoughPowerForSu "VCFRONT_a192_notEnoughPowerForSupport";
BA_ "SystemSignalLongSymbol" SG_ 1332 VCFRONT_a192_contactorEFuseStabl "VCFRONT_a192_contactorEFuseStable";
BA_ "SystemSignalLongSymbol" SG_ 1332 VCFRONT_a192_LVBatteryCannotSupp "VCFRONT_a192_LVBatteryCannotSupportVehicle";
BA_ "SystemSignalLongSymbol" SG_ 1332 VCFRONT_a192_HVFaultLoadShedActi "VCFRONT_a192_HVFaultLoadShedActive";
BA_ "SystemSignalLongSymbol" SG_ 1332 VCFRONT_a192_postCrashLoadShedAc "VCFRONT_a192_postCrashLoadShedActive";
BA_ "SystemSignalLongSymbol" SG_ 1332 VCFRONT_a196_disconnectedBattery "VCFRONT_a196_disconnectedBatteryTestCurrent";
BA_ "SystemSignalLongSymbol" SG_ 1332 VCFRONT_a196_disconnectedBa_0002 "VCFRONT_a196_disconnectedBatteryTestVoltage";
BA_ "SystemSignalLongSymbol" SG_ 1332 VCFRONT_a196_disconnectedBa_0001 "VCFRONT_a196_disconnectedBatteryTestPrevVoltage";
BA_ "SystemSignalLongSymbol" SG_ 1332 VCFRONT_a214_busVoltageIrrationa "VCFRONT_a214_busVoltageIrrational";
BA_ "SystemSignalLongSymbol" SG_ 1332 VCFRONT_a214_motorSpeedIrrationa "VCFRONT_a214_motorSpeedIrrational";
BA_ "SystemSignalLongSymbol" SG_ 1332 VCFRONT_a214_supplyVoltageIrrati "VCFRONT_a214_supplyVoltageIrrational";
BA_ "SystemSignalLongSymbol" SG_ 1332 VCFRONT_a214_motorPhaseCurrentIr "VCFRONT_a214_motorPhaseCurrentIrrational";
BA_ "SystemSignalLongSymbol" SG_ 1332 VCFRONT_a214_hsVdsOvervoltageMas "VCFRONT_a214_hsVdsOvervoltageMask";
BA_ "SystemSignalLongSymbol" SG_ 1332 VCFRONT_a214_lsVdsOvervoltageMas "VCFRONT_a214_lsVdsOvervoltageMask";
BA_ "SystemSignalLongSymbol" SG_ 1332 VCFRONT_a216_vcleftFastBlowImmin "VCFRONT_a216_vcleftFastBlowImminent";
BA_ "SystemSignalLongSymbol" SG_ 1332 VCFRONT_a216_vcleftFastBlowDebou "VCFRONT_a216_vcleftFastBlowDebounceImminent";
BA_ "SystemSignalLongSymbol" SG_ 1332 VCFRONT_a216_vcleftStaticImminen "VCFRONT_a216_vcleftStaticImminent";
BA_ "SystemSignalLongSymbol" SG_ 1332 VCFRONT_a216_vcleftDynamicImmine "VCFRONT_a216_vcleftDynamicImminent";
BA_ "SystemSignalLongSymbol" SG_ 1332 VCFRONT_a216_vcrightFastBlowImmi "VCFRONT_a216_vcrightFastBlowImminent";
BA_ "SystemSignalLongSymbol" SG_ 1332 VCFRONT_a216_vcrightFastBlowDebo "VCFRONT_a216_vcrightFastBlowDebounceImminent";
BA_ "SystemSignalLongSymbol" SG_ 1332 VCFRONT_a216_vcrightStaticImmine "VCFRONT_a216_vcrightStaticImminent";
BA_ "SystemSignalLongSymbol" SG_ 1332 VCFRONT_a216_vcrightDynamicImmin "VCFRONT_a216_vcrightDynamicImminent";
BA_ "SystemSignalLongSymbol" SG_ 1332 VCFRONT_a217_busVoltageIrrationa "VCFRONT_a217_busVoltageIrrational";
BA_ "SystemSignalLongSymbol" SG_ 1332 VCFRONT_a217_motorSpeedIrrationa "VCFRONT_a217_motorSpeedIrrational";
BA_ "SystemSignalLongSymbol" SG_ 1332 VCFRONT_a217_supplyVoltageIrrati "VCFRONT_a217_supplyVoltageIrrational";
BA_ "SystemSignalLongSymbol" SG_ 1332 VCFRONT_a217_motorPhaseCurrentIr "VCFRONT_a217_motorPhaseCurrentIrrational";
BA_ "SystemSignalLongSymbol" SG_ 1332 VCFRONT_a217_hsVdsOvervoltageMas "VCFRONT_a217_hsVdsOvervoltageMask";
BA_ "SystemSignalLongSymbol" SG_ 1332 VCFRONT_a217_lsVdsOvervoltageMas "VCFRONT_a217_lsVdsOvervoltageMask";
BA_ "SystemSignalLongSymbol" SG_ 1332 VCFRONT_a227_busVoltageIrrationa "VCFRONT_a227_busVoltageIrrational";
BA_ "SystemSignalLongSymbol" SG_ 1332 VCFRONT_a227_motorSpeedIrrationa "VCFRONT_a227_motorSpeedIrrational";
BA_ "SystemSignalLongSymbol" SG_ 1332 VCFRONT_a227_supplyVoltageIrrati "VCFRONT_a227_supplyVoltageIrrational";
BA_ "SystemSignalLongSymbol" SG_ 1332 VCFRONT_a227_motorPhaseCurrentIr "VCFRONT_a227_motorPhaseCurrentIrrational";
BA_ "SystemSignalLongSymbol" SG_ 1332 VCFRONT_a227_hsVdsOvervoltageMas "VCFRONT_a227_hsVdsOvervoltageMask";
BA_ "SystemSignalLongSymbol" SG_ 1332 VCFRONT_a227_lsVdsOvervoltageMas "VCFRONT_a227_lsVdsOvervoltageMask";
BA_ "SystemSignalLongSymbol" SG_ 1332 VCFRONT_a245_eFuseRemainingRetri "VCFRONT_a245_eFuseRemainingRetries";
BA_ "SystemSignalLongSymbol" SG_ 1332 VCFRONT_a246_eFuseRemainingRetri "VCFRONT_a246_eFuseRemainingRetries";
BA_ "SystemSignalLongSymbol" SG_ 1332 VCFRONT_a250_isVirtualPitchSenso "VCFRONT_a250_isVirtualPitchSensor";
BA_ "SystemSignalLongSymbol" SG_ 1332 VCFRONT_a250_calibratedVerticalP "VCFRONT_a250_calibratedVerticalPositionHCML";
BA_ "SystemSignalLongSymbol" SG_ 1332 VCFRONT_a250_calibratedVert_0001 "VCFRONT_a250_calibratedVerticalPositionHCMR";
BA_ "SystemSignalLongSymbol" SG_ 1332 VCFRONT_a250_calibratedHorizonta "VCFRONT_a250_calibratedHorizontalPositionHCML";
BA_ "SystemSignalLongSymbol" SG_ 1332 VCFRONT_a250_calibratedHori_0001 "VCFRONT_a250_calibratedHorizontalPositionHCMR";
BA_ "SystemSignalLongSymbol" SG_ 1332 VCFRONT_a253_ampHourTargetNotRea "VCFRONT_a253_ampHourTargetNotReached";
BA_ "SystemSignalLongSymbol" SG_ 1332 VCFRONT_a257_vcrightLockoutStatu "VCFRONT_a257_vcrightLockoutStatus";
BA_ "SystemSignalLongSymbol" SG_ 1332 VCFRONT_a260_notEnoughPowerForSu "VCFRONT_a260_notEnoughPowerForSupport";
BA_ "SystemSignalLongSymbol" SG_ 1332 VCFRONT_a260_coolantHasBeenFille "VCFRONT_a260_coolantHasBeenFilled";
BA_ "SystemSignalLongSymbol" SG_ 1332 VCFRONT_a260_PCSAndVCREFuseStabl "VCFRONT_a260_PCSAndVCREFuseStable";
BA_ "SystemSignalLongSymbol" SG_ 1332 VCFRONT_a271_shortedCellTestTrig "VCFRONT_a271_shortedCellTestTrigger";
BA_ "SystemSignalLongSymbol" SG_ 1332 VCFRONT_a271_voltDropOnHighCurre "VCFRONT_a271_voltDropOnHighCurrentTrigger";
BA_ "SystemSignalLongSymbol" SG_ 1332 VCFRONT_a271_deadLVMinimalAhDisc "VCFRONT_a271_deadLVMinimalAhDischargedTrigger";
BA_ "SystemSignalLongSymbol" SG_ 1332 VCFRONT_a271_resistanceEstimatio "VCFRONT_a271_resistanceEstimationHardFailTrigger";
BA_ "SystemSignalLongSymbol" SG_ 1332 VCFRONT_a271_dcrMilliOhmsAboveTh "VCFRONT_a271_dcrMilliOhmsAboveThresholdTrigger";
BA_ "SystemSignalLongSymbol" SG_ 1332 VCFRONT_a271_prechargeLVLoadRedu "VCFRONT_a271_prechargeLVLoadReductionTrigger";
BA_ "SystemSignalLongSymbol" SG_ 1332 VCFRONT_a271_instantPrechargeDCR "VCFRONT_a271_instantPrechargeDCRTooHighTrigger";
BA_ "SystemSignalLongSymbol" SG_ 1332 VCFRONT_a284_chargePumpUndervolt "VCFRONT_a284_chargePumpUndervoltage";
BA_ "SystemSignalLongSymbol" SG_ 1332 VCFRONT_a285_chargePumpUndervolt "VCFRONT_a285_chargePumpUndervoltage";
BA_ "SystemSignalLongSymbol" SG_ 1332 VCFRONT_a286_chargePumpUndervolt "VCFRONT_a286_chargePumpUndervoltage";
BA_ "SystemSignalLongSymbol" SG_ 1332 VCFRONT_a287_chargePumpUndervolt "VCFRONT_a287_chargePumpUndervoltage";
BA_ "SystemSignalLongSymbol" SG_ 1332 VCFRONT_a288_chargePumpUndervolt "VCFRONT_a288_chargePumpUndervoltage";
BA_ "SystemSignalLongSymbol" SG_ 1332 VCFRONT_a289_chargePumpUndervolt "VCFRONT_a289_chargePumpUndervoltage";
BA_ "SystemSignalLongSymbol" SG_ 1332 VCFRONT_a297_bmbDeviceFaultTempM "VCFRONT_a297_bmbDeviceFaultTempMask";
BA_ "SystemSignalLongSymbol" SG_ 1332 VCFRONT_a354_windshieldCameraHea "VCFRONT_a354_windshieldCameraHeaterCurrent";
BA_ "SystemSignalLongSymbol" SG_ 1332 VCFRONT_a355_systemNotCommission "VCFRONT_a355_systemNotCommissioned";
BA_ "SystemSignalLongSymbol" SG_ 1332 VCFRONT_a356_systemNotCommission "VCFRONT_a356_systemNotCommissioned";
BA_ "SystemSignalLongSymbol" SG_ 1332 VCFRONT_a359_coolantHasBeenFille "VCFRONT_a359_coolantHasBeenFilled";
BA_ "SystemSignalLongSymbol" SG_ 1332 VCFRONT_a360_vehicleLoadShedActi "VCFRONT_a360_vehicleLoadShedActive";
BA_ "SystemSignalLongSymbol" SG_ 1332 VCFRONT_a360_notEnoughPowerForSu "VCFRONT_a360_notEnoughPowerForSupport";
BA_ "SystemSignalLongSymbol" SG_ 1332 VCFRONT_a363_minBleedChargeBrick "VCFRONT_a363_minBleedChargeBrickId";
BA_ "SystemSignalLongSymbol" SG_ 1332 VCFRONT_a368_coolantTempSensorsF "VCFRONT_a368_coolantTempSensorsFaulted";
BA_ "SystemSignalLongSymbol" SG_ 1332 VCFRONT_a369_powerGenerationLimi "VCFRONT_a369_powerGenerationLimited";
BA_ "SystemSignalLongSymbol" SG_ 1332 VCFRONT_a369_heatRejectionLimite "VCFRONT_a369_heatRejectionLimited";
BA_ "SystemSignalLongSymbol" SG_ 1332 VCFRONT_a370_notEnoughPowerForSu "VCFRONT_a370_notEnoughPowerForSupport";
BA_ "SystemSignalLongSymbol" SG_ 1332 VCFRONT_a371_shortedCellTestTrig "VCFRONT_a371_shortedCellTestTrigger";
BA_ "SystemSignalLongSymbol" SG_ 1332 VCFRONT_a371_voltDropOnHighCurre "VCFRONT_a371_voltDropOnHighCurrentTrigger";
BA_ "SystemSignalLongSymbol" SG_ 1332 VCFRONT_a371_deadLVMinimalAhDisc "VCFRONT_a371_deadLVMinimalAhDischargedTrigger";
BA_ "SystemSignalLongSymbol" SG_ 1332 VCFRONT_a371_resistanceEstimatio "VCFRONT_a371_resistanceEstimationHardFailTrigger";
BA_ "SystemSignalLongSymbol" SG_ 1332 VCFRONT_a371_dcrMilliOhmsAboveTh "VCFRONT_a371_dcrMilliOhmsAboveThresholdTrigger";
BA_ "SystemSignalLongSymbol" SG_ 1332 VCFRONT_a371_prechargeLVLoadRedu "VCFRONT_a371_prechargeLVLoadReductionTrigger";
BA_ "SystemSignalLongSymbol" SG_ 1332 VCFRONT_a371_instantPrechargeDCR "VCFRONT_a371_instantPrechargeDCRTooHighTrigger";
BA_ "SystemSignalLongSymbol" SG_ 1332 VCFRONT_a372_bmbDeviceFaultBrick "VCFRONT_a372_bmbDeviceFaultBrickMask";
BA_ "SystemSignalLongSymbol" SG_ 1332 VCFRONT_a374_lccInletSolenoidISe "VCFRONT_a374_lccInletSolenoidISense";
BA_ "SystemSignalLongSymbol" SG_ 1332 VCFRONT_a387_shortedCellFaultCou "VCFRONT_a387_shortedCellFaultCounter";
BA_ "SystemSignalLongSymbol" SG_ 1332 VCFRONT_a388_shortedCellFaultCou "VCFRONT_a388_shortedCellFaultCounter";
BA_ "SystemSignalLongSymbol" SG_ 1332 VCFRONT_a389_faultedWhileOpenAtS "VCFRONT_a389_faultedWhileOpenAtSpeed";
BA_ "SystemSignalLongSymbol" SG_ 1332 VCFRONT_a391_switch1VoltageAvera "VCFRONT_a391_switch1VoltageAverage";
BA_ "SystemSignalLongSymbol" SG_ 1332 VCFRONT_a391_switch1VoltageInsta "VCFRONT_a391_switch1VoltageInstant";
BA_ "SystemSignalLongSymbol" SG_ 1332 VCFRONT_a391_switch2VoltageAvera "VCFRONT_a391_switch2VoltageAverage";
BA_ "SystemSignalLongSymbol" SG_ 1332 VCFRONT_a391_switch2VoltageInsta "VCFRONT_a391_switch2VoltageInstant";
BA_ "SystemSignalLongSymbol" SG_ 1332 VCFRONT_a392_bmbDeviceFaultBrick "VCFRONT_a392_bmbDeviceFaultBrickMask";
BA_ "SystemSignalLongSymbol" SG_ 1332 VCFRONT_a397_runTimeOffSetDetect "VCFRONT_a397_runTimeOffSetDetected";
BA_ "SystemSignalLongSymbol" SG_ 1332 VCFRONT_a402_failureToPrechargeR "VCFRONT_a402_failureToPrechargeRisk";
BA_ "SystemSignalLongSymbol" SG_ 1332 VCFRONT_a402_electricalDisconnec "VCFRONT_a402_electricalDisconnectLVBattery";
BA_ "SystemSignalLongSymbol" SG_ 1332 VCFRONT_a402_communicationDiscon "VCFRONT_a402_communicationDisconnectLVBattery";
BA_ "SystemSignalLongSymbol" SG_ 1332 VCFRONT_a407_intervalCurrentVari "VCFRONT_a407_intervalCurrentVariance";
BA_ "SystemSignalLongSymbol" SG_ 1332 VCFRONT_a407_pulseCurrentVarianc "VCFRONT_a407_pulseCurrentVarianceShifted";
BA_ "SystemSignalLongSymbol" SG_ 1332 VCFRONT_a409_brushlessMotorConfi "VCFRONT_a409_brushlessMotorConfigurationInvalid";
BA_ "SystemSignalLongSymbol" SG_ 1332 VCFRONT_a415_vcrightEfuseUnstabl "VCFRONT_a415_vcrightEfuseUnstable";
BA_ "SystemSignalLongSymbol" SG_ 1332 VCFRONT_a415_contactorEFuseUnsta "VCFRONT_a415_contactorEFuseUnstable";
BA_ "SystemSignalLongSymbol" SG_ 1332 VCFRONT_a431_maxChargeCurrentLim "VCFRONT_a431_maxChargeCurrentLimit";
BA_ "SystemSignalLongSymbol" SG_ 1332 VCFRONT_a436_maxDischargeCurrent "VCFRONT_a436_maxDischargeCurrentLimit";
BA_ "SystemSignalLongSymbol" SG_ 1332 VCFRONT_a446_compFaultRefrigeran "VCFRONT_a446_compFaultRefrigerant";
BA_ "SystemSignalLongSymbol" SG_ 1332 VCFRONT_a446_compStandbyLowAmbie "VCFRONT_a446_compStandbyLowAmbient";
BA_ "SystemSignalLongSymbol" SG_ 1332 VCFRONT_a446_compStandbyLowDisch "VCFRONT_a446_compStandbyLowDischPress";
BA_ "SystemSignalLongSymbol" SG_ 1332 VCFRONT_a446_compStandbyHVNotRea "VCFRONT_a446_compStandbyHVNotReady";
BA_ "SystemSignalLongSymbol" SG_ 1332 VCFRONT_a446_compStandbyCommunic "VCFRONT_a446_compStandbyCommunication";
BA_ "SystemSignalLongSymbol" SG_ 1332 VCFRONT_a446_compStandbySelfNotR "VCFRONT_a446_compStandbySelfNotReady";
BA_ "SystemSignalLongSymbol" SG_ 1332 VCFRONT_a446_compStandbyRefrigNo "VCFRONT_a446_compStandbyRefrigNotOk";
BA_ "SystemSignalLongSymbol" SG_ 1332 VCFRONT_a446_compStandbyCoastDow "VCFRONT_a446_compStandbyCoastDownMode";
BA_ "SystemSignalLongSymbol" SG_ 1332 VCFRONT_a446_compStandbyMultiple "VCFRONT_a446_compStandbyMultiplePdCutouts";
BA_ "SystemSignalLongSymbol" SG_ 1332 VCFRONT_a446_compStandbyShowroom "VCFRONT_a446_compStandbyShowroomMode";
BA_ "SystemSignalLongSymbol" SG_ 1332 VCFRONT_a446_compStandbyMul_0001 "VCFRONT_a446_compStandbyMultipleTdCutouts";
BA_ "SystemSignalLongSymbol" SG_ 1332 VCFRONT_a446_sensorIntermit_0002 "VCFRONT_a446_sensorIntermittentPs";
BA_ "SystemSignalLongSymbol" SG_ 1332 VCFRONT_a446_sensorIntermittentP "VCFRONT_a446_sensorIntermittentPd";
BA_ "SystemSignalLongSymbol" SG_ 1332 VCFRONT_a446_sensorIntermit_0001 "VCFRONT_a446_sensorIntermittentPl";
BA_ "SystemSignalLongSymbol" SG_ 1332 VCFRONT_a446_sensorIntermit_0004 "VCFRONT_a446_sensorIntermittentTs";
BA_ "SystemSignalLongSymbol" SG_ 1332 VCFRONT_a446_sensorIntermittentT "VCFRONT_a446_sensorIntermittentTd";
BA_ "SystemSignalLongSymbol" SG_ 1332 VCFRONT_a446_sensorIntermit_0003 "VCFRONT_a446_sensorIntermittentTl";
BA_ "SystemSignalLongSymbol" SG_ 1332 VCFRONT_a446_highSuctionSuperhea "VCFRONT_a446_highSuctionSuperheat";
BA_ "SystemSignalLongSymbol" SG_ 1332 VCFRONT_a447_heatPumpHVACUnavail "VCFRONT_a447_heatPumpHVACUnavailable";
BA_ "SystemSignalLongSymbol" SG_ 1332 VCFRONT_a447_activeLouverComprom "VCFRONT_a447_activeLouverCompromised";
BA_ "SystemSignalLongSymbol" SG_ 1332 VCFRONT_a447_coolantValveComprom "VCFRONT_a447_coolantValveCompromised";
BA_ "SystemSignalLongSymbol" SG_ 1332 VCFRONT_a447_ambientSourcingComp "VCFRONT_a447_ambientSourcingCompromised";
BA_ "SystemSignalLongSymbol" SG_ 1332 VCFRONT_a447_scavengeLoopComprom "VCFRONT_a447_scavengeLoopCompromised";
BA_ "SystemSignalLongSymbol" SG_ 1332 VCFRONT_a447_coolantSystemCompro "VCFRONT_a447_coolantSystemCompromised";
BA_ "SystemSignalLongSymbol" SG_ 1332 VCFRONT_a447_hvBattActiveDischgC "VCFRONT_a447_hvBattActiveDischgCompromised";
BA_ "SystemSignalLongSymbol" SG_ 1332 VCFRONT_a447_hvBatteryDischargin "VCFRONT_a447_hvBatteryDischargingCompromised";
BA_ "SystemSignalLongSymbol" SG_ 1332 VCFRONT_a447_lccSolenoidCompromi "VCFRONT_a447_lccSolenoidCompromised";
BA_ "SystemSignalLongSymbol" SG_ 1332 VCFRONT_a447_refrigerantSystemCo "VCFRONT_a447_refrigerantSystemCompromised";
BA_ "SystemSignalLongSymbol" SG_ 1332 VCFRONT_a447_powertrainThermalFa "VCFRONT_a447_powertrainThermalFansCompromised";
BA_ "SystemSignalLongSymbol" SG_ 1332 VCFRONT_a447_refrigDischargePres "VCFRONT_a447_refrigDischargePressCompromised";
BA_ "SystemSignalLongSymbol" SG_ 1332 VCFRONT_a447_refrigeDischargeTem "VCFRONT_a447_refrigeDischargeTempCompromised";
BA_ "SystemSignalLongSymbol" SG_ 1332 VCFRONT_a447_refrigSuctionPressC "VCFRONT_a447_refrigSuctionPressCompromised";
BA_ "SystemSignalLongSymbol" SG_ 1332 VCFRONT_a447_refrigSuctionTempCo "VCFRONT_a447_refrigSuctionTempCompromised";
BA_ "SystemSignalLongSymbol" SG_ 1332 VCFRONT_a447_refrigLiquidPressCo "VCFRONT_a447_refrigLiquidPressCompromised";
BA_ "SystemSignalLongSymbol" SG_ 1332 VCFRONT_a447_refrigLiquidTempCom "VCFRONT_a447_refrigLiquidTempCompromised";
BA_ "SystemSignalLongSymbol" SG_ 1332 VCFRONT_a459_refrigerantFillActi "VCFRONT_a459_refrigerantFillActive";
BA_ "SystemSignalLongSymbol" SG_ 1332 VCFRONT_a462_NTCTempDiffWarnLeve "VCFRONT_a462_NTCTempDiffWarnLevel1";
BA_ "SystemSignalLongSymbol" SG_ 1332 VCFRONT_a463_switch1VoltageAvera "VCFRONT_a463_switch1VoltageAverage";
BA_ "SystemSignalLongSymbol" SG_ 1332 VCFRONT_a463_switch1VoltageInsta "VCFRONT_a463_switch1VoltageInstant";
BA_ "SystemSignalLongSymbol" SG_ 1332 VCFRONT_a463_switch2VoltageAvera "VCFRONT_a463_switch2VoltageAverage";
BA_ "SystemSignalLongSymbol" SG_ 1332 VCFRONT_a463_switch2VoltageInsta "VCFRONT_a463_switch2VoltageInstant";
BA_ "SystemSignalLongSymbol" SG_ 1332 VCFRONT_a465_flaggedAtSteadyStat "VCFRONT_a465_flaggedAtSteadyState";
BA_ "SystemSignalLongSymbol" SG_ 1332 VCFRONT_a465_flaggedAtUnsteadySt "VCFRONT_a465_flaggedAtUnsteadyState";
BA_ "SystemSignalLongSymbol" SG_ 1332 VCFRONT_a474_lowBeamPrefieldStat "VCFRONT_a474_lowBeamPrefieldStatus";
BA_ "SystemSignalLongSymbol" SG_ 1332 VCFRONT_a475_lowBeamPrefieldStat "VCFRONT_a475_lowBeamPrefieldStatus";
BA_ "SystemSignalLongSymbol" SG_ 1332 VCFRONT_a478_battFaultPackOverVo "VCFRONT_a478_battFaultPackOverVoltage";
BA_ "SystemSignalLongSymbol" SG_ 1332 VCFRONT_a478_battFaultHardwareOv "VCFRONT_a478_battFaultHardwareOverCurrent";
BA_ "SystemSignalLongSymbol" SG_ 1332 VCFRONT_a478_battFaultChargeOver "VCFRONT_a478_battFaultChargeOverCurrent";
BA_ "SystemSignalLongSymbol" SG_ 1332 VCFRONT_a478_battFaultCellUnderV "VCFRONT_a478_battFaultCellUnderVoltage";
BA_ "SystemSignalLongSymbol" SG_ 1332 VCFRONT_a478_battFaultCellOverVo "VCFRONT_a478_battFaultCellOverVoltage";
BA_ "SystemSignalLongSymbol" SG_ 1332 VCFRONT_a478_notEnoughPowerForSu "VCFRONT_a478_notEnoughPowerForSupport";
BA_ "SystemSignalLongSymbol" SG_ 1332 VCFRONT_a478_contactorEFuseStabl "VCFRONT_a478_contactorEFuseStable";
