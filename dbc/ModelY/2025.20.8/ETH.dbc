VERSION "dbc-export 1 2025.20.8"

NS_ :

BS_:

BU_: ADSP APB APP APS APSB BB BMS CC CMP CMPD CP DAS DI DIF DIR DPB EPAS3P EPAS3S EPASTP EPASTS EPBL EPBR ESP GTW HVP IBST ICR IDB OCS1P ODIN PARK PCS PLG PM PMF PMR PTC RADC RCM RCM2 RCU SCCM SDCR TAS TCU TPMS TRCM UDS UI UIS UMC USM VC VCFRONT VCLEFT VCRIGHT VCSEC

BO_ 1655 VC_LVBMS_statusHigh: 8 VC
 SG_ VC_lvbmsStatusHighIndex M : 0|3@1+ (1,0) [0|7] "" Vector__XXX
 SG_ VC_LVBMS_packCurrent m0 : 3|22@1+ (0.001,-2000) [-2000|2194.302] "A" Vector__XXX
 SG_ VC_LVBMS_packVoltage m0 : 25|16@1+ (0.001,0) [0|65.534] "V" Vector__XXX
 SG_ VC_LVBMS_packTemperature m0 : 41|9@1+ (0.5,-50) [-50|205] "degC" Vector__XXX
 SG_ VC_LVBMS_MOSTemperature m0 : 50|12@1+ (0.5,-50) [-50|1997] "degC" Vector__XXX
 SG_ VC_LVBMS_sumCellVoltage m1 : 8|16@1+ (0.001,0) [0|65.534] "V" Vector__XXX
 SG_ VC_LVBMS_maxBrickVoltage m1 : 24|13@1+ (0.001,0) [0|8.19] "V" Vector__XXX
 SG_ VC_LVBMS_maxBrickVoltageIndex m1 : 40|8@1+ (1,0) [0|254] "" Vector__XXX
 SG_ VC_LVBMS_avgBrickVoltage m2 : 3|13@1+ (0.001,0) [0|8.19] "V" Vector__XXX
 SG_ VC_LVBMS_minBrickVoltage m2 : 16|13@1+ (0.001,0) [0|8.19] "V" Vector__XXX
 SG_ VC_LVBMS_minBrickVoltageIndex m2 : 32|8@1+ (1,0) [0|254] "" Vector__XXX
 SG_ VC_LVBMS_voltageTarget m3 : 3|16@1+ (0.001,0) [0|65.534] "V" Vector__XXX
 SG_ VC_LVBMS_currentTarget m3 : 19|17@1+ (0.001,-61) [-61|70.07] "A" Vector__XXX
 SG_ VC_LVBMS_maxAllowedChargeCurrent m3 : 36|13@1+ (0.1,0) [0|819] "A" Vector__XXX
 SG_ VC_LVBMS_maxAllowedDischargeCurr m3 : 49|13@1+ (0.1,0) [0|819] "A" Vector__XXX
 SG_ VC_LVBMS_MOSCommand m4 : 3|1@1+ (1,0) [0|1] "" Vector__XXX
 SG_ VC_LVBMS_ClearErrorCntrCommand m4 : 4|1@1+ (1,0) [0|1] "" Vector__XXX
 SG_ VC_LVBMS_ClearHistoricFaultComma m4 : 5|1@1+ (1,0) [0|1] "" Vector__XXX
 SG_ VC_LVBMS_ResetLVBMSCommand m4 : 6|1@1+ (1,0) [0|1] "" Vector__XXX
 SG_ VC_LVBMS_EnterHibernationCommand m4 : 7|1@1+ (1,0) [0|1] "" Vector__XXX
 SG_ VC_LVBMS_ECPAState m4 : 8|2@1+ (1,0) [0|2] "" Vector__XXX
 SG_ VC_LVBMS_MOSState m4 : 10|2@1+ (1,0) [0|2] "" Vector__XXX
 SG_ VC_LVBMS_VehicleState m4 : 12|2@1+ (1,0) [0|3] "" Vector__XXX
 SG_ VC_LVBMS_LINWakeDisabled m4 : 14|1@1+ (1,0) [0|1] "" Vector__XXX
 SG_ VC_LVBMS_chargeType m4 : 16|3@1+ (1,0) [0|7] "" Vector__XXX
 SG_ VC_LVBMS_cellAndArcProtEnabled m4 : 19|1@1+ (1,0) [0|1] "" Vector__XXX
 SG_ VC_totalLVLoadCurrent m5 : 8|14@1- (0.1,0) [-200|400] "A" Vector__XXX
 SG_ VC_LVPackChargeCurrentLimit m5 : 22|12@1+ (0.1,0) [0|400] "A" Vector__XXX
 SG_ VC_LVPackCurrent m5 : 34|14@1- (0.1,0) [-200|400] "A" Vector__XXX
 SG_ VC_LVBMS_estimatedPackOcv m5 : 48|16@1+ (0.001,0) [0|65.535] "V" Vector__XXX

BO_ 1816 VC_LVBMS_statusLow: 7 VC
 SG_ VC_lvbmsStatusLowIndex M : 0|3@1+ (1,0) [0|7] "" Vector__XXX
 SG_ VC_LVBMS_SOC m0 : 8|7@1+ (1,0) [0|102.2] "%" Vector__XXX
 SG_ VC_LVBMS_SOE m0 : 16|7@1+ (1,0) [0|126] "%" Vector__XXX
 SG_ VC_LVBMS_SOH m0 : 24|7@1+ (1,0) [0|126] "%" Vector__XXX
 SG_ VC_LVBMS_SOP m0 : 32|24@1+ (0.001,0) [0|5080] "W" Vector__XXX
 SG_ VC_LVBMS_AvgSleepCurrent m1 : 8|16@1+ (0.01,-200) [-200|455.34] "A" Vector__XXX
 SG_ VC_LVBMS_TimeSlept m1 : 24|24@1+ (1,0) [0|16777214] "min" Vector__XXX
 SG_ VC_LVBMS_AhCharged m2 : 8|32@1+ (0.001,0) [0|4294967.294] "Ah" Vector__XXX
 SG_ VC_LVBMS_MinSleepCurrent m2 : 40|16@1+ (0.01,-200) [-200|455.34] "A" Vector__XXX
 SG_ VC_LVBMS_AhDischarged m3 : 8|32@1+ (0.001,0) [0|4294967.294] "Ah" Vector__XXX
 SG_ VC_LVBMS_MaxSleepCurrent m3 : 40|16@1+ (0.01,-200) [-200|455.34] "A" Vector__XXX
 SG_ VC_LVBMS_sumCellVoltageFiltered m4 : 8|16@1+ (0.001,0) [0|65.534] "V" Vector__XXX
 SG_ VC_LVBMS_maxCellSOC m4 : 24|7@1+ (1,0) [0|102.2] "%" Vector__XXX
 SG_ VC_LVBMS_minCellSOC m4 : 32|7@1+ (1,0) [0|102.2] "%" Vector__XXX
 SG_ VC_LVBMS_staticSOCCorrection m4 : 39|1@1+ (1,0) [0|1] "" Vector__XXX
 SG_ VC_LVBMS_dynamicSOCCorrection m4 : 40|1@1+ (1,0) [0|1] "" Vector__XXX
 SG_ VC_LVBMS_usableEnergyAvailable m4 : 41|12@1+ (1,0) [0|4000] "Wh" Vector__XXX
 SG_ VC_LVBMS_CellOVLevel1 m5 : 3|1@1+ (1,0) [0|1] "" Vector__XXX
 SG_ VC_LVBMS_CellOVLevel2 m5 : 4|1@1+ (1,0) [0|1] "" Vector__XXX
 SG_ VC_LVBMS_CellOVLevel3 m5 : 5|1@1+ (1,0) [0|1] "" Vector__XXX
 SG_ VC_LVBMS_CellUVLevel1 m5 : 6|1@1+ (1,0) [0|1] "" Vector__XXX
 SG_ VC_LVBMS_CellUVLevel2 m5 : 7|1@1+ (1,0) [0|1] "" Vector__XXX
 SG_ VC_LVBMS_ModuleOTLevel1 m5 : 8|1@1+ (1,0) [0|1] "" Vector__XXX
 SG_ VC_LVBMS_PackOVLevel1 m5 : 9|1@1+ (1,0) [0|1] "" Vector__XXX
 SG_ VC_LVBMS_PackOVLevel2 m5 : 10|1@1+ (1,0) [0|1] "" Vector__XXX
 SG_ VC_LVBMS_DischrgOCLevel1 m5 : 11|1@1+ (1,0) [0|1] "" Vector__XXX
 SG_ VC_LVBMS_DischrgOCLevel2 m5 : 12|1@1+ (1,0) [0|1] "" Vector__XXX
 SG_ VC_LVBMS_ChrgOCLevel1 m5 : 13|1@1+ (1,0) [0|1] "" Vector__XXX
 SG_ VC_LVBMS_ChrgOCLevel2 m5 : 14|1@1+ (1,0) [0|1] "" Vector__XXX
 SG_ VC_LVBMS_MOSFETOTLevel1 m5 : 15|1@1+ (1,0) [0|1] "" Vector__XXX
 SG_ VC_LVBMS_KBValueLostFault m5 : 16|1@1+ (1,0) [0|1] "" Vector__XXX
 SG_ VC_LVBMS_BalanceCircuitFault m5 : 17|1@1+ (1,0) [0|1] "" Vector__XXX
 SG_ VC_LVBMS_MOSStateFault m5 : 18|1@1+ (1,0) [0|1] "" Vector__XXX
 SG_ VC_LVBMS_NTCTempDiffWarnLevel1 m5 : 19|1@1+ (1,0) [0|1] "" Vector__XXX
 SG_ VC_LVBMS_DeepDischargeFlag m5 : 20|1@1+ (1,0) [0|1] "" Vector__XXX
 SG_ VC_LVBMS_SamplingError m5 : 21|1@1+ (1,0) [0|1] "" Vector__XXX
 SG_ VC_LVBMS_MosfetStuckCloseError m5 : 22|1@1+ (1,0) [0|1] "" Vector__XXX
 SG_ VC_LVBMS_MosfetStuckOpenError m5 : 23|1@1+ (1,0) [0|1] "" Vector__XXX

BO_ 1089 VC_pcsInterface: 8 VC
 SG_ VC_pcsInterfaceMuxIndex M : 48|1@1+ (1,0) [0|1] "" Vector__XXX
 SG_ VC_pcsInterfaceCounter : 50|4@1+ (1,0) [0|15] "" Vector__XXX
 SG_ VC_pcsInterfaceChecksum : 56|8@1+ (1,0) [0|255] "" Vector__XXX
 SG_ VC_pcsLVVoltageTarget m0 : 0|13@1+ (0.01,0) [0|65.535] "V" Vector__XXX
 SG_ VC_pcsLVMinVoltageLimit m0 : 13|13@1+ (0.01,0) [0|65.535] "V" Vector__XXX
 SG_ VC_pcsLVMaxVoltageLimit m0 : 27|13@1+ (0.01,0) [0|65.535] "V" Vector__XXX
 SG_ VC_goodForPCSPowerCycle m0 : 46|1@1+ (1,0) [0|1] "" Vector__XXX
 SG_ VC_LVBatteryCannotSupportVehicle m0 : 47|1@1+ (1,0) [0|1] "" Vector__XXX
 SG_ VC_pcsResistanceFiltered m1 : 0|16@1+ (0.01,0) [0|655.34] "mOhm" Vector__XXX
 SG_ VC_pcsLVMaxDchrgCurrentLimit m1 : 16|12@1+ (0.1,0) [0|400] "A" Vector__XXX
 SG_ VC_defaultPcsLVVoltageTarget m1 : 28|13@1+ (0.01,0) [0|65.535] "V" Vector__XXX
 SG_ VC_lvHwProtSelfTestActive m1 : 41|1@1+ (1,0) [0|1] "" Vector__XXX

BO_TX_BU_ 1655 : VC;
BO_TX_BU_ 1816 : VC;
BO_TX_BU_ 1089 : VC;
CM_ BO_ 1655 "VC ECU message: LVBMS status high";
CM_ SG_ 1655 VC_lvbmsStatusHighIndex "VC ECU: lvbms status high index";
CM_ SG_ 1655 VC_LVBMS_packCurrent "Electrical current into the low voltage battery; raw 4194303 = signal not available (SNA)";
CM_ SG_ 1655 VC_LVBMS_packVoltage "Voltage of the low voltage battery; raw 65535 = signal not available (SNA)";
CM_ SG_ 1655 VC_LVBMS_packTemperature "Temperature of the low voltage battery; raw 511 = signal not available (SNA)";
CM_ SG_ 1655 VC_LVBMS_MOSTemperature "Temperature of the MOSFET on the low voltage battery; raw 4095 = signal not available (SNA)";
CM_ SG_ 1655 VC_LVBMS_sumCellVoltage "Sum of the cell voltage of the low voltage battery; raw 65535 = signal not available (SNA)";
CM_ SG_ 1655 VC_LVBMS_maxBrickVoltage "Maximum cell voltage in the low voltage battery; raw 8191 = signal not available (SNA)";
CM_ SG_ 1655 VC_LVBMS_maxBrickVoltageIndex "VC ECU: LVBMS max brick voltage index; raw 255 = signal not available (SNA)";
CM_ SG_ 1655 VC_LVBMS_avgBrickVoltage "Average voltage of all cells in the low voltage battery; raw 8191 = signal not available (SNA)";
CM_ SG_ 1655 VC_LVBMS_minBrickVoltage "Minimum cell voltage in the low voltage battery; raw 8191 = signal not available (SNA)";
CM_ SG_ 1655 VC_LVBMS_minBrickVoltageIndex "VC ECU: LVBMS min brick voltage index; raw 255 = signal not available (SNA)";
CM_ SG_ 1655 VC_LVBMS_voltageTarget "Voltage target of the LV battery; raw 65535 = signal not available (SNA)";
CM_ SG_ 1655 VC_LVBMS_currentTarget "Target current requested by the LV battery; raw 131071 = signal not available (SNA)";
CM_ SG_ 1655 VC_LVBMS_maxAllowedChargeCurrent "Maximum allowed charge current of the battery; raw 8191 = signal not available (SNA)";
CM_ SG_ 1655 VC_LVBMS_maxAllowedDischargeCurr "Maximum allowed discharge current of the battery; raw 8191 = signal not available (SNA)";
CM_ SG_ 1655 VC_LVBMS_MOSCommand "Current state of the MOS command to the LV battery";
CM_ SG_ 1655 VC_LVBMS_ClearErrorCntrCommand "VC ECU: LVBMS clear error cntr command";
CM_ SG_ 1655 VC_LVBMS_ClearHistoricFaultComma "VC ECU: LVBMS clear historic fault command";
CM_ SG_ 1655 VC_LVBMS_ResetLVBMSCommand "Reset command issued to LVBMS, commanded by VC";
CM_ SG_ 1655 VC_LVBMS_EnterHibernationCommand "VC ECU: LVBMS enter hibernation command";
CM_ SG_ 1655 VC_LVBMS_ECPAState "Current state of the E-CPA on the LV battery; raw 3 = signal not available (SNA)";
CM_ SG_ 1655 VC_LVBMS_MOSState "Current state of the MOS on the LV battery; raw 3 = signal not available (SNA)";
CM_ SG_ 1655 VC_LVBMS_VehicleState "VC ECU: LVBMS vehicle state";
CM_ SG_ 1655 VC_LVBMS_LINWakeDisabled "VC ECU: LVBMS LIN wake disabled";
CM_ SG_ 1655 VC_LVBMS_chargeType "VC ECU: LVBMS charge type; raw 4 = signal not available (SNA)";
CM_ SG_ 1655 VC_LVBMS_cellAndArcProtEnabled "Indicates whether the VC has commanded cell protections to be active";
CM_ SG_ 1655 VC_totalLVLoadCurrent "Total LV load current of the vehicle.";
CM_ SG_ 1655 VC_LVPackChargeCurrentLimit "Charge current limit for the LV battery pack.";
CM_ SG_ 1655 VC_LVPackCurrent "Current of the LV battery pack.";
CM_ SG_ 1655 VC_LVBMS_estimatedPackOcv "VC ECU: LVBMS estimated pack ocv";
CM_ BO_ 1816 "VC ECU message: LVBMS status low";
CM_ SG_ 1816 VC_lvbmsStatusLowIndex "VC ECU: lvbms status low index";
CM_ SG_ 1816 VC_LVBMS_SOC "State of charge reported by the low voltage battery sensor; raw 127 = signal not available (SNA)";
CM_ SG_ 1816 VC_LVBMS_SOE "State of energy reported by the low voltage battery; raw 127 = signal not available (SNA)";
CM_ SG_ 1816 VC_LVBMS_SOH "State of health reported by the low voltage battery; raw 127 = signal not available (SNA)";
CM_ SG_ 1816 VC_LVBMS_SOP "VC ECU: LVBMS SOP; raw 16777215 = signal not available (SNA)";
CM_ SG_ 1816 VC_LVBMS_AvgSleepCurrent "Low voltage battery average sleep current; raw 65535 = signal not available (SNA)";
CM_ SG_ 1816 VC_LVBMS_TimeSlept "VC ECU: LVBMS time slept; raw 16777215 = signal not available (SNA)";
CM_ SG_ 1816 VC_LVBMS_AhCharged "Low voltage battery charge state; raw 4294967295 = signal not available (SNA)";
CM_ SG_ 1816 VC_LVBMS_MinSleepCurrent "VC ECU: LVBMS min sleep current; raw 65535 = signal not available (SNA)";
CM_ SG_ 1816 VC_LVBMS_AhDischarged "Low voltage battery charge state; raw 4294967295 = signal not available (SNA)";
CM_ SG_ 1816 VC_LVBMS_MaxSleepCurrent "VC ECU: LVBMS max sleep current; raw 65535 = signal not available (SNA)";
CM_ SG_ 1816 VC_LVBMS_sumCellVoltageFiltered "VC ECU: LVBMS sum cell voltage filtered; raw 65535 = signal not available (SNA)";
CM_ SG_ 1816 VC_LVBMS_maxCellSOC "SOC estimate of the highest SOC cell; raw 127 = signal not available (SNA)";
CM_ SG_ 1816 VC_LVBMS_minCellSOC "SOC estimate of the lowest SOC cell; raw 127 = signal not available (SNA)";
CM_ SG_ 1816 VC_LVBMS_staticSOCCorrection "Flag indicating the LVBMS is performing static SOC correction.";
CM_ SG_ 1816 VC_LVBMS_dynamicSOCCorrection "Flag indicating the LVBMS is performing dynamic SOC correction.";
CM_ SG_ 1816 VC_LVBMS_usableEnergyAvailable "Available/remaining usable pack energy; raw 4095 = signal not available (SNA)";
CM_ SG_ 1816 VC_LVBMS_CellOVLevel1 "VC ECU: LVBMS cell OV level1";
CM_ SG_ 1816 VC_LVBMS_CellOVLevel2 "VC ECU: LVBMS cell OV level2";
CM_ SG_ 1816 VC_LVBMS_CellOVLevel3 "VC ECU: LVBMS cell OV level3";
CM_ SG_ 1816 VC_LVBMS_CellUVLevel1 "VC ECU: LVBMS cell UV level1";
CM_ SG_ 1816 VC_LVBMS_CellUVLevel2 "VC ECU: LVBMS cell UV level2";
CM_ SG_ 1816 VC_LVBMS_ModuleOTLevel1 "VC ECU: LVBMS module OT level1";
CM_ SG_ 1816 VC_LVBMS_PackOVLevel1 "VC ECU: LVBMS pack OV level1";
CM_ SG_ 1816 VC_LVBMS_PackOVLevel2 "Pack Over Voltage Level 2 flag status";
CM_ SG_ 1816 VC_LVBMS_DischrgOCLevel1 "VC ECU: LVBMS dischrg OC level1";
CM_ SG_ 1816 VC_LVBMS_DischrgOCLevel2 "Discharge Over Current Level 2 flag status";
CM_ SG_ 1816 VC_LVBMS_ChrgOCLevel1 "VC ECU: LVBMS chrg OC level1";
CM_ SG_ 1816 VC_LVBMS_ChrgOCLevel2 "Charge Over Current Level 2 flag status";
CM_ SG_ 1816 VC_LVBMS_MOSFETOTLevel1 "VC ECU: LVBMS MOSFETOT level1";
CM_ SG_ 1816 VC_LVBMS_KBValueLostFault "Loss of CATL specific internal value flag status. Lost value causes offset in current sensor reading.";
CM_ SG_ 1816 VC_LVBMS_BalanceCircuitFault "Balance Circuit Fault flag status";
CM_ SG_ 1816 VC_LVBMS_MOSStateFault "Mosfet fault state flag status. Not to be confused with VC_LVBMS_MOSState.";
CM_ SG_ 1816 VC_LVBMS_NTCTempDiffWarnLevel1 "VC ECU: LVBMS NTC temp diff warn level1";
CM_ SG_ 1816 VC_LVBMS_DeepDischargeFlag "Deep Discharge flag status";
CM_ SG_ 1816 VC_LVBMS_SamplingError "Sampling Error flag status";
CM_ SG_ 1816 VC_LVBMS_MosfetStuckCloseError "Mosfet Stuck Close flag status";
CM_ SG_ 1816 VC_LVBMS_MosfetStuckOpenError "Mosfet Stuck Open flag status";
CM_ BO_ 1089 "VC ECU message: pcs interface";
CM_ SG_ 1089 VC_pcsInterfaceMuxIndex "VC ECU: pcs interface mux index";
CM_ SG_ 1089 VC_pcsInterfaceCounter "VC ECU: pcs interface counter";
CM_ SG_ 1089 VC_pcsInterfaceChecksum "VC ECU: pcs interface checksum";
CM_ SG_ 1089 VC_pcsLVVoltageTarget "VC ECU: pcs LV voltage target";
CM_ SG_ 1089 VC_pcsLVMinVoltageLimit "VC ECU: pcs LV min voltage limit";
CM_ SG_ 1089 VC_pcsLVMaxVoltageLimit "VC ECU: pcs LV max voltage limit";
CM_ SG_ 1089 VC_goodForPCSPowerCycle "VC ECU: good for PCS power cycle";
CM_ SG_ 1089 VC_LVBatteryCannotSupportVehicle "VC ECU: LV battery cannot support vehicle";
CM_ SG_ 1089 VC_pcsResistanceFiltered "VC ECU: pcs resistance filtered; raw 65535 = signal not available (SNA)";
CM_ SG_ 1089 VC_pcsLVMaxDchrgCurrentLimit "VC ECU: pcs LV max dchrg current limit";
CM_ SG_ 1089 VC_defaultPcsLVVoltageTarget "VC ECU: default pcs LV voltage target";
CM_ SG_ 1089 VC_lvHwProtSelfTestActive "Reports whether Low Voltage (LV) Hardware (HW) protection self-tests are running or about to run due to a retry.";
BA_DEF_ BO_ "GenMsgCycleTime" INT 0 3600000;
BA_DEF_ BO_ "GenMsgSendType" ENUM "Cyclic","NotUsed","NotUsed","NotUsed","NotUsed","NotUsed","NotUsed","IfActive","NoMsgSendType","NotUsed";
BA_DEF_ BO_ "VFrameFormat" ENUM "StandardCAN","ExtendedCAN","reserved","J1939PG","reserved","reserved","reserved","reserved","reserved","reserved","reserved","reserved","reserved","reserved","StandardCAN_FD","ExtendedCAN_FD";
BA_DEF_ BO_ "CANFD_BRS" ENUM "0","1";
BA_DEF_ SG_ "GenSigSNA" STRING;
BA_DEF_ SG_ "SystemSignalLongSymbol" STRING;
BA_DEF_ SG_ "Confidence" ENUM "validated","plausible","layout-only","contradicted";
BA_DEF_DEF_ "GenMsgCycleTime" 0;
BA_DEF_DEF_ "GenMsgSendType" "NoMsgSendType";
BA_DEF_DEF_ "VFrameFormat" "StandardCAN";
BA_DEF_DEF_ "CANFD_BRS" "1";
BA_DEF_DEF_ "GenSigSNA" "";
BA_DEF_DEF_ "SystemSignalLongSymbol" "";
BA_DEF_DEF_ "Confidence" "layout-only";
BA_ "GenMsgCycleTime" BO_ 1655 33;
BA_ "GenMsgSendType" BO_ 1655 0;
BA_ "GenMsgCycleTime" BO_ 1816 100;
BA_ "GenMsgSendType" BO_ 1816 0;
BA_ "GenMsgCycleTime" BO_ 1089 50;
BA_ "GenMsgSendType" BO_ 1089 0;
BA_ "Confidence" SG_ 1655 VC_lvbmsStatusHighIndex 1;
BA_ "Confidence" SG_ 1655 VC_LVBMS_packCurrent 0;
BA_ "GenSigSNA" SG_ 1655 VC_LVBMS_packCurrent "4194303";
BA_ "Confidence" SG_ 1655 VC_LVBMS_packVoltage 0;
BA_ "GenSigSNA" SG_ 1655 VC_LVBMS_packVoltage "65535";
BA_ "Confidence" SG_ 1655 VC_LVBMS_packTemperature 0;
BA_ "GenSigSNA" SG_ 1655 VC_LVBMS_packTemperature "511";
BA_ "Confidence" SG_ 1655 VC_LVBMS_MOSTemperature 0;
BA_ "GenSigSNA" SG_ 1655 VC_LVBMS_MOSTemperature "4095";
BA_ "Confidence" SG_ 1655 VC_LVBMS_sumCellVoltage 0;
BA_ "GenSigSNA" SG_ 1655 VC_LVBMS_sumCellVoltage "65535";
BA_ "Confidence" SG_ 1655 VC_LVBMS_maxBrickVoltage 0;
BA_ "GenSigSNA" SG_ 1655 VC_LVBMS_maxBrickVoltage "8191";
BA_ "Confidence" SG_ 1655 VC_LVBMS_maxBrickVoltageIndex 0;
BA_ "GenSigSNA" SG_ 1655 VC_LVBMS_maxBrickVoltageIndex "255";
BA_ "Confidence" SG_ 1655 VC_LVBMS_avgBrickVoltage 1;
BA_ "GenSigSNA" SG_ 1655 VC_LVBMS_avgBrickVoltage "8191";
BA_ "Confidence" SG_ 1655 VC_LVBMS_minBrickVoltage 1;
BA_ "GenSigSNA" SG_ 1655 VC_LVBMS_minBrickVoltage "8191";
BA_ "Confidence" SG_ 1655 VC_LVBMS_minBrickVoltageIndex 1;
BA_ "GenSigSNA" SG_ 1655 VC_LVBMS_minBrickVoltageIndex "255";
BA_ "Confidence" SG_ 1655 VC_LVBMS_voltageTarget 0;
BA_ "GenSigSNA" SG_ 1655 VC_LVBMS_voltageTarget "65535";
BA_ "Confidence" SG_ 1655 VC_LVBMS_currentTarget 1;
BA_ "GenSigSNA" SG_ 1655 VC_LVBMS_currentTarget "131071";
BA_ "Confidence" SG_ 1655 VC_LVBMS_maxAllowedChargeCurrent 1;
BA_ "GenSigSNA" SG_ 1655 VC_LVBMS_maxAllowedChargeCurrent "8191";
BA_ "Confidence" SG_ 1655 VC_LVBMS_maxAllowedDischargeCurr 1;
BA_ "GenSigSNA" SG_ 1655 VC_LVBMS_maxAllowedDischargeCurr "8191";
BA_ "SystemSignalLongSymbol" SG_ 1655 VC_LVBMS_maxAllowedDischargeCurr "VC_LVBMS_maxAllowedDischargeCurrent";
BA_ "Confidence" SG_ 1655 VC_LVBMS_MOSCommand 0;
BA_ "Confidence" SG_ 1655 VC_LVBMS_ClearErrorCntrCommand 0;
BA_ "Confidence" SG_ 1655 VC_LVBMS_ClearHistoricFaultComma 0;
BA_ "SystemSignalLongSymbol" SG_ 1655 VC_LVBMS_ClearHistoricFaultComma "VC_LVBMS_ClearHistoricFaultCommand";
BA_ "Confidence" SG_ 1655 VC_LVBMS_ResetLVBMSCommand 0;
BA_ "Confidence" SG_ 1655 VC_LVBMS_EnterHibernationCommand 0;
BA_ "Confidence" SG_ 1655 VC_LVBMS_ECPAState 0;
BA_ "GenSigSNA" SG_ 1655 VC_LVBMS_ECPAState "3";
BA_ "Confidence" SG_ 1655 VC_LVBMS_MOSState 0;
BA_ "GenSigSNA" SG_ 1655 VC_LVBMS_MOSState "3";
BA_ "Confidence" SG_ 1655 VC_LVBMS_VehicleState 0;
BA_ "Confidence" SG_ 1655 VC_LVBMS_LINWakeDisabled 0;
BA_ "Confidence" SG_ 1655 VC_LVBMS_chargeType 0;
BA_ "GenSigSNA" SG_ 1655 VC_LVBMS_chargeType "4";
BA_ "Confidence" SG_ 1655 VC_LVBMS_cellAndArcProtEnabled 0;
BA_ "Confidence" SG_ 1655 VC_totalLVLoadCurrent 0;
BA_ "Confidence" SG_ 1655 VC_LVPackChargeCurrentLimit 0;
BA_ "Confidence" SG_ 1655 VC_LVPackCurrent 0;
BA_ "Confidence" SG_ 1655 VC_LVBMS_estimatedPackOcv 0;
BA_ "Confidence" SG_ 1816 VC_lvbmsStatusLowIndex 1;
BA_ "Confidence" SG_ 1816 VC_LVBMS_SOC 1;
BA_ "GenSigSNA" SG_ 1816 VC_LVBMS_SOC "127";
BA_ "Confidence" SG_ 1816 VC_LVBMS_SOE 0;
BA_ "GenSigSNA" SG_ 1816 VC_LVBMS_SOE "127";
BA_ "Confidence" SG_ 1816 VC_LVBMS_SOH 0;
BA_ "GenSigSNA" SG_ 1816 VC_LVBMS_SOH "127";
BA_ "Confidence" SG_ 1816 VC_LVBMS_SOP 1;
BA_ "GenSigSNA" SG_ 1816 VC_LVBMS_SOP "16777215";
BA_ "Confidence" SG_ 1816 VC_LVBMS_AvgSleepCurrent 0;
BA_ "GenSigSNA" SG_ 1816 VC_LVBMS_AvgSleepCurrent "65535";
BA_ "Confidence" SG_ 1816 VC_LVBMS_TimeSlept 0;
BA_ "GenSigSNA" SG_ 1816 VC_LVBMS_TimeSlept "16777215";
BA_ "Confidence" SG_ 1816 VC_LVBMS_AhCharged 0;
BA_ "GenSigSNA" SG_ 1816 VC_LVBMS_AhCharged "4294967295";
BA_ "Confidence" SG_ 1816 VC_LVBMS_MinSleepCurrent 0;
BA_ "GenSigSNA" SG_ 1816 VC_LVBMS_MinSleepCurrent "65535";
BA_ "Confidence" SG_ 1816 VC_LVBMS_AhDischarged 0;
BA_ "GenSigSNA" SG_ 1816 VC_LVBMS_AhDischarged "4294967295";
BA_ "Confidence" SG_ 1816 VC_LVBMS_MaxSleepCurrent 0;
BA_ "GenSigSNA" SG_ 1816 VC_LVBMS_MaxSleepCurrent "65535";
BA_ "Confidence" SG_ 1816 VC_LVBMS_sumCellVoltageFiltered 0;
BA_ "GenSigSNA" SG_ 1816 VC_LVBMS_sumCellVoltageFiltered "65535";
BA_ "Confidence" SG_ 1816 VC_LVBMS_maxCellSOC 1;
BA_ "GenSigSNA" SG_ 1816 VC_LVBMS_maxCellSOC "127";
BA_ "Confidence" SG_ 1816 VC_LVBMS_minCellSOC 1;
BA_ "GenSigSNA" SG_ 1816 VC_LVBMS_minCellSOC "127";
BA_ "Confidence" SG_ 1816 VC_LVBMS_staticSOCCorrection 1;
BA_ "Confidence" SG_ 1816 VC_LVBMS_dynamicSOCCorrection 1;
BA_ "Confidence" SG_ 1816 VC_LVBMS_usableEnergyAvailable 1;
BA_ "GenSigSNA" SG_ 1816 VC_LVBMS_usableEnergyAvailable "4095";
BA_ "Confidence" SG_ 1816 VC_LVBMS_CellOVLevel1 1;
BA_ "Confidence" SG_ 1816 VC_LVBMS_CellOVLevel2 1;
BA_ "Confidence" SG_ 1816 VC_LVBMS_CellOVLevel3 1;
BA_ "Confidence" SG_ 1816 VC_LVBMS_CellUVLevel1 1;
BA_ "Confidence" SG_ 1816 VC_LVBMS_CellUVLevel2 1;
BA_ "Confidence" SG_ 1816 VC_LVBMS_ModuleOTLevel1 1;
BA_ "Confidence" SG_ 1816 VC_LVBMS_PackOVLevel1 1;
BA_ "Confidence" SG_ 1816 VC_LVBMS_PackOVLevel2 1;
BA_ "Confidence" SG_ 1816 VC_LVBMS_DischrgOCLevel1 1;
BA_ "Confidence" SG_ 1816 VC_LVBMS_DischrgOCLevel2 1;
BA_ "Confidence" SG_ 1816 VC_LVBMS_ChrgOCLevel1 1;
BA_ "Confidence" SG_ 1816 VC_LVBMS_ChrgOCLevel2 1;
BA_ "Confidence" SG_ 1816 VC_LVBMS_MOSFETOTLevel1 1;
BA_ "Confidence" SG_ 1816 VC_LVBMS_KBValueLostFault 1;
BA_ "Confidence" SG_ 1816 VC_LVBMS_BalanceCircuitFault 1;
BA_ "Confidence" SG_ 1816 VC_LVBMS_MOSStateFault 1;
BA_ "Confidence" SG_ 1816 VC_LVBMS_NTCTempDiffWarnLevel1 1;
BA_ "Confidence" SG_ 1816 VC_LVBMS_DeepDischargeFlag 1;
BA_ "Confidence" SG_ 1816 VC_LVBMS_SamplingError 1;
BA_ "Confidence" SG_ 1816 VC_LVBMS_MosfetStuckCloseError 1;
BA_ "Confidence" SG_ 1816 VC_LVBMS_MosfetStuckOpenError 1;
BA_ "Confidence" SG_ 1089 VC_pcsInterfaceMuxIndex 1;
BA_ "Confidence" SG_ 1089 VC_pcsInterfaceCounter 0;
BA_ "Confidence" SG_ 1089 VC_pcsInterfaceChecksum 0;
BA_ "Confidence" SG_ 1089 VC_pcsLVVoltageTarget 0;
BA_ "Confidence" SG_ 1089 VC_pcsLVMinVoltageLimit 0;
BA_ "Confidence" SG_ 1089 VC_pcsLVMaxVoltageLimit 0;
BA_ "Confidence" SG_ 1089 VC_goodForPCSPowerCycle 0;
BA_ "Confidence" SG_ 1089 VC_LVBatteryCannotSupportVehicle 0;
BA_ "Confidence" SG_ 1089 VC_pcsResistanceFiltered 0;
BA_ "GenSigSNA" SG_ 1089 VC_pcsResistanceFiltered "65535";
BA_ "Confidence" SG_ 1089 VC_pcsLVMaxDchrgCurrentLimit 0;
BA_ "Confidence" SG_ 1089 VC_defaultPcsLVVoltageTarget 0;
BA_ "Confidence" SG_ 1089 VC_lvHwProtSelfTestActive 0;
VAL_ 1655 VC_lvbmsStatusHighIndex 6 "INVALID" 5 "PCS_INTERFACE" 4 "STATE_AND_COMMANDS" 3 "TARGETS" 2 "CELL_VITALS_2" 1 "CELL_VITALS_1" 0 "PACK_VITALS_1" ;
VAL_ 1655 VC_LVBMS_packCurrent 4194303 "SNA" ;
VAL_ 1655 VC_LVBMS_packVoltage 65535 "SNA" ;
VAL_ 1655 VC_LVBMS_packTemperature 511 "SNA" ;
VAL_ 1655 VC_LVBMS_MOSTemperature 4095 "SNA" ;
VAL_ 1655 VC_LVBMS_sumCellVoltage 65535 "SNA" 65534 "INVALID" ;
VAL_ 1655 VC_LVBMS_maxBrickVoltage 8191 "SNA" ;
VAL_ 1655 VC_LVBMS_maxBrickVoltageIndex 255 "SNA" ;
VAL_ 1655 VC_LVBMS_avgBrickVoltage 8191 "SNA" ;
VAL_ 1655 VC_LVBMS_minBrickVoltage 8191 "SNA" ;
VAL_ 1655 VC_LVBMS_minBrickVoltageIndex 255 "SNA" ;
VAL_ 1655 VC_LVBMS_voltageTarget 65535 "SNA" ;
VAL_ 1655 VC_LVBMS_currentTarget 131071 "SNA" ;
VAL_ 1655 VC_LVBMS_maxAllowedChargeCurrent 8191 "SNA" ;
VAL_ 1655 VC_LVBMS_maxAllowedDischargeCurr 8191 "SNA" ;
VAL_ 1655 VC_LVBMS_ECPAState 3 "LVBMS_ECPA_STATE_SNA" 2 "LVBMS_ECPA_STATE_INVALID" 1 "LVBMS_ECPA_STATE_CLOSED" 0 "LVBMS_ECPA_STATE_OPEN" ;
VAL_ 1655 VC_LVBMS_MOSState 3 "LVBMS_MOS_STATE_SNA" 2 "LVBMS_MOS_STATE_INVALID" 1 "LVBMS_MOS_STATE_CLOSED" 0 "LVBMS_MOS_STATE_OPEN" ;
VAL_ 1655 VC_LVBMS_VehicleState 3 "LVBMS_VEHICLE_STATE_OFF" 2 "LVBMS_VEHICLE_STATE_CONDITIONING" 1 "LVBMS_VEHICLE_STATE_ACCESSORY" 0 "LVBMS_VEHICLE_STATE_DRIVE" ;
VAL_ 1655 VC_LVBMS_LINWakeDisabled 1 "LVBMS_LIN_WAKE_DISABLED" 0 "LVBMS_LIN_WAKE_ENABLED" ;
VAL_ 1655 VC_LVBMS_chargeType 4 "LVBMS_CHARGE_SNA" 3 "LVBMS_CHARGE_COMPLETE" 2 "LVBMS_CHARGE_CONSTANT_VOLTAGE" 1 "LVBMS_CHARGE_CONSTANT_CURRENT" 0 "LVBMS_CHARGE_UNDEFINED" ;
VAL_ 1816 VC_lvbmsStatusLowIndex 6 "INVALID" 5 "FAULT_STATS" 4 "PACK_VITALS_2" 3 "THROUGHPUT_3" 2 "THROUGHPUT_2" 1 "THROUGHPUT_1" 0 "STATE" ;
VAL_ 1816 VC_LVBMS_SOC 127 "SNA" ;
VAL_ 1816 VC_LVBMS_SOE 127 "SNA" ;
VAL_ 1816 VC_LVBMS_SOH 127 "SNA" ;
VAL_ 1816 VC_LVBMS_SOP 16777215 "SNA" ;
VAL_ 1816 VC_LVBMS_AvgSleepCurrent 65535 "SNA" ;
VAL_ 1816 VC_LVBMS_TimeSlept 16777215 "SNA" ;
VAL_ 1816 VC_LVBMS_AhCharged 4294967295 "SNA" ;
VAL_ 1816 VC_LVBMS_MinSleepCurrent 65535 "SNA" ;
VAL_ 1816 VC_LVBMS_AhDischarged 4294967295 "SNA" ;
VAL_ 1816 VC_LVBMS_MaxSleepCurrent 65535 "SNA" ;
VAL_ 1816 VC_LVBMS_sumCellVoltageFiltered 65535 "SNA" 65534 "INVALID" ;
VAL_ 1816 VC_LVBMS_maxCellSOC 127 "SNA" ;
VAL_ 1816 VC_LVBMS_minCellSOC 127 "SNA" ;
VAL_ 1816 VC_LVBMS_staticSOCCorrection 1 "LVBMS_CORRECTION_STATE_ACTIVE" 0 "LVBMS_CORRECTION_STATE_INACTIVE" ;
VAL_ 1816 VC_LVBMS_dynamicSOCCorrection 1 "LVBMS_CORRECTION_STATE_ACTIVE" 0 "LVBMS_CORRECTION_STATE_INACTIVE" ;
VAL_ 1816 VC_LVBMS_usableEnergyAvailable 4095 "SNA" ;
VAL_ 1089 VC_pcsInterfaceMuxIndex 1 "1" 0 "0" ;
VAL_ 1089 VC_pcsResistanceFiltered 65535 "SNA" ;
