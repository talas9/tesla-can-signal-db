VERSION "dbc-export 1 2026.26.6.5"

NS_ :

BS_:

BU_: ADSP APSB CMP DAS GTW OCS1P PTC RCM TCU TCU2 TRCM UI UIS VCLEFT

BO_ 1297 RCM_alertLog: 8 RCM
 SG_ RCM_alertID M : 0|10@1+ (1,0) [0|1023] "" Vector__XXX
 SG_ RCM_a058_eventFrontLeftSeatbelt m58 : 26|1@1+ (1,0) [0|1] "" Vector__XXX
 SG_ RCM_a058_eventFrontRightSeatbelt m58 : 27|1@1+ (1,0) [0|1] "" Vector__XXX
 SG_ RCM_a058_eventVehicleSpeed m58 : 28|12@1+ (0.08,-40) [-40|287.6] "kph" Vector__XXX
 SG_ RCM_a058_eventSteeringAngle m58 : 45|14@0+ (0.1,-819.2) [-819.2|819.1] "deg" Vector__XXX
 SG_ RCM_a058_eventDriverBrakeApply m58 : 46|2@1+ (1,0) [0|2] "" Vector__XXX
 SG_ RCM_a058_eventAccelPedalPos m58 : 56|8@1+ (0.4,0) [0|101.6] "%" Vector__XXX
 SG_ RCM_a059_eventArmStatus m59 : 11|1@1+ (1,0) [0|1] "" Vector__XXX
 SG_ RCM_a059_eventFactoryMode m59 : 12|1@1+ (1,0) [0|1] "" Vector__XXX
 SG_ RCM_a059_eventDiagEnabled m59 : 13|1@1+ (1,0) [0|1] "" Vector__XXX
 SG_ RCM_a059_eventDriveOrientation m59 : 14|1@1+ (1,0) [0|1] "" Vector__XXX
 SG_ RCM_a059_bucklHallRightShort m59 : 16|1@1+ (1,0) [0|1] "" Vector__XXX
 SG_ RCM_a059_bucklHallRightSht2Bat m59 : 17|1@1+ (1,0) [0|1] "" Vector__XXX
 SG_ RCM_a059_bucklHallRightOpen m59 : 18|1@1+ (1,0) [0|1] "" Vector__XXX
 SG_ RCM_a059_bucklHallRightUndef m59 : 19|1@1+ (1,0) [0|1] "" Vector__XXX
 SG_ RCM_a059_bucklHallRightCrossCoup m59 : 20|1@1+ (1,0) [0|1] "" Vector__XXX
 SG_ RCM_a059_bucklSwRightConfig m59 : 21|1@1+ (1,0) [0|1] "" Vector__XXX
 SG_ RCM_a059_eventIDFsignal m59 : 25|1@1+ (1,0) [0|1] "" Vector__XXX
 SG_ RCM_a059_eventFrontLeftSeatbelt m59 : 26|1@1+ (1,0) [0|1] "" Vector__XXX
 SG_ RCM_a059_eventFrontRightSeatbelt m59 : 27|1@1+ (1,0) [0|1] "" Vector__XXX
 SG_ RCM_a059_eventVehicleSpeed m59 : 28|12@1+ (0.08,-40) [-40|287.6] "kph" Vector__XXX
 SG_ RCM_a059_eventSteeringAngle m59 : 45|14@0+ (0.1,-819.2) [-819.2|819.1] "deg" Vector__XXX
 SG_ RCM_a059_eventDriverBrakeApply m59 : 46|2@1+ (1,0) [0|2] "" Vector__XXX
 SG_ RCM_a059_eventAccelPedalPos m59 : 56|8@1+ (0.4,0) [0|101.6] "%" Vector__XXX
 SG_ RCM_a060_eventArmStatus m60 : 11|1@1+ (1,0) [0|1] "" Vector__XXX
 SG_ RCM_a060_eventFactoryMode m60 : 12|1@1+ (1,0) [0|1] "" Vector__XXX
 SG_ RCM_a060_eventDiagEnabled m60 : 13|1@1+ (1,0) [0|1] "" Vector__XXX
 SG_ RCM_a060_eventDriveOrientation m60 : 14|1@1+ (1,0) [0|1] "" Vector__XXX
 SG_ RCM_a060_seaTrkPosLeftShort m60 : 16|1@1+ (1,0) [0|1] "" Vector__XXX
 SG_ RCM_a060_seaTrkPosLeftShort2Bat m60 : 17|1@1+ (1,0) [0|1] "" Vector__XXX
 SG_ RCM_a060_seaTrkPosLeftOpen m60 : 18|1@1+ (1,0) [0|1] "" Vector__XXX
 SG_ RCM_a060_seaTrkPosLeftUndefined m60 : 19|1@1+ (1,0) [0|1] "" Vector__XXX
 SG_ RCM_a060_seaTrkPosLeftCrossCoup m60 : 20|1@1+ (1,0) [0|1] "" Vector__XXX
 SG_ RCM_a060_seaTrkPosLeftConfig m60 : 21|1@1+ (1,0) [0|1] "" Vector__XXX
 SG_ RCM_a060_eventIDFsignal m60 : 25|1@1+ (1,0) [0|1] "" Vector__XXX
 SG_ RCM_a060_eventFrontLeftSeatbelt m60 : 26|1@1+ (1,0) [0|1] "" Vector__XXX
 SG_ RCM_a060_eventFrontRightSeatbelt m60 : 27|1@1+ (1,0) [0|1] "" Vector__XXX
 SG_ RCM_a060_eventVehicleSpeed m60 : 28|12@1+ (0.08,-40) [-40|287.6] "kph" Vector__XXX
 SG_ RCM_a060_eventSteeringAngle m60 : 45|14@0+ (0.1,-819.2) [-819.2|819.1] "deg" Vector__XXX
 SG_ RCM_a060_eventDriverBrakeApply m60 : 46|2@1+ (1,0) [0|2] "" Vector__XXX
 SG_ RCM_a060_eventAccelPedalPos m60 : 56|8@1+ (0.4,0) [0|101.6] "%" Vector__XXX
 SG_ RCM_a061_eventArmStatus m61 : 11|1@1+ (1,0) [0|1] "" Vector__XXX
 SG_ RCM_a061_eventFactoryMode m61 : 12|1@1+ (1,0) [0|1] "" Vector__XXX
 SG_ RCM_a061_eventDiagEnabled m61 : 13|1@1+ (1,0) [0|1] "" Vector__XXX
 SG_ RCM_a061_eventDriveOrientation m61 : 14|1@1+ (1,0) [0|1] "" Vector__XXX
 SG_ RCM_a061_seaTrkPosRightShort m61 : 16|1@1+ (1,0) [0|1] "" Vector__XXX
 SG_ RCM_a061_seaTrkPosRightSht2Bat m61 : 17|1@1+ (1,0) [0|1] "" Vector__XXX
 SG_ RCM_a061_seaTrkPosRightOpen m61 : 18|1@1+ (1,0) [0|1] "" Vector__XXX
 SG_ RCM_a061_seaTrkPosRightUndefined m61 : 19|1@1+ (1,0) [0|1] "" Vector__XXX
 SG_ RCM_a061_seaTrkPosRightCrossCoup m61 : 20|1@1+ (1,0) [0|1] "" Vector__XXX
 SG_ RCM_a061_seaTrkPosRightConfig m61 : 21|1@1+ (1,0) [0|1] "" Vector__XXX
 SG_ RCM_a061_eventIDFsignal m61 : 25|1@1+ (1,0) [0|1] "" Vector__XXX
 SG_ RCM_a061_eventFrontLeftSeatbelt m61 : 26|1@1+ (1,0) [0|1] "" Vector__XXX
 SG_ RCM_a061_eventFrontRightSeatbelt m61 : 27|1@1+ (1,0) [0|1] "" Vector__XXX
 SG_ RCM_a061_eventVehicleSpeed m61 : 28|12@1+ (0.08,-40) [-40|287.6] "kph" Vector__XXX
 SG_ RCM_a061_eventSteeringAngle m61 : 45|14@0+ (0.1,-819.2) [-819.2|819.1] "deg" Vector__XXX
 SG_ RCM_a061_eventDriverBrakeApply m61 : 46|2@1+ (1,0) [0|2] "" Vector__XXX
 SG_ RCM_a061_eventAccelPedalPos m61 : 56|8@1+ (0.4,0) [0|101.6] "%" Vector__XXX
 SG_ RCM_a062_eventArmStatus m62 : 11|1@1+ (1,0) [0|1] "" Vector__XXX
 SG_ RCM_a062_eventFactoryMode m62 : 12|1@1+ (1,0) [0|1] "" Vector__XXX
 SG_ RCM_a062_eventDiagEnabled m62 : 13|1@1+ (1,0) [0|1] "" Vector__XXX
 SG_ RCM_a062_eventDriveOrientation m62 : 14|1@1+ (1,0) [0|1] "" Vector__XXX
 SG_ RCM_a062_alrShort m62 : 16|1@1+ (1,0) [0|1] "" Vector__XXX
 SG_ RCM_a062_alrSht2Bat m62 : 17|1@1+ (1,0) [0|1] "" Vector__XXX
 SG_ RCM_a062_alrOpen m62 : 18|1@1+ (1,0) [0|1] "" Vector__XXX
 SG_ RCM_a062_alrUndefined m62 : 19|1@1+ (1,0) [0|1] "" Vector__XXX
 SG_ RCM_a062_alrCrossCoup m62 : 20|1@1+ (1,0) [0|1] "" Vector__XXX
 SG_ RCM_a062_alrConfig m62 : 21|1@1+ (1,0) [0|1] "" Vector__XXX
 SG_ RCM_a062_eventIDFsignal m62 : 25|1@1+ (1,0) [0|1] "" Vector__XXX
 SG_ RCM_a062_eventFrontLeftSeatbelt m62 : 26|1@1+ (1,0) [0|1] "" Vector__XXX
 SG_ RCM_a062_eventFrontRightSeatbelt m62 : 27|1@1+ (1,0) [0|1] "" Vector__XXX
 SG_ RCM_a062_eventVehicleSpeed m62 : 28|12@1+ (0.08,-40) [-40|287.6] "kph" Vector__XXX
 SG_ RCM_a062_eventSteeringAngle m62 : 45|14@0+ (0.1,-819.2) [-819.2|819.1] "deg" Vector__XXX
 SG_ RCM_a062_eventDriverBrakeApply m62 : 46|2@1+ (1,0) [0|2] "" Vector__XXX
 SG_ RCM_a062_eventAccelPedalPos m62 : 56|8@1+ (0.4,0) [0|101.6] "%" Vector__XXX
 SG_ RCM_a063_eventArmStatus m63 : 11|1@1+ (1,0) [0|1] "" Vector__XXX
 SG_ RCM_a063_eventFactoryMode m63 : 12|1@1+ (1,0) [0|1] "" Vector__XXX
 SG_ RCM_a063_eventDiagEnabled m63 : 13|1@1+ (1,0) [0|1] "" Vector__XXX
 SG_ RCM_a063_eventDriveOrientation m63 : 14|1@1+ (1,0) [0|1] "" Vector__XXX
 SG_ RCM_a063_sbsw2ndRowRSht2Gnd m63 : 16|1@1+ (1,0) [0|1] "" Vector__XXX
 SG_ RCM_a063_sbsw2ndRowRSht2Bat m63 : 17|1@1+ (1,0) [0|1] "" Vector__XXX
 SG_ RCM_a063_sbsw2ndRowROpen m63 : 18|1@1+ (1,0) [0|1] "" Vector__XXX
 SG_ RCM_a063_sbsw2ndRowRUndefined m63 : 19|1@1+ (1,0) [0|1] "" Vector__XXX
 SG_ RCM_a063_sbsw2ndRowRCrossCoup m63 : 20|1@1+ (1,0) [0|1] "" Vector__XXX
 SG_ RCM_a063_sbsw2ndRowRConfig m63 : 21|1@1+ (1,0) [0|1] "" Vector__XXX
 SG_ RCM_a063_eventIDFsignal m63 : 25|1@1+ (1,0) [0|1] "" Vector__XXX
 SG_ RCM_a063_eventFrontLeftSeatbelt m63 : 26|1@1+ (1,0) [0|1] "" Vector__XXX
 SG_ RCM_a063_eventFrontRightSeatbelt m63 : 27|1@1+ (1,0) [0|1] "" Vector__XXX
 SG_ RCM_a063_eventVehicleSpeed m63 : 28|12@1+ (0.08,-40) [-40|287.6] "kph" Vector__XXX
 SG_ RCM_a063_eventSteeringAngle m63 : 45|14@0+ (0.1,-819.2) [-819.2|819.1] "deg" Vector__XXX
 SG_ RCM_a063_eventDriverBrakeApply m63 : 46|2@1+ (1,0) [0|2] "" Vector__XXX
 SG_ RCM_a063_eventAccelPedalPos m63 : 56|8@1+ (0.4,0) [0|101.6] "%" Vector__XXX
 SG_ RCM_a064_eventArmStatus m64 : 11|1@1+ (1,0) [0|1] "" Vector__XXX
 SG_ RCM_a064_eventFactoryMode m64 : 12|1@1+ (1,0) [0|1] "" Vector__XXX
 SG_ RCM_a064_eventDiagEnabled m64 : 13|1@1+ (1,0) [0|1] "" Vector__XXX
 SG_ RCM_a064_eventDriveOrientation m64 : 14|1@1+ (1,0) [0|1] "" Vector__XXX
 SG_ RCM_a064_hwcp1CheckFail m64 : 16|1@1+ (1,0) [0|1] "" Vector__XXX
 SG_ RCM_a064_hwcp1Sht2Bat m64 : 17|1@1+ (1,0) [0|1] "" Vector__XXX
 SG_ RCM_a064_hwcp1CrossCoup m64 : 18|1@1+ (1,0) [0|1] "" Vector__XXX
 SG_ RCM_a064_hwcp1Config m64 : 19|1@1+ (1,0) [0|1] "" Vector__XXX
 SG_ RCM_a064_eventIDFsignal m64 : 25|1@1+ (1,0) [0|1] "" Vector__XXX
 SG_ RCM_a064_eventFrontLeftSeatbelt m64 : 26|1@1+ (1,0) [0|1] "" Vector__XXX
 SG_ RCM_a064_eventFrontRightSeatbelt m64 : 27|1@1+ (1,0) [0|1] "" Vector__XXX
 SG_ RCM_a064_eventVehicleSpeed m64 : 28|12@1+ (0.08,-40) [-40|287.6] "kph" Vector__XXX
 SG_ RCM_a064_eventSteeringAngle m64 : 45|14@0+ (0.1,-819.2) [-819.2|819.1] "deg" Vector__XXX
 SG_ RCM_a064_eventDriverBrakeApply m64 : 46|2@1+ (1,0) [0|2] "" Vector__XXX
 SG_ RCM_a064_eventAccelPedalPos m64 : 56|8@1+ (0.4,0) [0|101.6] "%" Vector__XXX
 SG_ RCM_a065_eventArmStatus m65 : 11|1@1+ (1,0) [0|1] "" Vector__XXX
 SG_ RCM_a065_eventFactoryMode m65 : 12|1@1+ (1,0) [0|1] "" Vector__XXX
 SG_ RCM_a065_eventDiagEnabled m65 : 13|1@1+ (1,0) [0|1] "" Vector__XXX
 SG_ RCM_a065_eventDriveOrientation m65 : 14|1@1+ (1,0) [0|1] "" Vector__XXX
 SG_ RCM_a065_swDrvrOrientCheck m65 : 16|1@1+ (1,0) [0|1] "" Vector__XXX
 SG_ RCM_a065_swDrvrOrientSht2Bat m65 : 17|1@1+ (1,0) [0|1] "" Vector__XXX
 SG_ RCM_a065_swDrvrOrientCrossCoup m65 : 18|1@1+ (1,0) [0|1] "" Vector__XXX
 SG_ RCM_a065_swDrvrOrientConfig m65 : 19|1@1+ (1,0) [0|1] "" Vector__XXX
 SG_ RCM_a065_eventIDFsignal m65 : 25|1@1+ (1,0) [0|1] "" Vector__XXX
 SG_ RCM_a065_eventFrontLeftSeatbelt m65 : 26|1@1+ (1,0) [0|1] "" Vector__XXX
 SG_ RCM_a065_eventFrontRightSeatbelt m65 : 27|1@1+ (1,0) [0|1] "" Vector__XXX
 SG_ RCM_a065_eventVehicleSpeed m65 : 28|12@1+ (0.08,-40) [-40|287.6] "kph" Vector__XXX
 SG_ RCM_a065_eventSteeringAngle m65 : 45|14@0+ (0.1,-819.2) [-819.2|819.1] "deg" Vector__XXX
 SG_ RCM_a065_eventDriverBrakeApply m65 : 46|2@1+ (1,0) [0|2] "" Vector__XXX
 SG_ RCM_a065_eventAccelPedalPos m65 : 56|8@1+ (0.4,0) [0|101.6] "%" Vector__XXX
 SG_ RCM_a066_eventArmStatus m66 : 11|1@1+ (1,0) [0|1] "" Vector__XXX
 SG_ RCM_a066_eventFactoryMode m66 : 12|1@1+ (1,0) [0|1] "" Vector__XXX
 SG_ RCM_a066_eventDiagEnabled m66 : 13|1@1+ (1,0) [0|1] "" Vector__XXX
 SG_ RCM_a066_eventDriveOrientation m66 : 14|1@1+ (1,0) [0|1] "" Vector__XXX
 SG_ RCM_a066_sbsw2ndRowLShort m66 : 16|1@1+ (1,0) [0|1] "" Vector__XXX
 SG_ RCM_a066_sbsw2ndRowLSht2Bat m66 : 17|1@1+ (1,0) [0|1] "" Vector__XXX
 SG_ RCM_a066_sbsw2ndRowLCrossCoup m66 : 18|1@1+ (1,0) [0|1] "" Vector__XXX
 SG_ RCM_a066_sbsw2ndRowLConfig m66 : 19|1@1+ (1,0) [0|1] "" Vector__XXX
 SG_ RCM_a066_eventIDFsignal m66 : 25|1@1+ (1,0) [0|1] "" Vector__XXX
 SG_ RCM_a066_eventFrontLeftSeatbelt m66 : 26|1@1+ (1,0) [0|1] "" Vector__XXX
 SG_ RCM_a066_eventFrontRightSeatbelt m66 : 27|1@1+ (1,0) [0|1] "" Vector__XXX
 SG_ RCM_a066_eventVehicleSpeed m66 : 28|12@1+ (0.08,-40) [-40|287.6] "kph" Vector__XXX
 SG_ RCM_a066_eventSteeringAngle m66 : 45|14@0+ (0.1,-819.2) [-819.2|819.1] "deg" Vector__XXX
 SG_ RCM_a066_eventDriverBrakeApply m66 : 46|2@1+ (1,0) [0|2] "" Vector__XXX
 SG_ RCM_a066_eventAccelPedalPos m66 : 56|8@1+ (0.4,0) [0|101.6] "%" Vector__XXX
 SG_ RCM_a067_eventArmStatus m67 : 11|1@1+ (1,0) [0|1] "" Vector__XXX
 SG_ RCM_a067_eventFactoryMode m67 : 12|1@1+ (1,0) [0|1] "" Vector__XXX
 SG_ RCM_a067_eventDiagEnabled m67 : 13|1@1+ (1,0) [0|1] "" Vector__XXX
 SG_ RCM_a067_eventDriveOrientation m67 : 14|1@1+ (1,0) [0|1] "" Vector__XXX
 SG_ RCM_a067_comCANInitialization m67 : 16|1@1+ (1,0) [0|1] "" Vector__XXX
 SG_ RCM_a067_eventIDFsignal m67 : 25|1@1+ (1,0) [0|1] "" Vector__XXX
 SG_ RCM_a067_eventFrontLeftSeatbelt m67 : 26|1@1+ (1,0) [0|1] "" Vector__XXX
 SG_ RCM_a067_eventFrontRightSeatbelt m67 : 27|1@1+ (1,0) [0|1] "" Vector__XXX
 SG_ RCM_a067_eventVehicleSpeed m67 : 28|12@1+ (0.08,-40) [-40|287.6] "kph" Vector__XXX
 SG_ RCM_a067_eventSteeringAngle m67 : 45|14@0+ (0.1,-819.2) [-819.2|819.1] "deg" Vector__XXX
 SG_ RCM_a067_eventDriverBrakeApply m67 : 46|2@1+ (1,0) [0|2] "" Vector__XXX
 SG_ RCM_a067_eventAccelPedalPos m67 : 56|8@1+ (0.4,0) [0|101.6] "%" Vector__XXX
 SG_ RCM_a068_eventArmStatus m68 : 11|1@1+ (1,0) [0|1] "" Vector__XXX
 SG_ RCM_a068_eventFactoryMode m68 : 12|1@1+ (1,0) [0|1] "" Vector__XXX
 SG_ RCM_a068_eventDiagEnabled m68 : 13|1@1+ (1,0) [0|1] "" Vector__XXX
 SG_ RCM_a068_eventDriveOrientation m68 : 14|1@1+ (1,0) [0|1] "" Vector__XXX
 SG_ RCM_a068_comChassisCANBusOff m68 : 16|1@1+ (1,0) [0|1] "" Vector__XXX
 SG_ RCM_a068_eventIDFsignal m68 : 25|1@1+ (1,0) [0|1] "" Vector__XXX
 SG_ RCM_a068_eventFrontLeftSeatbelt m68 : 26|1@1+ (1,0) [0|1] "" Vector__XXX
 SG_ RCM_a068_eventFrontRightSeatbelt m68 : 27|1@1+ (1,0) [0|1] "" Vector__XXX
 SG_ RCM_a068_eventVehicleSpeed m68 : 28|12@1+ (0.08,-40) [-40|287.6] "kph" Vector__XXX
 SG_ RCM_a068_eventSteeringAngle m68 : 45|14@0+ (0.1,-819.2) [-819.2|819.1] "deg" Vector__XXX
 SG_ RCM_a068_eventDriverBrakeApply m68 : 46|2@1+ (1,0) [0|2] "" Vector__XXX
 SG_ RCM_a068_eventAccelPedalPos m68 : 56|8@1+ (0.4,0) [0|101.6] "%" Vector__XXX
 SG_ RCM_a069_eventArmStatus m69 : 11|1@1+ (1,0) [0|1] "" Vector__XXX
 SG_ RCM_a069_eventFactoryMode m69 : 12|1@1+ (1,0) [0|1] "" Vector__XXX
 SG_ RCM_a069_eventDiagEnabled m69 : 13|1@1+ (1,0) [0|1] "" Vector__XXX
 SG_ RCM_a069_eventDriveOrientation m69 : 14|1@1+ (1,0) [0|1] "" Vector__XXX
 SG_ RCM_a069_comChassisCANPH7MIA m69 : 16|1@1+ (1,0) [0|1] "" Vector__XXX
 SG_ RCM_a069_comChassisCANPH7ChkSm m69 : 17|1@1+ (1,0) [0|1] "" Vector__XXX
 SG_ RCM_a069_comChassisCANPH7Cntr m69 : 18|1@1+ (1,0) [0|1] "" Vector__XXX
 SG_ RCM_a069_eventIDFsignal m69 : 25|1@1+ (1,0) [0|1] "" Vector__XXX
 SG_ RCM_a069_eventFrontLeftSeatbelt m69 : 26|1@1+ (1,0) [0|1] "" Vector__XXX
 SG_ RCM_a069_eventFrontRightSeatbelt m69 : 27|1@1+ (1,0) [0|1] "" Vector__XXX
 SG_ RCM_a069_eventVehicleSpeed m69 : 28|12@1+ (0.08,-40) [-40|287.6] "kph" Vector__XXX
 SG_ RCM_a069_eventSteeringAngle m69 : 45|14@0+ (0.1,-819.2) [-819.2|819.1] "deg" Vector__XXX
 SG_ RCM_a069_eventDriverBrakeApply m69 : 46|2@1+ (1,0) [0|2] "" Vector__XXX
 SG_ RCM_a069_eventAccelPedalPos m69 : 56|8@1+ (0.4,0) [0|101.6] "%" Vector__XXX
 SG_ RCM_a070_eventArmStatus m70 : 11|1@1+ (1,0) [0|1] "" Vector__XXX
 SG_ RCM_a070_eventFactoryMode m70 : 12|1@1+ (1,0) [0|1] "" Vector__XXX
 SG_ RCM_a070_eventDiagEnabled m70 : 13|1@1+ (1,0) [0|1] "" Vector__XXX
 SG_ RCM_a070_eventDriveOrientation m70 : 14|1@1+ (1,0) [0|1] "" Vector__XXX
 SG_ RCM_a070_comChassisCANPH8MIA m70 : 16|1@1+ (1,0) [0|1] "" Vector__XXX
 SG_ RCM_a070_comChassisCANPH8ChkSm m70 : 17|1@1+ (1,0) [0|1] "" Vector__XXX
 SG_ RCM_a070_comChassisCANPH8Cntr m70 : 18|1@1+ (1,0) [0|1] "" Vector__XXX
 SG_ RCM_a070_eventIDFsignal m70 : 25|1@1+ (1,0) [0|1] "" Vector__XXX
 SG_ RCM_a070_eventFrontLeftSeatbelt m70 : 26|1@1+ (1,0) [0|1] "" Vector__XXX
 SG_ RCM_a070_eventFrontRightSeatbelt m70 : 27|1@1+ (1,0) [0|1] "" Vector__XXX
 SG_ RCM_a070_eventVehicleSpeed m70 : 28|12@1+ (0.08,-40) [-40|287.6] "kph" Vector__XXX
 SG_ RCM_a070_eventSteeringAngle m70 : 45|14@0+ (0.1,-819.2) [-819.2|819.1] "deg" Vector__XXX
 SG_ RCM_a070_eventDriverBrakeApply m70 : 46|2@1+ (1,0) [0|2] "" Vector__XXX
 SG_ RCM_a070_eventAccelPedalPos m70 : 56|8@1+ (0.4,0) [0|101.6] "%" Vector__XXX
 SG_ RCM_a071_eventArmStatus m71 : 11|1@1+ (1,0) [0|1] "" Vector__XXX
 SG_ RCM_a071_eventFactoryMode m71 : 12|1@1+ (1,0) [0|1] "" Vector__XXX
 SG_ RCM_a071_eventDiagEnabled m71 : 13|1@1+ (1,0) [0|1] "" Vector__XXX
 SG_ RCM_a071_eventDriveOrientation m71 : 14|1@1+ (1,0) [0|1] "" Vector__XXX
 SG_ RCM_a071_comChassisCANPH9MIA m71 : 16|1@1+ (1,0) [0|1] "" Vector__XXX
 SG_ RCM_a071_comChassisCANPH9ChkSm m71 : 17|1@1+ (1,0) [0|1] "" Vector__XXX
 SG_ RCM_a071_comChassisCANPH9Cntr m71 : 18|1@1+ (1,0) [0|1] "" Vector__XXX
 SG_ RCM_a071_eventIDFsignal m71 : 25|1@1+ (1,0) [0|1] "" Vector__XXX
 SG_ RCM_a071_eventFrontLeftSeatbelt m71 : 26|1@1+ (1,0) [0|1] "" Vector__XXX
 SG_ RCM_a071_eventFrontRightSeatbelt m71 : 27|1@1+ (1,0) [0|1] "" Vector__XXX
 SG_ RCM_a071_eventVehicleSpeed m71 : 28|12@1+ (0.08,-40) [-40|287.6] "kph" Vector__XXX
 SG_ RCM_a071_eventSteeringAngle m71 : 45|14@0+ (0.1,-819.2) [-819.2|819.1] "deg" Vector__XXX
 SG_ RCM_a071_eventDriverBrakeApply m71 : 46|2@1+ (1,0) [0|2] "" Vector__XXX
 SG_ RCM_a071_eventAccelPedalPos m71 : 56|8@1+ (0.4,0) [0|101.6] "%" Vector__XXX
 SG_ RCM_a072_eventArmStatus m72 : 11|1@1+ (1,0) [0|1] "" Vector__XXX
 SG_ RCM_a072_eventFactoryMode m72 : 12|1@1+ (1,0) [0|1] "" Vector__XXX
 SG_ RCM_a072_eventDiagEnabled m72 : 13|1@1+ (1,0) [0|1] "" Vector__XXX
 SG_ RCM_a072_eventDriveOrientation m72 : 14|1@1+ (1,0) [0|1] "" Vector__XXX
 SG_ RCM_a072_comUnusedMIA m72 : 16|1@1+ (1,0) [0|1] "" Vector__XXX
 SG_ RCM_a072_comUnusedChkSm m72 : 17|1@1+ (1,0) [0|1] "" Vector__XXX
 SG_ RCM_a072_comUnusedCntr m72 : 18|1@1+ (1,0) [0|1] "" Vector__XXX
 SG_ RCM_a072_eventIDFsignal m72 : 25|1@1+ (1,0) [0|1] "" Vector__XXX
 SG_ RCM_a072_eventFrontLeftSeatbelt m72 : 26|1@1+ (1,0) [0|1] "" Vector__XXX
 SG_ RCM_a072_eventFrontRightSeatbelt m72 : 27|1@1+ (1,0) [0|1] "" Vector__XXX
 SG_ RCM_a072_eventVehicleSpeed m72 : 28|12@1+ (0.08,-40) [-40|287.6] "kph" Vector__XXX
 SG_ RCM_a072_eventSteeringAngle m72 : 45|14@0+ (0.1,-819.2) [-819.2|819.1] "deg" Vector__XXX
 SG_ RCM_a072_eventDriverBrakeApply m72 : 46|2@1+ (1,0) [0|2] "" Vector__XXX
 SG_ RCM_a072_eventAccelPedalPos m72 : 56|8@1+ (0.4,0) [0|101.6] "%" Vector__XXX
 SG_ RCM_a073_eventArmStatus m73 : 11|1@1+ (1,0) [0|1] "" Vector__XXX
 SG_ RCM_a073_eventFactoryMode m73 : 12|1@1+ (1,0) [0|1] "" Vector__XXX
 SG_ RCM_a073_eventDiagEnabled m73 : 13|1@1+ (1,0) [0|1] "" Vector__XXX
 SG_ RCM_a073_eventDriveOrientation m73 : 14|1@1+ (1,0) [0|1] "" Vector__XXX
 SG_ RCM_a073_comChassisCANPH4MIA m73 : 16|1@1+ (1,0) [0|1] "" Vector__XXX
 SG_ RCM_a073_comChassisCANPH4ChkSm m73 : 17|1@1+ (1,0) [0|1] "" Vector__XXX
 SG_ RCM_a073_comChassisCANPH4Cntr m73 : 18|1@1+ (1,0) [0|1] "" Vector__XXX
 SG_ RCM_a073_eventIDFsignal m73 : 25|1@1+ (1,0) [0|1] "" Vector__XXX
 SG_ RCM_a073_eventFrontLeftSeatbelt m73 : 26|1@1+ (1,0) [0|1] "" Vector__XXX
 SG_ RCM_a073_eventFrontRightSeatbelt m73 : 27|1@1+ (1,0) [0|1] "" Vector__XXX
 SG_ RCM_a073_eventVehicleSpeed m73 : 28|12@1+ (0.08,-40) [-40|287.6] "kph" Vector__XXX
 SG_ RCM_a073_eventSteeringAngle m73 : 45|14@0+ (0.1,-819.2) [-819.2|819.1] "deg" Vector__XXX
 SG_ RCM_a073_eventDriverBrakeApply m73 : 46|2@1+ (1,0) [0|2] "" Vector__XXX
 SG_ RCM_a073_eventAccelPedalPos m73 : 56|8@1+ (0.4,0) [0|101.6] "%" Vector__XXX
 SG_ RCM_a074_eventArmStatus m74 : 11|1@1+ (1,0) [0|1] "" Vector__XXX
 SG_ RCM_a074_eventFactoryMode m74 : 12|1@1+ (1,0) [0|1] "" Vector__XXX
 SG_ RCM_a074_eventDiagEnabled m74 : 13|1@1+ (1,0) [0|1] "" Vector__XXX
 SG_ RCM_a074_eventDriveOrientation m74 : 14|1@1+ (1,0) [0|1] "" Vector__XXX
 SG_ RCM_a074_comChassisCANPH5MIA m74 : 16|1@1+ (1,0) [0|1] "" Vector__XXX
 SG_ RCM_a074_comChassisCANPH5ChkSm m74 : 17|1@1+ (1,0) [0|1] "" Vector__XXX
 SG_ RCM_a074_comChassisCANPH5Cntr m74 : 18|1@1+ (1,0) [0|1] "" Vector__XXX
 SG_ RCM_a074_eventIDFsignal m74 : 25|1@1+ (1,0) [0|1] "" Vector__XXX
 SG_ RCM_a074_eventFrontLeftSeatbelt m74 : 26|1@1+ (1,0) [0|1] "" Vector__XXX
 SG_ RCM_a074_eventFrontRightSeatbelt m74 : 27|1@1+ (1,0) [0|1] "" Vector__XXX
 SG_ RCM_a074_eventVehicleSpeed m74 : 28|12@1+ (0.08,-40) [-40|287.6] "kph" Vector__XXX
 SG_ RCM_a074_eventSteeringAngle m74 : 45|14@0+ (0.1,-819.2) [-819.2|819.1] "deg" Vector__XXX
 SG_ RCM_a074_eventDriverBrakeApply m74 : 46|2@1+ (1,0) [0|2] "" Vector__XXX
 SG_ RCM_a074_eventAccelPedalPos m74 : 56|8@1+ (0.4,0) [0|101.6] "%" Vector__XXX
 SG_ RCM_a075_eventArmStatus m75 : 11|1@1+ (1,0) [0|1] "" Vector__XXX
 SG_ RCM_a075_eventFactoryMode m75 : 12|1@1+ (1,0) [0|1] "" Vector__XXX
 SG_ RCM_a075_eventDiagEnabled m75 : 13|1@1+ (1,0) [0|1] "" Vector__XXX
 SG_ RCM_a075_eventDriveOrientation m75 : 14|1@1+ (1,0) [0|1] "" Vector__XXX
 SG_ RCM_a075_comChassisCANPH6MIA m75 : 16|1@1+ (1,0) [0|1] "" Vector__XXX
 SG_ RCM_a075_comChassisCANPH6ChkSm m75 : 17|1@1+ (1,0) [0|1] "" Vector__XXX
 SG_ RCM_a075_comChassisCANPH6Cntr m75 : 18|1@1+ (1,0) [0|1] "" Vector__XXX
 SG_ RCM_a075_eventIDFsignal m75 : 25|1@1+ (1,0) [0|1] "" Vector__XXX
 SG_ RCM_a075_eventFrontLeftSeatbelt m75 : 26|1@1+ (1,0) [0|1] "" Vector__XXX
 SG_ RCM_a075_eventFrontRightSeatbelt m75 : 27|1@1+ (1,0) [0|1] "" Vector__XXX
 SG_ RCM_a075_eventVehicleSpeed m75 : 28|12@1+ (0.08,-40) [-40|287.6] "kph" Vector__XXX
 SG_ RCM_a075_eventSteeringAngle m75 : 45|14@0+ (0.1,-819.2) [-819.2|819.1] "deg" Vector__XXX
 SG_ RCM_a075_eventDriverBrakeApply m75 : 46|2@1+ (1,0) [0|2] "" Vector__XXX
 SG_ RCM_a075_eventAccelPedalPos m75 : 56|8@1+ (0.4,0) [0|101.6] "%" Vector__XXX
 SG_ RCM_a078_eventArmStatus m78 : 11|1@1+ (1,0) [0|1] "" Vector__XXX
 SG_ RCM_a078_eventFactoryMode m78 : 12|1@1+ (1,0) [0|1] "" Vector__XXX
 SG_ RCM_a078_eventDiagEnabled m78 : 13|1@1+ (1,0) [0|1] "" Vector__XXX
 SG_ RCM_a078_eventDriveOrientation m78 : 14|1@1+ (1,0) [0|1] "" Vector__XXX
 SG_ RCM_a078_comOCS1PMIA m78 : 16|1@1+ (1,0) [0|1] "" Vector__XXX
 SG_ RCM_a078_comOCS1PChkSm m78 : 17|1@1+ (1,0) [0|1] "" Vector__XXX
 SG_ RCM_a078_comOCS1PCntr m78 : 18|1@1+ (1,0) [0|1] "" Vector__XXX
 SG_ RCM_a078_eventIDFsignal m78 : 25|1@1+ (1,0) [0|1] "" Vector__XXX
 SG_ RCM_a078_eventFrontLeftSeatbelt m78 : 26|1@1+ (1,0) [0|1] "" Vector__XXX
 SG_ RCM_a078_eventFrontRightSeatbelt m78 : 27|1@1+ (1,0) [0|1] "" Vector__XXX
 SG_ RCM_a078_eventVehicleSpeed m78 : 28|12@1+ (0.08,-40) [-40|287.6] "kph" Vector__XXX
 SG_ RCM_a078_eventSteeringAngle m78 : 45|14@0+ (0.1,-819.2) [-819.2|819.1] "deg" Vector__XXX
 SG_ RCM_a078_eventDriverBrakeApply m78 : 46|2@1+ (1,0) [0|2] "" Vector__XXX
 SG_ RCM_a078_eventAccelPedalPos m78 : 56|8@1+ (0.4,0) [0|101.6] "%" Vector__XXX
 SG_ RCM_a079_eventArmStatus m79 : 11|1@1+ (1,0) [0|1] "" Vector__XXX
 SG_ RCM_a079_eventFactoryMode m79 : 12|1@1+ (1,0) [0|1] "" Vector__XXX
 SG_ RCM_a079_eventDiagEnabled m79 : 13|1@1+ (1,0) [0|1] "" Vector__XXX
 SG_ RCM_a079_eventDriveOrientation m79 : 14|1@1+ (1,0) [0|1] "" Vector__XXX
 SG_ RCM_a079_comOCS1DMIA m79 : 16|1@1+ (1,0) [0|1] "" Vector__XXX
 SG_ RCM_a079_comOCS1DChkSm m79 : 17|1@1+ (1,0) [0|1] "" Vector__XXX
 SG_ RCM_a079_comOCS1DCntr m79 : 18|1@1+ (1,0) [0|1] "" Vector__XXX
 SG_ RCM_a079_eventIDFsignal m79 : 25|1@1+ (1,0) [0|1] "" Vector__XXX
 SG_ RCM_a079_eventFrontLeftSeatbelt m79 : 26|1@1+ (1,0) [0|1] "" Vector__XXX
 SG_ RCM_a079_eventFrontRightSeatbelt m79 : 27|1@1+ (1,0) [0|1] "" Vector__XXX
 SG_ RCM_a079_eventVehicleSpeed m79 : 28|12@1+ (0.08,-40) [-40|287.6] "kph" Vector__XXX
 SG_ RCM_a079_eventSteeringAngle m79 : 45|14@0+ (0.1,-819.2) [-819.2|819.1] "deg" Vector__XXX
 SG_ RCM_a079_eventDriverBrakeApply m79 : 46|2@1+ (1,0) [0|2] "" Vector__XXX
 SG_ RCM_a079_eventAccelPedalPos m79 : 56|8@1+ (0.4,0) [0|101.6] "%" Vector__XXX
 SG_ RCM_a080_eventArmStatus m80 : 11|1@1+ (1,0) [0|1] "" Vector__XXX
 SG_ RCM_a080_eventFactoryMode m80 : 12|1@1+ (1,0) [0|1] "" Vector__XXX
 SG_ RCM_a080_eventDiagEnabled m80 : 13|1@1+ (1,0) [0|1] "" Vector__XXX
 SG_ RCM_a080_eventDriveOrientation m80 : 14|1@1+ (1,0) [0|1] "" Vector__XXX
 SG_ RCM_a080_comGTWACSMIA m80 : 16|1@1+ (1,0) [0|1] "" Vector__XXX
 SG_ RCM_a080_comGTWACSChkSm m80 : 17|1@1+ (1,0) [0|1] "" Vector__XXX
 SG_ RCM_a080_comGTWACSCntr m80 : 18|1@1+ (1,0) [0|1] "" Vector__XXX
 SG_ RCM_a080_eventIDFsignal m80 : 25|1@1+ (1,0) [0|1] "" Vector__XXX
 SG_ RCM_a080_eventFrontLeftSeatbelt m80 : 26|1@1+ (1,0) [0|1] "" Vector__XXX
 SG_ RCM_a080_eventFrontRightSeatbelt m80 : 27|1@1+ (1,0) [0|1] "" Vector__XXX
 SG_ RCM_a080_eventVehicleSpeed m80 : 28|12@1+ (0.08,-40) [-40|287.6] "kph" Vector__XXX
 SG_ RCM_a080_eventSteeringAngle m80 : 45|14@0+ (0.1,-819.2) [-819.2|819.1] "deg" Vector__XXX
 SG_ RCM_a080_eventDriverBrakeApply m80 : 46|2@1+ (1,0) [0|2] "" Vector__XXX
 SG_ RCM_a080_eventAccelPedalPos m80 : 56|8@1+ (0.4,0) [0|101.6] "%" Vector__XXX
 SG_ RCM_a083_eventArmStatus m83 : 11|1@1+ (1,0) [0|1] "" Vector__XXX
 SG_ RCM_a083_eventFactoryMode m83 : 12|1@1+ (1,0) [0|1] "" Vector__XXX
 SG_ RCM_a083_eventDiagEnabled m83 : 13|1@1+ (1,0) [0|1] "" Vector__XXX
 SG_ RCM_a083_eventDriveOrientation m83 : 14|1@1+ (1,0) [0|1] "" Vector__XXX
 SG_ RCM_a083_comGTWCarStateMIA m83 : 16|1@1+ (1,0) [0|1] "" Vector__XXX
 SG_ RCM_a083_eventIDFsignal m83 : 25|1@1+ (1,0) [0|1] "" Vector__XXX
 SG_ RCM_a083_eventFrontLeftSeatbelt m83 : 26|1@1+ (1,0) [0|1] "" Vector__XXX
 SG_ RCM_a083_eventFrontRightSeatbelt m83 : 27|1@1+ (1,0) [0|1] "" Vector__XXX
 SG_ RCM_a083_eventVehicleSpeed m83 : 28|12@1+ (0.08,-40) [-40|287.6] "kph" Vector__XXX
 SG_ RCM_a083_eventSteeringAngle m83 : 45|14@0+ (0.1,-819.2) [-819.2|819.1] "deg" Vector__XXX
 SG_ RCM_a083_eventDriverBrakeApply m83 : 46|2@1+ (1,0) [0|2] "" Vector__XXX
 SG_ RCM_a083_eventAccelPedalPos m83 : 56|8@1+ (0.4,0) [0|101.6] "%" Vector__XXX
 SG_ RCM_a087_eventArmStatus m87 : 11|1@1+ (1,0) [0|1] "" Vector__XXX
 SG_ RCM_a087_eventFactoryMode m87 : 12|1@1+ (1,0) [0|1] "" Vector__XXX
 SG_ RCM_a087_eventDiagEnabled m87 : 13|1@1+ (1,0) [0|1] "" Vector__XXX
 SG_ RCM_a087_eventDriveOrientation m87 : 14|1@1+ (1,0) [0|1] "" Vector__XXX
 SG_ RCM_a087_comChassisCANSilent m87 : 16|1@1+ (1,0) [0|1] "" Vector__XXX
 SG_ RCM_a087_comPARTYCANSilent m87 : 17|1@1+ (1,0) [0|1] "" Vector__XXX
 SG_ RCM_a087_comUnusedCANSilent m87 : 18|1@1+ (1,0) [0|1] "" Vector__XXX
 SG_ RCM_a087_eventIDFsignal m87 : 25|1@1+ (1,0) [0|1] "" Vector__XXX
 SG_ RCM_a087_eventFrontLeftSeatbelt m87 : 26|1@1+ (1,0) [0|1] "" Vector__XXX
 SG_ RCM_a087_eventFrontRightSeatbelt m87 : 27|1@1+ (1,0) [0|1] "" Vector__XXX
 SG_ RCM_a087_eventVehicleSpeed m87 : 28|12@1+ (0.08,-40) [-40|287.6] "kph" Vector__XXX
 SG_ RCM_a087_eventSteeringAngle m87 : 45|14@0+ (0.1,-819.2) [-819.2|819.1] "deg" Vector__XXX
 SG_ RCM_a087_eventDriverBrakeApply m87 : 46|2@1+ (1,0) [0|2] "" Vector__XXX
 SG_ RCM_a087_eventAccelPedalPos m87 : 56|8@1+ (0.4,0) [0|101.6] "%" Vector__XXX
 SG_ RCM_a088_eventArmStatus m88 : 11|1@1+ (1,0) [0|1] "" Vector__XXX
 SG_ RCM_a088_eventFactoryMode m88 : 12|1@1+ (1,0) [0|1] "" Vector__XXX
 SG_ RCM_a088_eventDiagEnabled m88 : 13|1@1+ (1,0) [0|1] "" Vector__XXX
 SG_ RCM_a088_eventDriveOrientation m88 : 14|1@1+ (1,0) [0|1] "" Vector__XXX
 SG_ RCM_a088_comChassisCANPH2MIA m88 : 16|1@1+ (1,0) [0|1] "" Vector__XXX
 SG_ RCM_a088_comChassisCANPH2ChkSm m88 : 17|1@1+ (1,0) [0|1] "" Vector__XXX
 SG_ RCM_a088_comChassisCANPH2Cntr m88 : 18|1@1+ (1,0) [0|1] "" Vector__XXX
 SG_ RCM_a088_eventIDFsignal m88 : 25|1@1+ (1,0) [0|1] "" Vector__XXX
 SG_ RCM_a088_eventFrontLeftSeatbelt m88 : 26|1@1+ (1,0) [0|1] "" Vector__XXX
 SG_ RCM_a088_eventFrontRightSeatbelt m88 : 27|1@1+ (1,0) [0|1] "" Vector__XXX
 SG_ RCM_a088_eventVehicleSpeed m88 : 28|12@1+ (0.08,-40) [-40|287.6] "kph" Vector__XXX
 SG_ RCM_a088_eventSteeringAngle m88 : 45|14@0+ (0.1,-819.2) [-819.2|819.1] "deg" Vector__XXX
 SG_ RCM_a088_eventDriverBrakeApply m88 : 46|2@1+ (1,0) [0|2] "" Vector__XXX
 SG_ RCM_a088_eventAccelPedalPos m88 : 56|8@1+ (0.4,0) [0|101.6] "%" Vector__XXX
 SG_ RCM_a089_eventArmStatus m89 : 11|1@1+ (1,0) [0|1] "" Vector__XXX
 SG_ RCM_a089_eventFactoryMode m89 : 12|1@1+ (1,0) [0|1] "" Vector__XXX
 SG_ RCM_a089_eventDiagEnabled m89 : 13|1@1+ (1,0) [0|1] "" Vector__XXX
 SG_ RCM_a089_eventDriveOrientation m89 : 14|1@1+ (1,0) [0|1] "" Vector__XXX
 SG_ RCM_a089_comChassisCANPH3MIA m89 : 16|1@1+ (1,0) [0|1] "" Vector__XXX
 SG_ RCM_a089_comChassisCANPH3ChkSm m89 : 17|1@1+ (1,0) [0|1] "" Vector__XXX
 SG_ RCM_a089_comChassisCANPH3Cntr m89 : 18|1@1+ (1,0) [0|1] "" Vector__XXX
 SG_ RCM_a089_eventIDFsignal m89 : 25|1@1+ (1,0) [0|1] "" Vector__XXX
 SG_ RCM_a089_eventFrontLeftSeatbelt m89 : 26|1@1+ (1,0) [0|1] "" Vector__XXX
 SG_ RCM_a089_eventFrontRightSeatbelt m89 : 27|1@1+ (1,0) [0|1] "" Vector__XXX
 SG_ RCM_a089_eventVehicleSpeed m89 : 28|12@1+ (0.08,-40) [-40|287.6] "kph" Vector__XXX
 SG_ RCM_a089_eventSteeringAngle m89 : 45|14@0+ (0.1,-819.2) [-819.2|819.1] "deg" Vector__XXX
 SG_ RCM_a089_eventDriverBrakeApply m89 : 46|2@1+ (1,0) [0|2] "" Vector__XXX
 SG_ RCM_a089_eventAccelPedalPos m89 : 56|8@1+ (0.4,0) [0|101.6] "%" Vector__XXX
 SG_ RCM_a090_eventArmStatus m90 : 11|1@1+ (1,0) [0|1] "" Vector__XXX
 SG_ RCM_a090_eventFactoryMode m90 : 12|1@1+ (1,0) [0|1] "" Vector__XXX
 SG_ RCM_a090_eventDiagEnabled m90 : 13|1@1+ (1,0) [0|1] "" Vector__XXX
 SG_ RCM_a090_eventDriveOrientation m90 : 14|1@1+ (1,0) [0|1] "" Vector__XXX
 SG_ RCM_a090_comPartyCANBusOff m90 : 16|1@1+ (1,0) [0|1] "" Vector__XXX
 SG_ RCM_a090_eventIDFsignal m90 : 25|1@1+ (1,0) [0|1] "" Vector__XXX
 SG_ RCM_a090_eventFrontLeftSeatbelt m90 : 26|1@1+ (1,0) [0|1] "" Vector__XXX
 SG_ RCM_a090_eventFrontRightSeatbelt m90 : 27|1@1+ (1,0) [0|1] "" Vector__XXX
 SG_ RCM_a090_eventVehicleSpeed m90 : 28|12@1+ (0.08,-40) [-40|287.6] "kph" Vector__XXX
 SG_ RCM_a090_eventSteeringAngle m90 : 45|14@0+ (0.1,-819.2) [-819.2|819.1] "deg" Vector__XXX
 SG_ RCM_a090_eventDriverBrakeApply m90 : 46|2@1+ (1,0) [0|2] "" Vector__XXX
 SG_ RCM_a090_eventAccelPedalPos m90 : 56|8@1+ (0.4,0) [0|101.6] "%" Vector__XXX
 SG_ RCM_a092_eventArmStatus m92 : 11|1@1+ (1,0) [0|1] "" Vector__XXX
 SG_ RCM_a092_eventFactoryMode m92 : 12|1@1+ (1,0) [0|1] "" Vector__XXX
 SG_ RCM_a092_eventDiagEnabled m92 : 13|1@1+ (1,0) [0|1] "" Vector__XXX
 SG_ RCM_a092_eventDriveOrientation m92 : 14|1@1+ (1,0) [0|1] "" Vector__XXX
 SG_ RCM_a092_comDASSafetyFrontMIA m92 : 16|1@1+ (1,0) [0|1] "" Vector__XXX
 SG_ RCM_a092_comDASSafetyFrontChkSm m92 : 17|1@1+ (1,0) [0|1] "" Vector__XXX
 SG_ RCM_a092_comDASSafetyFrontCntr m92 : 18|1@1+ (1,0) [0|1] "" Vector__XXX
 SG_ RCM_a092_eventIDFsignal m92 : 25|1@1+ (1,0) [0|1] "" Vector__XXX
 SG_ RCM_a092_eventFrontLeftSeatbelt m92 : 26|1@1+ (1,0) [0|1] "" Vector__XXX
 SG_ RCM_a092_eventFrontRightSeatbelt m92 : 27|1@1+ (1,0) [0|1] "" Vector__XXX
 SG_ RCM_a092_eventVehicleSpeed m92 : 28|12@1+ (0.08,-40) [-40|287.6] "kph" Vector__XXX
 SG_ RCM_a092_eventSteeringAngle m92 : 45|14@0+ (0.1,-819.2) [-819.2|819.1] "deg" Vector__XXX
 SG_ RCM_a092_eventDriverBrakeApply m92 : 46|2@1+ (1,0) [0|2] "" Vector__XXX
 SG_ RCM_a092_eventAccelPedalPos m92 : 56|8@1+ (0.4,0) [0|101.6] "%" Vector__XXX
 SG_ RCM_a093_eventArmStatus m93 : 11|1@1+ (1,0) [0|1] "" Vector__XXX
 SG_ RCM_a093_eventFactoryMode m93 : 12|1@1+ (1,0) [0|1] "" Vector__XXX
 SG_ RCM_a093_eventDiagEnabled m93 : 13|1@1+ (1,0) [0|1] "" Vector__XXX
 SG_ RCM_a093_eventDriveOrientation m93 : 14|1@1+ (1,0) [0|1] "" Vector__XXX
 SG_ RCM_a093_comVCLEFTStatusMIA m93 : 16|1@1+ (1,0) [0|1] "" Vector__XXX
 SG_ RCM_a093_comVCLEFTStatusChkSm m93 : 17|1@1+ (1,0) [0|1] "" Vector__XXX
 SG_ RCM_a093_comVCLEFTStatusCntr m93 : 18|1@1+ (1,0) [0|1] "" Vector__XXX
 SG_ RCM_a093_bucklSwVCFrontLeftFault m93 : 19|1@1+ (1,0) [0|1] "" Vector__XXX
 SG_ RCM_a093_bucklSwVCRearLeftFault m93 : 20|1@1+ (1,0) [0|1] "" Vector__XXX
 SG_ RCM_a093_eventIDFsignal m93 : 25|1@1+ (1,0) [0|1] "" Vector__XXX
 SG_ RCM_a093_eventFrontLeftSeatbelt m93 : 26|1@1+ (1,0) [0|1] "" Vector__XXX
 SG_ RCM_a093_eventFrontRightSeatbelt m93 : 27|1@1+ (1,0) [0|1] "" Vector__XXX
 SG_ RCM_a093_eventVehicleSpeed m93 : 28|12@1+ (0.08,-40) [-40|287.6] "kph" Vector__XXX
 SG_ RCM_a093_eventSteeringAngle m93 : 45|14@0+ (0.1,-819.2) [-819.2|819.1] "deg" Vector__XXX
 SG_ RCM_a093_eventDriverBrakeApply m93 : 46|2@1+ (1,0) [0|2] "" Vector__XXX
 SG_ RCM_a093_eventAccelPedalPos m93 : 56|8@1+ (0.4,0) [0|101.6] "%" Vector__XXX
 SG_ RCM_a094_eventArmStatus m94 : 11|1@1+ (1,0) [0|1] "" Vector__XXX
 SG_ RCM_a094_eventFactoryMode m94 : 12|1@1+ (1,0) [0|1] "" Vector__XXX
 SG_ RCM_a094_eventDiagEnabled m94 : 13|1@1+ (1,0) [0|1] "" Vector__XXX
 SG_ RCM_a094_eventDriveOrientation m94 : 14|1@1+ (1,0) [0|1] "" Vector__XXX
 SG_ RCM_a094_comVCRIGHTStatusMIA m94 : 16|1@1+ (1,0) [0|1] "" Vector__XXX
 SG_ RCM_a094_comVCRIGHTStatusChkSm m94 : 17|1@1+ (1,0) [0|1] "" Vector__XXX
 SG_ RCM_a094_comVCRIGHTStatusCntr m94 : 18|1@1+ (1,0) [0|1] "" Vector__XXX
 SG_ RCM_a094_bucklSwVCFrontRghtFault m94 : 19|1@1+ (1,0) [0|1] "" Vector__XXX
 SG_ RCM_a094_bucklSwVCRearRghtFault m94 : 20|1@1+ (1,0) [0|1] "" Vector__XXX
 SG_ RCM_a094_bucklSwVCRearCnterFault m94 : 21|1@1+ (1,0) [0|1] "" Vector__XXX
 SG_ RCM_a094_eventIDFsignal m94 : 25|1@1+ (1,0) [0|1] "" Vector__XXX
 SG_ RCM_a094_eventFrontLeftSeatbelt m94 : 26|1@1+ (1,0) [0|1] "" Vector__XXX
 SG_ RCM_a094_eventFrontRightSeatbelt m94 : 27|1@1+ (1,0) [0|1] "" Vector__XXX
 SG_ RCM_a094_eventVehicleSpeed m94 : 28|12@1+ (0.08,-40) [-40|287.6] "kph" Vector__XXX
 SG_ RCM_a094_eventSteeringAngle m94 : 45|14@0+ (0.1,-819.2) [-819.2|819.1] "deg" Vector__XXX
 SG_ RCM_a094_eventDriverBrakeApply m94 : 46|2@1+ (1,0) [0|2] "" Vector__XXX
 SG_ RCM_a094_eventAccelPedalPos m94 : 56|8@1+ (0.4,0) [0|101.6] "%" Vector__XXX
 SG_ RCM_a101_eventArmStatus m101 : 11|1@1+ (1,0) [0|1] "" Vector__XXX
 SG_ RCM_a101_eventFactoryMode m101 : 12|1@1+ (1,0) [0|1] "" Vector__XXX
 SG_ RCM_a101_eventDiagEnabled m101 : 13|1@1+ (1,0) [0|1] "" Vector__XXX
 SG_ RCM_a101_eventDriveOrientation m101 : 14|1@1+ (1,0) [0|1] "" Vector__XXX
 SG_ RCM_a101_idfMisuseMonitoringErr m101 : 16|1@1+ (1,0) [0|1] "" Vector__XXX
 SG_ RCM_a101_idfEnviMonitoringError m101 : 17|1@1+ (1,0) [0|1] "" Vector__XXX
 SG_ RCM_a101_idfEnviMonitoringEvent m101 : 18|1@1+ (1,0) [0|1] "" Vector__XXX
 SG_ RCM_a101_eventIDFsignal m101 : 25|1@1+ (1,0) [0|1] "" Vector__XXX
 SG_ RCM_a101_eventFrontLeftSeatbelt m101 : 26|1@1+ (1,0) [0|1] "" Vector__XXX
 SG_ RCM_a101_eventFrontRightSeatbelt m101 : 27|1@1+ (1,0) [0|1] "" Vector__XXX
 SG_ RCM_a101_eventVehicleSpeed m101 : 28|12@1+ (0.08,-40) [-40|287.6] "kph" Vector__XXX
 SG_ RCM_a101_eventSteeringAngle m101 : 45|14@0+ (0.1,-819.2) [-819.2|819.1] "deg" Vector__XXX
 SG_ RCM_a101_eventDriverBrakeApply m101 : 46|2@1+ (1,0) [0|2] "" Vector__XXX
 SG_ RCM_a101_eventAccelPedalPos m101 : 56|8@1+ (0.4,0) [0|101.6] "%" Vector__XXX
 SG_ RCM_a102_eventArmStatus m102 : 11|1@1+ (1,0) [0|1] "" Vector__XXX
 SG_ RCM_a102_eventFactoryMode m102 : 12|1@1+ (1,0) [0|1] "" Vector__XXX
 SG_ RCM_a102_eventDiagEnabled m102 : 13|1@1+ (1,0) [0|1] "" Vector__XXX
 SG_ RCM_a102_eventDriveOrientation m102 : 14|1@1+ (1,0) [0|1] "" Vector__XXX
 SG_ RCM_a102_imuYawR8OffCompPosLife m102 : 16|1@1+ (1,0) [0|1] "" Vector__XXX
 SG_ RCM_a102_imuYawR8OffCompNegLife m102 : 17|1@1+ (1,0) [0|1] "" Vector__XXX
 SG_ RCM_a102_imuYawR8OffCompPosFLDC m102 : 18|1@1+ (1,0) [0|1] "" Vector__XXX
 SG_ RCM_a102_imuYawR8OffCompNegFLDC m102 : 19|1@1+ (1,0) [0|1] "" Vector__XXX
 SG_ RCM_a102_imuYawR8OffCompPosSLDC m102 : 20|1@1+ (1,0) [0|1] "" Vector__XXX
 SG_ RCM_a102_imuYawR8OffCompNegSLDC m102 : 21|1@1+ (1,0) [0|1] "" Vector__XXX
 SG_ RCM_a102_eventIDFsignal m102 : 25|1@1+ (1,0) [0|1] "" Vector__XXX
 SG_ RCM_a102_eventFrontLeftSeatbelt m102 : 26|1@1+ (1,0) [0|1] "" Vector__XXX
 SG_ RCM_a102_eventFrontRightSeatbelt m102 : 27|1@1+ (1,0) [0|1] "" Vector__XXX
 SG_ RCM_a102_eventVehicleSpeed m102 : 28|12@1+ (0.08,-40) [-40|287.6] "kph" Vector__XXX
 SG_ RCM_a102_eventSteeringAngle m102 : 45|14@0+ (0.1,-819.2) [-819.2|819.1] "deg" Vector__XXX
 SG_ RCM_a102_eventDriverBrakeApply m102 : 46|2@1+ (1,0) [0|2] "" Vector__XXX
 SG_ RCM_a102_eventAccelPedalPos m102 : 56|8@1+ (0.4,0) [0|101.6] "%" Vector__XXX
 SG_ RCM_a103_eventArmStatus m103 : 11|1@1+ (1,0) [0|1] "" Vector__XXX
 SG_ RCM_a103_eventFactoryMode m103 : 12|1@1+ (1,0) [0|1] "" Vector__XXX
 SG_ RCM_a103_eventDiagEnabled m103 : 13|1@1+ (1,0) [0|1] "" Vector__XXX
 SG_ RCM_a103_eventDriveOrientation m103 : 14|1@1+ (1,0) [0|1] "" Vector__XXX
 SG_ RCM_a103_imuPtchR8OffCompPosLife m103 : 16|1@1+ (1,0) [0|1] "" Vector__XXX
 SG_ RCM_a103_imuPtchR8OffCompNegLife m103 : 17|1@1+ (1,0) [0|1] "" Vector__XXX
 SG_ RCM_a103_imuPtchR8OffCompPosFLDC m103 : 18|1@1+ (1,0) [0|1] "" Vector__XXX
 SG_ RCM_a103_imuPtchR8OffCompNegFLDC m103 : 19|1@1+ (1,0) [0|1] "" Vector__XXX
 SG_ RCM_a103_imuPtchR8OffCompPosSLDC m103 : 20|1@1+ (1,0) [0|1] "" Vector__XXX
 SG_ RCM_a103_imuPtchR8OffCompNegSLDC m103 : 21|1@1+ (1,0) [0|1] "" Vector__XXX
 SG_ RCM_a103_eventIDFsignal m103 : 25|1@1+ (1,0) [0|1] "" Vector__XXX
 SG_ RCM_a103_eventFrontLeftSeatbelt m103 : 26|1@1+ (1,0) [0|1] "" Vector__XXX
 SG_ RCM_a103_eventFrontRightSeatbelt m103 : 27|1@1+ (1,0) [0|1] "" Vector__XXX
 SG_ RCM_a103_eventVehicleSpeed m103 : 28|12@1+ (0.08,-40) [-40|287.6] "kph" Vector__XXX
 SG_ RCM_a103_eventSteeringAngle m103 : 45|14@0+ (0.1,-819.2) [-819.2|819.1] "deg" Vector__XXX
 SG_ RCM_a103_eventDriverBrakeApply m103 : 46|2@1+ (1,0) [0|2] "" Vector__XXX
 SG_ RCM_a103_eventAccelPedalPos m103 : 56|8@1+ (0.4,0) [0|101.6] "%" Vector__XXX
 SG_ RCM_a104_eventArmStatus m104 : 11|1@1+ (1,0) [0|1] "" Vector__XXX
 SG_ RCM_a104_eventFactoryMode m104 : 12|1@1+ (1,0) [0|1] "" Vector__XXX
 SG_ RCM_a104_eventDiagEnabled m104 : 13|1@1+ (1,0) [0|1] "" Vector__XXX
 SG_ RCM_a104_eventDriveOrientation m104 : 14|1@1+ (1,0) [0|1] "" Vector__XXX
 SG_ RCM_a104_imuRollR8OffCompPosLife m104 : 16|1@1+ (1,0) [0|1] "" Vector__XXX
 SG_ RCM_a104_imuRollR8OffCompNegLife m104 : 17|1@1+ (1,0) [0|1] "" Vector__XXX
 SG_ RCM_a104_imuRollR8OffCompPosFLDC m104 : 18|1@1+ (1,0) [0|1] "" Vector__XXX
 SG_ RCM_a104_imuRollR8OffCompNegFLDC m104 : 19|1@1+ (1,0) [0|1] "" Vector__XXX
 SG_ RCM_a104_imuRollR8OffCompPosSLDC m104 : 20|1@1+ (1,0) [0|1] "" Vector__XXX
 SG_ RCM_a104_imuRollR8OffCompNegSLDC m104 : 21|1@1+ (1,0) [0|1] "" Vector__XXX
 SG_ RCM_a104_eventIDFsignal m104 : 25|1@1+ (1,0) [0|1] "" Vector__XXX
 SG_ RCM_a104_eventFrontLeftSeatbelt m104 : 26|1@1+ (1,0) [0|1] "" Vector__XXX
 SG_ RCM_a104_eventFrontRightSeatbelt m104 : 27|1@1+ (1,0) [0|1] "" Vector__XXX
 SG_ RCM_a104_eventVehicleSpeed m104 : 28|12@1+ (0.08,-40) [-40|287.6] "kph" Vector__XXX
 SG_ RCM_a104_eventSteeringAngle m104 : 45|14@0+ (0.1,-819.2) [-819.2|819.1] "deg" Vector__XXX
 SG_ RCM_a104_eventDriverBrakeApply m104 : 46|2@1+ (1,0) [0|2] "" Vector__XXX
 SG_ RCM_a104_eventAccelPedalPos m104 : 56|8@1+ (0.4,0) [0|101.6] "%" Vector__XXX
 SG_ RCM_a105_eventArmStatus m105 : 11|1@1+ (1,0) [0|1] "" Vector__XXX
 SG_ RCM_a105_eventFactoryMode m105 : 12|1@1+ (1,0) [0|1] "" Vector__XXX
 SG_ RCM_a105_eventDiagEnabled m105 : 13|1@1+ (1,0) [0|1] "" Vector__XXX
 SG_ RCM_a105_eventDriveOrientation m105 : 14|1@1+ (1,0) [0|1] "" Vector__XXX
 SG_ RCM_a105_imuLongAOffCompPosLife m105 : 16|1@1+ (1,0) [0|1] "" Vector__XXX
 SG_ RCM_a105_imuLongAOffCompNegLife m105 : 17|1@1+ (1,0) [0|1] "" Vector__XXX
 SG_ RCM_a105_imuLongAOffCompPosFLDC m105 : 18|1@1+ (1,0) [0|1] "" Vector__XXX
 SG_ RCM_a105_imuLongAOffCompNegFLDC m105 : 19|1@1+ (1,0) [0|1] "" Vector__XXX
 SG_ RCM_a105_imuLongAOffCompPosSLDC m105 : 20|1@1+ (1,0) [0|1] "" Vector__XXX
 SG_ RCM_a105_imuLongAOffCompNegSLDC m105 : 21|1@1+ (1,0) [0|1] "" Vector__XXX
 SG_ RCM_a105_eventIDFsignal m105 : 25|1@1+ (1,0) [0|1] "" Vector__XXX
 SG_ RCM_a105_eventFrontLeftSeatbelt m105 : 26|1@1+ (1,0) [0|1] "" Vector__XXX
 SG_ RCM_a105_eventFrontRightSeatbelt m105 : 27|1@1+ (1,0) [0|1] "" Vector__XXX
 SG_ RCM_a105_eventVehicleSpeed m105 : 28|12@1+ (0.08,-40) [-40|287.6] "kph" Vector__XXX
 SG_ RCM_a105_eventSteeringAngle m105 : 45|14@0+ (0.1,-819.2) [-819.2|819.1] "deg" Vector__XXX
 SG_ RCM_a105_eventDriverBrakeApply m105 : 46|2@1+ (1,0) [0|2] "" Vector__XXX
 SG_ RCM_a105_eventAccelPedalPos m105 : 56|8@1+ (0.4,0) [0|101.6] "%" Vector__XXX
 SG_ RCM_a106_eventArmStatus m106 : 11|1@1+ (1,0) [0|1] "" Vector__XXX
 SG_ RCM_a106_eventFactoryMode m106 : 12|1@1+ (1,0) [0|1] "" Vector__XXX
 SG_ RCM_a106_eventDiagEnabled m106 : 13|1@1+ (1,0) [0|1] "" Vector__XXX
 SG_ RCM_a106_eventDriveOrientation m106 : 14|1@1+ (1,0) [0|1] "" Vector__XXX
 SG_ RCM_a106_imuLatAcOffCompPosLife m106 : 16|1@1+ (1,0) [0|1] "" Vector__XXX
 SG_ RCM_a106_imuLatAcOffCompNegLife m106 : 17|1@1+ (1,0) [0|1] "" Vector__XXX
 SG_ RCM_a106_imuLatAcOffCompPosFLDC m106 : 18|1@1+ (1,0) [0|1] "" Vector__XXX
 SG_ RCM_a106_imuLatAcOffCompNegFLDC m106 : 19|1@1+ (1,0) [0|1] "" Vector__XXX
 SG_ RCM_a106_imuLatAcOffCompPosSLDC m106 : 20|1@1+ (1,0) [0|1] "" Vector__XXX
 SG_ RCM_a106_imuLatAcOffCompNegSLDC m106 : 21|1@1+ (1,0) [0|1] "" Vector__XXX
 SG_ RCM_a106_eventIDFsignal m106 : 25|1@1+ (1,0) [0|1] "" Vector__XXX
 SG_ RCM_a106_eventFrontLeftSeatbelt m106 : 26|1@1+ (1,0) [0|1] "" Vector__XXX
 SG_ RCM_a106_eventFrontRightSeatbelt m106 : 27|1@1+ (1,0) [0|1] "" Vector__XXX
 SG_ RCM_a106_eventVehicleSpeed m106 : 28|12@1+ (0.08,-40) [-40|287.6] "kph" Vector__XXX
 SG_ RCM_a106_eventSteeringAngle m106 : 45|14@0+ (0.1,-819.2) [-819.2|819.1] "deg" Vector__XXX
 SG_ RCM_a106_eventDriverBrakeApply m106 : 46|2@1+ (1,0) [0|2] "" Vector__XXX
 SG_ RCM_a106_eventAccelPedalPos m106 : 56|8@1+ (0.4,0) [0|101.6] "%" Vector__XXX
 SG_ RCM_a107_eventArmStatus m107 : 11|1@1+ (1,0) [0|1] "" Vector__XXX
 SG_ RCM_a107_eventFactoryMode m107 : 12|1@1+ (1,0) [0|1] "" Vector__XXX
 SG_ RCM_a107_eventDiagEnabled m107 : 13|1@1+ (1,0) [0|1] "" Vector__XXX
 SG_ RCM_a107_eventDriveOrientation m107 : 14|1@1+ (1,0) [0|1] "" Vector__XXX
 SG_ RCM_a107_imuVertAOffCompPosLife m107 : 16|1@1+ (1,0) [0|1] "" Vector__XXX
 SG_ RCM_a107_imuVertAOffCompNegLife m107 : 17|1@1+ (1,0) [0|1] "" Vector__XXX
 SG_ RCM_a107_imuVertAOffCompPosFLDC m107 : 18|1@1+ (1,0) [0|1] "" Vector__XXX
 SG_ RCM_a107_imuVertAOffCompNegFLDC m107 : 19|1@1+ (1,0) [0|1] "" Vector__XXX
 SG_ RCM_a107_imuVertAOffCompPosSLDC m107 : 20|1@1+ (1,0) [0|1] "" Vector__XXX
 SG_ RCM_a107_imuVertAOffCompNegSLDC m107 : 21|1@1+ (1,0) [0|1] "" Vector__XXX
 SG_ RCM_a107_eventIDFsignal m107 : 25|1@1+ (1,0) [0|1] "" Vector__XXX
 SG_ RCM_a107_eventFrontLeftSeatbelt m107 : 26|1@1+ (1,0) [0|1] "" Vector__XXX
 SG_ RCM_a107_eventFrontRightSeatbelt m107 : 27|1@1+ (1,0) [0|1] "" Vector__XXX
 SG_ RCM_a107_eventVehicleSpeed m107 : 28|12@1+ (0.08,-40) [-40|287.6] "kph" Vector__XXX
 SG_ RCM_a107_eventSteeringAngle m107 : 45|14@0+ (0.1,-819.2) [-819.2|819.1] "deg" Vector__XXX
 SG_ RCM_a107_eventDriverBrakeApply m107 : 46|2@1+ (1,0) [0|2] "" Vector__XXX
 SG_ RCM_a107_eventAccelPedalPos m107 : 56|8@1+ (0.4,0) [0|101.6] "%" Vector__XXX
 SG_ RCM_a108_eventArmStatus m108 : 11|1@1+ (1,0) [0|1] "" Vector__XXX
 SG_ RCM_a108_eventFactoryMode m108 : 12|1@1+ (1,0) [0|1] "" Vector__XXX
 SG_ RCM_a108_eventDiagEnabled m108 : 13|1@1+ (1,0) [0|1] "" Vector__XXX
 SG_ RCM_a108_eventDriveOrientation m108 : 14|1@1+ (1,0) [0|1] "" Vector__XXX
 SG_ RCM_a108_crashAlgoWakeupSig m108 : 16|1@1+ (1,0) [0|1] "" Vector__XXX
 SG_ RCM_a108_eventIDFsignal m108 : 25|1@1+ (1,0) [0|1] "" Vector__XXX
 SG_ RCM_a108_eventFrontLeftSeatbelt m108 : 26|1@1+ (1,0) [0|1] "" Vector__XXX
 SG_ RCM_a108_eventFrontRightSeatbelt m108 : 27|1@1+ (1,0) [0|1] "" Vector__XXX
 SG_ RCM_a108_eventVehicleSpeed m108 : 28|12@1+ (0.08,-40) [-40|287.6] "kph" Vector__XXX
 SG_ RCM_a108_eventSteeringAngle m108 : 45|14@0+ (0.1,-819.2) [-819.2|819.1] "deg" Vector__XXX
 SG_ RCM_a108_eventDriverBrakeApply m108 : 46|2@1+ (1,0) [0|2] "" Vector__XXX
 SG_ RCM_a108_eventAccelPedalPos m108 : 56|8@1+ (0.4,0) [0|101.6] "%" Vector__XXX
 SG_ RCM_a109_eventArmStatus m109 : 11|1@1+ (1,0) [0|1] "" Vector__XXX
 SG_ RCM_a109_eventFactoryMode m109 : 12|1@1+ (1,0) [0|1] "" Vector__XXX
 SG_ RCM_a109_eventDiagEnabled m109 : 13|1@1+ (1,0) [0|1] "" Vector__XXX
 SG_ RCM_a109_eventDriveOrientation m109 : 14|1@1+ (1,0) [0|1] "" Vector__XXX
 SG_ RCM_a109_immunityThrsholdCrossed m109 : 16|1@1+ (1,0) [0|1] "" Vector__XXX
 SG_ RCM_a109_eventIDFsignal m109 : 25|1@1+ (1,0) [0|1] "" Vector__XXX
 SG_ RCM_a109_eventFrontLeftSeatbelt m109 : 26|1@1+ (1,0) [0|1] "" Vector__XXX
 SG_ RCM_a109_eventFrontRightSeatbelt m109 : 27|1@1+ (1,0) [0|1] "" Vector__XXX
 SG_ RCM_a109_eventVehicleSpeed m109 : 28|12@1+ (0.08,-40) [-40|287.6] "kph" Vector__XXX
 SG_ RCM_a109_eventSteeringAngle m109 : 45|14@0+ (0.1,-819.2) [-819.2|819.1] "deg" Vector__XXX
 SG_ RCM_a109_eventDriverBrakeApply m109 : 46|2@1+ (1,0) [0|2] "" Vector__XXX
 SG_ RCM_a109_eventAccelPedalPos m109 : 56|8@1+ (0.4,0) [0|101.6] "%" Vector__XXX
 SG_ RCM_a110_eventArmStatus m110 : 11|1@1+ (1,0) [0|1] "" Vector__XXX
 SG_ RCM_a110_eventFactoryMode m110 : 12|1@1+ (1,0) [0|1] "" Vector__XXX
 SG_ RCM_a110_eventDiagEnabled m110 : 13|1@1+ (1,0) [0|1] "" Vector__XXX
 SG_ RCM_a110_eventDriveOrientation m110 : 14|1@1+ (1,0) [0|1] "" Vector__XXX
 SG_ RCM_a110_inFactoryMode m110 : 16|1@1+ (1,0) [0|1] "" Vector__XXX
 SG_ RCM_a110_eventIDFsignal m110 : 25|1@1+ (1,0) [0|1] "" Vector__XXX
 SG_ RCM_a110_eventFrontLeftSeatbelt m110 : 26|1@1+ (1,0) [0|1] "" Vector__XXX
 SG_ RCM_a110_eventFrontRightSeatbelt m110 : 27|1@1+ (1,0) [0|1] "" Vector__XXX
 SG_ RCM_a110_eventVehicleSpeed m110 : 28|12@1+ (0.08,-40) [-40|287.6] "kph" Vector__XXX
 SG_ RCM_a110_eventSteeringAngle m110 : 45|14@0+ (0.1,-819.2) [-819.2|819.1] "deg" Vector__XXX
 SG_ RCM_a110_eventDriverBrakeApply m110 : 46|2@1+ (1,0) [0|2] "" Vector__XXX
 SG_ RCM_a110_eventAccelPedalPos m110 : 56|8@1+ (0.4,0) [0|101.6] "%" Vector__XXX
 SG_ RCM_a112_eventArmStatus m112 : 11|1@1+ (1,0) [0|1] "" Vector__XXX
 SG_ RCM_a112_eventFactoryMode m112 : 12|1@1+ (1,0) [0|1] "" Vector__XXX
 SG_ RCM_a112_eventDiagEnabled m112 : 13|1@1+ (1,0) [0|1] "" Vector__XXX
 SG_ RCM_a112_eventDriveOrientation m112 : 14|1@1+ (1,0) [0|1] "" Vector__XXX
 SG_ RCM_a112_imuYawR8SnsrMonitTmp m112 : 16|1@1+ (1,0) [0|1] "" Vector__XXX
 SG_ RCM_a112_imuYawR8SnsrMonitPerm m112 : 17|1@1+ (1,0) [0|1] "" Vector__XXX
 SG_ RCM_a112_imuYawR8ChnlMonitTmp m112 : 19|1@1+ (1,0) [0|1] "" Vector__XXX
 SG_ RCM_a112_imuYawR8ChnlMonitPerm m112 : 20|1@1+ (1,0) [0|1] "" Vector__XXX
 SG_ RCM_a112_eventIDFsignal m112 : 25|1@1+ (1,0) [0|1] "" Vector__XXX
 SG_ RCM_a112_eventFrontLeftSeatbelt m112 : 26|1@1+ (1,0) [0|1] "" Vector__XXX
 SG_ RCM_a112_eventFrontRightSeatbelt m112 : 27|1@1+ (1,0) [0|1] "" Vector__XXX
 SG_ RCM_a112_eventVehicleSpeed m112 : 28|12@1+ (0.08,-40) [-40|287.6] "kph" Vector__XXX
 SG_ RCM_a112_eventSteeringAngle m112 : 45|14@0+ (0.1,-819.2) [-819.2|819.1] "deg" Vector__XXX
 SG_ RCM_a112_eventDriverBrakeApply m112 : 46|2@1+ (1,0) [0|2] "" Vector__XXX
 SG_ RCM_a112_eventAccelPedalPos m112 : 56|8@1+ (0.4,0) [0|101.6] "%" Vector__XXX
 SG_ RCM_a113_eventArmStatus m113 : 11|1@1+ (1,0) [0|1] "" Vector__XXX
 SG_ RCM_a113_eventFactoryMode m113 : 12|1@1+ (1,0) [0|1] "" Vector__XXX
 SG_ RCM_a113_eventDiagEnabled m113 : 13|1@1+ (1,0) [0|1] "" Vector__XXX
 SG_ RCM_a113_eventDriveOrientation m113 : 14|1@1+ (1,0) [0|1] "" Vector__XXX
 SG_ RCM_a113_imuPitchR8SnsrMonitTmp m113 : 16|1@1+ (1,0) [0|1] "" Vector__XXX
 SG_ RCM_a113_imuPitchR8SnsrMonitPerm m113 : 17|1@1+ (1,0) [0|1] "" Vector__XXX
 SG_ RCM_a113_imuPitchR8ChnlMonitTmp m113 : 18|1@1+ (1,0) [0|1] "" Vector__XXX
 SG_ RCM_a113_imuPitchR8ChnlMonitPerm m113 : 19|1@1+ (1,0) [0|1] "" Vector__XXX
 SG_ RCM_a113_eventIDFsignal m113 : 25|1@1+ (1,0) [0|1] "" Vector__XXX
 SG_ RCM_a113_eventFrontLeftSeatbelt m113 : 26|1@1+ (1,0) [0|1] "" Vector__XXX
 SG_ RCM_a113_eventFrontRightSeatbelt m113 : 27|1@1+ (1,0) [0|1] "" Vector__XXX
 SG_ RCM_a113_eventVehicleSpeed m113 : 28|12@1+ (0.08,-40) [-40|287.6] "kph" Vector__XXX
 SG_ RCM_a113_eventSteeringAngle m113 : 45|14@0+ (0.1,-819.2) [-819.2|819.1] "deg" Vector__XXX
 SG_ RCM_a113_eventDriverBrakeApply m113 : 46|2@1+ (1,0) [0|2] "" Vector__XXX
 SG_ RCM_a113_eventAccelPedalPos m113 : 56|8@1+ (0.4,0) [0|101.6] "%" Vector__XXX
 SG_ RCM_a114_eventArmStatus m114 : 11|1@1+ (1,0) [0|1] "" Vector__XXX
 SG_ RCM_a114_eventFactoryMode m114 : 12|1@1+ (1,0) [0|1] "" Vector__XXX
 SG_ RCM_a114_eventDiagEnabled m114 : 13|1@1+ (1,0) [0|1] "" Vector__XXX
 SG_ RCM_a114_eventDriveOrientation m114 : 14|1@1+ (1,0) [0|1] "" Vector__XXX
 SG_ RCM_a114_imuRollR8SnsrMonitTmp m114 : 16|1@1+ (1,0) [0|1] "" Vector__XXX
 SG_ RCM_a114_imuRollR8SnsrMonitPerm m114 : 17|1@1+ (1,0) [0|1] "" Vector__XXX
 SG_ RCM_a114_imuRollR8ChnlMonitTmp m114 : 18|1@1+ (1,0) [0|1] "" Vector__XXX
 SG_ RCM_a114_imuRollR8ChnlMonitPerm m114 : 19|1@1+ (1,0) [0|1] "" Vector__XXX
 SG_ RCM_a114_eventIDFsignal m114 : 25|1@1+ (1,0) [0|1] "" Vector__XXX
 SG_ RCM_a114_eventFrontLeftSeatbelt m114 : 26|1@1+ (1,0) [0|1] "" Vector__XXX
 SG_ RCM_a114_eventFrontRightSeatbelt m114 : 27|1@1+ (1,0) [0|1] "" Vector__XXX
 SG_ RCM_a114_eventVehicleSpeed m114 : 28|12@1+ (0.08,-40) [-40|287.6] "kph" Vector__XXX
 SG_ RCM_a114_eventSteeringAngle m114 : 45|14@0+ (0.1,-819.2) [-819.2|819.1] "deg" Vector__XXX
 SG_ RCM_a114_eventDriverBrakeApply m114 : 46|2@1+ (1,0) [0|2] "" Vector__XXX
 SG_ RCM_a114_eventAccelPedalPos m114 : 56|8@1+ (0.4,0) [0|101.6] "%" Vector__XXX
 SG_ RCM_a115_eventArmStatus m115 : 11|1@1+ (1,0) [0|1] "" Vector__XXX
 SG_ RCM_a115_eventFactoryMode m115 : 12|1@1+ (1,0) [0|1] "" Vector__XXX
 SG_ RCM_a115_eventDiagEnabled m115 : 13|1@1+ (1,0) [0|1] "" Vector__XXX
 SG_ RCM_a115_eventDriveOrientation m115 : 14|1@1+ (1,0) [0|1] "" Vector__XXX
 SG_ RCM_a115_imuLinAccChnlMonitTmp m115 : 16|1@1+ (1,0) [0|1] "" Vector__XXX
 SG_ RCM_a115_imuLinAccChnlMonitPerm m115 : 17|1@1+ (1,0) [0|1] "" Vector__XXX
 SG_ RCM_a115_eventIDFsignal m115 : 25|1@1+ (1,0) [0|1] "" Vector__XXX
 SG_ RCM_a115_eventFrontLeftSeatbelt m115 : 26|1@1+ (1,0) [0|1] "" Vector__XXX
 SG_ RCM_a115_eventFrontRightSeatbelt m115 : 27|1@1+ (1,0) [0|1] "" Vector__XXX
 SG_ RCM_a115_eventVehicleSpeed m115 : 28|12@1+ (0.08,-40) [-40|287.6] "kph" Vector__XXX
 SG_ RCM_a115_eventSteeringAngle m115 : 45|14@0+ (0.1,-819.2) [-819.2|819.1] "deg" Vector__XXX
 SG_ RCM_a115_eventDriverBrakeApply m115 : 46|2@1+ (1,0) [0|2] "" Vector__XXX
 SG_ RCM_a115_eventAccelPedalPos m115 : 56|8@1+ (0.4,0) [0|101.6] "%" Vector__XXX
 SG_ RCM_a116_eventArmStatus m116 : 11|1@1+ (1,0) [0|1] "" Vector__XXX
 SG_ RCM_a116_eventFactoryMode m116 : 12|1@1+ (1,0) [0|1] "" Vector__XXX
 SG_ RCM_a116_eventDiagEnabled m116 : 13|1@1+ (1,0) [0|1] "" Vector__XXX
 SG_ RCM_a116_eventDriveOrientation m116 : 14|1@1+ (1,0) [0|1] "" Vector__XXX
 SG_ RCM_a116_imuLatAccChnlMonitTmp m116 : 16|1@1+ (1,0) [0|1] "" Vector__XXX
 SG_ RCM_a116_imuLatAccChnlMonitPerm m116 : 17|1@1+ (1,0) [0|1] "" Vector__XXX
 SG_ RCM_a116_eventIDFsignal m116 : 25|1@1+ (1,0) [0|1] "" Vector__XXX
 SG_ RCM_a116_eventFrontLeftSeatbelt m116 : 26|1@1+ (1,0) [0|1] "" Vector__XXX
 SG_ RCM_a116_eventFrontRightSeatbelt m116 : 27|1@1+ (1,0) [0|1] "" Vector__XXX
 SG_ RCM_a116_eventVehicleSpeed m116 : 28|12@1+ (0.08,-40) [-40|287.6] "kph" Vector__XXX
 SG_ RCM_a116_eventSteeringAngle m116 : 45|14@0+ (0.1,-819.2) [-819.2|819.1] "deg" Vector__XXX
 SG_ RCM_a116_eventDriverBrakeApply m116 : 46|2@1+ (1,0) [0|2] "" Vector__XXX
 SG_ RCM_a116_eventAccelPedalPos m116 : 56|8@1+ (0.4,0) [0|101.6] "%" Vector__XXX
 SG_ RCM_a117_eventArmStatus m117 : 11|1@1+ (1,0) [0|1] "" Vector__XXX
 SG_ RCM_a117_eventFactoryMode m117 : 12|1@1+ (1,0) [0|1] "" Vector__XXX
 SG_ RCM_a117_eventDiagEnabled m117 : 13|1@1+ (1,0) [0|1] "" Vector__XXX
 SG_ RCM_a117_eventDriveOrientation m117 : 14|1@1+ (1,0) [0|1] "" Vector__XXX
 SG_ RCM_a117_imuZaccelChnlMonitTmp m117 : 16|1@1+ (1,0) [0|1] "" Vector__XXX
 SG_ RCM_a117_imuZaccelChnlMonitPerm m117 : 17|1@1+ (1,0) [0|1] "" Vector__XXX
 SG_ RCM_a117_eventIDFsignal m117 : 25|1@1+ (1,0) [0|1] "" Vector__XXX
 SG_ RCM_a117_eventFrontLeftSeatbelt m117 : 26|1@1+ (1,0) [0|1] "" Vector__XXX
 SG_ RCM_a117_eventFrontRightSeatbelt m117 : 27|1@1+ (1,0) [0|1] "" Vector__XXX
 SG_ RCM_a117_eventVehicleSpeed m117 : 28|12@1+ (0.08,-40) [-40|287.6] "kph" Vector__XXX
 SG_ RCM_a117_eventSteeringAngle m117 : 45|14@0+ (0.1,-819.2) [-819.2|819.1] "deg" Vector__XXX
 SG_ RCM_a117_eventDriverBrakeApply m117 : 46|2@1+ (1,0) [0|2] "" Vector__XXX
 SG_ RCM_a117_eventAccelPedalPos m117 : 56|8@1+ (0.4,0) [0|101.6] "%" Vector__XXX
 SG_ RCM_a118_eventArmStatus m118 : 11|1@1+ (1,0) [0|1] "" Vector__XXX
 SG_ RCM_a118_eventFactoryMode m118 : 12|1@1+ (1,0) [0|1] "" Vector__XXX
 SG_ RCM_a118_eventDiagEnabled m118 : 13|1@1+ (1,0) [0|1] "" Vector__XXX
 SG_ RCM_a118_eventDriveOrientation m118 : 14|1@1+ (1,0) [0|1] "" Vector__XXX
 SG_ RCM_a118_imuInPlaneSnsrMonitTmp m118 : 16|1@1+ (1,0) [0|1] "" Vector__XXX
 SG_ RCM_a118_imuInPlaneSnsrMonitPerm m118 : 17|1@1+ (1,0) [0|1] "" Vector__XXX
 SG_ RCM_a118_eventIDFsignal m118 : 25|1@1+ (1,0) [0|1] "" Vector__XXX
 SG_ RCM_a118_eventFrontLeftSeatbelt m118 : 26|1@1+ (1,0) [0|1] "" Vector__XXX

CM_ SG_ 1297 RCM_a058_eventFrontLeftSeatbelt "Restraint control module: a058 event front left seatbelt";
CM_ SG_ 1297 RCM_a058_eventFrontRightSeatbelt "Restraint control module: a058 event front right seatbelt";
CM_ SG_ 1297 RCM_a058_eventVehicleSpeed "Restraint control module: a058 event vehicle speed";
CM_ SG_ 1297 RCM_a058_eventSteeringAngle "Restraint control module: a058 event steering angle";
CM_ SG_ 1297 RCM_a058_eventDriverBrakeApply "Restraint control module: a058 event driver brake apply; raw 3 = signal not available (SNA)";
CM_ SG_ 1297 RCM_a058_eventAccelPedalPos "Restraint control module: a058 event accel pedal pos; raw 255 = signal not available (SNA)";
CM_ SG_ 1297 RCM_a059_eventArmStatus "Restraint control module: a059 event arm status";
CM_ SG_ 1297 RCM_a059_eventFactoryMode "Restraint control module: a059 event factory mode";
CM_ SG_ 1297 RCM_a059_eventDiagEnabled "Restraint control module: a059 event diag enabled";
CM_ SG_ 1297 RCM_a059_eventDriveOrientation "Restraint control module: a059 event drive orientation";
CM_ SG_ 1297 RCM_a059_bucklHallRightShort "Restraint control module: a059 buckl hall right short";
CM_ SG_ 1297 RCM_a059_bucklHallRightSht2Bat "Restraint control module: a059 buckl hall right sht2 bat";
CM_ SG_ 1297 RCM_a059_bucklHallRightOpen "Restraint control module: a059 buckl hall right open";
CM_ SG_ 1297 RCM_a059_bucklHallRightUndef "Restraint control module: a059 buckl hall right undef";
CM_ SG_ 1297 RCM_a059_bucklHallRightCrossCoup "Restraint control module: a059 buckl hall right cross coup";
CM_ SG_ 1297 RCM_a059_bucklSwRightConfig "Restraint control module: a059 buckl sw right config";
CM_ SG_ 1297 RCM_a059_eventIDFsignal "Restraint control module: a059 event ID fsignal";
CM_ SG_ 1297 RCM_a059_eventFrontLeftSeatbelt "Restraint control module: a059 event front left seatbelt";
CM_ SG_ 1297 RCM_a059_eventFrontRightSeatbelt "Restraint control module: a059 event front right seatbelt";
CM_ SG_ 1297 RCM_a059_eventVehicleSpeed "Restraint control module: a059 event vehicle speed";
CM_ SG_ 1297 RCM_a059_eventSteeringAngle "Restraint control module: a059 event steering angle";
CM_ SG_ 1297 RCM_a059_eventDriverBrakeApply "Restraint control module: a059 event driver brake apply; raw 3 = signal not available (SNA)";
CM_ SG_ 1297 RCM_a059_eventAccelPedalPos "Restraint control module: a059 event accel pedal pos; raw 255 = signal not available (SNA)";
CM_ SG_ 1297 RCM_a060_eventArmStatus "Restraint control module: a060 event arm status";
CM_ SG_ 1297 RCM_a060_eventFactoryMode "Restraint control module: a060 event factory mode";
CM_ SG_ 1297 RCM_a060_eventDiagEnabled "Restraint control module: a060 event diag enabled";
CM_ SG_ 1297 RCM_a060_eventDriveOrientation "Restraint control module: a060 event drive orientation";
CM_ SG_ 1297 RCM_a060_seaTrkPosLeftShort "Restraint control module: a060 sea trk pos left short";
CM_ SG_ 1297 RCM_a060_seaTrkPosLeftShort2Bat "Restraint control module: a060 sea trk pos left short2 bat";
CM_ SG_ 1297 RCM_a060_seaTrkPosLeftOpen "Restraint control module: a060 sea trk pos left open";
CM_ SG_ 1297 RCM_a060_seaTrkPosLeftUndefined "Restraint control module: a060 sea trk pos left undefined";
CM_ SG_ 1297 RCM_a060_seaTrkPosLeftCrossCoup "Restraint control module: a060 sea trk pos left cross coup";
CM_ SG_ 1297 RCM_a060_seaTrkPosLeftConfig "Restraint control module: a060 sea trk pos left config";
CM_ SG_ 1297 RCM_a060_eventIDFsignal "Restraint control module: a060 event ID fsignal";
CM_ SG_ 1297 RCM_a060_eventFrontLeftSeatbelt "Restraint control module: a060 event front left seatbelt";
CM_ SG_ 1297 RCM_a060_eventFrontRightSeatbelt "Restraint control module: a060 event front right seatbelt";
CM_ SG_ 1297 RCM_a060_eventVehicleSpeed "Restraint control module: a060 event vehicle speed";
CM_ SG_ 1297 RCM_a060_eventSteeringAngle "Restraint control module: a060 event steering angle";
CM_ SG_ 1297 RCM_a060_eventDriverBrakeApply "Restraint control module: a060 event driver brake apply; raw 3 = signal not available (SNA)";
CM_ SG_ 1297 RCM_a060_eventAccelPedalPos "Restraint control module: a060 event accel pedal pos; raw 255 = signal not available (SNA)";
CM_ SG_ 1297 RCM_a061_eventArmStatus "Restraint control module: a061 event arm status";
CM_ SG_ 1297 RCM_a061_eventFactoryMode "Restraint control module: a061 event factory mode";
CM_ SG_ 1297 RCM_a061_eventDiagEnabled "Restraint control module: a061 event diag enabled";
CM_ SG_ 1297 RCM_a061_eventDriveOrientation "Restraint control module: a061 event drive orientation";
CM_ SG_ 1297 RCM_a061_seaTrkPosRightShort "Restraint control module: a061 sea trk pos right short";
CM_ SG_ 1297 RCM_a061_seaTrkPosRightSht2Bat "Restraint control module: a061 sea trk pos right sht2 bat";
CM_ SG_ 1297 RCM_a061_seaTrkPosRightOpen "Restraint control module: a061 sea trk pos right open";
CM_ SG_ 1297 RCM_a061_seaTrkPosRightUndefined "Restraint control module: a061 sea trk pos right undefined";
CM_ SG_ 1297 RCM_a061_seaTrkPosRightCrossCoup "Restraint control module: a061 sea trk pos right cross coup";
CM_ SG_ 1297 RCM_a061_seaTrkPosRightConfig "Restraint control module: a061 sea trk pos right config";
CM_ SG_ 1297 RCM_a061_eventIDFsignal "Restraint control module: a061 event ID fsignal";
CM_ SG_ 1297 RCM_a061_eventFrontLeftSeatbelt "Restraint control module: a061 event front left seatbelt";
CM_ SG_ 1297 RCM_a061_eventFrontRightSeatbelt "Restraint control module: a061 event front right seatbelt";
CM_ SG_ 1297 RCM_a061_eventVehicleSpeed "Restraint control module: a061 event vehicle speed";
CM_ SG_ 1297 RCM_a061_eventSteeringAngle "Restraint control module: a061 event steering angle";
CM_ SG_ 1297 RCM_a061_eventDriverBrakeApply "Restraint control module: a061 event driver brake apply; raw 3 = signal not available (SNA)";
CM_ SG_ 1297 RCM_a061_eventAccelPedalPos "Restraint control module: a061 event accel pedal pos; raw 255 = signal not available (SNA)";
CM_ SG_ 1297 RCM_a062_eventArmStatus "Restraint control module: a062 event arm status";
CM_ SG_ 1297 RCM_a062_eventFactoryMode "Restraint control module: a062 event factory mode";
CM_ SG_ 1297 RCM_a062_eventDiagEnabled "Restraint control module: a062 event diag enabled";
CM_ SG_ 1297 RCM_a062_eventDriveOrientation "Restraint control module: a062 event drive orientation";
CM_ SG_ 1297 RCM_a062_alrShort "Restraint control module: a062 alr short";
CM_ SG_ 1297 RCM_a062_alrSht2Bat "Restraint control module: a062 alr sht2 bat";
CM_ SG_ 1297 RCM_a062_alrOpen "Restraint control module: a062 alr open";
CM_ SG_ 1297 RCM_a062_alrUndefined "Restraint control module: a062 alr undefined";
CM_ SG_ 1297 RCM_a062_alrCrossCoup "Restraint control module: a062 alr cross coup";
CM_ SG_ 1297 RCM_a062_alrConfig "Restraint control module: a062 alr config";
CM_ SG_ 1297 RCM_a062_eventIDFsignal "Restraint control module: a062 event ID fsignal";
CM_ SG_ 1297 RCM_a062_eventFrontLeftSeatbelt "Restraint control module: a062 event front left seatbelt";
CM_ SG_ 1297 RCM_a062_eventFrontRightSeatbelt "Restraint control module: a062 event front right seatbelt";
CM_ SG_ 1297 RCM_a062_eventVehicleSpeed "Restraint control module: a062 event vehicle speed";
CM_ SG_ 1297 RCM_a062_eventSteeringAngle "Restraint control module: a062 event steering angle";
CM_ SG_ 1297 RCM_a062_eventDriverBrakeApply "Restraint control module: a062 event driver brake apply; raw 3 = signal not available (SNA)";
CM_ SG_ 1297 RCM_a062_eventAccelPedalPos "Restraint control module: a062 event accel pedal pos; raw 255 = signal not available (SNA)";
CM_ SG_ 1297 RCM_a063_eventArmStatus "Restraint control module: a063 event arm status";
CM_ SG_ 1297 RCM_a063_eventFactoryMode "Restraint control module: a063 event factory mode";
CM_ SG_ 1297 RCM_a063_eventDiagEnabled "Restraint control module: a063 event diag enabled";
CM_ SG_ 1297 RCM_a063_eventDriveOrientation "Restraint control module: a063 event drive orientation";
CM_ SG_ 1297 RCM_a063_sbsw2ndRowRSht2Gnd "Restraint control module: a063 sbsw2nd row r sht2 gnd";
CM_ SG_ 1297 RCM_a063_sbsw2ndRowRSht2Bat "Restraint control module: a063 sbsw2nd row r sht2 bat";
CM_ SG_ 1297 RCM_a063_sbsw2ndRowROpen "Restraint control module: a063 sbsw2nd row r open";
CM_ SG_ 1297 RCM_a063_sbsw2ndRowRUndefined "Restraint control module: a063 sbsw2nd row r undefined";
CM_ SG_ 1297 RCM_a063_sbsw2ndRowRCrossCoup "Restraint control module: a063 sbsw2nd row r cross coup";
CM_ SG_ 1297 RCM_a063_sbsw2ndRowRConfig "Restraint control module: a063 sbsw2nd row r config";
CM_ SG_ 1297 RCM_a063_eventIDFsignal "Restraint control module: a063 event ID fsignal";
CM_ SG_ 1297 RCM_a063_eventFrontLeftSeatbelt "Restraint control module: a063 event front left seatbelt";
CM_ SG_ 1297 RCM_a063_eventFrontRightSeatbelt "Restraint control module: a063 event front right seatbelt";
CM_ SG_ 1297 RCM_a063_eventVehicleSpeed "Restraint control module: a063 event vehicle speed";
CM_ SG_ 1297 RCM_a063_eventSteeringAngle "Restraint control module: a063 event steering angle";
CM_ SG_ 1297 RCM_a063_eventDriverBrakeApply "Restraint control module: a063 event driver brake apply; raw 3 = signal not available (SNA)";
CM_ SG_ 1297 RCM_a063_eventAccelPedalPos "Restraint control module: a063 event accel pedal pos; raw 255 = signal not available (SNA)";
CM_ SG_ 1297 RCM_a064_eventArmStatus "Restraint control module: a064 event arm status";
CM_ SG_ 1297 RCM_a064_eventFactoryMode "Restraint control module: a064 event factory mode";
CM_ SG_ 1297 RCM_a064_eventDiagEnabled "Restraint control module: a064 event diag enabled";
CM_ SG_ 1297 RCM_a064_eventDriveOrientation "Restraint control module: a064 event drive orientation";
CM_ SG_ 1297 RCM_a064_hwcp1CheckFail "Restraint control module: a064 hwcp1 check fail";
CM_ SG_ 1297 RCM_a064_hwcp1Sht2Bat "Restraint control module: a064 hwcp1 sht2 bat";
CM_ SG_ 1297 RCM_a064_hwcp1CrossCoup "Restraint control module: a064 hwcp1 cross coup";
CM_ SG_ 1297 RCM_a064_hwcp1Config "Restraint control module: a064 hwcp1 config";
CM_ SG_ 1297 RCM_a064_eventIDFsignal "Restraint control module: a064 event ID fsignal";
CM_ SG_ 1297 RCM_a064_eventFrontLeftSeatbelt "Restraint control module: a064 event front left seatbelt";
CM_ SG_ 1297 RCM_a064_eventFrontRightSeatbelt "Restraint control module: a064 event front right seatbelt";
CM_ SG_ 1297 RCM_a064_eventVehicleSpeed "Restraint control module: a064 event vehicle speed";
CM_ SG_ 1297 RCM_a064_eventSteeringAngle "Restraint control module: a064 event steering angle";
CM_ SG_ 1297 RCM_a064_eventDriverBrakeApply "Restraint control module: a064 event driver brake apply; raw 3 = signal not available (SNA)";
CM_ SG_ 1297 RCM_a064_eventAccelPedalPos "Restraint control module: a064 event accel pedal pos; raw 255 = signal not available (SNA)";
CM_ SG_ 1297 RCM_a065_eventArmStatus "Restraint control module: a065 event arm status";
CM_ SG_ 1297 RCM_a065_eventFactoryMode "Restraint control module: a065 event factory mode";
CM_ SG_ 1297 RCM_a065_eventDiagEnabled "Restraint control module: a065 event diag enabled";
CM_ SG_ 1297 RCM_a065_eventDriveOrientation "Restraint control module: a065 event drive orientation";
CM_ SG_ 1297 RCM_a065_swDrvrOrientCheck "Restraint control module: a065 sw drvr orient check";
CM_ SG_ 1297 RCM_a065_swDrvrOrientSht2Bat "Restraint control module: a065 sw drvr orient sht2 bat";
CM_ SG_ 1297 RCM_a065_swDrvrOrientCrossCoup "Restraint control module: a065 sw drvr orient cross coup";
CM_ SG_ 1297 RCM_a065_swDrvrOrientConfig "Restraint control module: a065 sw drvr orient config";
CM_ SG_ 1297 RCM_a065_eventIDFsignal "Restraint control module: a065 event ID fsignal";
CM_ SG_ 1297 RCM_a065_eventFrontLeftSeatbelt "Restraint control module: a065 event front left seatbelt";
CM_ SG_ 1297 RCM_a065_eventFrontRightSeatbelt "Restraint control module: a065 event front right seatbelt";
CM_ SG_ 1297 RCM_a065_eventVehicleSpeed "Restraint control module: a065 event vehicle speed";
CM_ SG_ 1297 RCM_a065_eventSteeringAngle "Restraint control module: a065 event steering angle";
CM_ SG_ 1297 RCM_a065_eventDriverBrakeApply "Restraint control module: a065 event driver brake apply; raw 3 = signal not available (SNA)";
CM_ SG_ 1297 RCM_a065_eventAccelPedalPos "Restraint control module: a065 event accel pedal pos; raw 255 = signal not available (SNA)";
CM_ SG_ 1297 RCM_a066_eventArmStatus "Restraint control module: a066 event arm status";
CM_ SG_ 1297 RCM_a066_eventFactoryMode "Restraint control module: a066 event factory mode";
CM_ SG_ 1297 RCM_a066_eventDiagEnabled "Restraint control module: a066 event diag enabled";
CM_ SG_ 1297 RCM_a066_eventDriveOrientation "Restraint control module: a066 event drive orientation";
CM_ SG_ 1297 RCM_a066_sbsw2ndRowLShort "Restraint control module: a066 sbsw2nd row l short";
CM_ SG_ 1297 RCM_a066_sbsw2ndRowLSht2Bat "Restraint control module: a066 sbsw2nd row l sht2 bat";
CM_ SG_ 1297 RCM_a066_sbsw2ndRowLCrossCoup "Restraint control module: a066 sbsw2nd row l cross coup";
CM_ SG_ 1297 RCM_a066_sbsw2ndRowLConfig "Restraint control module: a066 sbsw2nd row l config";
CM_ SG_ 1297 RCM_a066_eventIDFsignal "Restraint control module: a066 event ID fsignal";
CM_ SG_ 1297 RCM_a066_eventFrontLeftSeatbelt "Restraint control module: a066 event front left seatbelt";
CM_ SG_ 1297 RCM_a066_eventFrontRightSeatbelt "Restraint control module: a066 event front right seatbelt";
CM_ SG_ 1297 RCM_a066_eventVehicleSpeed "Restraint control module: a066 event vehicle speed";
CM_ SG_ 1297 RCM_a066_eventSteeringAngle "Restraint control module: a066 event steering angle";
CM_ SG_ 1297 RCM_a066_eventDriverBrakeApply "Restraint control module: a066 event driver brake apply; raw 3 = signal not available (SNA)";
CM_ SG_ 1297 RCM_a066_eventAccelPedalPos "Restraint control module: a066 event accel pedal pos; raw 255 = signal not available (SNA)";
CM_ SG_ 1297 RCM_a067_eventArmStatus "Restraint control module: a067 event arm status";
CM_ SG_ 1297 RCM_a067_eventFactoryMode "Restraint control module: a067 event factory mode";
CM_ SG_ 1297 RCM_a067_eventDiagEnabled "Restraint control module: a067 event diag enabled";
CM_ SG_ 1297 RCM_a067_eventDriveOrientation "Restraint control module: a067 event drive orientation";
CM_ SG_ 1297 RCM_a067_comCANInitialization "Restraint control module: a067 com CAN initialization";
CM_ SG_ 1297 RCM_a067_eventIDFsignal "Restraint control module: a067 event ID fsignal";
CM_ SG_ 1297 RCM_a067_eventFrontLeftSeatbelt "Restraint control module: a067 event front left seatbelt";
CM_ SG_ 1297 RCM_a067_eventFrontRightSeatbelt "Restraint control module: a067 event front right seatbelt";
CM_ SG_ 1297 RCM_a067_eventVehicleSpeed "Restraint control module: a067 event vehicle speed";
CM_ SG_ 1297 RCM_a067_eventSteeringAngle "Restraint control module: a067 event steering angle";
CM_ SG_ 1297 RCM_a067_eventDriverBrakeApply "Restraint control module: a067 event driver brake apply; raw 3 = signal not available (SNA)";
CM_ SG_ 1297 RCM_a067_eventAccelPedalPos "Restraint control module: a067 event accel pedal pos; raw 255 = signal not available (SNA)";
CM_ SG_ 1297 RCM_a068_eventArmStatus "Restraint control module: a068 event arm status";
CM_ SG_ 1297 RCM_a068_eventFactoryMode "Restraint control module: a068 event factory mode";
CM_ SG_ 1297 RCM_a068_eventDiagEnabled "Restraint control module: a068 event diag enabled";
CM_ SG_ 1297 RCM_a068_eventDriveOrientation "Restraint control module: a068 event drive orientation";
CM_ SG_ 1297 RCM_a068_comChassisCANBusOff "Restraint control module: a068 com chassis CAN bus off";
CM_ SG_ 1297 RCM_a068_eventIDFsignal "Restraint control module: a068 event ID fsignal";
CM_ SG_ 1297 RCM_a068_eventFrontLeftSeatbelt "Restraint control module: a068 event front left seatbelt";
CM_ SG_ 1297 RCM_a068_eventFrontRightSeatbelt "Restraint control module: a068 event front right seatbelt";
CM_ SG_ 1297 RCM_a068_eventVehicleSpeed "Restraint control module: a068 event vehicle speed";
CM_ SG_ 1297 RCM_a068_eventSteeringAngle "Restraint control module: a068 event steering angle";
CM_ SG_ 1297 RCM_a068_eventDriverBrakeApply "Restraint control module: a068 event driver brake apply; raw 3 = signal not available (SNA)";
CM_ SG_ 1297 RCM_a068_eventAccelPedalPos "Restraint control module: a068 event accel pedal pos; raw 255 = signal not available (SNA)";
CM_ SG_ 1297 RCM_a069_eventArmStatus "Restraint control module: a069 event arm status";
CM_ SG_ 1297 RCM_a069_eventFactoryMode "Restraint control module: a069 event factory mode";
CM_ SG_ 1297 RCM_a069_eventDiagEnabled "Restraint control module: a069 event diag enabled";
CM_ SG_ 1297 RCM_a069_eventDriveOrientation "Restraint control module: a069 event drive orientation";
CM_ SG_ 1297 RCM_a069_comChassisCANPH7MIA "Restraint control module: a069 com chassis CANPH7 MIA";
CM_ SG_ 1297 RCM_a069_comChassisCANPH7ChkSm "Restraint control module: a069 com chassis CANPH7 chk sm";
CM_ SG_ 1297 RCM_a069_comChassisCANPH7Cntr "Restraint control module: a069 com chassis CANPH7 cntr";
CM_ SG_ 1297 RCM_a069_eventIDFsignal "Restraint control module: a069 event ID fsignal";
CM_ SG_ 1297 RCM_a069_eventFrontLeftSeatbelt "Restraint control module: a069 event front left seatbelt";
CM_ SG_ 1297 RCM_a069_eventFrontRightSeatbelt "Restraint control module: a069 event front right seatbelt";
CM_ SG_ 1297 RCM_a069_eventVehicleSpeed "Restraint control module: a069 event vehicle speed";
CM_ SG_ 1297 RCM_a069_eventSteeringAngle "Restraint control module: a069 event steering angle";
CM_ SG_ 1297 RCM_a069_eventDriverBrakeApply "Restraint control module: a069 event driver brake apply; raw 3 = signal not available (SNA)";
CM_ SG_ 1297 RCM_a069_eventAccelPedalPos "Restraint control module: a069 event accel pedal pos; raw 255 = signal not available (SNA)";
CM_ SG_ 1297 RCM_a070_eventArmStatus "Restraint control module: a070 event arm status";
CM_ SG_ 1297 RCM_a070_eventFactoryMode "Restraint control module: a070 event factory mode";
CM_ SG_ 1297 RCM_a070_eventDiagEnabled "Restraint control module: a070 event diag enabled";
CM_ SG_ 1297 RCM_a070_eventDriveOrientation "Restraint control module: a070 event drive orientation";
CM_ SG_ 1297 RCM_a070_comChassisCANPH8MIA "Restraint control module: a070 com chassis CANPH8 MIA";
CM_ SG_ 1297 RCM_a070_comChassisCANPH8ChkSm "Restraint control module: a070 com chassis CANPH8 chk sm";
CM_ SG_ 1297 RCM_a070_comChassisCANPH8Cntr "Restraint control module: a070 com chassis CANPH8 cntr";
CM_ SG_ 1297 RCM_a070_eventIDFsignal "Restraint control module: a070 event ID fsignal";
CM_ SG_ 1297 RCM_a070_eventFrontLeftSeatbelt "Restraint control module: a070 event front left seatbelt";
CM_ SG_ 1297 RCM_a070_eventFrontRightSeatbelt "Restraint control module: a070 event front right seatbelt";
CM_ SG_ 1297 RCM_a070_eventVehicleSpeed "Restraint control module: a070 event vehicle speed";
CM_ SG_ 1297 RCM_a070_eventSteeringAngle "Restraint control module: a070 event steering angle";
CM_ SG_ 1297 RCM_a070_eventDriverBrakeApply "Restraint control module: a070 event driver brake apply; raw 3 = signal not available (SNA)";
CM_ SG_ 1297 RCM_a070_eventAccelPedalPos "Restraint control module: a070 event accel pedal pos; raw 255 = signal not available (SNA)";
CM_ SG_ 1297 RCM_a071_eventArmStatus "Restraint control module: a071 event arm status";
CM_ SG_ 1297 RCM_a071_eventFactoryMode "Restraint control module: a071 event factory mode";
CM_ SG_ 1297 RCM_a071_eventDiagEnabled "Restraint control module: a071 event diag enabled";
CM_ SG_ 1297 RCM_a071_eventDriveOrientation "Restraint control module: a071 event drive orientation";
CM_ SG_ 1297 RCM_a071_comChassisCANPH9MIA "Restraint control module: a071 com chassis CANPH9 MIA";
CM_ SG_ 1297 RCM_a071_comChassisCANPH9ChkSm "Restraint control module: a071 com chassis CANPH9 chk sm";
CM_ SG_ 1297 RCM_a071_comChassisCANPH9Cntr "Restraint control module: a071 com chassis CANPH9 cntr";
CM_ SG_ 1297 RCM_a071_eventIDFsignal "Restraint control module: a071 event ID fsignal";
CM_ SG_ 1297 RCM_a071_eventFrontLeftSeatbelt "Restraint control module: a071 event front left seatbelt";
CM_ SG_ 1297 RCM_a071_eventFrontRightSeatbelt "Restraint control module: a071 event front right seatbelt";
CM_ SG_ 1297 RCM_a071_eventVehicleSpeed "Restraint control module: a071 event vehicle speed";
CM_ SG_ 1297 RCM_a071_eventSteeringAngle "Restraint control module: a071 event steering angle";
CM_ SG_ 1297 RCM_a071_eventDriverBrakeApply "Restraint control module: a071 event driver brake apply; raw 3 = signal not available (SNA)";
CM_ SG_ 1297 RCM_a071_eventAccelPedalPos "Restraint control module: a071 event accel pedal pos; raw 255 = signal not available (SNA)";
CM_ SG_ 1297 RCM_a072_eventArmStatus "Restraint control module: a072 event arm status";
CM_ SG_ 1297 RCM_a072_eventFactoryMode "Restraint control module: a072 event factory mode";
CM_ SG_ 1297 RCM_a072_eventDiagEnabled "Restraint control module: a072 event diag enabled";
CM_ SG_ 1297 RCM_a072_eventDriveOrientation "Restraint control module: a072 event drive orientation";
CM_ SG_ 1297 RCM_a072_comUnusedMIA "Restraint control module: a072 com unused MIA";
CM_ SG_ 1297 RCM_a072_comUnusedChkSm "Restraint control module: a072 com unused chk sm";
CM_ SG_ 1297 RCM_a072_comUnusedCntr "Restraint control module: a072 com unused cntr";
CM_ SG_ 1297 RCM_a072_eventIDFsignal "Restraint control module: a072 event ID fsignal";
CM_ SG_ 1297 RCM_a072_eventFrontLeftSeatbelt "Restraint control module: a072 event front left seatbelt";
CM_ SG_ 1297 RCM_a072_eventFrontRightSeatbelt "Restraint control module: a072 event front right seatbelt";
CM_ SG_ 1297 RCM_a072_eventVehicleSpeed "Restraint control module: a072 event vehicle speed";
CM_ SG_ 1297 RCM_a072_eventSteeringAngle "Restraint control module: a072 event steering angle";
CM_ SG_ 1297 RCM_a072_eventDriverBrakeApply "Restraint control module: a072 event driver brake apply; raw 3 = signal not available (SNA)";
CM_ SG_ 1297 RCM_a072_eventAccelPedalPos "Restraint control module: a072 event accel pedal pos; raw 255 = signal not available (SNA)";
CM_ SG_ 1297 RCM_a073_eventArmStatus "Restraint control module: a073 event arm status";
CM_ SG_ 1297 RCM_a073_eventFactoryMode "Restraint control module: a073 event factory mode";
CM_ SG_ 1297 RCM_a073_eventDiagEnabled "Restraint control module: a073 event diag enabled";
CM_ SG_ 1297 RCM_a073_eventDriveOrientation "Restraint control module: a073 event drive orientation";
CM_ SG_ 1297 RCM_a073_comChassisCANPH4MIA "Restraint control module: a073 com chassis CANPH4 MIA";
CM_ SG_ 1297 RCM_a073_comChassisCANPH4ChkSm "Restraint control module: a073 com chassis CANPH4 chk sm";
CM_ SG_ 1297 RCM_a073_comChassisCANPH4Cntr "Restraint control module: a073 com chassis CANPH4 cntr";
CM_ SG_ 1297 RCM_a073_eventIDFsignal "Restraint control module: a073 event ID fsignal";
CM_ SG_ 1297 RCM_a073_eventFrontLeftSeatbelt "Restraint control module: a073 event front left seatbelt";
CM_ SG_ 1297 RCM_a073_eventFrontRightSeatbelt "Restraint control module: a073 event front right seatbelt";
CM_ SG_ 1297 RCM_a073_eventVehicleSpeed "Restraint control module: a073 event vehicle speed";
CM_ SG_ 1297 RCM_a073_eventSteeringAngle "Restraint control module: a073 event steering angle";
CM_ SG_ 1297 RCM_a073_eventDriverBrakeApply "Restraint control module: a073 event driver brake apply; raw 3 = signal not available (SNA)";
CM_ SG_ 1297 RCM_a073_eventAccelPedalPos "Restraint control module: a073 event accel pedal pos; raw 255 = signal not available (SNA)";
CM_ SG_ 1297 RCM_a074_eventArmStatus "Restraint control module: a074 event arm status";
CM_ SG_ 1297 RCM_a074_eventFactoryMode "Restraint control module: a074 event factory mode";
CM_ SG_ 1297 RCM_a074_eventDiagEnabled "Restraint control module: a074 event diag enabled";
CM_ SG_ 1297 RCM_a074_eventDriveOrientation "Restraint control module: a074 event drive orientation";
CM_ SG_ 1297 RCM_a074_comChassisCANPH5MIA "Restraint control module: a074 com chassis CANPH5 MIA";
CM_ SG_ 1297 RCM_a074_comChassisCANPH5ChkSm "Restraint control module: a074 com chassis CANPH5 chk sm";
CM_ SG_ 1297 RCM_a074_comChassisCANPH5Cntr "Restraint control module: a074 com chassis CANPH5 cntr";
CM_ SG_ 1297 RCM_a074_eventIDFsignal "Restraint control module: a074 event ID fsignal";
CM_ SG_ 1297 RCM_a074_eventFrontLeftSeatbelt "Restraint control module: a074 event front left seatbelt";
CM_ SG_ 1297 RCM_a074_eventFrontRightSeatbelt "Restraint control module: a074 event front right seatbelt";
CM_ SG_ 1297 RCM_a074_eventVehicleSpeed "Restraint control module: a074 event vehicle speed";
CM_ SG_ 1297 RCM_a074_eventSteeringAngle "Restraint control module: a074 event steering angle";
CM_ SG_ 1297 RCM_a074_eventDriverBrakeApply "Restraint control module: a074 event driver brake apply; raw 3 = signal not available (SNA)";
CM_ SG_ 1297 RCM_a074_eventAccelPedalPos "Restraint control module: a074 event accel pedal pos; raw 255 = signal not available (SNA)";
CM_ SG_ 1297 RCM_a075_eventArmStatus "Restraint control module: a075 event arm status";
CM_ SG_ 1297 RCM_a075_eventFactoryMode "Restraint control module: a075 event factory mode";
CM_ SG_ 1297 RCM_a075_eventDiagEnabled "Restraint control module: a075 event diag enabled";
CM_ SG_ 1297 RCM_a075_eventDriveOrientation "Restraint control module: a075 event drive orientation";
CM_ SG_ 1297 RCM_a075_comChassisCANPH6MIA "Restraint control module: a075 com chassis CANPH6 MIA";
CM_ SG_ 1297 RCM_a075_comChassisCANPH6ChkSm "Restraint control module: a075 com chassis CANPH6 chk sm";
CM_ SG_ 1297 RCM_a075_comChassisCANPH6Cntr "Restraint control module: a075 com chassis CANPH6 cntr";
CM_ SG_ 1297 RCM_a075_eventIDFsignal "Restraint control module: a075 event ID fsignal";
CM_ SG_ 1297 RCM_a075_eventFrontLeftSeatbelt "Restraint control module: a075 event front left seatbelt";
CM_ SG_ 1297 RCM_a075_eventFrontRightSeatbelt "Restraint control module: a075 event front right seatbelt";
CM_ SG_ 1297 RCM_a075_eventVehicleSpeed "Restraint control module: a075 event vehicle speed";
CM_ SG_ 1297 RCM_a075_eventSteeringAngle "Restraint control module: a075 event steering angle";
CM_ SG_ 1297 RCM_a075_eventDriverBrakeApply "Restraint control module: a075 event driver brake apply; raw 3 = signal not available (SNA)";
CM_ SG_ 1297 RCM_a075_eventAccelPedalPos "Restraint control module: a075 event accel pedal pos; raw 255 = signal not available (SNA)";
CM_ SG_ 1297 RCM_a078_eventArmStatus "Restraint control module: a078 event arm status";
CM_ SG_ 1297 RCM_a078_eventFactoryMode "Restraint control module: a078 event factory mode";
CM_ SG_ 1297 RCM_a078_eventDiagEnabled "Restraint control module: a078 event diag enabled";
CM_ SG_ 1297 RCM_a078_eventDriveOrientation "Restraint control module: a078 event drive orientation";
CM_ SG_ 1297 RCM_a078_comOCS1PMIA "Restraint control module: a078 com OCS1 PMIA";
CM_ SG_ 1297 RCM_a078_comOCS1PChkSm "Restraint control module: a078 com OCS1 p chk sm";
CM_ SG_ 1297 RCM_a078_comOCS1PCntr "Restraint control module: a078 com OCS1 p cntr";
CM_ SG_ 1297 RCM_a078_eventIDFsignal "Restraint control module: a078 event ID fsignal";
CM_ SG_ 1297 RCM_a078_eventFrontLeftSeatbelt "Restraint control module: a078 event front left seatbelt";
CM_ SG_ 1297 RCM_a078_eventFrontRightSeatbelt "Restraint control module: a078 event front right seatbelt";
CM_ SG_ 1297 RCM_a078_eventVehicleSpeed "Restraint control module: a078 event vehicle speed";
CM_ SG_ 1297 RCM_a078_eventSteeringAngle "Restraint control module: a078 event steering angle";
CM_ SG_ 1297 RCM_a078_eventDriverBrakeApply "Restraint control module: a078 event driver brake apply; raw 3 = signal not available (SNA)";
CM_ SG_ 1297 RCM_a078_eventAccelPedalPos "Restraint control module: a078 event accel pedal pos; raw 255 = signal not available (SNA)";
CM_ SG_ 1297 RCM_a079_eventArmStatus "Restraint control module: a079 event arm status";
CM_ SG_ 1297 RCM_a079_eventFactoryMode "Restraint control module: a079 event factory mode";
CM_ SG_ 1297 RCM_a079_eventDiagEnabled "Restraint control module: a079 event diag enabled";
CM_ SG_ 1297 RCM_a079_eventDriveOrientation "Restraint control module: a079 event drive orientation";
CM_ SG_ 1297 RCM_a079_comOCS1DMIA "Restraint control module: a079 com OCS1 DMIA";
CM_ SG_ 1297 RCM_a079_comOCS1DChkSm "Restraint control module: a079 com OCS1 d chk sm";
CM_ SG_ 1297 RCM_a079_comOCS1DCntr "Restraint control module: a079 com OCS1 d cntr";
CM_ SG_ 1297 RCM_a079_eventIDFsignal "Restraint control module: a079 event ID fsignal";
CM_ SG_ 1297 RCM_a079_eventFrontLeftSeatbelt "Restraint control module: a079 event front left seatbelt";
CM_ SG_ 1297 RCM_a079_eventFrontRightSeatbelt "Restraint control module: a079 event front right seatbelt";
CM_ SG_ 1297 RCM_a079_eventVehicleSpeed "Restraint control module: a079 event vehicle speed";
CM_ SG_ 1297 RCM_a079_eventSteeringAngle "Restraint control module: a079 event steering angle";
CM_ SG_ 1297 RCM_a079_eventDriverBrakeApply "Restraint control module: a079 event driver brake apply; raw 3 = signal not available (SNA)";
CM_ SG_ 1297 RCM_a079_eventAccelPedalPos "Restraint control module: a079 event accel pedal pos; raw 255 = signal not available (SNA)";
CM_ SG_ 1297 RCM_a080_eventArmStatus "Restraint control module: a080 event arm status";
CM_ SG_ 1297 RCM_a080_eventFactoryMode "Restraint control module: a080 event factory mode";
CM_ SG_ 1297 RCM_a080_eventDiagEnabled "Restraint control module: a080 event diag enabled";
CM_ SG_ 1297 RCM_a080_eventDriveOrientation "Restraint control module: a080 event drive orientation";
CM_ SG_ 1297 RCM_a080_comGTWACSMIA "Restraint control module: a080 com GTWACSMIA";
CM_ SG_ 1297 RCM_a080_comGTWACSChkSm "Restraint control module: a080 com GTWACS chk sm";
CM_ SG_ 1297 RCM_a080_comGTWACSCntr "Restraint control module: a080 com GTWACS cntr";
CM_ SG_ 1297 RCM_a080_eventIDFsignal "Restraint control module: a080 event ID fsignal";
CM_ SG_ 1297 RCM_a080_eventFrontLeftSeatbelt "Restraint control module: a080 event front left seatbelt";
CM_ SG_ 1297 RCM_a080_eventFrontRightSeatbelt "Restraint control module: a080 event front right seatbelt";
CM_ SG_ 1297 RCM_a080_eventVehicleSpeed "Restraint control module: a080 event vehicle speed";
CM_ SG_ 1297 RCM_a080_eventSteeringAngle "Restraint control module: a080 event steering angle";
CM_ SG_ 1297 RCM_a080_eventDriverBrakeApply "Restraint control module: a080 event driver brake apply; raw 3 = signal not available (SNA)";
CM_ SG_ 1297 RCM_a080_eventAccelPedalPos "Restraint control module: a080 event accel pedal pos; raw 255 = signal not available (SNA)";
CM_ SG_ 1297 RCM_a083_eventArmStatus "Restraint control module: a083 event arm status";
CM_ SG_ 1297 RCM_a083_eventFactoryMode "Restraint control module: a083 event factory mode";
CM_ SG_ 1297 RCM_a083_eventDiagEnabled "Restraint control module: a083 event diag enabled";
CM_ SG_ 1297 RCM_a083_eventDriveOrientation "Restraint control module: a083 event drive orientation";
CM_ SG_ 1297 RCM_a083_comGTWCarStateMIA "Restraint control module: a083 com GTW car state MIA";
CM_ SG_ 1297 RCM_a083_eventIDFsignal "Restraint control module: a083 event ID fsignal";
CM_ SG_ 1297 RCM_a083_eventFrontLeftSeatbelt "Restraint control module: a083 event front left seatbelt";
CM_ SG_ 1297 RCM_a083_eventFrontRightSeatbelt "Restraint control module: a083 event front right seatbelt";
CM_ SG_ 1297 RCM_a083_eventVehicleSpeed "Restraint control module: a083 event vehicle speed";
CM_ SG_ 1297 RCM_a083_eventSteeringAngle "Restraint control module: a083 event steering angle";
CM_ SG_ 1297 RCM_a083_eventDriverBrakeApply "Restraint control module: a083 event driver brake apply; raw 3 = signal not available (SNA)";
CM_ SG_ 1297 RCM_a083_eventAccelPedalPos "Restraint control module: a083 event accel pedal pos; raw 255 = signal not available (SNA)";
CM_ SG_ 1297 RCM_a087_eventArmStatus "Restraint control module: a087 event arm status";
CM_ SG_ 1297 RCM_a087_eventFactoryMode "Restraint control module: a087 event factory mode";
CM_ SG_ 1297 RCM_a087_eventDiagEnabled "Restraint control module: a087 event diag enabled";
CM_ SG_ 1297 RCM_a087_eventDriveOrientation "Restraint control module: a087 event drive orientation";
CM_ SG_ 1297 RCM_a087_comChassisCANSilent "Restraint control module: a087 com chassis CAN silent";
CM_ SG_ 1297 RCM_a087_comPARTYCANSilent "Restraint control module: a087 com PARTYCAN silent";
CM_ SG_ 1297 RCM_a087_comUnusedCANSilent "Restraint control module: a087 com unused CAN silent";
CM_ SG_ 1297 RCM_a087_eventIDFsignal "Restraint control module: a087 event ID fsignal";
CM_ SG_ 1297 RCM_a087_eventFrontLeftSeatbelt "Restraint control module: a087 event front left seatbelt";
CM_ SG_ 1297 RCM_a087_eventFrontRightSeatbelt "Restraint control module: a087 event front right seatbelt";
CM_ SG_ 1297 RCM_a087_eventVehicleSpeed "Restraint control module: a087 event vehicle speed";
CM_ SG_ 1297 RCM_a087_eventSteeringAngle "Restraint control module: a087 event steering angle";
CM_ SG_ 1297 RCM_a087_eventDriverBrakeApply "Restraint control module: a087 event driver brake apply; raw 3 = signal not available (SNA)";
CM_ SG_ 1297 RCM_a087_eventAccelPedalPos "Restraint control module: a087 event accel pedal pos; raw 255 = signal not available (SNA)";
CM_ SG_ 1297 RCM_a088_eventArmStatus "Restraint control module: a088 event arm status";
CM_ SG_ 1297 RCM_a088_eventFactoryMode "Restraint control module: a088 event factory mode";
CM_ SG_ 1297 RCM_a088_eventDiagEnabled "Restraint control module: a088 event diag enabled";
CM_ SG_ 1297 RCM_a088_eventDriveOrientation "Restraint control module: a088 event drive orientation";
CM_ SG_ 1297 RCM_a088_comChassisCANPH2MIA "Restraint control module: a088 com chassis CANPH2 MIA";
CM_ SG_ 1297 RCM_a088_comChassisCANPH2ChkSm "Restraint control module: a088 com chassis CANPH2 chk sm";
CM_ SG_ 1297 RCM_a088_comChassisCANPH2Cntr "Restraint control module: a088 com chassis CANPH2 cntr";
CM_ SG_ 1297 RCM_a088_eventIDFsignal "Restraint control module: a088 event ID fsignal";
CM_ SG_ 1297 RCM_a088_eventFrontLeftSeatbelt "Restraint control module: a088 event front left seatbelt";
CM_ SG_ 1297 RCM_a088_eventFrontRightSeatbelt "Restraint control module: a088 event front right seatbelt";
CM_ SG_ 1297 RCM_a088_eventVehicleSpeed "Restraint control module: a088 event vehicle speed";
CM_ SG_ 1297 RCM_a088_eventSteeringAngle "Restraint control module: a088 event steering angle";
CM_ SG_ 1297 RCM_a088_eventDriverBrakeApply "Restraint control module: a088 event driver brake apply; raw 3 = signal not available (SNA)";
CM_ SG_ 1297 RCM_a088_eventAccelPedalPos "Restraint control module: a088 event accel pedal pos; raw 255 = signal not available (SNA)";
CM_ SG_ 1297 RCM_a089_eventArmStatus "Restraint control module: a089 event arm status";
CM_ SG_ 1297 RCM_a089_eventFactoryMode "Restraint control module: a089 event factory mode";
CM_ SG_ 1297 RCM_a089_eventDiagEnabled "Restraint control module: a089 event diag enabled";
CM_ SG_ 1297 RCM_a089_eventDriveOrientation "Restraint control module: a089 event drive orientation";
CM_ SG_ 1297 RCM_a089_comChassisCANPH3MIA "Restraint control module: a089 com chassis CANPH3 MIA";
CM_ SG_ 1297 RCM_a089_comChassisCANPH3ChkSm "Restraint control module: a089 com chassis CANPH3 chk sm";
CM_ SG_ 1297 RCM_a089_comChassisCANPH3Cntr "Restraint control module: a089 com chassis CANPH3 cntr";
CM_ SG_ 1297 RCM_a089_eventIDFsignal "Restraint control module: a089 event ID fsignal";
CM_ SG_ 1297 RCM_a089_eventFrontLeftSeatbelt "Restraint control module: a089 event front left seatbelt";
CM_ SG_ 1297 RCM_a089_eventFrontRightSeatbelt "Restraint control module: a089 event front right seatbelt";
CM_ SG_ 1297 RCM_a089_eventVehicleSpeed "Restraint control module: a089 event vehicle speed";
CM_ SG_ 1297 RCM_a089_eventSteeringAngle "Restraint control module: a089 event steering angle";
CM_ SG_ 1297 RCM_a089_eventDriverBrakeApply "Restraint control module: a089 event driver brake apply; raw 3 = signal not available (SNA)";
CM_ SG_ 1297 RCM_a089_eventAccelPedalPos "Restraint control module: a089 event accel pedal pos; raw 255 = signal not available (SNA)";
CM_ SG_ 1297 RCM_a090_eventArmStatus "Restraint control module: a090 event arm status";
CM_ SG_ 1297 RCM_a090_eventFactoryMode "Restraint control module: a090 event factory mode";
CM_ SG_ 1297 RCM_a090_eventDiagEnabled "Restraint control module: a090 event diag enabled";
CM_ SG_ 1297 RCM_a090_eventDriveOrientation "Restraint control module: a090 event drive orientation";
CM_ SG_ 1297 RCM_a090_comPartyCANBusOff "Restraint control module: a090 com party CAN bus off";
CM_ SG_ 1297 RCM_a090_eventIDFsignal "Restraint control module: a090 event ID fsignal";
CM_ SG_ 1297 RCM_a090_eventFrontLeftSeatbelt "Restraint control module: a090 event front left seatbelt";
CM_ SG_ 1297 RCM_a090_eventFrontRightSeatbelt "Restraint control module: a090 event front right seatbelt";
CM_ SG_ 1297 RCM_a090_eventVehicleSpeed "Restraint control module: a090 event vehicle speed";
CM_ SG_ 1297 RCM_a090_eventSteeringAngle "Restraint control module: a090 event steering angle";
CM_ SG_ 1297 RCM_a090_eventDriverBrakeApply "Restraint control module: a090 event driver brake apply; raw 3 = signal not available (SNA)";
CM_ SG_ 1297 RCM_a090_eventAccelPedalPos "Restraint control module: a090 event accel pedal pos; raw 255 = signal not available (SNA)";
CM_ SG_ 1297 RCM_a092_eventArmStatus "Restraint control module: a092 event arm status";
CM_ SG_ 1297 RCM_a092_eventFactoryMode "Restraint control module: a092 event factory mode";
CM_ SG_ 1297 RCM_a092_eventDiagEnabled "Restraint control module: a092 event diag enabled";
CM_ SG_ 1297 RCM_a092_eventDriveOrientation "Restraint control module: a092 event drive orientation";
CM_ SG_ 1297 RCM_a092_comDASSafetyFrontMIA "Restraint control module: a092 com DAS safety front MIA";
CM_ SG_ 1297 RCM_a092_comDASSafetyFrontChkSm "Restraint control module: a092 com DAS safety front chk sm";
CM_ SG_ 1297 RCM_a092_comDASSafetyFrontCntr "Restraint control module: a092 com DAS safety front cntr";
CM_ SG_ 1297 RCM_a092_eventIDFsignal "Restraint control module: a092 event ID fsignal";
CM_ SG_ 1297 RCM_a092_eventFrontLeftSeatbelt "Restraint control module: a092 event front left seatbelt";
CM_ SG_ 1297 RCM_a092_eventFrontRightSeatbelt "Restraint control module: a092 event front right seatbelt";
CM_ SG_ 1297 RCM_a092_eventVehicleSpeed "Restraint control module: a092 event vehicle speed";
CM_ SG_ 1297 RCM_a092_eventSteeringAngle "Restraint control module: a092 event steering angle";
CM_ SG_ 1297 RCM_a092_eventDriverBrakeApply "Restraint control module: a092 event driver brake apply; raw 3 = signal not available (SNA)";
CM_ SG_ 1297 RCM_a092_eventAccelPedalPos "Restraint control module: a092 event accel pedal pos; raw 255 = signal not available (SNA)";
CM_ SG_ 1297 RCM_a093_eventArmStatus "Restraint control module: a093 event arm status";
CM_ SG_ 1297 RCM_a093_eventFactoryMode "Restraint control module: a093 event factory mode";
CM_ SG_ 1297 RCM_a093_eventDiagEnabled "Restraint control module: a093 event diag enabled";
CM_ SG_ 1297 RCM_a093_eventDriveOrientation "Restraint control module: a093 event drive orientation";
CM_ SG_ 1297 RCM_a093_comVCLEFTStatusMIA "Restraint control module: a093 com VCLEFT status MIA";
CM_ SG_ 1297 RCM_a093_comVCLEFTStatusChkSm "Restraint control module: a093 com VCLEFT status chk sm";
CM_ SG_ 1297 RCM_a093_comVCLEFTStatusCntr "Restraint control module: a093 com VCLEFT status cntr";
CM_ SG_ 1297 RCM_a093_bucklSwVCFrontLeftFault "Restraint control module: a093 buckl sw VC front left fault";
CM_ SG_ 1297 RCM_a093_bucklSwVCRearLeftFault "Restraint control module: a093 buckl sw VC rear left fault";
CM_ SG_ 1297 RCM_a093_eventIDFsignal "Restraint control module: a093 event ID fsignal";
CM_ SG_ 1297 RCM_a093_eventFrontLeftSeatbelt "Restraint control module: a093 event front left seatbelt";
CM_ SG_ 1297 RCM_a093_eventFrontRightSeatbelt "Restraint control module: a093 event front right seatbelt";
CM_ SG_ 1297 RCM_a093_eventVehicleSpeed "Restraint control module: a093 event vehicle speed";
CM_ SG_ 1297 RCM_a093_eventSteeringAngle "Restraint control module: a093 event steering angle";
CM_ SG_ 1297 RCM_a093_eventDriverBrakeApply "Restraint control module: a093 event driver brake apply; raw 3 = signal not available (SNA)";
CM_ SG_ 1297 RCM_a093_eventAccelPedalPos "Restraint control module: a093 event accel pedal pos; raw 255 = signal not available (SNA)";
CM_ SG_ 1297 RCM_a094_eventArmStatus "Restraint control module: a094 event arm status";
CM_ SG_ 1297 RCM_a094_eventFactoryMode "Restraint control module: a094 event factory mode";
CM_ SG_ 1297 RCM_a094_eventDiagEnabled "Restraint control module: a094 event diag enabled";
CM_ SG_ 1297 RCM_a094_eventDriveOrientation "Restraint control module: a094 event drive orientation";
CM_ SG_ 1297 RCM_a094_comVCRIGHTStatusMIA "Restraint control module: a094 com VCRIGHT status MIA";
CM_ SG_ 1297 RCM_a094_comVCRIGHTStatusChkSm "Restraint control module: a094 com VCRIGHT status chk sm";
CM_ SG_ 1297 RCM_a094_comVCRIGHTStatusCntr "Restraint control module: a094 com VCRIGHT status cntr";
CM_ SG_ 1297 RCM_a094_bucklSwVCFrontRghtFault "Restraint control module: a094 buckl sw VC front rght fault";
CM_ SG_ 1297 RCM_a094_bucklSwVCRearRghtFault "Restraint control module: a094 buckl sw VC rear rght fault";
CM_ SG_ 1297 RCM_a094_bucklSwVCRearCnterFault "Restraint control module: a094 buckl sw VC rear cnter fault";
CM_ SG_ 1297 RCM_a094_eventIDFsignal "Restraint control module: a094 event ID fsignal";
CM_ SG_ 1297 RCM_a094_eventFrontLeftSeatbelt "Restraint control module: a094 event front left seatbelt";
CM_ SG_ 1297 RCM_a094_eventFrontRightSeatbelt "Restraint control module: a094 event front right seatbelt";
CM_ SG_ 1297 RCM_a094_eventVehicleSpeed "Restraint control module: a094 event vehicle speed";
CM_ SG_ 1297 RCM_a094_eventSteeringAngle "Restraint control module: a094 event steering angle";
CM_ SG_ 1297 RCM_a094_eventDriverBrakeApply "Restraint control module: a094 event driver brake apply; raw 3 = signal not available (SNA)";
CM_ SG_ 1297 RCM_a094_eventAccelPedalPos "Restraint control module: a094 event accel pedal pos; raw 255 = signal not available (SNA)";
CM_ SG_ 1297 RCM_a101_eventArmStatus "Restraint control module: a101 event arm status";
CM_ SG_ 1297 RCM_a101_eventFactoryMode "Restraint control module: a101 event factory mode";
CM_ SG_ 1297 RCM_a101_eventDiagEnabled "Restraint control module: a101 event diag enabled";
CM_ SG_ 1297 RCM_a101_eventDriveOrientation "Restraint control module: a101 event drive orientation";
CM_ SG_ 1297 RCM_a101_idfMisuseMonitoringErr "Restraint control module: a101 idf misuse monitoring err";
CM_ SG_ 1297 RCM_a101_idfEnviMonitoringError "Restraint control module: a101 idf envi monitoring error";
CM_ SG_ 1297 RCM_a101_idfEnviMonitoringEvent "Restraint control module: a101 idf envi monitoring event";
CM_ SG_ 1297 RCM_a101_eventIDFsignal "Restraint control module: a101 event ID fsignal";
CM_ SG_ 1297 RCM_a101_eventFrontLeftSeatbelt "Restraint control module: a101 event front left seatbelt";
CM_ SG_ 1297 RCM_a101_eventFrontRightSeatbelt "Restraint control module: a101 event front right seatbelt";
CM_ SG_ 1297 RCM_a101_eventVehicleSpeed "Restraint control module: a101 event vehicle speed";
CM_ SG_ 1297 RCM_a101_eventSteeringAngle "Restraint control module: a101 event steering angle";
CM_ SG_ 1297 RCM_a101_eventDriverBrakeApply "Restraint control module: a101 event driver brake apply; raw 3 = signal not available (SNA)";
CM_ SG_ 1297 RCM_a101_eventAccelPedalPos "Restraint control module: a101 event accel pedal pos; raw 255 = signal not available (SNA)";
CM_ SG_ 1297 RCM_a102_eventArmStatus "Restraint control module: a102 event arm status";
CM_ SG_ 1297 RCM_a102_eventFactoryMode "Restraint control module: a102 event factory mode";
CM_ SG_ 1297 RCM_a102_eventDiagEnabled "Restraint control module: a102 event diag enabled";
CM_ SG_ 1297 RCM_a102_eventDriveOrientation "Restraint control module: a102 event drive orientation";
CM_ SG_ 1297 RCM_a102_imuYawR8OffCompPosLife "Restraint control module: a102 imu yaw R8 off comp pos life";
CM_ SG_ 1297 RCM_a102_imuYawR8OffCompNegLife "Restraint control module: a102 imu yaw R8 off comp neg life";
CM_ SG_ 1297 RCM_a102_imuYawR8OffCompPosFLDC "Restraint control module: a102 imu yaw R8 off comp pos FLDC";
CM_ SG_ 1297 RCM_a102_imuYawR8OffCompNegFLDC "Restraint control module: a102 imu yaw R8 off comp neg FLDC";
CM_ SG_ 1297 RCM_a102_imuYawR8OffCompPosSLDC "Restraint control module: a102 imu yaw R8 off comp pos SLDC";
CM_ SG_ 1297 RCM_a102_imuYawR8OffCompNegSLDC "Restraint control module: a102 imu yaw R8 off comp neg SLDC";
CM_ SG_ 1297 RCM_a102_eventIDFsignal "Restraint control module: a102 event ID fsignal";
CM_ SG_ 1297 RCM_a102_eventFrontLeftSeatbelt "Restraint control module: a102 event front left seatbelt";
CM_ SG_ 1297 RCM_a102_eventFrontRightSeatbelt "Restraint control module: a102 event front right seatbelt";
CM_ SG_ 1297 RCM_a102_eventVehicleSpeed "Restraint control module: a102 event vehicle speed";
CM_ SG_ 1297 RCM_a102_eventSteeringAngle "Restraint control module: a102 event steering angle";
CM_ SG_ 1297 RCM_a102_eventDriverBrakeApply "Restraint control module: a102 event driver brake apply; raw 3 = signal not available (SNA)";
CM_ SG_ 1297 RCM_a102_eventAccelPedalPos "Restraint control module: a102 event accel pedal pos; raw 255 = signal not available (SNA)";
CM_ SG_ 1297 RCM_a103_eventArmStatus "Restraint control module: a103 event arm status";
CM_ SG_ 1297 RCM_a103_eventFactoryMode "Restraint control module: a103 event factory mode";
CM_ SG_ 1297 RCM_a103_eventDiagEnabled "Restraint control module: a103 event diag enabled";
CM_ SG_ 1297 RCM_a103_eventDriveOrientation "Restraint control module: a103 event drive orientation";
CM_ SG_ 1297 RCM_a103_imuPtchR8OffCompPosLife "Restraint control module: a103 imu ptch R8 off comp pos life";
CM_ SG_ 1297 RCM_a103_imuPtchR8OffCompNegLife "Restraint control module: a103 imu ptch R8 off comp neg life";
CM_ SG_ 1297 RCM_a103_imuPtchR8OffCompPosFLDC "Restraint control module: a103 imu ptch R8 off comp pos FLDC";
CM_ SG_ 1297 RCM_a103_imuPtchR8OffCompNegFLDC "Restraint control module: a103 imu ptch R8 off comp neg FLDC";
CM_ SG_ 1297 RCM_a103_imuPtchR8OffCompPosSLDC "Restraint control module: a103 imu ptch R8 off comp pos SLDC";
CM_ SG_ 1297 RCM_a103_imuPtchR8OffCompNegSLDC "Restraint control module: a103 imu ptch R8 off comp neg SLDC";
CM_ SG_ 1297 RCM_a103_eventIDFsignal "Restraint control module: a103 event ID fsignal";
CM_ SG_ 1297 RCM_a103_eventFrontLeftSeatbelt "Restraint control module: a103 event front left seatbelt";
CM_ SG_ 1297 RCM_a103_eventFrontRightSeatbelt "Restraint control module: a103 event front right seatbelt";
CM_ SG_ 1297 RCM_a103_eventVehicleSpeed "Restraint control module: a103 event vehicle speed";
CM_ SG_ 1297 RCM_a103_eventSteeringAngle "Restraint control module: a103 event steering angle";
CM_ SG_ 1297 RCM_a103_eventDriverBrakeApply "Restraint control module: a103 event driver brake apply; raw 3 = signal not available (SNA)";
CM_ SG_ 1297 RCM_a103_eventAccelPedalPos "Restraint control module: a103 event accel pedal pos; raw 255 = signal not available (SNA)";
CM_ SG_ 1297 RCM_a104_eventArmStatus "Restraint control module: a104 event arm status";
CM_ SG_ 1297 RCM_a104_eventFactoryMode "Restraint control module: a104 event factory mode";
CM_ SG_ 1297 RCM_a104_eventDiagEnabled "Restraint control module: a104 event diag enabled";
CM_ SG_ 1297 RCM_a104_eventDriveOrientation "Restraint control module: a104 event drive orientation";
CM_ SG_ 1297 RCM_a104_imuRollR8OffCompPosLife "Restraint control module: a104 imu roll R8 off comp pos life";
CM_ SG_ 1297 RCM_a104_imuRollR8OffCompNegLife "Restraint control module: a104 imu roll R8 off comp neg life";
CM_ SG_ 1297 RCM_a104_imuRollR8OffCompPosFLDC "Restraint control module: a104 imu roll R8 off comp pos FLDC";
CM_ SG_ 1297 RCM_a104_imuRollR8OffCompNegFLDC "Restraint control module: a104 imu roll R8 off comp neg FLDC";
CM_ SG_ 1297 RCM_a104_imuRollR8OffCompPosSLDC "Restraint control module: a104 imu roll R8 off comp pos SLDC";
CM_ SG_ 1297 RCM_a104_imuRollR8OffCompNegSLDC "Restraint control module: a104 imu roll R8 off comp neg SLDC";
CM_ SG_ 1297 RCM_a104_eventIDFsignal "Restraint control module: a104 event ID fsignal";
CM_ SG_ 1297 RCM_a104_eventFrontLeftSeatbelt "Restraint control module: a104 event front left seatbelt";
CM_ SG_ 1297 RCM_a104_eventFrontRightSeatbelt "Restraint control module: a104 event front right seatbelt";
CM_ SG_ 1297 RCM_a104_eventVehicleSpeed "Restraint control module: a104 event vehicle speed";
CM_ SG_ 1297 RCM_a104_eventSteeringAngle "Restraint control module: a104 event steering angle";
CM_ SG_ 1297 RCM_a104_eventDriverBrakeApply "Restraint control module: a104 event driver brake apply; raw 3 = signal not available (SNA)";
CM_ SG_ 1297 RCM_a104_eventAccelPedalPos "Restraint control module: a104 event accel pedal pos; raw 255 = signal not available (SNA)";
CM_ SG_ 1297 RCM_a105_eventArmStatus "Restraint control module: a105 event arm status";
CM_ SG_ 1297 RCM_a105_eventFactoryMode "Restraint control module: a105 event factory mode";
CM_ SG_ 1297 RCM_a105_eventDiagEnabled "Restraint control module: a105 event diag enabled";
CM_ SG_ 1297 RCM_a105_eventDriveOrientation "Restraint control module: a105 event drive orientation";
CM_ SG_ 1297 RCM_a105_imuLongAOffCompPosLife "Restraint control module: a105 imu long a off comp pos life";
CM_ SG_ 1297 RCM_a105_imuLongAOffCompNegLife "Restraint control module: a105 imu long a off comp neg life";
CM_ SG_ 1297 RCM_a105_imuLongAOffCompPosFLDC "Restraint control module: a105 imu long a off comp pos FLDC";
CM_ SG_ 1297 RCM_a105_imuLongAOffCompNegFLDC "Restraint control module: a105 imu long a off comp neg FLDC";
CM_ SG_ 1297 RCM_a105_imuLongAOffCompPosSLDC "Restraint control module: a105 imu long a off comp pos SLDC";
CM_ SG_ 1297 RCM_a105_imuLongAOffCompNegSLDC "Restraint control module: a105 imu long a off comp neg SLDC";
CM_ SG_ 1297 RCM_a105_eventIDFsignal "Restraint control module: a105 event ID fsignal";
CM_ SG_ 1297 RCM_a105_eventFrontLeftSeatbelt "Restraint control module: a105 event front left seatbelt";
CM_ SG_ 1297 RCM_a105_eventFrontRightSeatbelt "Restraint control module: a105 event front right seatbelt";
CM_ SG_ 1297 RCM_a105_eventVehicleSpeed "Restraint control module: a105 event vehicle speed";
CM_ SG_ 1297 RCM_a105_eventSteeringAngle "Restraint control module: a105 event steering angle";
CM_ SG_ 1297 RCM_a105_eventDriverBrakeApply "Restraint control module: a105 event driver brake apply; raw 3 = signal not available (SNA)";
CM_ SG_ 1297 RCM_a105_eventAccelPedalPos "Restraint control module: a105 event accel pedal pos; raw 255 = signal not available (SNA)";
CM_ SG_ 1297 RCM_a106_eventArmStatus "Restraint control module: a106 event arm status";
CM_ SG_ 1297 RCM_a106_eventFactoryMode "Restraint control module: a106 event factory mode";
CM_ SG_ 1297 RCM_a106_eventDiagEnabled "Restraint control module: a106 event diag enabled";
CM_ SG_ 1297 RCM_a106_eventDriveOrientation "Restraint control module: a106 event drive orientation";
CM_ SG_ 1297 RCM_a106_imuLatAcOffCompPosLife "Restraint control module: a106 imu lat ac off comp pos life";
CM_ SG_ 1297 RCM_a106_imuLatAcOffCompNegLife "Restraint control module: a106 imu lat ac off comp neg life";
CM_ SG_ 1297 RCM_a106_imuLatAcOffCompPosFLDC "Restraint control module: a106 imu lat ac off comp pos FLDC";
CM_ SG_ 1297 RCM_a106_imuLatAcOffCompNegFLDC "Restraint control module: a106 imu lat ac off comp neg FLDC";
CM_ SG_ 1297 RCM_a106_imuLatAcOffCompPosSLDC "Restraint control module: a106 imu lat ac off comp pos SLDC";
CM_ SG_ 1297 RCM_a106_imuLatAcOffCompNegSLDC "Restraint control module: a106 imu lat ac off comp neg SLDC";
CM_ SG_ 1297 RCM_a106_eventIDFsignal "Restraint control module: a106 event ID fsignal";
CM_ SG_ 1297 RCM_a106_eventFrontLeftSeatbelt "Restraint control module: a106 event front left seatbelt";
CM_ SG_ 1297 RCM_a106_eventFrontRightSeatbelt "Restraint control module: a106 event front right seatbelt";
CM_ SG_ 1297 RCM_a106_eventVehicleSpeed "Restraint control module: a106 event vehicle speed";
CM_ SG_ 1297 RCM_a106_eventSteeringAngle "Restraint control module: a106 event steering angle";
CM_ SG_ 1297 RCM_a106_eventDriverBrakeApply "Restraint control module: a106 event driver brake apply; raw 3 = signal not available (SNA)";
CM_ SG_ 1297 RCM_a106_eventAccelPedalPos "Restraint control module: a106 event accel pedal pos; raw 255 = signal not available (SNA)";
CM_ SG_ 1297 RCM_a107_eventArmStatus "Restraint control module: a107 event arm status";
CM_ SG_ 1297 RCM_a107_eventFactoryMode "Restraint control module: a107 event factory mode";
CM_ SG_ 1297 RCM_a107_eventDiagEnabled "Restraint control module: a107 event diag enabled";
CM_ SG_ 1297 RCM_a107_eventDriveOrientation "Restraint control module: a107 event drive orientation";
CM_ SG_ 1297 RCM_a107_imuVertAOffCompPosLife "Restraint control module: a107 imu vert a off comp pos life";
CM_ SG_ 1297 RCM_a107_imuVertAOffCompNegLife "Restraint control module: a107 imu vert a off comp neg life";
CM_ SG_ 1297 RCM_a107_imuVertAOffCompPosFLDC "Restraint control module: a107 imu vert a off comp pos FLDC";
CM_ SG_ 1297 RCM_a107_imuVertAOffCompNegFLDC "Restraint control module: a107 imu vert a off comp neg FLDC";
CM_ SG_ 1297 RCM_a107_imuVertAOffCompPosSLDC "Restraint control module: a107 imu vert a off comp pos SLDC";
CM_ SG_ 1297 RCM_a107_imuVertAOffCompNegSLDC "Restraint control module: a107 imu vert a off comp neg SLDC";
CM_ SG_ 1297 RCM_a107_eventIDFsignal "Restraint control module: a107 event ID fsignal";
CM_ SG_ 1297 RCM_a107_eventFrontLeftSeatbelt "Restraint control module: a107 event front left seatbelt";
CM_ SG_ 1297 RCM_a107_eventFrontRightSeatbelt "Restraint control module: a107 event front right seatbelt";
CM_ SG_ 1297 RCM_a107_eventVehicleSpeed "Restraint control module: a107 event vehicle speed";
CM_ SG_ 1297 RCM_a107_eventSteeringAngle "Restraint control module: a107 event steering angle";
CM_ SG_ 1297 RCM_a107_eventDriverBrakeApply "Restraint control module: a107 event driver brake apply; raw 3 = signal not available (SNA)";
CM_ SG_ 1297 RCM_a107_eventAccelPedalPos "Restraint control module: a107 event accel pedal pos; raw 255 = signal not available (SNA)";
CM_ SG_ 1297 RCM_a108_eventArmStatus "Restraint control module: a108 event arm status";
CM_ SG_ 1297 RCM_a108_eventFactoryMode "Restraint control module: a108 event factory mode";
CM_ SG_ 1297 RCM_a108_eventDiagEnabled "Restraint control module: a108 event diag enabled";
CM_ SG_ 1297 RCM_a108_eventDriveOrientation "Restraint control module: a108 event drive orientation";
CM_ SG_ 1297 RCM_a108_crashAlgoWakeupSig "Restraint control module: a108 crash algo wakeup sig";
CM_ SG_ 1297 RCM_a108_eventIDFsignal "Restraint control module: a108 event ID fsignal";
CM_ SG_ 1297 RCM_a108_eventFrontLeftSeatbelt "Restraint control module: a108 event front left seatbelt";
CM_ SG_ 1297 RCM_a108_eventFrontRightSeatbelt "Restraint control module: a108 event front right seatbelt";
CM_ SG_ 1297 RCM_a108_eventVehicleSpeed "Restraint control module: a108 event vehicle speed";
CM_ SG_ 1297 RCM_a108_eventSteeringAngle "Restraint control module: a108 event steering angle";
CM_ SG_ 1297 RCM_a108_eventDriverBrakeApply "Restraint control module: a108 event driver brake apply; raw 3 = signal not available (SNA)";
CM_ SG_ 1297 RCM_a108_eventAccelPedalPos "Restraint control module: a108 event accel pedal pos; raw 255 = signal not available (SNA)";
CM_ SG_ 1297 RCM_a109_eventArmStatus "Restraint control module: a109 event arm status";
CM_ SG_ 1297 RCM_a109_eventFactoryMode "Restraint control module: a109 event factory mode";
CM_ SG_ 1297 RCM_a109_eventDiagEnabled "Restraint control module: a109 event diag enabled";
CM_ SG_ 1297 RCM_a109_eventDriveOrientation "Restraint control module: a109 event drive orientation";
CM_ SG_ 1297 RCM_a109_immunityThrsholdCrossed "Restraint control module: a109 immunity thrshold crossed";
CM_ SG_ 1297 RCM_a109_eventIDFsignal "Restraint control module: a109 event ID fsignal";
CM_ SG_ 1297 RCM_a109_eventFrontLeftSeatbelt "Restraint control module: a109 event front left seatbelt";
CM_ SG_ 1297 RCM_a109_eventFrontRightSeatbelt "Restraint control module: a109 event front right seatbelt";
CM_ SG_ 1297 RCM_a109_eventVehicleSpeed "Restraint control module: a109 event vehicle speed";
CM_ SG_ 1297 RCM_a109_eventSteeringAngle "Restraint control module: a109 event steering angle";
CM_ SG_ 1297 RCM_a109_eventDriverBrakeApply "Restraint control module: a109 event driver brake apply; raw 3 = signal not available (SNA)";
CM_ SG_ 1297 RCM_a109_eventAccelPedalPos "Restraint control module: a109 event accel pedal pos; raw 255 = signal not available (SNA)";
CM_ SG_ 1297 RCM_a110_eventArmStatus "Restraint control module: a110 event arm status";
CM_ SG_ 1297 RCM_a110_eventFactoryMode "Restraint control module: a110 event factory mode";
CM_ SG_ 1297 RCM_a110_eventDiagEnabled "Restraint control module: a110 event diag enabled";
CM_ SG_ 1297 RCM_a110_eventDriveOrientation "Restraint control module: a110 event drive orientation";
CM_ SG_ 1297 RCM_a110_inFactoryMode "Restraint control module: a110 in factory mode";
CM_ SG_ 1297 RCM_a110_eventIDFsignal "Restraint control module: a110 event ID fsignal";
CM_ SG_ 1297 RCM_a110_eventFrontLeftSeatbelt "Restraint control module: a110 event front left seatbelt";
CM_ SG_ 1297 RCM_a110_eventFrontRightSeatbelt "Restraint control module: a110 event front right seatbelt";
CM_ SG_ 1297 RCM_a110_eventVehicleSpeed "Restraint control module: a110 event vehicle speed";
CM_ SG_ 1297 RCM_a110_eventSteeringAngle "Restraint control module: a110 event steering angle";
CM_ SG_ 1297 RCM_a110_eventDriverBrakeApply "Restraint control module: a110 event driver brake apply; raw 3 = signal not available (SNA)";
CM_ SG_ 1297 RCM_a110_eventAccelPedalPos "Restraint control module: a110 event accel pedal pos; raw 255 = signal not available (SNA)";
CM_ SG_ 1297 RCM_a112_eventArmStatus "Restraint control module: a112 event arm status";
CM_ SG_ 1297 RCM_a112_eventFactoryMode "Restraint control module: a112 event factory mode";
CM_ SG_ 1297 RCM_a112_eventDiagEnabled "Restraint control module: a112 event diag enabled";
CM_ SG_ 1297 RCM_a112_eventDriveOrientation "Restraint control module: a112 event drive orientation";
CM_ SG_ 1297 RCM_a112_imuYawR8SnsrMonitTmp "Restraint control module: a112 imu yaw R8 snsr monit tmp";
CM_ SG_ 1297 RCM_a112_imuYawR8SnsrMonitPerm "Restraint control module: a112 imu yaw R8 snsr monit perm";
CM_ SG_ 1297 RCM_a112_imuYawR8ChnlMonitTmp "Restraint control module: a112 imu yaw R8 chnl monit tmp";
CM_ SG_ 1297 RCM_a112_imuYawR8ChnlMonitPerm "Restraint control module: a112 imu yaw R8 chnl monit perm";
CM_ SG_ 1297 RCM_a112_eventIDFsignal "Restraint control module: a112 event ID fsignal";
CM_ SG_ 1297 RCM_a112_eventFrontLeftSeatbelt "Restraint control module: a112 event front left seatbelt";
CM_ SG_ 1297 RCM_a112_eventFrontRightSeatbelt "Restraint control module: a112 event front right seatbelt";
CM_ SG_ 1297 RCM_a112_eventVehicleSpeed "Restraint control module: a112 event vehicle speed";
CM_ SG_ 1297 RCM_a112_eventSteeringAngle "Restraint control module: a112 event steering angle";
CM_ SG_ 1297 RCM_a112_eventDriverBrakeApply "Restraint control module: a112 event driver brake apply; raw 3 = signal not available (SNA)";
CM_ SG_ 1297 RCM_a112_eventAccelPedalPos "Restraint control module: a112 event accel pedal pos; raw 255 = signal not available (SNA)";
CM_ SG_ 1297 RCM_a113_eventArmStatus "Restraint control module: a113 event arm status";
CM_ SG_ 1297 RCM_a113_eventFactoryMode "Restraint control module: a113 event factory mode";
CM_ SG_ 1297 RCM_a113_eventDiagEnabled "Restraint control module: a113 event diag enabled";
CM_ SG_ 1297 RCM_a113_eventDriveOrientation "Restraint control module: a113 event drive orientation";
CM_ SG_ 1297 RCM_a113_imuPitchR8SnsrMonitTmp "Restraint control module: a113 imu pitch R8 snsr monit tmp";
CM_ SG_ 1297 RCM_a113_imuPitchR8SnsrMonitPerm "Restraint control module: a113 imu pitch R8 snsr monit perm";
CM_ SG_ 1297 RCM_a113_imuPitchR8ChnlMonitTmp "Restraint control module: a113 imu pitch R8 chnl monit tmp";
CM_ SG_ 1297 RCM_a113_imuPitchR8ChnlMonitPerm "Restraint control module: a113 imu pitch R8 chnl monit perm";
CM_ SG_ 1297 RCM_a113_eventIDFsignal "Restraint control module: a113 event ID fsignal";
CM_ SG_ 1297 RCM_a113_eventFrontLeftSeatbelt "Restraint control module: a113 event front left seatbelt";
CM_ SG_ 1297 RCM_a113_eventFrontRightSeatbelt "Restraint control module: a113 event front right seatbelt";
CM_ SG_ 1297 RCM_a113_eventVehicleSpeed "Restraint control module: a113 event vehicle speed";
CM_ SG_ 1297 RCM_a113_eventSteeringAngle "Restraint control module: a113 event steering angle";
CM_ SG_ 1297 RCM_a113_eventDriverBrakeApply "Restraint control module: a113 event driver brake apply; raw 3 = signal not available (SNA)";
CM_ SG_ 1297 RCM_a113_eventAccelPedalPos "Restraint control module: a113 event accel pedal pos; raw 255 = signal not available (SNA)";
CM_ SG_ 1297 RCM_a114_eventArmStatus "Restraint control module: a114 event arm status";
CM_ SG_ 1297 RCM_a114_eventFactoryMode "Restraint control module: a114 event factory mode";
CM_ SG_ 1297 RCM_a114_eventDiagEnabled "Restraint control module: a114 event diag enabled";
CM_ SG_ 1297 RCM_a114_eventDriveOrientation "Restraint control module: a114 event drive orientation";
CM_ SG_ 1297 RCM_a114_imuRollR8SnsrMonitTmp "Restraint control module: a114 imu roll R8 snsr monit tmp";
CM_ SG_ 1297 RCM_a114_imuRollR8SnsrMonitPerm "Restraint control module: a114 imu roll R8 snsr monit perm";
CM_ SG_ 1297 RCM_a114_imuRollR8ChnlMonitTmp "Restraint control module: a114 imu roll R8 chnl monit tmp";
CM_ SG_ 1297 RCM_a114_imuRollR8ChnlMonitPerm "Restraint control module: a114 imu roll R8 chnl monit perm";
CM_ SG_ 1297 RCM_a114_eventIDFsignal "Restraint control module: a114 event ID fsignal";
CM_ SG_ 1297 RCM_a114_eventFrontLeftSeatbelt "Restraint control module: a114 event front left seatbelt";
CM_ SG_ 1297 RCM_a114_eventFrontRightSeatbelt "Restraint control module: a114 event front right seatbelt";
CM_ SG_ 1297 RCM_a114_eventVehicleSpeed "Restraint control module: a114 event vehicle speed";
CM_ SG_ 1297 RCM_a114_eventSteeringAngle "Restraint control module: a114 event steering angle";
CM_ SG_ 1297 RCM_a114_eventDriverBrakeApply "Restraint control module: a114 event driver brake apply; raw 3 = signal not available (SNA)";
CM_ SG_ 1297 RCM_a114_eventAccelPedalPos "Restraint control module: a114 event accel pedal pos; raw 255 = signal not available (SNA)";
CM_ SG_ 1297 RCM_a115_eventArmStatus "Restraint control module: a115 event arm status";
CM_ SG_ 1297 RCM_a115_eventFactoryMode "Restraint control module: a115 event factory mode";
CM_ SG_ 1297 RCM_a115_eventDiagEnabled "Restraint control module: a115 event diag enabled";
CM_ SG_ 1297 RCM_a115_eventDriveOrientation "Restraint control module: a115 event drive orientation";
CM_ SG_ 1297 RCM_a115_imuLinAccChnlMonitTmp "Restraint control module: a115 imu lin acc chnl monit tmp";
CM_ SG_ 1297 RCM_a115_imuLinAccChnlMonitPerm "Restraint control module: a115 imu lin acc chnl monit perm";
CM_ SG_ 1297 RCM_a115_eventIDFsignal "Restraint control module: a115 event ID fsignal";
CM_ SG_ 1297 RCM_a115_eventFrontLeftSeatbelt "Restraint control module: a115 event front left seatbelt";
CM_ SG_ 1297 RCM_a115_eventFrontRightSeatbelt "Restraint control module: a115 event front right seatbelt";
CM_ SG_ 1297 RCM_a115_eventVehicleSpeed "Restraint control module: a115 event vehicle speed";
CM_ SG_ 1297 RCM_a115_eventSteeringAngle "Restraint control module: a115 event steering angle";
CM_ SG_ 1297 RCM_a115_eventDriverBrakeApply "Restraint control module: a115 event driver brake apply; raw 3 = signal not available (SNA)";
CM_ SG_ 1297 RCM_a115_eventAccelPedalPos "Restraint control module: a115 event accel pedal pos; raw 255 = signal not available (SNA)";
CM_ SG_ 1297 RCM_a116_eventArmStatus "Restraint control module: a116 event arm status";
CM_ SG_ 1297 RCM_a116_eventFactoryMode "Restraint control module: a116 event factory mode";
CM_ SG_ 1297 RCM_a116_eventDiagEnabled "Restraint control module: a116 event diag enabled";
CM_ SG_ 1297 RCM_a116_eventDriveOrientation "Restraint control module: a116 event drive orientation";
CM_ SG_ 1297 RCM_a116_imuLatAccChnlMonitTmp "Restraint control module: a116 imu lat acc chnl monit tmp";
CM_ SG_ 1297 RCM_a116_imuLatAccChnlMonitPerm "Restraint control module: a116 imu lat acc chnl monit perm";
CM_ SG_ 1297 RCM_a116_eventIDFsignal "Restraint control module: a116 event ID fsignal";
CM_ SG_ 1297 RCM_a116_eventFrontLeftSeatbelt "Restraint control module: a116 event front left seatbelt";
CM_ SG_ 1297 RCM_a116_eventFrontRightSeatbelt "Restraint control module: a116 event front right seatbelt";
CM_ SG_ 1297 RCM_a116_eventVehicleSpeed "Restraint control module: a116 event vehicle speed";
CM_ SG_ 1297 RCM_a116_eventSteeringAngle "Restraint control module: a116 event steering angle";
CM_ SG_ 1297 RCM_a116_eventDriverBrakeApply "Restraint control module: a116 event driver brake apply; raw 3 = signal not available (SNA)";
CM_ SG_ 1297 RCM_a116_eventAccelPedalPos "Restraint control module: a116 event accel pedal pos; raw 255 = signal not available (SNA)";
CM_ SG_ 1297 RCM_a117_eventArmStatus "Restraint control module: a117 event arm status";
CM_ SG_ 1297 RCM_a117_eventFactoryMode "Restraint control module: a117 event factory mode";
CM_ SG_ 1297 RCM_a117_eventDiagEnabled "Restraint control module: a117 event diag enabled";
CM_ SG_ 1297 RCM_a117_eventDriveOrientation "Restraint control module: a117 event drive orientation";
CM_ SG_ 1297 RCM_a117_imuZaccelChnlMonitTmp "Restraint control module: a117 imu zaccel chnl monit tmp";
CM_ SG_ 1297 RCM_a117_imuZaccelChnlMonitPerm "Restraint control module: a117 imu zaccel chnl monit perm";
CM_ SG_ 1297 RCM_a117_eventIDFsignal "Restraint control module: a117 event ID fsignal";
CM_ SG_ 1297 RCM_a117_eventFrontLeftSeatbelt "Restraint control module: a117 event front left seatbelt";
CM_ SG_ 1297 RCM_a117_eventFrontRightSeatbelt "Restraint control module: a117 event front right seatbelt";
CM_ SG_ 1297 RCM_a117_eventVehicleSpeed "Restraint control module: a117 event vehicle speed";
CM_ SG_ 1297 RCM_a117_eventSteeringAngle "Restraint control module: a117 event steering angle";
CM_ SG_ 1297 RCM_a117_eventDriverBrakeApply "Restraint control module: a117 event driver brake apply; raw 3 = signal not available (SNA)";
CM_ SG_ 1297 RCM_a117_eventAccelPedalPos "Restraint control module: a117 event accel pedal pos; raw 255 = signal not available (SNA)";
CM_ SG_ 1297 RCM_a118_eventArmStatus "Restraint control module: a118 event arm status";
CM_ SG_ 1297 RCM_a118_eventFactoryMode "Restraint control module: a118 event factory mode";
CM_ SG_ 1297 RCM_a118_eventDiagEnabled "Restraint control module: a118 event diag enabled";
CM_ SG_ 1297 RCM_a118_eventDriveOrientation "Restraint control module: a118 event drive orientation";
CM_ SG_ 1297 RCM_a118_imuInPlaneSnsrMonitTmp "Restraint control module: a118 imu in plane snsr monit tmp";
CM_ SG_ 1297 RCM_a118_imuInPlaneSnsrMonitPerm "Restraint control module: a118 imu in plane snsr monit perm";
CM_ SG_ 1297 RCM_a118_eventIDFsignal "Restraint control module: a118 event ID fsignal";
CM_ SG_ 1297 RCM_a118_eventFrontLeftSeatbelt "Restraint control module: a118 event front left seatbelt";
BA_DEF_ BO_ "GenMsgCycleTime" INT 0 3600000;
BA_DEF_ BO_ "GenMsgSendType" ENUM "Cyclic","NotUsed","NotUsed","NotUsed","NotUsed","NotUsed","NotUsed","IfActive","NoMsgSendType","NotUsed";
BA_DEF_ BO_ "VFrameFormat" ENUM "StandardCAN","ExtendedCAN","reserved","J1939PG","reserved","reserved","reserved","reserved","reserved","reserved","reserved","reserved","reserved","reserved","StandardCAN_FD","ExtendedCAN_FD";
BA_DEF_ BO_ "CANFD_BRS" ENUM "0","1";
BA_DEF_ SG_ "GenSigSNA" STRING;
BA_DEF_ SG_ "SystemSignalLongSymbol" STRING;
BA_DEF_ SG_ "Confidence" ENUM "validated","plausible","layout-only","contradicted";
BA_DEF_DEF_ "GenMsgCycleTime" 0;
BA_DEF_DEF_ "GenMsgSendType" "NoMsgSendType";
BA_DEF_DEF_ "VFrameFormat" "StandardCAN";
BA_DEF_DEF_ "CANFD_BRS" "1";
BA_DEF_DEF_ "GenSigSNA" "";
BA_DEF_DEF_ "SystemSignalLongSymbol" "";
BA_DEF_DEF_ "Confidence" "layout-only";
BA_ "Confidence" SG_ 1297 RCM_a058_eventFrontLeftSeatbelt 1;
BA_ "Confidence" SG_ 1297 RCM_a058_eventFrontRightSeatbelt 1;
BA_ "Confidence" SG_ 1297 RCM_a058_eventVehicleSpeed 1;
BA_ "Confidence" SG_ 1297 RCM_a058_eventSteeringAngle 1;
BA_ "Confidence" SG_ 1297 RCM_a058_eventDriverBrakeApply 1;
BA_ "GenSigSNA" SG_ 1297 RCM_a058_eventDriverBrakeApply "3";
BA_ "Confidence" SG_ 1297 RCM_a058_eventAccelPedalPos 1;
BA_ "GenSigSNA" SG_ 1297 RCM_a058_eventAccelPedalPos "255";
BA_ "Confidence" SG_ 1297 RCM_a059_eventArmStatus 1;
BA_ "Confidence" SG_ 1297 RCM_a059_eventFactoryMode 1;
BA_ "Confidence" SG_ 1297 RCM_a059_eventDiagEnabled 1;
BA_ "Confidence" SG_ 1297 RCM_a059_eventDriveOrientation 1;
BA_ "Confidence" SG_ 1297 RCM_a059_eventIDFsignal 1;
BA_ "Confidence" SG_ 1297 RCM_a059_eventFrontLeftSeatbelt 1;
BA_ "Confidence" SG_ 1297 RCM_a059_eventFrontRightSeatbelt 1;
BA_ "Confidence" SG_ 1297 RCM_a059_eventVehicleSpeed 1;
BA_ "Confidence" SG_ 1297 RCM_a059_eventSteeringAngle 1;
BA_ "Confidence" SG_ 1297 RCM_a059_eventDriverBrakeApply 1;
BA_ "GenSigSNA" SG_ 1297 RCM_a059_eventDriverBrakeApply "3";
BA_ "Confidence" SG_ 1297 RCM_a059_eventAccelPedalPos 1;
BA_ "GenSigSNA" SG_ 1297 RCM_a059_eventAccelPedalPos "255";
BA_ "Confidence" SG_ 1297 RCM_a060_eventArmStatus 1;
BA_ "Confidence" SG_ 1297 RCM_a060_eventFactoryMode 1;
BA_ "Confidence" SG_ 1297 RCM_a060_eventDiagEnabled 1;
BA_ "Confidence" SG_ 1297 RCM_a060_eventDriveOrientation 1;
BA_ "Confidence" SG_ 1297 RCM_a060_eventIDFsignal 1;
BA_ "Confidence" SG_ 1297 RCM_a060_eventFrontLeftSeatbelt 1;
BA_ "Confidence" SG_ 1297 RCM_a060_eventFrontRightSeatbelt 1;
BA_ "Confidence" SG_ 1297 RCM_a060_eventVehicleSpeed 1;
BA_ "Confidence" SG_ 1297 RCM_a060_eventSteeringAngle 1;
BA_ "Confidence" SG_ 1297 RCM_a060_eventDriverBrakeApply 1;
BA_ "GenSigSNA" SG_ 1297 RCM_a060_eventDriverBrakeApply "3";
BA_ "Confidence" SG_ 1297 RCM_a060_eventAccelPedalPos 1;
BA_ "GenSigSNA" SG_ 1297 RCM_a060_eventAccelPedalPos "255";
BA_ "Confidence" SG_ 1297 RCM_a061_eventArmStatus 1;
BA_ "Confidence" SG_ 1297 RCM_a061_eventFactoryMode 1;
BA_ "Confidence" SG_ 1297 RCM_a061_eventDiagEnabled 1;
BA_ "Confidence" SG_ 1297 RCM_a061_eventDriveOrientation 1;
BA_ "Confidence" SG_ 1297 RCM_a061_eventIDFsignal 1;
BA_ "Confidence" SG_ 1297 RCM_a061_eventFrontLeftSeatbelt 1;
BA_ "Confidence" SG_ 1297 RCM_a061_eventFrontRightSeatbelt 1;
BA_ "Confidence" SG_ 1297 RCM_a061_eventVehicleSpeed 1;
BA_ "Confidence" SG_ 1297 RCM_a061_eventSteeringAngle 1;
BA_ "Confidence" SG_ 1297 RCM_a061_eventDriverBrakeApply 1;
BA_ "GenSigSNA" SG_ 1297 RCM_a061_eventDriverBrakeApply "3";
BA_ "Confidence" SG_ 1297 RCM_a061_eventAccelPedalPos 1;
BA_ "GenSigSNA" SG_ 1297 RCM_a061_eventAccelPedalPos "255";
BA_ "Confidence" SG_ 1297 RCM_a062_eventArmStatus 1;
BA_ "Confidence" SG_ 1297 RCM_a062_eventFactoryMode 1;
BA_ "Confidence" SG_ 1297 RCM_a062_eventDiagEnabled 1;
BA_ "Confidence" SG_ 1297 RCM_a062_eventDriveOrientation 1;
BA_ "Confidence" SG_ 1297 RCM_a062_eventIDFsignal 1;
BA_ "Confidence" SG_ 1297 RCM_a062_eventFrontLeftSeatbelt 1;
BA_ "Confidence" SG_ 1297 RCM_a062_eventFrontRightSeatbelt 1;
BA_ "Confidence" SG_ 1297 RCM_a062_eventVehicleSpeed 1;
BA_ "Confidence" SG_ 1297 RCM_a062_eventSteeringAngle 1;
BA_ "Confidence" SG_ 1297 RCM_a062_eventDriverBrakeApply 1;
BA_ "GenSigSNA" SG_ 1297 RCM_a062_eventDriverBrakeApply "3";
BA_ "Confidence" SG_ 1297 RCM_a062_eventAccelPedalPos 1;
BA_ "GenSigSNA" SG_ 1297 RCM_a062_eventAccelPedalPos "255";
BA_ "Confidence" SG_ 1297 RCM_a063_eventArmStatus 1;
BA_ "Confidence" SG_ 1297 RCM_a063_eventFactoryMode 1;
BA_ "Confidence" SG_ 1297 RCM_a063_eventDiagEnabled 1;
BA_ "Confidence" SG_ 1297 RCM_a063_eventDriveOrientation 1;
BA_ "Confidence" SG_ 1297 RCM_a063_eventIDFsignal 1;
BA_ "Confidence" SG_ 1297 RCM_a063_eventFrontLeftSeatbelt 1;
BA_ "Confidence" SG_ 1297 RCM_a063_eventFrontRightSeatbelt 1;
BA_ "Confidence" SG_ 1297 RCM_a063_eventVehicleSpeed 1;
BA_ "Confidence" SG_ 1297 RCM_a063_eventSteeringAngle 1;
BA_ "Confidence" SG_ 1297 RCM_a063_eventDriverBrakeApply 1;
BA_ "GenSigSNA" SG_ 1297 RCM_a063_eventDriverBrakeApply "3";
BA_ "Confidence" SG_ 1297 RCM_a063_eventAccelPedalPos 1;
BA_ "GenSigSNA" SG_ 1297 RCM_a063_eventAccelPedalPos "255";
BA_ "Confidence" SG_ 1297 RCM_a064_eventArmStatus 1;
BA_ "Confidence" SG_ 1297 RCM_a064_eventFactoryMode 1;
BA_ "Confidence" SG_ 1297 RCM_a064_eventDiagEnabled 1;
BA_ "Confidence" SG_ 1297 RCM_a064_eventDriveOrientation 1;
BA_ "Confidence" SG_ 1297 RCM_a064_eventIDFsignal 1;
BA_ "Confidence" SG_ 1297 RCM_a064_eventFrontLeftSeatbelt 1;
BA_ "Confidence" SG_ 1297 RCM_a064_eventFrontRightSeatbelt 1;
BA_ "Confidence" SG_ 1297 RCM_a064_eventVehicleSpeed 1;
BA_ "Confidence" SG_ 1297 RCM_a064_eventSteeringAngle 1;
BA_ "Confidence" SG_ 1297 RCM_a064_eventDriverBrakeApply 1;
BA_ "GenSigSNA" SG_ 1297 RCM_a064_eventDriverBrakeApply "3";
BA_ "Confidence" SG_ 1297 RCM_a064_eventAccelPedalPos 1;
BA_ "GenSigSNA" SG_ 1297 RCM_a064_eventAccelPedalPos "255";
BA_ "Confidence" SG_ 1297 RCM_a065_eventArmStatus 1;
BA_ "Confidence" SG_ 1297 RCM_a065_eventFactoryMode 1;
BA_ "Confidence" SG_ 1297 RCM_a065_eventDiagEnabled 1;
BA_ "Confidence" SG_ 1297 RCM_a065_eventDriveOrientation 1;
BA_ "Confidence" SG_ 1297 RCM_a065_eventIDFsignal 1;
BA_ "Confidence" SG_ 1297 RCM_a065_eventFrontLeftSeatbelt 1;
BA_ "Confidence" SG_ 1297 RCM_a065_eventFrontRightSeatbelt 1;
BA_ "Confidence" SG_ 1297 RCM_a065_eventVehicleSpeed 1;
BA_ "Confidence" SG_ 1297 RCM_a065_eventSteeringAngle 1;
BA_ "Confidence" SG_ 1297 RCM_a065_eventDriverBrakeApply 1;
BA_ "GenSigSNA" SG_ 1297 RCM_a065_eventDriverBrakeApply "3";
BA_ "Confidence" SG_ 1297 RCM_a065_eventAccelPedalPos 1;
BA_ "GenSigSNA" SG_ 1297 RCM_a065_eventAccelPedalPos "255";
BA_ "Confidence" SG_ 1297 RCM_a066_eventArmStatus 1;
BA_ "Confidence" SG_ 1297 RCM_a066_eventFactoryMode 1;
BA_ "Confidence" SG_ 1297 RCM_a066_eventDiagEnabled 1;
BA_ "Confidence" SG_ 1297 RCM_a066_eventDriveOrientation 1;
BA_ "Confidence" SG_ 1297 RCM_a066_eventIDFsignal 1;
BA_ "Confidence" SG_ 1297 RCM_a066_eventFrontLeftSeatbelt 1;
BA_ "Confidence" SG_ 1297 RCM_a066_eventFrontRightSeatbelt 1;
BA_ "Confidence" SG_ 1297 RCM_a066_eventVehicleSpeed 1;
BA_ "Confidence" SG_ 1297 RCM_a066_eventSteeringAngle 1;
BA_ "Confidence" SG_ 1297 RCM_a066_eventDriverBrakeApply 1;
BA_ "GenSigSNA" SG_ 1297 RCM_a066_eventDriverBrakeApply "3";
BA_ "Confidence" SG_ 1297 RCM_a066_eventAccelPedalPos 1;
BA_ "GenSigSNA" SG_ 1297 RCM_a066_eventAccelPedalPos "255";
BA_ "Confidence" SG_ 1297 RCM_a067_eventArmStatus 1;
BA_ "Confidence" SG_ 1297 RCM_a067_eventFactoryMode 1;
BA_ "Confidence" SG_ 1297 RCM_a067_eventDiagEnabled 1;
BA_ "Confidence" SG_ 1297 RCM_a067_eventDriveOrientation 1;
BA_ "Confidence" SG_ 1297 RCM_a067_eventIDFsignal 1;
BA_ "Confidence" SG_ 1297 RCM_a067_eventFrontLeftSeatbelt 1;
BA_ "Confidence" SG_ 1297 RCM_a067_eventFrontRightSeatbelt 1;
BA_ "Confidence" SG_ 1297 RCM_a067_eventVehicleSpeed 1;
BA_ "Confidence" SG_ 1297 RCM_a067_eventSteeringAngle 1;
BA_ "Confidence" SG_ 1297 RCM_a067_eventDriverBrakeApply 1;
BA_ "GenSigSNA" SG_ 1297 RCM_a067_eventDriverBrakeApply "3";
BA_ "Confidence" SG_ 1297 RCM_a067_eventAccelPedalPos 1;
BA_ "GenSigSNA" SG_ 1297 RCM_a067_eventAccelPedalPos "255";
BA_ "Confidence" SG_ 1297 RCM_a068_eventArmStatus 1;
BA_ "Confidence" SG_ 1297 RCM_a068_eventFactoryMode 1;
BA_ "Confidence" SG_ 1297 RCM_a068_eventDiagEnabled 1;
BA_ "Confidence" SG_ 1297 RCM_a068_eventDriveOrientation 1;
BA_ "Confidence" SG_ 1297 RCM_a068_eventIDFsignal 1;
BA_ "Confidence" SG_ 1297 RCM_a068_eventFrontLeftSeatbelt 1;
BA_ "Confidence" SG_ 1297 RCM_a068_eventFrontRightSeatbelt 1;
BA_ "Confidence" SG_ 1297 RCM_a068_eventVehicleSpeed 1;
BA_ "Confidence" SG_ 1297 RCM_a068_eventSteeringAngle 1;
BA_ "Confidence" SG_ 1297 RCM_a068_eventDriverBrakeApply 1;
BA_ "GenSigSNA" SG_ 1297 RCM_a068_eventDriverBrakeApply "3";
BA_ "Confidence" SG_ 1297 RCM_a068_eventAccelPedalPos 1;
BA_ "GenSigSNA" SG_ 1297 RCM_a068_eventAccelPedalPos "255";
BA_ "Confidence" SG_ 1297 RCM_a069_eventArmStatus 1;
BA_ "Confidence" SG_ 1297 RCM_a069_eventFactoryMode 1;
BA_ "Confidence" SG_ 1297 RCM_a069_eventDiagEnabled 1;
BA_ "Confidence" SG_ 1297 RCM_a069_eventDriveOrientation 1;
BA_ "Confidence" SG_ 1297 RCM_a069_eventIDFsignal 1;
BA_ "Confidence" SG_ 1297 RCM_a069_eventFrontLeftSeatbelt 1;
BA_ "Confidence" SG_ 1297 RCM_a069_eventFrontRightSeatbelt 1;
BA_ "Confidence" SG_ 1297 RCM_a069_eventVehicleSpeed 1;
BA_ "Confidence" SG_ 1297 RCM_a069_eventSteeringAngle 1;
BA_ "Confidence" SG_ 1297 RCM_a069_eventDriverBrakeApply 1;
BA_ "GenSigSNA" SG_ 1297 RCM_a069_eventDriverBrakeApply "3";
BA_ "Confidence" SG_ 1297 RCM_a069_eventAccelPedalPos 1;
BA_ "GenSigSNA" SG_ 1297 RCM_a069_eventAccelPedalPos "255";
BA_ "Confidence" SG_ 1297 RCM_a070_eventArmStatus 1;
BA_ "Confidence" SG_ 1297 RCM_a070_eventFactoryMode 1;
BA_ "Confidence" SG_ 1297 RCM_a070_eventDiagEnabled 1;
BA_ "Confidence" SG_ 1297 RCM_a070_eventDriveOrientation 1;
BA_ "Confidence" SG_ 1297 RCM_a070_eventIDFsignal 1;
BA_ "Confidence" SG_ 1297 RCM_a070_eventFrontLeftSeatbelt 1;
BA_ "Confidence" SG_ 1297 RCM_a070_eventFrontRightSeatbelt 1;
BA_ "Confidence" SG_ 1297 RCM_a070_eventVehicleSpeed 1;
BA_ "Confidence" SG_ 1297 RCM_a070_eventSteeringAngle 1;
BA_ "Confidence" SG_ 1297 RCM_a070_eventDriverBrakeApply 1;
BA_ "GenSigSNA" SG_ 1297 RCM_a070_eventDriverBrakeApply "3";
BA_ "Confidence" SG_ 1297 RCM_a070_eventAccelPedalPos 1;
BA_ "GenSigSNA" SG_ 1297 RCM_a070_eventAccelPedalPos "255";
BA_ "Confidence" SG_ 1297 RCM_a071_eventArmStatus 1;
BA_ "Confidence" SG_ 1297 RCM_a071_eventFactoryMode 1;
BA_ "Confidence" SG_ 1297 RCM_a071_eventDiagEnabled 1;
BA_ "Confidence" SG_ 1297 RCM_a071_eventDriveOrientation 1;
BA_ "Confidence" SG_ 1297 RCM_a071_eventIDFsignal 1;
BA_ "Confidence" SG_ 1297 RCM_a071_eventFrontLeftSeatbelt 1;
BA_ "Confidence" SG_ 1297 RCM_a071_eventFrontRightSeatbelt 1;
BA_ "Confidence" SG_ 1297 RCM_a071_eventVehicleSpeed 1;
BA_ "Confidence" SG_ 1297 RCM_a071_eventSteeringAngle 1;
BA_ "Confidence" SG_ 1297 RCM_a071_eventDriverBrakeApply 1;
BA_ "GenSigSNA" SG_ 1297 RCM_a071_eventDriverBrakeApply "3";
BA_ "Confidence" SG_ 1297 RCM_a071_eventAccelPedalPos 1;
BA_ "GenSigSNA" SG_ 1297 RCM_a071_eventAccelPedalPos "255";
BA_ "Confidence" SG_ 1297 RCM_a072_eventArmStatus 1;
BA_ "Confidence" SG_ 1297 RCM_a072_eventFactoryMode 1;
BA_ "Confidence" SG_ 1297 RCM_a072_eventDiagEnabled 1;
BA_ "Confidence" SG_ 1297 RCM_a072_eventDriveOrientation 1;
BA_ "Confidence" SG_ 1297 RCM_a072_eventIDFsignal 1;
BA_ "Confidence" SG_ 1297 RCM_a072_eventFrontLeftSeatbelt 1;
BA_ "Confidence" SG_ 1297 RCM_a072_eventFrontRightSeatbelt 1;
BA_ "Confidence" SG_ 1297 RCM_a072_eventVehicleSpeed 1;
BA_ "Confidence" SG_ 1297 RCM_a072_eventSteeringAngle 1;
BA_ "Confidence" SG_ 1297 RCM_a072_eventDriverBrakeApply 1;
BA_ "GenSigSNA" SG_ 1297 RCM_a072_eventDriverBrakeApply "3";
BA_ "Confidence" SG_ 1297 RCM_a072_eventAccelPedalPos 1;
BA_ "GenSigSNA" SG_ 1297 RCM_a072_eventAccelPedalPos "255";
BA_ "Confidence" SG_ 1297 RCM_a073_eventArmStatus 1;
BA_ "Confidence" SG_ 1297 RCM_a073_eventFactoryMode 1;
BA_ "Confidence" SG_ 1297 RCM_a073_eventDiagEnabled 1;
BA_ "Confidence" SG_ 1297 RCM_a073_eventDriveOrientation 1;
BA_ "Confidence" SG_ 1297 RCM_a073_eventIDFsignal 1;
BA_ "Confidence" SG_ 1297 RCM_a073_eventFrontLeftSeatbelt 1;
BA_ "Confidence" SG_ 1297 RCM_a073_eventFrontRightSeatbelt 1;
BA_ "Confidence" SG_ 1297 RCM_a073_eventVehicleSpeed 1;
BA_ "Confidence" SG_ 1297 RCM_a073_eventSteeringAngle 1;
BA_ "Confidence" SG_ 1297 RCM_a073_eventDriverBrakeApply 1;
BA_ "GenSigSNA" SG_ 1297 RCM_a073_eventDriverBrakeApply "3";
BA_ "Confidence" SG_ 1297 RCM_a073_eventAccelPedalPos 1;
BA_ "GenSigSNA" SG_ 1297 RCM_a073_eventAccelPedalPos "255";
BA_ "Confidence" SG_ 1297 RCM_a074_eventArmStatus 1;
BA_ "Confidence" SG_ 1297 RCM_a074_eventFactoryMode 1;
BA_ "Confidence" SG_ 1297 RCM_a074_eventDiagEnabled 1;
BA_ "Confidence" SG_ 1297 RCM_a074_eventDriveOrientation 1;
BA_ "Confidence" SG_ 1297 RCM_a074_eventIDFsignal 1;
BA_ "Confidence" SG_ 1297 RCM_a074_eventFrontLeftSeatbelt 1;
BA_ "Confidence" SG_ 1297 RCM_a074_eventFrontRightSeatbelt 1;
BA_ "Confidence" SG_ 1297 RCM_a074_eventVehicleSpeed 1;
BA_ "Confidence" SG_ 1297 RCM_a074_eventSteeringAngle 1;
BA_ "Confidence" SG_ 1297 RCM_a074_eventDriverBrakeApply 1;
BA_ "GenSigSNA" SG_ 1297 RCM_a074_eventDriverBrakeApply "3";
BA_ "Confidence" SG_ 1297 RCM_a074_eventAccelPedalPos 1;
BA_ "GenSigSNA" SG_ 1297 RCM_a074_eventAccelPedalPos "255";
BA_ "Confidence" SG_ 1297 RCM_a075_eventArmStatus 1;
BA_ "Confidence" SG_ 1297 RCM_a075_eventFactoryMode 1;
BA_ "Confidence" SG_ 1297 RCM_a075_eventDiagEnabled 1;
BA_ "Confidence" SG_ 1297 RCM_a075_eventDriveOrientation 1;
BA_ "Confidence" SG_ 1297 RCM_a075_eventIDFsignal 1;
BA_ "Confidence" SG_ 1297 RCM_a075_eventFrontLeftSeatbelt 1;
BA_ "Confidence" SG_ 1297 RCM_a075_eventFrontRightSeatbelt 1;
BA_ "Confidence" SG_ 1297 RCM_a075_eventVehicleSpeed 1;
BA_ "Confidence" SG_ 1297 RCM_a075_eventSteeringAngle 1;
BA_ "Confidence" SG_ 1297 RCM_a075_eventDriverBrakeApply 1;
BA_ "GenSigSNA" SG_ 1297 RCM_a075_eventDriverBrakeApply "3";
BA_ "Confidence" SG_ 1297 RCM_a075_eventAccelPedalPos 1;
BA_ "GenSigSNA" SG_ 1297 RCM_a075_eventAccelPedalPos "255";
BA_ "Confidence" SG_ 1297 RCM_a078_eventArmStatus 1;
BA_ "Confidence" SG_ 1297 RCM_a078_eventFactoryMode 1;
BA_ "Confidence" SG_ 1297 RCM_a078_eventDiagEnabled 1;
BA_ "Confidence" SG_ 1297 RCM_a078_eventDriveOrientation 1;
BA_ "Confidence" SG_ 1297 RCM_a078_eventIDFsignal 1;
BA_ "Confidence" SG_ 1297 RCM_a078_eventFrontLeftSeatbelt 1;
BA_ "Confidence" SG_ 1297 RCM_a078_eventFrontRightSeatbelt 1;
BA_ "Confidence" SG_ 1297 RCM_a078_eventVehicleSpeed 1;
BA_ "Confidence" SG_ 1297 RCM_a078_eventSteeringAngle 1;
BA_ "Confidence" SG_ 1297 RCM_a078_eventDriverBrakeApply 1;
BA_ "GenSigSNA" SG_ 1297 RCM_a078_eventDriverBrakeApply "3";
BA_ "Confidence" SG_ 1297 RCM_a078_eventAccelPedalPos 1;
BA_ "GenSigSNA" SG_ 1297 RCM_a078_eventAccelPedalPos "255";
BA_ "Confidence" SG_ 1297 RCM_a079_eventArmStatus 1;
BA_ "Confidence" SG_ 1297 RCM_a079_eventFactoryMode 1;
BA_ "Confidence" SG_ 1297 RCM_a079_eventDiagEnabled 1;
BA_ "Confidence" SG_ 1297 RCM_a079_eventDriveOrientation 1;
BA_ "Confidence" SG_ 1297 RCM_a079_eventIDFsignal 1;
BA_ "Confidence" SG_ 1297 RCM_a079_eventFrontLeftSeatbelt 1;
BA_ "Confidence" SG_ 1297 RCM_a079_eventFrontRightSeatbelt 1;
BA_ "Confidence" SG_ 1297 RCM_a079_eventVehicleSpeed 1;
BA_ "Confidence" SG_ 1297 RCM_a079_eventSteeringAngle 1;
BA_ "Confidence" SG_ 1297 RCM_a079_eventDriverBrakeApply 1;
BA_ "GenSigSNA" SG_ 1297 RCM_a079_eventDriverBrakeApply "3";
BA_ "Confidence" SG_ 1297 RCM_a079_eventAccelPedalPos 1;
BA_ "GenSigSNA" SG_ 1297 RCM_a079_eventAccelPedalPos "255";
BA_ "Confidence" SG_ 1297 RCM_a080_eventArmStatus 1;
BA_ "Confidence" SG_ 1297 RCM_a080_eventFactoryMode 1;
BA_ "Confidence" SG_ 1297 RCM_a080_eventDiagEnabled 1;
BA_ "Confidence" SG_ 1297 RCM_a080_eventDriveOrientation 1;
BA_ "Confidence" SG_ 1297 RCM_a080_eventIDFsignal 1;
BA_ "Confidence" SG_ 1297 RCM_a080_eventFrontLeftSeatbelt 1;
BA_ "Confidence" SG_ 1297 RCM_a080_eventFrontRightSeatbelt 1;
BA_ "Confidence" SG_ 1297 RCM_a080_eventVehicleSpeed 1;
BA_ "Confidence" SG_ 1297 RCM_a080_eventSteeringAngle 1;
BA_ "Confidence" SG_ 1297 RCM_a080_eventDriverBrakeApply 1;
BA_ "GenSigSNA" SG_ 1297 RCM_a080_eventDriverBrakeApply "3";
BA_ "Confidence" SG_ 1297 RCM_a080_eventAccelPedalPos 1;
BA_ "GenSigSNA" SG_ 1297 RCM_a080_eventAccelPedalPos "255";
BA_ "Confidence" SG_ 1297 RCM_a083_eventArmStatus 1;
BA_ "Confidence" SG_ 1297 RCM_a083_eventFactoryMode 1;
BA_ "Confidence" SG_ 1297 RCM_a083_eventDiagEnabled 1;
BA_ "Confidence" SG_ 1297 RCM_a083_eventDriveOrientation 1;
BA_ "Confidence" SG_ 1297 RCM_a083_eventIDFsignal 1;
BA_ "Confidence" SG_ 1297 RCM_a083_eventFrontLeftSeatbelt 1;
BA_ "Confidence" SG_ 1297 RCM_a083_eventFrontRightSeatbelt 1;
BA_ "Confidence" SG_ 1297 RCM_a083_eventVehicleSpeed 1;
BA_ "Confidence" SG_ 1297 RCM_a083_eventSteeringAngle 1;
BA_ "Confidence" SG_ 1297 RCM_a083_eventDriverBrakeApply 1;
BA_ "GenSigSNA" SG_ 1297 RCM_a083_eventDriverBrakeApply "3";
BA_ "Confidence" SG_ 1297 RCM_a083_eventAccelPedalPos 1;
BA_ "GenSigSNA" SG_ 1297 RCM_a083_eventAccelPedalPos "255";
BA_ "Confidence" SG_ 1297 RCM_a087_eventArmStatus 1;
BA_ "Confidence" SG_ 1297 RCM_a087_eventFactoryMode 1;
BA_ "Confidence" SG_ 1297 RCM_a087_eventDiagEnabled 1;
BA_ "Confidence" SG_ 1297 RCM_a087_eventDriveOrientation 1;
BA_ "Confidence" SG_ 1297 RCM_a087_eventIDFsignal 1;
BA_ "Confidence" SG_ 1297 RCM_a087_eventFrontLeftSeatbelt 1;
BA_ "Confidence" SG_ 1297 RCM_a087_eventFrontRightSeatbelt 1;
BA_ "Confidence" SG_ 1297 RCM_a087_eventVehicleSpeed 1;
BA_ "Confidence" SG_ 1297 RCM_a087_eventSteeringAngle 1;
BA_ "Confidence" SG_ 1297 RCM_a087_eventDriverBrakeApply 1;
BA_ "GenSigSNA" SG_ 1297 RCM_a087_eventDriverBrakeApply "3";
BA_ "Confidence" SG_ 1297 RCM_a087_eventAccelPedalPos 1;
BA_ "GenSigSNA" SG_ 1297 RCM_a087_eventAccelPedalPos "255";
BA_ "Confidence" SG_ 1297 RCM_a088_eventArmStatus 1;
BA_ "Confidence" SG_ 1297 RCM_a088_eventFactoryMode 1;
BA_ "Confidence" SG_ 1297 RCM_a088_eventDiagEnabled 1;
BA_ "Confidence" SG_ 1297 RCM_a088_eventDriveOrientation 1;
BA_ "Confidence" SG_ 1297 RCM_a088_eventIDFsignal 1;
BA_ "Confidence" SG_ 1297 RCM_a088_eventFrontLeftSeatbelt 1;
BA_ "Confidence" SG_ 1297 RCM_a088_eventFrontRightSeatbelt 1;
BA_ "Confidence" SG_ 1297 RCM_a088_eventVehicleSpeed 1;
BA_ "Confidence" SG_ 1297 RCM_a088_eventSteeringAngle 1;
BA_ "Confidence" SG_ 1297 RCM_a088_eventDriverBrakeApply 1;
BA_ "GenSigSNA" SG_ 1297 RCM_a088_eventDriverBrakeApply "3";
BA_ "Confidence" SG_ 1297 RCM_a088_eventAccelPedalPos 1;
BA_ "GenSigSNA" SG_ 1297 RCM_a088_eventAccelPedalPos "255";
BA_ "Confidence" SG_ 1297 RCM_a089_eventArmStatus 1;
BA_ "Confidence" SG_ 1297 RCM_a089_eventFactoryMode 1;
BA_ "Confidence" SG_ 1297 RCM_a089_eventDiagEnabled 1;
BA_ "Confidence" SG_ 1297 RCM_a089_eventDriveOrientation 1;
BA_ "Confidence" SG_ 1297 RCM_a089_eventIDFsignal 1;
BA_ "Confidence" SG_ 1297 RCM_a089_eventFrontLeftSeatbelt 1;
BA_ "Confidence" SG_ 1297 RCM_a089_eventFrontRightSeatbelt 1;
BA_ "Confidence" SG_ 1297 RCM_a089_eventVehicleSpeed 1;
BA_ "Confidence" SG_ 1297 RCM_a089_eventSteeringAngle 1;
BA_ "Confidence" SG_ 1297 RCM_a089_eventDriverBrakeApply 1;
BA_ "GenSigSNA" SG_ 1297 RCM_a089_eventDriverBrakeApply "3";
BA_ "Confidence" SG_ 1297 RCM_a089_eventAccelPedalPos 1;
BA_ "GenSigSNA" SG_ 1297 RCM_a089_eventAccelPedalPos "255";
BA_ "Confidence" SG_ 1297 RCM_a090_eventArmStatus 1;
BA_ "Confidence" SG_ 1297 RCM_a090_eventFactoryMode 1;
BA_ "Confidence" SG_ 1297 RCM_a090_eventDiagEnabled 1;
BA_ "Confidence" SG_ 1297 RCM_a090_eventDriveOrientation 1;
BA_ "Confidence" SG_ 1297 RCM_a090_eventIDFsignal 1;
BA_ "Confidence" SG_ 1297 RCM_a090_eventFrontLeftSeatbelt 1;
BA_ "Confidence" SG_ 1297 RCM_a090_eventFrontRightSeatbelt 1;
BA_ "Confidence" SG_ 1297 RCM_a090_eventVehicleSpeed 1;
BA_ "Confidence" SG_ 1297 RCM_a090_eventSteeringAngle 1;
BA_ "Confidence" SG_ 1297 RCM_a090_eventDriverBrakeApply 1;
BA_ "GenSigSNA" SG_ 1297 RCM_a090_eventDriverBrakeApply "3";
BA_ "Confidence" SG_ 1297 RCM_a090_eventAccelPedalPos 1;
BA_ "GenSigSNA" SG_ 1297 RCM_a090_eventAccelPedalPos "255";
BA_ "Confidence" SG_ 1297 RCM_a092_eventArmStatus 1;
BA_ "Confidence" SG_ 1297 RCM_a092_eventFactoryMode 1;
BA_ "Confidence" SG_ 1297 RCM_a092_eventDiagEnabled 1;
BA_ "Confidence" SG_ 1297 RCM_a092_eventDriveOrientation 1;
BA_ "Confidence" SG_ 1297 RCM_a092_eventIDFsignal 1;
BA_ "Confidence" SG_ 1297 RCM_a092_eventFrontLeftSeatbelt 1;
BA_ "Confidence" SG_ 1297 RCM_a092_eventFrontRightSeatbelt 1;
BA_ "Confidence" SG_ 1297 RCM_a092_eventVehicleSpeed 1;
BA_ "Confidence" SG_ 1297 RCM_a092_eventSteeringAngle 1;
BA_ "Confidence" SG_ 1297 RCM_a092_eventDriverBrakeApply 1;
BA_ "GenSigSNA" SG_ 1297 RCM_a092_eventDriverBrakeApply "3";
BA_ "Confidence" SG_ 1297 RCM_a092_eventAccelPedalPos 1;
BA_ "GenSigSNA" SG_ 1297 RCM_a092_eventAccelPedalPos "255";
BA_ "Confidence" SG_ 1297 RCM_a093_eventArmStatus 1;
BA_ "Confidence" SG_ 1297 RCM_a093_eventFactoryMode 1;
BA_ "Confidence" SG_ 1297 RCM_a093_eventDiagEnabled 1;
BA_ "Confidence" SG_ 1297 RCM_a093_eventDriveOrientation 1;
BA_ "Confidence" SG_ 1297 RCM_a093_eventIDFsignal 1;
BA_ "Confidence" SG_ 1297 RCM_a093_eventFrontLeftSeatbelt 1;
BA_ "Confidence" SG_ 1297 RCM_a093_eventFrontRightSeatbelt 1;
BA_ "Confidence" SG_ 1297 RCM_a093_eventVehicleSpeed 1;
BA_ "Confidence" SG_ 1297 RCM_a093_eventSteeringAngle 1;
BA_ "Confidence" SG_ 1297 RCM_a093_eventDriverBrakeApply 1;
BA_ "GenSigSNA" SG_ 1297 RCM_a093_eventDriverBrakeApply "3";
BA_ "Confidence" SG_ 1297 RCM_a093_eventAccelPedalPos 1;
BA_ "GenSigSNA" SG_ 1297 RCM_a093_eventAccelPedalPos "255";
BA_ "Confidence" SG_ 1297 RCM_a094_eventArmStatus 1;
BA_ "Confidence" SG_ 1297 RCM_a094_eventFactoryMode 1;
BA_ "Confidence" SG_ 1297 RCM_a094_eventDiagEnabled 1;
BA_ "Confidence" SG_ 1297 RCM_a094_eventDriveOrientation 1;
BA_ "Confidence" SG_ 1297 RCM_a094_eventIDFsignal 1;
BA_ "Confidence" SG_ 1297 RCM_a094_eventFrontLeftSeatbelt 1;
BA_ "Confidence" SG_ 1297 RCM_a094_eventFrontRightSeatbelt 1;
BA_ "Confidence" SG_ 1297 RCM_a094_eventVehicleSpeed 1;
BA_ "Confidence" SG_ 1297 RCM_a094_eventSteeringAngle 1;
BA_ "Confidence" SG_ 1297 RCM_a094_eventDriverBrakeApply 1;
BA_ "GenSigSNA" SG_ 1297 RCM_a094_eventDriverBrakeApply "3";
BA_ "Confidence" SG_ 1297 RCM_a094_eventAccelPedalPos 1;
BA_ "GenSigSNA" SG_ 1297 RCM_a094_eventAccelPedalPos "255";
BA_ "Confidence" SG_ 1297 RCM_a101_eventArmStatus 1;
BA_ "Confidence" SG_ 1297 RCM_a101_eventFactoryMode 1;
BA_ "Confidence" SG_ 1297 RCM_a101_eventDiagEnabled 1;
BA_ "Confidence" SG_ 1297 RCM_a101_eventDriveOrientation 1;
BA_ "Confidence" SG_ 1297 RCM_a101_eventIDFsignal 1;
BA_ "Confidence" SG_ 1297 RCM_a101_eventFrontLeftSeatbelt 1;
BA_ "Confidence" SG_ 1297 RCM_a101_eventFrontRightSeatbelt 1;
BA_ "Confidence" SG_ 1297 RCM_a101_eventVehicleSpeed 1;
BA_ "Confidence" SG_ 1297 RCM_a101_eventSteeringAngle 1;
BA_ "Confidence" SG_ 1297 RCM_a101_eventDriverBrakeApply 1;
BA_ "GenSigSNA" SG_ 1297 RCM_a101_eventDriverBrakeApply "3";
BA_ "Confidence" SG_ 1297 RCM_a101_eventAccelPedalPos 1;
BA_ "GenSigSNA" SG_ 1297 RCM_a101_eventAccelPedalPos "255";
BA_ "Confidence" SG_ 1297 RCM_a102_eventArmStatus 1;
BA_ "Confidence" SG_ 1297 RCM_a102_eventFactoryMode 1;
BA_ "Confidence" SG_ 1297 RCM_a102_eventDiagEnabled 1;
BA_ "Confidence" SG_ 1297 RCM_a102_eventDriveOrientation 1;
BA_ "Confidence" SG_ 1297 RCM_a102_eventIDFsignal 1;
BA_ "Confidence" SG_ 1297 RCM_a102_eventFrontLeftSeatbelt 1;
BA_ "Confidence" SG_ 1297 RCM_a102_eventFrontRightSeatbelt 1;
BA_ "Confidence" SG_ 1297 RCM_a102_eventVehicleSpeed 1;
BA_ "Confidence" SG_ 1297 RCM_a102_eventSteeringAngle 1;
BA_ "Confidence" SG_ 1297 RCM_a102_eventDriverBrakeApply 1;
BA_ "GenSigSNA" SG_ 1297 RCM_a102_eventDriverBrakeApply "3";
BA_ "Confidence" SG_ 1297 RCM_a102_eventAccelPedalPos 1;
BA_ "GenSigSNA" SG_ 1297 RCM_a102_eventAccelPedalPos "255";
BA_ "Confidence" SG_ 1297 RCM_a103_eventArmStatus 1;
BA_ "Confidence" SG_ 1297 RCM_a103_eventFactoryMode 1;
BA_ "Confidence" SG_ 1297 RCM_a103_eventDiagEnabled 1;
BA_ "Confidence" SG_ 1297 RCM_a103_eventDriveOrientation 1;
BA_ "Confidence" SG_ 1297 RCM_a103_eventIDFsignal 1;
BA_ "Confidence" SG_ 1297 RCM_a103_eventFrontLeftSeatbelt 1;
BA_ "Confidence" SG_ 1297 RCM_a103_eventFrontRightSeatbelt 1;
BA_ "Confidence" SG_ 1297 RCM_a103_eventVehicleSpeed 1;
BA_ "Confidence" SG_ 1297 RCM_a103_eventSteeringAngle 1;
BA_ "Confidence" SG_ 1297 RCM_a103_eventDriverBrakeApply 1;
BA_ "GenSigSNA" SG_ 1297 RCM_a103_eventDriverBrakeApply "3";
BA_ "Confidence" SG_ 1297 RCM_a103_eventAccelPedalPos 1;
BA_ "GenSigSNA" SG_ 1297 RCM_a103_eventAccelPedalPos "255";
BA_ "Confidence" SG_ 1297 RCM_a104_eventArmStatus 1;
BA_ "Confidence" SG_ 1297 RCM_a104_eventFactoryMode 1;
BA_ "Confidence" SG_ 1297 RCM_a104_eventDiagEnabled 1;
BA_ "Confidence" SG_ 1297 RCM_a104_eventDriveOrientation 1;
BA_ "Confidence" SG_ 1297 RCM_a104_eventIDFsignal 1;
BA_ "Confidence" SG_ 1297 RCM_a104_eventFrontLeftSeatbelt 1;
BA_ "Confidence" SG_ 1297 RCM_a104_eventFrontRightSeatbelt 1;
BA_ "Confidence" SG_ 1297 RCM_a104_eventVehicleSpeed 1;
BA_ "Confidence" SG_ 1297 RCM_a104_eventSteeringAngle 1;
BA_ "Confidence" SG_ 1297 RCM_a104_eventDriverBrakeApply 1;
BA_ "GenSigSNA" SG_ 1297 RCM_a104_eventDriverBrakeApply "3";
BA_ "Confidence" SG_ 1297 RCM_a104_eventAccelPedalPos 1;
BA_ "GenSigSNA" SG_ 1297 RCM_a104_eventAccelPedalPos "255";
BA_ "Confidence" SG_ 1297 RCM_a105_eventArmStatus 1;
BA_ "Confidence" SG_ 1297 RCM_a105_eventFactoryMode 1;
BA_ "Confidence" SG_ 1297 RCM_a105_eventDiagEnabled 1;
BA_ "Confidence" SG_ 1297 RCM_a105_eventDriveOrientation 1;
BA_ "Confidence" SG_ 1297 RCM_a105_eventIDFsignal 1;
BA_ "Confidence" SG_ 1297 RCM_a105_eventFrontLeftSeatbelt 1;
BA_ "Confidence" SG_ 1297 RCM_a105_eventFrontRightSeatbelt 1;
BA_ "Confidence" SG_ 1297 RCM_a105_eventVehicleSpeed 1;
BA_ "Confidence" SG_ 1297 RCM_a105_eventSteeringAngle 1;
BA_ "Confidence" SG_ 1297 RCM_a105_eventDriverBrakeApply 1;
BA_ "GenSigSNA" SG_ 1297 RCM_a105_eventDriverBrakeApply "3";
BA_ "Confidence" SG_ 1297 RCM_a105_eventAccelPedalPos 1;
BA_ "GenSigSNA" SG_ 1297 RCM_a105_eventAccelPedalPos "255";
BA_ "Confidence" SG_ 1297 RCM_a106_eventArmStatus 1;
BA_ "Confidence" SG_ 1297 RCM_a106_eventFactoryMode 1;
BA_ "Confidence" SG_ 1297 RCM_a106_eventDiagEnabled 1;
BA_ "Confidence" SG_ 1297 RCM_a106_eventDriveOrientation 1;
BA_ "Confidence" SG_ 1297 RCM_a106_eventIDFsignal 1;
BA_ "Confidence" SG_ 1297 RCM_a106_eventFrontLeftSeatbelt 1;
BA_ "Confidence" SG_ 1297 RCM_a106_eventFrontRightSeatbelt 1;
BA_ "Confidence" SG_ 1297 RCM_a106_eventVehicleSpeed 1;
BA_ "Confidence" SG_ 1297 RCM_a106_eventSteeringAngle 1;
BA_ "Confidence" SG_ 1297 RCM_a106_eventDriverBrakeApply 1;
BA_ "GenSigSNA" SG_ 1297 RCM_a106_eventDriverBrakeApply "3";
BA_ "Confidence" SG_ 1297 RCM_a106_eventAccelPedalPos 1;
BA_ "GenSigSNA" SG_ 1297 RCM_a106_eventAccelPedalPos "255";
BA_ "Confidence" SG_ 1297 RCM_a107_eventArmStatus 1;
BA_ "Confidence" SG_ 1297 RCM_a107_eventFactoryMode 1;
BA_ "Confidence" SG_ 1297 RCM_a107_eventDiagEnabled 1;
BA_ "Confidence" SG_ 1297 RCM_a107_eventDriveOrientation 1;
BA_ "Confidence" SG_ 1297 RCM_a107_eventIDFsignal 1;
BA_ "Confidence" SG_ 1297 RCM_a107_eventFrontLeftSeatbelt 1;
BA_ "Confidence" SG_ 1297 RCM_a107_eventFrontRightSeatbelt 1;
BA_ "Confidence" SG_ 1297 RCM_a107_eventVehicleSpeed 1;
BA_ "Confidence" SG_ 1297 RCM_a107_eventSteeringAngle 1;
BA_ "Confidence" SG_ 1297 RCM_a107_eventDriverBrakeApply 1;
BA_ "GenSigSNA" SG_ 1297 RCM_a107_eventDriverBrakeApply "3";
BA_ "Confidence" SG_ 1297 RCM_a107_eventAccelPedalPos 1;
BA_ "GenSigSNA" SG_ 1297 RCM_a107_eventAccelPedalPos "255";
BA_ "Confidence" SG_ 1297 RCM_a108_eventArmStatus 1;
BA_ "Confidence" SG_ 1297 RCM_a108_eventFactoryMode 1;
BA_ "Confidence" SG_ 1297 RCM_a108_eventDiagEnabled 1;
BA_ "Confidence" SG_ 1297 RCM_a108_eventDriveOrientation 1;
BA_ "Confidence" SG_ 1297 RCM_a108_eventIDFsignal 1;
BA_ "Confidence" SG_ 1297 RCM_a108_eventFrontLeftSeatbelt 1;
BA_ "Confidence" SG_ 1297 RCM_a108_eventFrontRightSeatbelt 1;
BA_ "Confidence" SG_ 1297 RCM_a108_eventVehicleSpeed 1;
BA_ "Confidence" SG_ 1297 RCM_a108_eventSteeringAngle 1;
BA_ "Confidence" SG_ 1297 RCM_a108_eventDriverBrakeApply 1;
BA_ "GenSigSNA" SG_ 1297 RCM_a108_eventDriverBrakeApply "3";
BA_ "Confidence" SG_ 1297 RCM_a108_eventAccelPedalPos 1;
BA_ "GenSigSNA" SG_ 1297 RCM_a108_eventAccelPedalPos "255";
BA_ "Confidence" SG_ 1297 RCM_a109_eventArmStatus 1;
BA_ "Confidence" SG_ 1297 RCM_a109_eventFactoryMode 1;
BA_ "Confidence" SG_ 1297 RCM_a109_eventDiagEnabled 1;
BA_ "Confidence" SG_ 1297 RCM_a109_eventDriveOrientation 1;
BA_ "Confidence" SG_ 1297 RCM_a109_eventIDFsignal 1;
BA_ "Confidence" SG_ 1297 RCM_a109_eventFrontLeftSeatbelt 1;
BA_ "Confidence" SG_ 1297 RCM_a109_eventFrontRightSeatbelt 1;
BA_ "Confidence" SG_ 1297 RCM_a109_eventVehicleSpeed 1;
BA_ "Confidence" SG_ 1297 RCM_a109_eventSteeringAngle 1;
BA_ "Confidence" SG_ 1297 RCM_a109_eventDriverBrakeApply 1;
BA_ "GenSigSNA" SG_ 1297 RCM_a109_eventDriverBrakeApply "3";
BA_ "Confidence" SG_ 1297 RCM_a109_eventAccelPedalPos 1;
BA_ "GenSigSNA" SG_ 1297 RCM_a109_eventAccelPedalPos "255";
BA_ "Confidence" SG_ 1297 RCM_a110_eventArmStatus 1;
BA_ "Confidence" SG_ 1297 RCM_a110_eventFactoryMode 1;
BA_ "Confidence" SG_ 1297 RCM_a110_eventDiagEnabled 1;
BA_ "Confidence" SG_ 1297 RCM_a110_eventDriveOrientation 1;
BA_ "Confidence" SG_ 1297 RCM_a110_eventIDFsignal 1;
BA_ "Confidence" SG_ 1297 RCM_a110_eventFrontLeftSeatbelt 1;
BA_ "Confidence" SG_ 1297 RCM_a110_eventFrontRightSeatbelt 1;
BA_ "Confidence" SG_ 1297 RCM_a110_eventVehicleSpeed 1;
BA_ "Confidence" SG_ 1297 RCM_a110_eventSteeringAngle 1;
BA_ "Confidence" SG_ 1297 RCM_a110_eventDriverBrakeApply 1;
BA_ "GenSigSNA" SG_ 1297 RCM_a110_eventDriverBrakeApply "3";
BA_ "Confidence" SG_ 1297 RCM_a110_eventAccelPedalPos 1;
BA_ "GenSigSNA" SG_ 1297 RCM_a110_eventAccelPedalPos "255";
BA_ "Confidence" SG_ 1297 RCM_a112_eventArmStatus 1;
BA_ "Confidence" SG_ 1297 RCM_a112_eventFactoryMode 1;
BA_ "Confidence" SG_ 1297 RCM_a112_eventDiagEnabled 1;
BA_ "Confidence" SG_ 1297 RCM_a112_eventDriveOrientation 1;
BA_ "Confidence" SG_ 1297 RCM_a112_eventIDFsignal 1;
BA_ "Confidence" SG_ 1297 RCM_a112_eventFrontLeftSeatbelt 1;
BA_ "Confidence" SG_ 1297 RCM_a112_eventFrontRightSeatbelt 1;
BA_ "Confidence" SG_ 1297 RCM_a112_eventVehicleSpeed 1;
BA_ "Confidence" SG_ 1297 RCM_a112_eventSteeringAngle 1;
BA_ "Confidence" SG_ 1297 RCM_a112_eventDriverBrakeApply 1;
BA_ "GenSigSNA" SG_ 1297 RCM_a112_eventDriverBrakeApply "3";
BA_ "Confidence" SG_ 1297 RCM_a112_eventAccelPedalPos 1;
BA_ "GenSigSNA" SG_ 1297 RCM_a112_eventAccelPedalPos "255";
BA_ "Confidence" SG_ 1297 RCM_a113_eventArmStatus 1;
BA_ "Confidence" SG_ 1297 RCM_a113_eventFactoryMode 1;
BA_ "Confidence" SG_ 1297 RCM_a113_eventDiagEnabled 1;
BA_ "Confidence" SG_ 1297 RCM_a113_eventDriveOrientation 1;
BA_ "Confidence" SG_ 1297 RCM_a113_eventIDFsignal 1;
BA_ "Confidence" SG_ 1297 RCM_a113_eventFrontLeftSeatbelt 1;
BA_ "Confidence" SG_ 1297 RCM_a113_eventFrontRightSeatbelt 1;
BA_ "Confidence" SG_ 1297 RCM_a113_eventVehicleSpeed 1;
BA_ "Confidence" SG_ 1297 RCM_a113_eventSteeringAngle 1;
BA_ "Confidence" SG_ 1297 RCM_a113_eventDriverBrakeApply 1;
BA_ "GenSigSNA" SG_ 1297 RCM_a113_eventDriverBrakeApply "3";
BA_ "Confidence" SG_ 1297 RCM_a113_eventAccelPedalPos 1;
BA_ "GenSigSNA" SG_ 1297 RCM_a113_eventAccelPedalPos "255";
BA_ "Confidence" SG_ 1297 RCM_a114_eventArmStatus 1;
BA_ "Confidence" SG_ 1297 RCM_a114_eventFactoryMode 1;
BA_ "Confidence" SG_ 1297 RCM_a114_eventDiagEnabled 1;
BA_ "Confidence" SG_ 1297 RCM_a114_eventDriveOrientation 1;
BA_ "Confidence" SG_ 1297 RCM_a114_eventIDFsignal 1;
BA_ "Confidence" SG_ 1297 RCM_a114_eventFrontLeftSeatbelt 1;
BA_ "Confidence" SG_ 1297 RCM_a114_eventFrontRightSeatbelt 1;
BA_ "Confidence" SG_ 1297 RCM_a114_eventVehicleSpeed 1;
BA_ "Confidence" SG_ 1297 RCM_a114_eventSteeringAngle 1;
BA_ "Confidence" SG_ 1297 RCM_a114_eventDriverBrakeApply 1;
BA_ "GenSigSNA" SG_ 1297 RCM_a114_eventDriverBrakeApply "3";
BA_ "Confidence" SG_ 1297 RCM_a114_eventAccelPedalPos 1;
BA_ "GenSigSNA" SG_ 1297 RCM_a114_eventAccelPedalPos "255";
BA_ "Confidence" SG_ 1297 RCM_a115_eventArmStatus 1;
BA_ "Confidence" SG_ 1297 RCM_a115_eventFactoryMode 1;
BA_ "Confidence" SG_ 1297 RCM_a115_eventDiagEnabled 1;
BA_ "Confidence" SG_ 1297 RCM_a115_eventDriveOrientation 1;
BA_ "Confidence" SG_ 1297 RCM_a115_eventIDFsignal 1;
BA_ "Confidence" SG_ 1297 RCM_a115_eventFrontLeftSeatbelt 1;
BA_ "Confidence" SG_ 1297 RCM_a115_eventFrontRightSeatbelt 1;
BA_ "Confidence" SG_ 1297 RCM_a115_eventVehicleSpeed 1;
BA_ "Confidence" SG_ 1297 RCM_a115_eventSteeringAngle 1;
BA_ "Confidence" SG_ 1297 RCM_a115_eventDriverBrakeApply 1;
BA_ "GenSigSNA" SG_ 1297 RCM_a115_eventDriverBrakeApply "3";
BA_ "Confidence" SG_ 1297 RCM_a115_eventAccelPedalPos 1;
BA_ "GenSigSNA" SG_ 1297 RCM_a115_eventAccelPedalPos "255";
BA_ "Confidence" SG_ 1297 RCM_a116_eventArmStatus 1;
BA_ "Confidence" SG_ 1297 RCM_a116_eventFactoryMode 1;
BA_ "Confidence" SG_ 1297 RCM_a116_eventDiagEnabled 1;
BA_ "Confidence" SG_ 1297 RCM_a116_eventDriveOrientation 1;
BA_ "Confidence" SG_ 1297 RCM_a116_eventIDFsignal 1;
BA_ "Confidence" SG_ 1297 RCM_a116_eventFrontLeftSeatbelt 1;
BA_ "Confidence" SG_ 1297 RCM_a116_eventFrontRightSeatbelt 1;
BA_ "Confidence" SG_ 1297 RCM_a116_eventVehicleSpeed 1;
BA_ "Confidence" SG_ 1297 RCM_a116_eventSteeringAngle 1;
BA_ "Confidence" SG_ 1297 RCM_a116_eventDriverBrakeApply 1;
BA_ "GenSigSNA" SG_ 1297 RCM_a116_eventDriverBrakeApply "3";
BA_ "Confidence" SG_ 1297 RCM_a116_eventAccelPedalPos 1;
BA_ "GenSigSNA" SG_ 1297 RCM_a116_eventAccelPedalPos "255";
BA_ "Confidence" SG_ 1297 RCM_a117_eventArmStatus 1;
BA_ "Confidence" SG_ 1297 RCM_a117_eventFactoryMode 1;
BA_ "Confidence" SG_ 1297 RCM_a117_eventDiagEnabled 1;
BA_ "Confidence" SG_ 1297 RCM_a117_eventDriveOrientation 1;
BA_ "Confidence" SG_ 1297 RCM_a117_eventIDFsignal 1;
BA_ "Confidence" SG_ 1297 RCM_a117_eventFrontLeftSeatbelt 1;
BA_ "Confidence" SG_ 1297 RCM_a117_eventFrontRightSeatbelt 1;
BA_ "Confidence" SG_ 1297 RCM_a117_eventVehicleSpeed 1;
BA_ "Confidence" SG_ 1297 RCM_a117_eventSteeringAngle 1;
BA_ "Confidence" SG_ 1297 RCM_a117_eventDriverBrakeApply 1;
BA_ "GenSigSNA" SG_ 1297 RCM_a117_eventDriverBrakeApply "3";
BA_ "Confidence" SG_ 1297 RCM_a117_eventAccelPedalPos 1;
BA_ "GenSigSNA" SG_ 1297 RCM_a117_eventAccelPedalPos "255";
BA_ "Confidence" SG_ 1297 RCM_a118_eventArmStatus 1;
BA_ "Confidence" SG_ 1297 RCM_a118_eventFactoryMode 1;
BA_ "Confidence" SG_ 1297 RCM_a118_eventDiagEnabled 1;
BA_ "Confidence" SG_ 1297 RCM_a118_eventDriveOrientation 1;
BA_ "Confidence" SG_ 1297 RCM_a118_eventIDFsignal 1;
BA_ "Confidence" SG_ 1297 RCM_a118_eventFrontLeftSeatbelt 1;
VAL_ 1297 RCM_a058_eventFrontLeftSeatbelt 1 "LATCHED" 0 "UNLATCHED" ;
VAL_ 1297 RCM_a058_eventFrontRightSeatbelt 1 "LATCHED" 0 "UNLATCHED" ;
VAL_ 1297 RCM_a058_eventDriverBrakeApply 3 "Faulty_SNA" 2 "Driver_applying_brakes" 1 "Not_Applied" 0 "NotInit_orOff" ;
VAL_ 1297 RCM_a058_eventAccelPedalPos 255 "SNA" ;
VAL_ 1297 RCM_a059_eventArmStatus 1 "ARMED" 0 "UNARMED" ;
VAL_ 1297 RCM_a059_eventFactoryMode 1 "ENABLED" 0 "DISABLED" ;
VAL_ 1297 RCM_a059_eventDiagEnabled 1 "ENABLED" 0 "DISABLED" ;
VAL_ 1297 RCM_a059_eventDriveOrientation 1 "RIGHT_HAND_DRIVE" 0 "LEFT_HAND_DRIVE" ;
VAL_ 1297 RCM_a059_eventIDFsignal 1 "ACTIVE" 0 "NOT_ACTIVE" ;
VAL_ 1297 RCM_a059_eventFrontLeftSeatbelt 1 "LATCHED" 0 "UNLATCHED" ;
VAL_ 1297 RCM_a059_eventFrontRightSeatbelt 1 "LATCHED" 0 "UNLATCHED" ;
VAL_ 1297 RCM_a059_eventDriverBrakeApply 3 "Faulty_SNA" 2 "Driver_applying_brakes" 1 "Not_Applied" 0 "NotInit_orOff" ;
VAL_ 1297 RCM_a059_eventAccelPedalPos 255 "SNA" ;
VAL_ 1297 RCM_a060_eventArmStatus 1 "ARMED" 0 "UNARMED" ;
VAL_ 1297 RCM_a060_eventFactoryMode 1 "ENABLED" 0 "DISABLED" ;
VAL_ 1297 RCM_a060_eventDiagEnabled 1 "ENABLED" 0 "DISABLED" ;
VAL_ 1297 RCM_a060_eventDriveOrientation 1 "RIGHT_HAND_DRIVE" 0 "LEFT_HAND_DRIVE" ;
VAL_ 1297 RCM_a060_eventIDFsignal 1 "ACTIVE" 0 "NOT_ACTIVE" ;
VAL_ 1297 RCM_a060_eventFrontLeftSeatbelt 1 "LATCHED" 0 "UNLATCHED" ;
VAL_ 1297 RCM_a060_eventFrontRightSeatbelt 1 "LATCHED" 0 "UNLATCHED" ;
VAL_ 1297 RCM_a060_eventDriverBrakeApply 3 "Faulty_SNA" 2 "Driver_applying_brakes" 1 "Not_Applied" 0 "NotInit_orOff" ;
VAL_ 1297 RCM_a060_eventAccelPedalPos 255 "SNA" ;
VAL_ 1297 RCM_a061_eventArmStatus 1 "ARMED" 0 "UNARMED" ;
VAL_ 1297 RCM_a061_eventFactoryMode 1 "ENABLED" 0 "DISABLED" ;
VAL_ 1297 RCM_a061_eventDiagEnabled 1 "ENABLED" 0 "DISABLED" ;
VAL_ 1297 RCM_a061_eventDriveOrientation 1 "RIGHT_HAND_DRIVE" 0 "LEFT_HAND_DRIVE" ;
VAL_ 1297 RCM_a061_eventIDFsignal 1 "ACTIVE" 0 "NOT_ACTIVE" ;
VAL_ 1297 RCM_a061_eventFrontLeftSeatbelt 1 "LATCHED" 0 "UNLATCHED" ;
VAL_ 1297 RCM_a061_eventFrontRightSeatbelt 1 "LATCHED" 0 "UNLATCHED" ;
VAL_ 1297 RCM_a061_eventDriverBrakeApply 3 "Faulty_SNA" 2 "Driver_applying_brakes" 1 "Not_Applied" 0 "NotInit_orOff" ;
VAL_ 1297 RCM_a061_eventAccelPedalPos 255 "SNA" ;
VAL_ 1297 RCM_a062_eventArmStatus 1 "ARMED" 0 "UNARMED" ;
VAL_ 1297 RCM_a062_eventFactoryMode 1 "ENABLED" 0 "DISABLED" ;
VAL_ 1297 RCM_a062_eventDiagEnabled 1 "ENABLED" 0 "DISABLED" ;
VAL_ 1297 RCM_a062_eventDriveOrientation 1 "RIGHT_HAND_DRIVE" 0 "LEFT_HAND_DRIVE" ;
VAL_ 1297 RCM_a062_eventIDFsignal 1 "ACTIVE" 0 "NOT_ACTIVE" ;
VAL_ 1297 RCM_a062_eventFrontLeftSeatbelt 1 "LATCHED" 0 "UNLATCHED" ;
VAL_ 1297 RCM_a062_eventFrontRightSeatbelt 1 "LATCHED" 0 "UNLATCHED" ;
VAL_ 1297 RCM_a062_eventDriverBrakeApply 3 "Faulty_SNA" 2 "Driver_applying_brakes" 1 "Not_Applied" 0 "NotInit_orOff" ;
VAL_ 1297 RCM_a062_eventAccelPedalPos 255 "SNA" ;
VAL_ 1297 RCM_a063_eventArmStatus 1 "ARMED" 0 "UNARMED" ;
VAL_ 1297 RCM_a063_eventFactoryMode 1 "ENABLED" 0 "DISABLED" ;
VAL_ 1297 RCM_a063_eventDiagEnabled 1 "ENABLED" 0 "DISABLED" ;
VAL_ 1297 RCM_a063_eventDriveOrientation 1 "RIGHT_HAND_DRIVE" 0 "LEFT_HAND_DRIVE" ;
VAL_ 1297 RCM_a063_eventIDFsignal 1 "ACTIVE" 0 "NOT_ACTIVE" ;
VAL_ 1297 RCM_a063_eventFrontLeftSeatbelt 1 "LATCHED" 0 "UNLATCHED" ;
VAL_ 1297 RCM_a063_eventFrontRightSeatbelt 1 "LATCHED" 0 "UNLATCHED" ;
VAL_ 1297 RCM_a063_eventDriverBrakeApply 3 "Faulty_SNA" 2 "Driver_applying_brakes" 1 "Not_Applied" 0 "NotInit_orOff" ;
VAL_ 1297 RCM_a063_eventAccelPedalPos 255 "SNA" ;
VAL_ 1297 RCM_a064_eventArmStatus 1 "ARMED" 0 "UNARMED" ;
VAL_ 1297 RCM_a064_eventFactoryMode 1 "ENABLED" 0 "DISABLED" ;
VAL_ 1297 RCM_a064_eventDiagEnabled 1 "ENABLED" 0 "DISABLED" ;
VAL_ 1297 RCM_a064_eventDriveOrientation 1 "RIGHT_HAND_DRIVE" 0 "LEFT_HAND_DRIVE" ;
VAL_ 1297 RCM_a064_eventIDFsignal 1 "ACTIVE" 0 "NOT_ACTIVE" ;
VAL_ 1297 RCM_a064_eventFrontLeftSeatbelt 1 "LATCHED" 0 "UNLATCHED" ;
VAL_ 1297 RCM_a064_eventFrontRightSeatbelt 1 "LATCHED" 0 "UNLATCHED" ;
VAL_ 1297 RCM_a064_eventDriverBrakeApply 3 "Faulty_SNA" 2 "Driver_applying_brakes" 1 "Not_Applied" 0 "NotInit_orOff" ;
VAL_ 1297 RCM_a064_eventAccelPedalPos 255 "SNA" ;
VAL_ 1297 RCM_a065_eventArmStatus 1 "ARMED" 0 "UNARMED" ;
VAL_ 1297 RCM_a065_eventFactoryMode 1 "ENABLED" 0 "DISABLED" ;
VAL_ 1297 RCM_a065_eventDiagEnabled 1 "ENABLED" 0 "DISABLED" ;
VAL_ 1297 RCM_a065_eventDriveOrientation 1 "RIGHT_HAND_DRIVE" 0 "LEFT_HAND_DRIVE" ;
VAL_ 1297 RCM_a065_eventIDFsignal 1 "ACTIVE" 0 "NOT_ACTIVE" ;
VAL_ 1297 RCM_a065_eventFrontLeftSeatbelt 1 "LATCHED" 0 "UNLATCHED" ;
VAL_ 1297 RCM_a065_eventFrontRightSeatbelt 1 "LATCHED" 0 "UNLATCHED" ;
VAL_ 1297 RCM_a065_eventDriverBrakeApply 3 "Faulty_SNA" 2 "Driver_applying_brakes" 1 "Not_Applied" 0 "NotInit_orOff" ;
VAL_ 1297 RCM_a065_eventAccelPedalPos 255 "SNA" ;
VAL_ 1297 RCM_a066_eventArmStatus 1 "ARMED" 0 "UNARMED" ;
VAL_ 1297 RCM_a066_eventFactoryMode 1 "ENABLED" 0 "DISABLED" ;
VAL_ 1297 RCM_a066_eventDiagEnabled 1 "ENABLED" 0 "DISABLED" ;
VAL_ 1297 RCM_a066_eventDriveOrientation 1 "RIGHT_HAND_DRIVE" 0 "LEFT_HAND_DRIVE" ;
VAL_ 1297 RCM_a066_eventIDFsignal 1 "ACTIVE" 0 "NOT_ACTIVE" ;
VAL_ 1297 RCM_a066_eventFrontLeftSeatbelt 1 "LATCHED" 0 "UNLATCHED" ;
VAL_ 1297 RCM_a066_eventFrontRightSeatbelt 1 "LATCHED" 0 "UNLATCHED" ;
VAL_ 1297 RCM_a066_eventDriverBrakeApply 3 "Faulty_SNA" 2 "Driver_applying_brakes" 1 "Not_Applied" 0 "NotInit_orOff" ;
VAL_ 1297 RCM_a066_eventAccelPedalPos 255 "SNA" ;
VAL_ 1297 RCM_a067_eventArmStatus 1 "ARMED" 0 "UNARMED" ;
VAL_ 1297 RCM_a067_eventFactoryMode 1 "ENABLED" 0 "DISABLED" ;
VAL_ 1297 RCM_a067_eventDiagEnabled 1 "ENABLED" 0 "DISABLED" ;
VAL_ 1297 RCM_a067_eventDriveOrientation 1 "RIGHT_HAND_DRIVE" 0 "LEFT_HAND_DRIVE" ;
VAL_ 1297 RCM_a067_eventIDFsignal 1 "ACTIVE" 0 "NOT_ACTIVE" ;
VAL_ 1297 RCM_a067_eventFrontLeftSeatbelt 1 "LATCHED" 0 "UNLATCHED" ;
VAL_ 1297 RCM_a067_eventFrontRightSeatbelt 1 "LATCHED" 0 "UNLATCHED" ;
VAL_ 1297 RCM_a067_eventDriverBrakeApply 3 "Faulty_SNA" 2 "Driver_applying_brakes" 1 "Not_Applied" 0 "NotInit_orOff" ;
VAL_ 1297 RCM_a067_eventAccelPedalPos 255 "SNA" ;
VAL_ 1297 RCM_a068_eventArmStatus 1 "ARMED" 0 "UNARMED" ;
VAL_ 1297 RCM_a068_eventFactoryMode 1 "ENABLED" 0 "DISABLED" ;
VAL_ 1297 RCM_a068_eventDiagEnabled 1 "ENABLED" 0 "DISABLED" ;
VAL_ 1297 RCM_a068_eventDriveOrientation 1 "RIGHT_HAND_DRIVE" 0 "LEFT_HAND_DRIVE" ;
VAL_ 1297 RCM_a068_eventIDFsignal 1 "ACTIVE" 0 "NOT_ACTIVE" ;
VAL_ 1297 RCM_a068_eventFrontLeftSeatbelt 1 "LATCHED" 0 "UNLATCHED" ;
VAL_ 1297 RCM_a068_eventFrontRightSeatbelt 1 "LATCHED" 0 "UNLATCHED" ;
VAL_ 1297 RCM_a068_eventDriverBrakeApply 3 "Faulty_SNA" 2 "Driver_applying_brakes" 1 "Not_Applied" 0 "NotInit_orOff" ;
VAL_ 1297 RCM_a068_eventAccelPedalPos 255 "SNA" ;
VAL_ 1297 RCM_a069_eventArmStatus 1 "ARMED" 0 "UNARMED" ;
VAL_ 1297 RCM_a069_eventFactoryMode 1 "ENABLED" 0 "DISABLED" ;
VAL_ 1297 RCM_a069_eventDiagEnabled 1 "ENABLED" 0 "DISABLED" ;
VAL_ 1297 RCM_a069_eventDriveOrientation 1 "RIGHT_HAND_DRIVE" 0 "LEFT_HAND_DRIVE" ;
VAL_ 1297 RCM_a069_eventIDFsignal 1 "ACTIVE" 0 "NOT_ACTIVE" ;
VAL_ 1297 RCM_a069_eventFrontLeftSeatbelt 1 "LATCHED" 0 "UNLATCHED" ;
VAL_ 1297 RCM_a069_eventFrontRightSeatbelt 1 "LATCHED" 0 "UNLATCHED" ;
VAL_ 1297 RCM_a069_eventDriverBrakeApply 3 "Faulty_SNA" 2 "Driver_applying_brakes" 1 "Not_Applied" 0 "NotInit_orOff" ;
VAL_ 1297 RCM_a069_eventAccelPedalPos 255 "SNA" ;
VAL_ 1297 RCM_a070_eventArmStatus 1 "ARMED" 0 "UNARMED" ;
VAL_ 1297 RCM_a070_eventFactoryMode 1 "ENABLED" 0 "DISABLED" ;
VAL_ 1297 RCM_a070_eventDiagEnabled 1 "ENABLED" 0 "DISABLED" ;
VAL_ 1297 RCM_a070_eventDriveOrientation 1 "RIGHT_HAND_DRIVE" 0 "LEFT_HAND_DRIVE" ;
VAL_ 1297 RCM_a070_eventIDFsignal 1 "ACTIVE" 0 "NOT_ACTIVE" ;
VAL_ 1297 RCM_a070_eventFrontLeftSeatbelt 1 "LATCHED" 0 "UNLATCHED" ;
VAL_ 1297 RCM_a070_eventFrontRightSeatbelt 1 "LATCHED" 0 "UNLATCHED" ;
VAL_ 1297 RCM_a070_eventDriverBrakeApply 3 "Faulty_SNA" 2 "Driver_applying_brakes" 1 "Not_Applied" 0 "NotInit_orOff" ;
VAL_ 1297 RCM_a070_eventAccelPedalPos 255 "SNA" ;
VAL_ 1297 RCM_a071_eventArmStatus 1 "ARMED" 0 "UNARMED" ;
VAL_ 1297 RCM_a071_eventFactoryMode 1 "ENABLED" 0 "DISABLED" ;
VAL_ 1297 RCM_a071_eventDiagEnabled 1 "ENABLED" 0 "DISABLED" ;
VAL_ 1297 RCM_a071_eventDriveOrientation 1 "RIGHT_HAND_DRIVE" 0 "LEFT_HAND_DRIVE" ;
VAL_ 1297 RCM_a071_eventIDFsignal 1 "ACTIVE" 0 "NOT_ACTIVE" ;
VAL_ 1297 RCM_a071_eventFrontLeftSeatbelt 1 "LATCHED" 0 "UNLATCHED" ;
VAL_ 1297 RCM_a071_eventFrontRightSeatbelt 1 "LATCHED" 0 "UNLATCHED" ;
VAL_ 1297 RCM_a071_eventDriverBrakeApply 3 "Faulty_SNA" 2 "Driver_applying_brakes" 1 "Not_Applied" 0 "NotInit_orOff" ;
VAL_ 1297 RCM_a071_eventAccelPedalPos 255 "SNA" ;
VAL_ 1297 RCM_a072_eventArmStatus 1 "ARMED" 0 "UNARMED" ;
VAL_ 1297 RCM_a072_eventFactoryMode 1 "ENABLED" 0 "DISABLED" ;
VAL_ 1297 RCM_a072_eventDiagEnabled 1 "ENABLED" 0 "DISABLED" ;
VAL_ 1297 RCM_a072_eventDriveOrientation 1 "RIGHT_HAND_DRIVE" 0 "LEFT_HAND_DRIVE" ;
VAL_ 1297 RCM_a072_eventIDFsignal 1 "ACTIVE" 0 "NOT_ACTIVE" ;
VAL_ 1297 RCM_a072_eventFrontLeftSeatbelt 1 "LATCHED" 0 "UNLATCHED" ;
VAL_ 1297 RCM_a072_eventFrontRightSeatbelt 1 "LATCHED" 0 "UNLATCHED" ;
VAL_ 1297 RCM_a072_eventDriverBrakeApply 3 "Faulty_SNA" 2 "Driver_applying_brakes" 1 "Not_Applied" 0 "NotInit_orOff" ;
VAL_ 1297 RCM_a072_eventAccelPedalPos 255 "SNA" ;
VAL_ 1297 RCM_a073_eventArmStatus 1 "ARMED" 0 "UNARMED" ;
VAL_ 1297 RCM_a073_eventFactoryMode 1 "ENABLED" 0 "DISABLED" ;
VAL_ 1297 RCM_a073_eventDiagEnabled 1 "ENABLED" 0 "DISABLED" ;
VAL_ 1297 RCM_a073_eventDriveOrientation 1 "RIGHT_HAND_DRIVE" 0 "LEFT_HAND_DRIVE" ;
VAL_ 1297 RCM_a073_eventIDFsignal 1 "ACTIVE" 0 "NOT_ACTIVE" ;
VAL_ 1297 RCM_a073_eventFrontLeftSeatbelt 1 "LATCHED" 0 "UNLATCHED" ;
VAL_ 1297 RCM_a073_eventFrontRightSeatbelt 1 "LATCHED" 0 "UNLATCHED" ;
VAL_ 1297 RCM_a073_eventDriverBrakeApply 3 "Faulty_SNA" 2 "Driver_applying_brakes" 1 "Not_Applied" 0 "NotInit_orOff" ;
VAL_ 1297 RCM_a073_eventAccelPedalPos 255 "SNA" ;
VAL_ 1297 RCM_a074_eventArmStatus 1 "ARMED" 0 "UNARMED" ;
VAL_ 1297 RCM_a074_eventFactoryMode 1 "ENABLED" 0 "DISABLED" ;
VAL_ 1297 RCM_a074_eventDiagEnabled 1 "ENABLED" 0 "DISABLED" ;
VAL_ 1297 RCM_a074_eventDriveOrientation 1 "RIGHT_HAND_DRIVE" 0 "LEFT_HAND_DRIVE" ;
VAL_ 1297 RCM_a074_eventIDFsignal 1 "ACTIVE" 0 "NOT_ACTIVE" ;
VAL_ 1297 RCM_a074_eventFrontLeftSeatbelt 1 "LATCHED" 0 "UNLATCHED" ;
VAL_ 1297 RCM_a074_eventFrontRightSeatbelt 1 "LATCHED" 0 "UNLATCHED" ;
VAL_ 1297 RCM_a074_eventDriverBrakeApply 3 "Faulty_SNA" 2 "Driver_applying_brakes" 1 "Not_Applied" 0 "NotInit_orOff" ;
VAL_ 1297 RCM_a074_eventAccelPedalPos 255 "SNA" ;
VAL_ 1297 RCM_a075_eventArmStatus 1 "ARMED" 0 "UNARMED" ;
VAL_ 1297 RCM_a075_eventFactoryMode 1 "ENABLED" 0 "DISABLED" ;
VAL_ 1297 RCM_a075_eventDiagEnabled 1 "ENABLED" 0 "DISABLED" ;
VAL_ 1297 RCM_a075_eventDriveOrientation 1 "RIGHT_HAND_DRIVE" 0 "LEFT_HAND_DRIVE" ;
VAL_ 1297 RCM_a075_eventIDFsignal 1 "ACTIVE" 0 "NOT_ACTIVE" ;
VAL_ 1297 RCM_a075_eventFrontLeftSeatbelt 1 "LATCHED" 0 "UNLATCHED" ;
VAL_ 1297 RCM_a075_eventFrontRightSeatbelt 1 "LATCHED" 0 "UNLATCHED" ;
VAL_ 1297 RCM_a075_eventDriverBrakeApply 3 "Faulty_SNA" 2 "Driver_applying_brakes" 1 "Not_Applied" 0 "NotInit_orOff" ;
VAL_ 1297 RCM_a075_eventAccelPedalPos 255 "SNA" ;
VAL_ 1297 RCM_a078_eventArmStatus 1 "ARMED" 0 "UNARMED" ;
VAL_ 1297 RCM_a078_eventFactoryMode 1 "ENABLED" 0 "DISABLED" ;
VAL_ 1297 RCM_a078_eventDiagEnabled 1 "ENABLED" 0 "DISABLED" ;
VAL_ 1297 RCM_a078_eventDriveOrientation 1 "RIGHT_HAND_DRIVE" 0 "LEFT_HAND_DRIVE" ;
VAL_ 1297 RCM_a078_eventIDFsignal 1 "ACTIVE" 0 "NOT_ACTIVE" ;
VAL_ 1297 RCM_a078_eventFrontLeftSeatbelt 1 "LATCHED" 0 "UNLATCHED" ;
VAL_ 1297 RCM_a078_eventFrontRightSeatbelt 1 "LATCHED" 0 "UNLATCHED" ;
VAL_ 1297 RCM_a078_eventDriverBrakeApply 3 "Faulty_SNA" 2 "Driver_applying_brakes" 1 "Not_Applied" 0 "NotInit_orOff" ;
VAL_ 1297 RCM_a078_eventAccelPedalPos 255 "SNA" ;
VAL_ 1297 RCM_a079_eventArmStatus 1 "ARMED" 0 "UNARMED" ;
VAL_ 1297 RCM_a079_eventFactoryMode 1 "ENABLED" 0 "DISABLED" ;
VAL_ 1297 RCM_a079_eventDiagEnabled 1 "ENABLED" 0 "DISABLED" ;
VAL_ 1297 RCM_a079_eventDriveOrientation 1 "RIGHT_HAND_DRIVE" 0 "LEFT_HAND_DRIVE" ;
VAL_ 1297 RCM_a079_eventIDFsignal 1 "ACTIVE" 0 "NOT_ACTIVE" ;
VAL_ 1297 RCM_a079_eventFrontLeftSeatbelt 1 "LATCHED" 0 "UNLATCHED" ;
VAL_ 1297 RCM_a079_eventFrontRightSeatbelt 1 "LATCHED" 0 "UNLATCHED" ;
VAL_ 1297 RCM_a079_eventDriverBrakeApply 3 "Faulty_SNA" 2 "Driver_applying_brakes" 1 "Not_Applied" 0 "NotInit_orOff" ;
VAL_ 1297 RCM_a079_eventAccelPedalPos 255 "SNA" ;
VAL_ 1297 RCM_a080_eventArmStatus 1 "ARMED" 0 "UNARMED" ;
VAL_ 1297 RCM_a080_eventFactoryMode 1 "ENABLED" 0 "DISABLED" ;
VAL_ 1297 RCM_a080_eventDiagEnabled 1 "ENABLED" 0 "DISABLED" ;
VAL_ 1297 RCM_a080_eventDriveOrientation 1 "RIGHT_HAND_DRIVE" 0 "LEFT_HAND_DRIVE" ;
VAL_ 1297 RCM_a080_eventIDFsignal 1 "ACTIVE" 0 "NOT_ACTIVE" ;
VAL_ 1297 RCM_a080_eventFrontLeftSeatbelt 1 "LATCHED" 0 "UNLATCHED" ;
VAL_ 1297 RCM_a080_eventFrontRightSeatbelt 1 "LATCHED" 0 "UNLATCHED" ;
VAL_ 1297 RCM_a080_eventDriverBrakeApply 3 "Faulty_SNA" 2 "Driver_applying_brakes" 1 "Not_Applied" 0 "NotInit_orOff" ;
VAL_ 1297 RCM_a080_eventAccelPedalPos 255 "SNA" ;
VAL_ 1297 RCM_a083_eventArmStatus 1 "ARMED" 0 "UNARMED" ;
VAL_ 1297 RCM_a083_eventFactoryMode 1 "ENABLED" 0 "DISABLED" ;
VAL_ 1297 RCM_a083_eventDiagEnabled 1 "ENABLED" 0 "DISABLED" ;
VAL_ 1297 RCM_a083_eventDriveOrientation 1 "RIGHT_HAND_DRIVE" 0 "LEFT_HAND_DRIVE" ;
VAL_ 1297 RCM_a083_eventIDFsignal 1 "ACTIVE" 0 "NOT_ACTIVE" ;
VAL_ 1297 RCM_a083_eventFrontLeftSeatbelt 1 "LATCHED" 0 "UNLATCHED" ;
VAL_ 1297 RCM_a083_eventFrontRightSeatbelt 1 "LATCHED" 0 "UNLATCHED" ;
VAL_ 1297 RCM_a083_eventDriverBrakeApply 3 "Faulty_SNA" 2 "Driver_applying_brakes" 1 "Not_Applied" 0 "NotInit_orOff" ;
VAL_ 1297 RCM_a083_eventAccelPedalPos 255 "SNA" ;
VAL_ 1297 RCM_a087_eventArmStatus 1 "ARMED" 0 "UNARMED" ;
VAL_ 1297 RCM_a087_eventFactoryMode 1 "ENABLED" 0 "DISABLED" ;
VAL_ 1297 RCM_a087_eventDiagEnabled 1 "ENABLED" 0 "DISABLED" ;
VAL_ 1297 RCM_a087_eventDriveOrientation 1 "RIGHT_HAND_DRIVE" 0 "LEFT_HAND_DRIVE" ;
VAL_ 1297 RCM_a087_eventIDFsignal 1 "ACTIVE" 0 "NOT_ACTIVE" ;
VAL_ 1297 RCM_a087_eventFrontLeftSeatbelt 1 "LATCHED" 0 "UNLATCHED" ;
VAL_ 1297 RCM_a087_eventFrontRightSeatbelt 1 "LATCHED" 0 "UNLATCHED" ;
VAL_ 1297 RCM_a087_eventDriverBrakeApply 3 "Faulty_SNA" 2 "Driver_applying_brakes" 1 "Not_Applied" 0 "NotInit_orOff" ;
VAL_ 1297 RCM_a087_eventAccelPedalPos 255 "SNA" ;
VAL_ 1297 RCM_a088_eventArmStatus 1 "ARMED" 0 "UNARMED" ;
VAL_ 1297 RCM_a088_eventFactoryMode 1 "ENABLED" 0 "DISABLED" ;
VAL_ 1297 RCM_a088_eventDiagEnabled 1 "ENABLED" 0 "DISABLED" ;
VAL_ 1297 RCM_a088_eventDriveOrientation 1 "RIGHT_HAND_DRIVE" 0 "LEFT_HAND_DRIVE" ;
VAL_ 1297 RCM_a088_eventIDFsignal 1 "ACTIVE" 0 "NOT_ACTIVE" ;
VAL_ 1297 RCM_a088_eventFrontLeftSeatbelt 1 "LATCHED" 0 "UNLATCHED" ;
VAL_ 1297 RCM_a088_eventFrontRightSeatbelt 1 "LATCHED" 0 "UNLATCHED" ;
VAL_ 1297 RCM_a088_eventDriverBrakeApply 3 "Faulty_SNA" 2 "Driver_applying_brakes" 1 "Not_Applied" 0 "NotInit_orOff" ;
VAL_ 1297 RCM_a088_eventAccelPedalPos 255 "SNA" ;
VAL_ 1297 RCM_a089_eventArmStatus 1 "ARMED" 0 "UNARMED" ;
VAL_ 1297 RCM_a089_eventFactoryMode 1 "ENABLED" 0 "DISABLED" ;
VAL_ 1297 RCM_a089_eventDiagEnabled 1 "ENABLED" 0 "DISABLED" ;
VAL_ 1297 RCM_a089_eventDriveOrientation 1 "RIGHT_HAND_DRIVE" 0 "LEFT_HAND_DRIVE" ;
VAL_ 1297 RCM_a089_eventIDFsignal 1 "ACTIVE" 0 "NOT_ACTIVE" ;
VAL_ 1297 RCM_a089_eventFrontLeftSeatbelt 1 "LATCHED" 0 "UNLATCHED" ;
VAL_ 1297 RCM_a089_eventFrontRightSeatbelt 1 "LATCHED" 0 "UNLATCHED" ;
VAL_ 1297 RCM_a089_eventDriverBrakeApply 3 "Faulty_SNA" 2 "Driver_applying_brakes" 1 "Not_Applied" 0 "NotInit_orOff" ;
VAL_ 1297 RCM_a089_eventAccelPedalPos 255 "SNA" ;
VAL_ 1297 RCM_a090_eventArmStatus 1 "ARMED" 0 "UNARMED" ;
VAL_ 1297 RCM_a090_eventFactoryMode 1 "ENABLED" 0 "DISABLED" ;
VAL_ 1297 RCM_a090_eventDiagEnabled 1 "ENABLED" 0 "DISABLED" ;
VAL_ 1297 RCM_a090_eventDriveOrientation 1 "RIGHT_HAND_DRIVE" 0 "LEFT_HAND_DRIVE" ;
VAL_ 1297 RCM_a090_eventIDFsignal 1 "ACTIVE" 0 "NOT_ACTIVE" ;
VAL_ 1297 RCM_a090_eventFrontLeftSeatbelt 1 "LATCHED" 0 "UNLATCHED" ;
VAL_ 1297 RCM_a090_eventFrontRightSeatbelt 1 "LATCHED" 0 "UNLATCHED" ;
VAL_ 1297 RCM_a090_eventDriverBrakeApply 3 "Faulty_SNA" 2 "Driver_applying_brakes" 1 "Not_Applied" 0 "NotInit_orOff" ;
VAL_ 1297 RCM_a090_eventAccelPedalPos 255 "SNA" ;
VAL_ 1297 RCM_a092_eventArmStatus 1 "ARMED" 0 "UNARMED" ;
VAL_ 1297 RCM_a092_eventFactoryMode 1 "ENABLED" 0 "DISABLED" ;
VAL_ 1297 RCM_a092_eventDiagEnabled 1 "ENABLED" 0 "DISABLED" ;
VAL_ 1297 RCM_a092_eventDriveOrientation 1 "RIGHT_HAND_DRIVE" 0 "LEFT_HAND_DRIVE" ;
VAL_ 1297 RCM_a092_eventIDFsignal 1 "ACTIVE" 0 "NOT_ACTIVE" ;
VAL_ 1297 RCM_a092_eventFrontLeftSeatbelt 1 "LATCHED" 0 "UNLATCHED" ;
VAL_ 1297 RCM_a092_eventFrontRightSeatbelt 1 "LATCHED" 0 "UNLATCHED" ;
VAL_ 1297 RCM_a092_eventDriverBrakeApply 3 "Faulty_SNA" 2 "Driver_applying_brakes" 1 "Not_Applied" 0 "NotInit_orOff" ;
VAL_ 1297 RCM_a092_eventAccelPedalPos 255 "SNA" ;
VAL_ 1297 RCM_a093_eventArmStatus 1 "ARMED" 0 "UNARMED" ;
VAL_ 1297 RCM_a093_eventFactoryMode 1 "ENABLED" 0 "DISABLED" ;
VAL_ 1297 RCM_a093_eventDiagEnabled 1 "ENABLED" 0 "DISABLED" ;
VAL_ 1297 RCM_a093_eventDriveOrientation 1 "RIGHT_HAND_DRIVE" 0 "LEFT_HAND_DRIVE" ;
VAL_ 1297 RCM_a093_eventIDFsignal 1 "ACTIVE" 0 "NOT_ACTIVE" ;
VAL_ 1297 RCM_a093_eventFrontLeftSeatbelt 1 "LATCHED" 0 "UNLATCHED" ;
VAL_ 1297 RCM_a093_eventFrontRightSeatbelt 1 "LATCHED" 0 "UNLATCHED" ;
VAL_ 1297 RCM_a093_eventDriverBrakeApply 3 "Faulty_SNA" 2 "Driver_applying_brakes" 1 "Not_Applied" 0 "NotInit_orOff" ;
VAL_ 1297 RCM_a093_eventAccelPedalPos 255 "SNA" ;
VAL_ 1297 RCM_a094_eventArmStatus 1 "ARMED" 0 "UNARMED" ;
VAL_ 1297 RCM_a094_eventFactoryMode 1 "ENABLED" 0 "DISABLED" ;
VAL_ 1297 RCM_a094_eventDiagEnabled 1 "ENABLED" 0 "DISABLED" ;
VAL_ 1297 RCM_a094_eventDriveOrientation 1 "RIGHT_HAND_DRIVE" 0 "LEFT_HAND_DRIVE" ;
VAL_ 1297 RCM_a094_eventIDFsignal 1 "ACTIVE" 0 "NOT_ACTIVE" ;
VAL_ 1297 RCM_a094_eventFrontLeftSeatbelt 1 "LATCHED" 0 "UNLATCHED" ;
VAL_ 1297 RCM_a094_eventFrontRightSeatbelt 1 "LATCHED" 0 "UNLATCHED" ;
VAL_ 1297 RCM_a094_eventDriverBrakeApply 3 "Faulty_SNA" 2 "Driver_applying_brakes" 1 "Not_Applied" 0 "NotInit_orOff" ;
VAL_ 1297 RCM_a094_eventAccelPedalPos 255 "SNA" ;
VAL_ 1297 RCM_a101_eventArmStatus 1 "ARMED" 0 "UNARMED" ;
VAL_ 1297 RCM_a101_eventFactoryMode 1 "ENABLED" 0 "DISABLED" ;
VAL_ 1297 RCM_a101_eventDiagEnabled 1 "ENABLED" 0 "DISABLED" ;
VAL_ 1297 RCM_a101_eventDriveOrientation 1 "RIGHT_HAND_DRIVE" 0 "LEFT_HAND_DRIVE" ;
VAL_ 1297 RCM_a101_eventIDFsignal 1 "ACTIVE" 0 "NOT_ACTIVE" ;
VAL_ 1297 RCM_a101_eventFrontLeftSeatbelt 1 "LATCHED" 0 "UNLATCHED" ;
VAL_ 1297 RCM_a101_eventFrontRightSeatbelt 1 "LATCHED" 0 "UNLATCHED" ;
VAL_ 1297 RCM_a101_eventDriverBrakeApply 3 "Faulty_SNA" 2 "Driver_applying_brakes" 1 "Not_Applied" 0 "NotInit_orOff" ;
VAL_ 1297 RCM_a101_eventAccelPedalPos 255 "SNA" ;
VAL_ 1297 RCM_a102_eventArmStatus 1 "ARMED" 0 "UNARMED" ;
VAL_ 1297 RCM_a102_eventFactoryMode 1 "ENABLED" 0 "DISABLED" ;
VAL_ 1297 RCM_a102_eventDiagEnabled 1 "ENABLED" 0 "DISABLED" ;
VAL_ 1297 RCM_a102_eventDriveOrientation 1 "RIGHT_HAND_DRIVE" 0 "LEFT_HAND_DRIVE" ;
VAL_ 1297 RCM_a102_eventIDFsignal 1 "ACTIVE" 0 "NOT_ACTIVE" ;
VAL_ 1297 RCM_a102_eventFrontLeftSeatbelt 1 "LATCHED" 0 "UNLATCHED" ;
VAL_ 1297 RCM_a102_eventFrontRightSeatbelt 1 "LATCHED" 0 "UNLATCHED" ;
VAL_ 1297 RCM_a102_eventDriverBrakeApply 3 "Faulty_SNA" 2 "Driver_applying_brakes" 1 "Not_Applied" 0 "NotInit_orOff" ;
VAL_ 1297 RCM_a102_eventAccelPedalPos 255 "SNA" ;
VAL_ 1297 RCM_a103_eventArmStatus 1 "ARMED" 0 "UNARMED" ;
VAL_ 1297 RCM_a103_eventFactoryMode 1 "ENABLED" 0 "DISABLED" ;
VAL_ 1297 RCM_a103_eventDiagEnabled 1 "ENABLED" 0 "DISABLED" ;
VAL_ 1297 RCM_a103_eventDriveOrientation 1 "RIGHT_HAND_DRIVE" 0 "LEFT_HAND_DRIVE" ;
VAL_ 1297 RCM_a103_eventIDFsignal 1 "ACTIVE" 0 "NOT_ACTIVE" ;
VAL_ 1297 RCM_a103_eventFrontLeftSeatbelt 1 "LATCHED" 0 "UNLATCHED" ;
VAL_ 1297 RCM_a103_eventFrontRightSeatbelt 1 "LATCHED" 0 "UNLATCHED" ;
VAL_ 1297 RCM_a103_eventDriverBrakeApply 3 "Faulty_SNA" 2 "Driver_applying_brakes" 1 "Not_Applied" 0 "NotInit_orOff" ;
VAL_ 1297 RCM_a103_eventAccelPedalPos 255 "SNA" ;
VAL_ 1297 RCM_a104_eventArmStatus 1 "ARMED" 0 "UNARMED" ;
VAL_ 1297 RCM_a104_eventFactoryMode 1 "ENABLED" 0 "DISABLED" ;
VAL_ 1297 RCM_a104_eventDiagEnabled 1 "ENABLED" 0 "DISABLED" ;
VAL_ 1297 RCM_a104_eventDriveOrientation 1 "RIGHT_HAND_DRIVE" 0 "LEFT_HAND_DRIVE" ;
VAL_ 1297 RCM_a104_eventIDFsignal 1 "ACTIVE" 0 "NOT_ACTIVE" ;
VAL_ 1297 RCM_a104_eventFrontLeftSeatbelt 1 "LATCHED" 0 "UNLATCHED" ;
VAL_ 1297 RCM_a104_eventFrontRightSeatbelt 1 "LATCHED" 0 "UNLATCHED" ;
VAL_ 1297 RCM_a104_eventDriverBrakeApply 3 "Faulty_SNA" 2 "Driver_applying_brakes" 1 "Not_Applied" 0 "NotInit_orOff" ;
VAL_ 1297 RCM_a104_eventAccelPedalPos 255 "SNA" ;
VAL_ 1297 RCM_a105_eventArmStatus 1 "ARMED" 0 "UNARMED" ;
VAL_ 1297 RCM_a105_eventFactoryMode 1 "ENABLED" 0 "DISABLED" ;
VAL_ 1297 RCM_a105_eventDiagEnabled 1 "ENABLED" 0 "DISABLED" ;
VAL_ 1297 RCM_a105_eventDriveOrientation 1 "RIGHT_HAND_DRIVE" 0 "LEFT_HAND_DRIVE" ;
VAL_ 1297 RCM_a105_eventIDFsignal 1 "ACTIVE" 0 "NOT_ACTIVE" ;
VAL_ 1297 RCM_a105_eventFrontLeftSeatbelt 1 "LATCHED" 0 "UNLATCHED" ;
VAL_ 1297 RCM_a105_eventFrontRightSeatbelt 1 "LATCHED" 0 "UNLATCHED" ;
VAL_ 1297 RCM_a105_eventDriverBrakeApply 3 "Faulty_SNA" 2 "Driver_applying_brakes" 1 "Not_Applied" 0 "NotInit_orOff" ;
VAL_ 1297 RCM_a105_eventAccelPedalPos 255 "SNA" ;
VAL_ 1297 RCM_a106_eventArmStatus 1 "ARMED" 0 "UNARMED" ;
VAL_ 1297 RCM_a106_eventFactoryMode 1 "ENABLED" 0 "DISABLED" ;
VAL_ 1297 RCM_a106_eventDiagEnabled 1 "ENABLED" 0 "DISABLED" ;
VAL_ 1297 RCM_a106_eventDriveOrientation 1 "RIGHT_HAND_DRIVE" 0 "LEFT_HAND_DRIVE" ;
VAL_ 1297 RCM_a106_eventIDFsignal 1 "ACTIVE" 0 "NOT_ACTIVE" ;
VAL_ 1297 RCM_a106_eventFrontLeftSeatbelt 1 "LATCHED" 0 "UNLATCHED" ;
VAL_ 1297 RCM_a106_eventFrontRightSeatbelt 1 "LATCHED" 0 "UNLATCHED" ;
VAL_ 1297 RCM_a106_eventDriverBrakeApply 3 "Faulty_SNA" 2 "Driver_applying_brakes" 1 "Not_Applied" 0 "NotInit_orOff" ;
VAL_ 1297 RCM_a106_eventAccelPedalPos 255 "SNA" ;
VAL_ 1297 RCM_a107_eventArmStatus 1 "ARMED" 0 "UNARMED" ;
VAL_ 1297 RCM_a107_eventFactoryMode 1 "ENABLED" 0 "DISABLED" ;
VAL_ 1297 RCM_a107_eventDiagEnabled 1 "ENABLED" 0 "DISABLED" ;
VAL_ 1297 RCM_a107_eventDriveOrientation 1 "RIGHT_HAND_DRIVE" 0 "LEFT_HAND_DRIVE" ;
VAL_ 1297 RCM_a107_eventIDFsignal 1 "ACTIVE" 0 "NOT_ACTIVE" ;
VAL_ 1297 RCM_a107_eventFrontLeftSeatbelt 1 "LATCHED" 0 "UNLATCHED" ;
VAL_ 1297 RCM_a107_eventFrontRightSeatbelt 1 "LATCHED" 0 "UNLATCHED" ;
VAL_ 1297 RCM_a107_eventDriverBrakeApply 3 "Faulty_SNA" 2 "Driver_applying_brakes" 1 "Not_Applied" 0 "NotInit_orOff" ;
VAL_ 1297 RCM_a107_eventAccelPedalPos 255 "SNA" ;
VAL_ 1297 RCM_a108_eventArmStatus 1 "ARMED" 0 "UNARMED" ;
VAL_ 1297 RCM_a108_eventFactoryMode 1 "ENABLED" 0 "DISABLED" ;
VAL_ 1297 RCM_a108_eventDiagEnabled 1 "ENABLED" 0 "DISABLED" ;
VAL_ 1297 RCM_a108_eventDriveOrientation 1 "RIGHT_HAND_DRIVE" 0 "LEFT_HAND_DRIVE" ;
VAL_ 1297 RCM_a108_eventIDFsignal 1 "ACTIVE" 0 "NOT_ACTIVE" ;
VAL_ 1297 RCM_a108_eventFrontLeftSeatbelt 1 "LATCHED" 0 "UNLATCHED" ;
VAL_ 1297 RCM_a108_eventFrontRightSeatbelt 1 "LATCHED" 0 "UNLATCHED" ;
VAL_ 1297 RCM_a108_eventDriverBrakeApply 3 "Faulty_SNA" 2 "Driver_applying_brakes" 1 "Not_Applied" 0 "NotInit_orOff" ;
VAL_ 1297 RCM_a108_eventAccelPedalPos 255 "SNA" ;
VAL_ 1297 RCM_a109_eventArmStatus 1 "ARMED" 0 "UNARMED" ;
VAL_ 1297 RCM_a109_eventFactoryMode 1 "ENABLED" 0 "DISABLED" ;
VAL_ 1297 RCM_a109_eventDiagEnabled 1 "ENABLED" 0 "DISABLED" ;
VAL_ 1297 RCM_a109_eventDriveOrientation 1 "RIGHT_HAND_DRIVE" 0 "LEFT_HAND_DRIVE" ;
VAL_ 1297 RCM_a109_eventIDFsignal 1 "ACTIVE" 0 "NOT_ACTIVE" ;
VAL_ 1297 RCM_a109_eventFrontLeftSeatbelt 1 "LATCHED" 0 "UNLATCHED" ;
VAL_ 1297 RCM_a109_eventFrontRightSeatbelt 1 "LATCHED" 0 "UNLATCHED" ;
VAL_ 1297 RCM_a109_eventDriverBrakeApply 3 "Faulty_SNA" 2 "Driver_applying_brakes" 1 "Not_Applied" 0 "NotInit_orOff" ;
VAL_ 1297 RCM_a109_eventAccelPedalPos 255 "SNA" ;
VAL_ 1297 RCM_a110_eventArmStatus 1 "ARMED" 0 "UNARMED" ;
VAL_ 1297 RCM_a110_eventFactoryMode 1 "ENABLED" 0 "DISABLED" ;
VAL_ 1297 RCM_a110_eventDiagEnabled 1 "ENABLED" 0 "DISABLED" ;
VAL_ 1297 RCM_a110_eventDriveOrientation 1 "RIGHT_HAND_DRIVE" 0 "LEFT_HAND_DRIVE" ;
VAL_ 1297 RCM_a110_eventIDFsignal 1 "ACTIVE" 0 "NOT_ACTIVE" ;
VAL_ 1297 RCM_a110_eventFrontLeftSeatbelt 1 "LATCHED" 0 "UNLATCHED" ;
VAL_ 1297 RCM_a110_eventFrontRightSeatbelt 1 "LATCHED" 0 "UNLATCHED" ;
VAL_ 1297 RCM_a110_eventDriverBrakeApply 3 "Faulty_SNA" 2 "Driver_applying_brakes" 1 "Not_Applied" 0 "NotInit_orOff" ;
VAL_ 1297 RCM_a110_eventAccelPedalPos 255 "SNA" ;
VAL_ 1297 RCM_a112_eventArmStatus 1 "ARMED" 0 "UNARMED" ;
VAL_ 1297 RCM_a112_eventFactoryMode 1 "ENABLED" 0 "DISABLED" ;
VAL_ 1297 RCM_a112_eventDiagEnabled 1 "ENABLED" 0 "DISABLED" ;
VAL_ 1297 RCM_a112_eventDriveOrientation 1 "RIGHT_HAND_DRIVE" 0 "LEFT_HAND_DRIVE" ;
VAL_ 1297 RCM_a112_eventIDFsignal 1 "ACTIVE" 0 "NOT_ACTIVE" ;
VAL_ 1297 RCM_a112_eventFrontLeftSeatbelt 1 "LATCHED" 0 "UNLATCHED" ;
VAL_ 1297 RCM_a112_eventFrontRightSeatbelt 1 "LATCHED" 0 "UNLATCHED" ;
VAL_ 1297 RCM_a112_eventDriverBrakeApply 3 "Faulty_SNA" 2 "Driver_applying_brakes" 1 "Not_Applied" 0 "NotInit_orOff" ;
VAL_ 1297 RCM_a112_eventAccelPedalPos 255 "SNA" ;
VAL_ 1297 RCM_a113_eventArmStatus 1 "ARMED" 0 "UNARMED" ;
VAL_ 1297 RCM_a113_eventFactoryMode 1 "ENABLED" 0 "DISABLED" ;
VAL_ 1297 RCM_a113_eventDiagEnabled 1 "ENABLED" 0 "DISABLED" ;
VAL_ 1297 RCM_a113_eventDriveOrientation 1 "RIGHT_HAND_DRIVE" 0 "LEFT_HAND_DRIVE" ;
VAL_ 1297 RCM_a113_eventIDFsignal 1 "ACTIVE" 0 "NOT_ACTIVE" ;
VAL_ 1297 RCM_a113_eventFrontLeftSeatbelt 1 "LATCHED" 0 "UNLATCHED" ;
VAL_ 1297 RCM_a113_eventFrontRightSeatbelt 1 "LATCHED" 0 "UNLATCHED" ;
VAL_ 1297 RCM_a113_eventDriverBrakeApply 3 "Faulty_SNA" 2 "Driver_applying_brakes" 1 "Not_Applied" 0 "NotInit_orOff" ;
VAL_ 1297 RCM_a113_eventAccelPedalPos 255 "SNA" ;
VAL_ 1297 RCM_a114_eventArmStatus 1 "ARMED" 0 "UNARMED" ;
VAL_ 1297 RCM_a114_eventFactoryMode 1 "ENABLED" 0 "DISABLED" ;
VAL_ 1297 RCM_a114_eventDiagEnabled 1 "ENABLED" 0 "DISABLED" ;
VAL_ 1297 RCM_a114_eventDriveOrientation 1 "RIGHT_HAND_DRIVE" 0 "LEFT_HAND_DRIVE" ;
VAL_ 1297 RCM_a114_eventIDFsignal 1 "ACTIVE" 0 "NOT_ACTIVE" ;
VAL_ 1297 RCM_a114_eventFrontLeftSeatbelt 1 "LATCHED" 0 "UNLATCHED" ;
VAL_ 1297 RCM_a114_eventFrontRightSeatbelt 1 "LATCHED" 0 "UNLATCHED" ;
VAL_ 1297 RCM_a114_eventDriverBrakeApply 3 "Faulty_SNA" 2 "Driver_applying_brakes" 1 "Not_Applied" 0 "NotInit_orOff" ;
VAL_ 1297 RCM_a114_eventAccelPedalPos 255 "SNA" ;
VAL_ 1297 RCM_a115_eventArmStatus 1 "ARMED" 0 "UNARMED" ;
VAL_ 1297 RCM_a115_eventFactoryMode 1 "ENABLED" 0 "DISABLED" ;
VAL_ 1297 RCM_a115_eventDiagEnabled 1 "ENABLED" 0 "DISABLED" ;
VAL_ 1297 RCM_a115_eventDriveOrientation 1 "RIGHT_HAND_DRIVE" 0 "LEFT_HAND_DRIVE" ;
VAL_ 1297 RCM_a115_eventIDFsignal 1 "ACTIVE" 0 "NOT_ACTIVE" ;
VAL_ 1297 RCM_a115_eventFrontLeftSeatbelt 1 "LATCHED" 0 "UNLATCHED" ;
VAL_ 1297 RCM_a115_eventFrontRightSeatbelt 1 "LATCHED" 0 "UNLATCHED" ;
VAL_ 1297 RCM_a115_eventDriverBrakeApply 3 "Faulty_SNA" 2 "Driver_applying_brakes" 1 "Not_Applied" 0 "NotInit_orOff" ;
VAL_ 1297 RCM_a115_eventAccelPedalPos 255 "SNA" ;
VAL_ 1297 RCM_a116_eventArmStatus 1 "ARMED" 0 "UNARMED" ;
VAL_ 1297 RCM_a116_eventFactoryMode 1 "ENABLED" 0 "DISABLED" ;
VAL_ 1297 RCM_a116_eventDiagEnabled 1 "ENABLED" 0 "DISABLED" ;
VAL_ 1297 RCM_a116_eventDriveOrientation 1 "RIGHT_HAND_DRIVE" 0 "LEFT_HAND_DRIVE" ;
VAL_ 1297 RCM_a116_eventIDFsignal 1 "ACTIVE" 0 "NOT_ACTIVE" ;
VAL_ 1297 RCM_a116_eventFrontLeftSeatbelt 1 "LATCHED" 0 "UNLATCHED" ;
VAL_ 1297 RCM_a116_eventFrontRightSeatbelt 1 "LATCHED" 0 "UNLATCHED" ;
VAL_ 1297 RCM_a116_eventDriverBrakeApply 3 "Faulty_SNA" 2 "Driver_applying_brakes" 1 "Not_Applied" 0 "NotInit_orOff" ;
VAL_ 1297 RCM_a116_eventAccelPedalPos 255 "SNA" ;
VAL_ 1297 RCM_a117_eventArmStatus 1 "ARMED" 0 "UNARMED" ;
VAL_ 1297 RCM_a117_eventFactoryMode 1 "ENABLED" 0 "DISABLED" ;
VAL_ 1297 RCM_a117_eventDiagEnabled 1 "ENABLED" 0 "DISABLED" ;
VAL_ 1297 RCM_a117_eventDriveOrientation 1 "RIGHT_HAND_DRIVE" 0 "LEFT_HAND_DRIVE" ;
VAL_ 1297 RCM_a117_eventIDFsignal 1 "ACTIVE" 0 "NOT_ACTIVE" ;
VAL_ 1297 RCM_a117_eventFrontLeftSeatbelt 1 "LATCHED" 0 "UNLATCHED" ;
VAL_ 1297 RCM_a117_eventFrontRightSeatbelt 1 "LATCHED" 0 "UNLATCHED" ;
VAL_ 1297 RCM_a117_eventDriverBrakeApply 3 "Faulty_SNA" 2 "Driver_applying_brakes" 1 "Not_Applied" 0 "NotInit_orOff" ;
VAL_ 1297 RCM_a117_eventAccelPedalPos 255 "SNA" ;
VAL_ 1297 RCM_a118_eventArmStatus 1 "ARMED" 0 "UNARMED" ;
VAL_ 1297 RCM_a118_eventFactoryMode 1 "ENABLED" 0 "DISABLED" ;
VAL_ 1297 RCM_a118_eventDiagEnabled 1 "ENABLED" 0 "DISABLED" ;
VAL_ 1297 RCM_a118_eventDriveOrientation 1 "RIGHT_HAND_DRIVE" 0 "LEFT_HAND_DRIVE" ;
VAL_ 1297 RCM_a118_eventIDFsignal 1 "ACTIVE" 0 "NOT_ACTIVE" ;
VAL_ 1297 RCM_a118_eventFrontLeftSeatbelt 1 "LATCHED" 0 "UNLATCHED" ;
