VERSION "dbc-export 1 2025.20.8"

NS_ :

BS_:

BU_: ADSP APB APP APS APSB BB BMS CC CMP CMPD CP DAS DI DIF DIR DPB EPAS3P EPAS3S EPASTP EPASTS EPBL EPBR ESP EVSE FC GTW HCML HCMR HVP IBST ICR IDB LS OCS1P ODIN PARK PCS PLG PM PMF PMR PNCD PTC RADC RCM RCM2 RCM3 RCU SCCM SCM SCS SDCR TAS TCU TPMS TRCM UDS UI UIS UMC USM VC VCFRONT VCLEFT VCRIGHT VCSEC VEH

BO_ 1480 EPBL_alertLog: 8 EPBL
 SG_ EPBL_alertID M : 0|9@1+ (1,0) [0|511] "" Vector__XXX
 SG_ EPBL_alertState : 15|1@1+ (1,0) [0|1] "" Vector__XXX
 SG_ EPBL_a001_InternalWatchdog m1 : 16|1@1+ (1,0) [0|1] "" Vector__XXX
 SG_ EPBL_a002_CPUUndervoltage m2 : 16|1@1+ (1,0) [0|1] "" Vector__XXX
 SG_ EPBL_a002_PowerOnReset m2 : 17|1@1+ (1,0) [0|1] "" Vector__XXX
 SG_ EPBL_a015_NVMMMemOverflow m15 : 16|1@1+ (1,0) [0|1] "" Vector__XXX
 SG_ EPBL_a015_NVMMFilesystemError m15 : 17|1@1+ (1,0) [0|1] "" Vector__XXX
 SG_ EPBL_a015_NVMMRecordIDError m15 : 18|1@1+ (1,0) [0|1] "" Vector__XXX
 SG_ EPBL_a057_VEH_cpControl m57 : 16|1@1+ (1,0) [0|1] "" Vector__XXX
 SG_ EPBL_a059_voltageDrop m59 : 16|12@1+ (0.005443676,0) [0|22.29185322] "V" Vector__XXX
 SG_ EPBL_a059_resistanceEstimate m59 : 28|12@1+ (0.00244,0) [0|9.9918] "Ohms" Vector__XXX
 SG_ EPBL_a059_current m59 : 40|12@1+ (0.05,0) [0|204.75] "A" Vector__XXX
 SG_ EPBL_a063_switchChannel m63 : 16|8@1+ (1,0) [0|255] "" Vector__XXX
 SG_ EPBL_a063_switchType m63 : 24|8@1+ (1,0) [0|255] "" Vector__XXX
 SG_ EPBL_a063_ADCVoltage m63 : 32|8@1+ (0.025,0) [0|6.375] "V" Vector__XXX
 SG_ EPBL_a063_disconnected m63 : 40|1@1+ (1,0) [0|1] "" Vector__XXX
 SG_ EPBL_a063_indeterminate m63 : 41|1@1+ (1,0) [0|1] "" Vector__XXX
 SG_ EPBL_a063_stuckActive m63 : 42|1@1+ (1,0) [0|1] "" Vector__XXX
 SG_ EPBL_a063_faulted m63 : 43|1@1+ (1,0) [0|1] "" Vector__XXX
 SG_ EPBL_a081_VEH_defogInfoMessage m81 : 16|1@1+ (1,0) [0|1] "" Vector__XXX
 SG_ EPBL_a082_RIPC_epbPrivateState m82 : 16|1@1+ (1,0) [0|1] "" Vector__XXX
 SG_ EPBL_a082_RIPC_remoteHSD m82 : 17|1@1+ (1,0) [0|1] "" Vector__XXX
 SG_ EPBL_a082_RIPC_railStatus m82 : 18|1@1+ (1,0) [0|1] "" Vector__XXX
 SG_ EPBL_a082_RIPC_remoteMux m82 : 19|1@1+ (1,0) [0|1] "" Vector__XXX
 SG_ EPBL_a082_RIPC_remoteCurrent m82 : 20|1@1+ (1,0) [0|1] "" Vector__XXX
 SG_ EPBL_a083_LIPC_epbPrivateState m83 : 16|1@1+ (1,0) [0|1] "" Vector__XXX
 SG_ EPBL_a083_LIPC_remoteHSD m83 : 17|1@1+ (1,0) [0|1] "" Vector__XXX
 SG_ EPBL_a083_LIPC_railStatus m83 : 18|1@1+ (1,0) [0|1] "" Vector__XXX
 SG_ EPBL_a083_LIPC_HSDFaults m83 : 19|1@1+ (1,0) [0|1] "" Vector__XXX
 SG_ EPBL_a083_LIPC_remoteCurrent m83 : 20|1@1+ (1,0) [0|1] "" Vector__XXX
 SG_ EPBL_a084_CH_StatusC m84 : 16|1@1+ (1,0) [0|1] "" Vector__XXX
 SG_ EPBL_a085_PARTY_buttonStatus m85 : 16|1@1+ (1,0) [0|1] "" Vector__XXX
 SG_ EPBL_a086_VEH_LVBMS_statusHigh m86 : 16|1@1+ (1,0) [0|1] "" Vector__XXX
 SG_ EPBL_a086_VEH_LVBMS_statusLow m86 : 17|1@1+ (1,0) [0|1] "" Vector__XXX
 SG_ EPBL_a086_VEH_status m86 : 18|1@1+ (1,0) [0|1] "" Vector__XXX
 SG_ EPBL_a086_VEH_12VBatteryStatus m86 : 19|1@1+ (1,0) [0|1] "" Vector__XXX
 SG_ EPBL_a086_VEH_LVPowerState m86 : 20|1@1+ (1,0) [0|1] "" Vector__XXX
 SG_ EPBL_a086_VEH_lightStatus m86 : 21|1@1+ (1,0) [0|1] "" Vector__XXX
 SG_ EPBL_a086_VEH_systemStatus m86 : 22|1@1+ (1,0) [0|1] "" Vector__XXX
 SG_ EPBL_a086_VEH_thermalStatus m86 : 23|1@1+ (1,0) [0|1] "" Vector__XXX
 SG_ EPBL_a086_VEH_vehNm m86 : 24|1@1+ (1,0) [0|1] "" Vector__XXX
 SG_ EPBL_a087_VEH_temperature m87 : 16|1@1+ (1,0) [0|1] "" Vector__XXX
 SG_ EPBL_a087_VEH_thermalControl m87 : 17|1@1+ (1,0) [0|1] "" Vector__XXX
 SG_ EPBL_a087_VEH_torque m87 : 18|1@1+ (1,0) [0|1] "" Vector__XXX
 SG_ EPBL_a087_VEH_status m87 : 19|1@1+ (1,0) [0|1] "" Vector__XXX
 SG_ EPBL_a087_PARTY_torque m87 : 20|1@1+ (1,0) [0|1] "" Vector__XXX
 SG_ EPBL_a087_PARTY_status m87 : 21|1@1+ (1,0) [0|1] "" Vector__XXX
 SG_ EPBL_a087_PARTY_temperature m87 : 22|1@1+ (1,0) [0|1] "" Vector__XXX
 SG_ EPBL_a087_PARTY_thermalControl m87 : 23|1@1+ (1,0) [0|1] "" Vector__XXX
 SG_ EPBL_a088_VEH_temperature m88 : 16|1@1+ (1,0) [0|1] "" Vector__XXX
 SG_ EPBL_a088_VEH_thermalControl m88 : 17|1@1+ (1,0) [0|1] "" Vector__XXX
 SG_ EPBL_a088_VEH_torque m88 : 18|1@1+ (1,0) [0|1] "" Vector__XXX
 SG_ EPBL_a088_VEH_status m88 : 19|1@1+ (1,0) [0|1] "" Vector__XXX
 SG_ EPBL_a088_PARTY_torque m88 : 20|1@1+ (1,0) [0|1] "" Vector__XXX
 SG_ EPBL_a088_PARTY_status m88 : 21|1@1+ (1,0) [0|1] "" Vector__XXX
 SG_ EPBL_a088_PARTY_temperature m88 : 22|1@1+ (1,0) [0|1] "" Vector__XXX
 SG_ EPBL_a088_PARTY_thermalControl m88 : 23|1@1+ (1,0) [0|1] "" Vector__XXX
 SG_ EPBL_a089_PARTY_party1 m89 : 16|1@1+ (1,0) [0|1] "" Vector__XXX
 SG_ EPBL_a089_PARTY_status m89 : 17|1@1+ (1,0) [0|1] "" Vector__XXX
 SG_ EPBL_a089_VEH_status m89 : 18|1@1+ (1,0) [0|1] "" Vector__XXX
 SG_ EPBL_a089_BDY_party1 m89 : 19|1@1+ (1,0) [0|1] "" Vector__XXX
 SG_ EPBL_a089_BDY_status m89 : 20|1@1+ (1,0) [0|1] "" Vector__XXX
 SG_ EPBL_a089_CH_status m89 : 21|1@1+ (1,0) [0|1] "" Vector__XXX
 SG_ EPBL_a089_CH_party1 m89 : 22|1@1+ (1,0) [0|1] "" Vector__XXX
 SG_ EPBL_a089_CH_party3 m89 : 23|1@1+ (1,0) [0|1] "" Vector__XXX
 SG_ EPBL_a089_VEH_party1 m89 : 24|1@1+ (1,0) [0|1] "" Vector__XXX
 SG_ EPBL_a089_VEH_party3 m89 : 25|1@1+ (1,0) [0|1] "" Vector__XXX
 SG_ EPBL_a091_VEH_faultsAndExtras m91 : 16|1@1+ (1,0) [0|1] "" Vector__XXX
 SG_ EPBL_a091_VEH_info m91 : 17|1@1+ (1,0) [0|1] "" Vector__XXX
 SG_ EPBL_a091_VEH_state m91 : 18|1@1+ (1,0) [0|1] "" Vector__XXX
 SG_ EPBL_a092_VEH_restraintStatus m92 : 16|1@1+ (1,0) [0|1] "" Vector__XXX
 SG_ EPBL_a092_VEH_switchStatus m92 : 17|1@1+ (1,0) [0|1] "" Vector__XXX
 SG_ EPBL_a092_VEH_seatStatus2 m92 : 18|1@1+ (1,0) [0|1] "" Vector__XXX
 SG_ EPBL_a092_VEH_vehNm m92 : 19|1@1+ (1,0) [0|1] "" Vector__XXX
 SG_ EPBL_a093_VEH_restraintStatus m93 : 16|1@1+ (1,0) [0|1] "" Vector__XXX
 SG_ EPBL_a093_VEH_switchStatus m93 : 17|1@1+ (1,0) [0|1] "" Vector__XXX
 SG_ EPBL_a093_VEH_seatStatus2 m93 : 18|1@1+ (1,0) [0|1] "" Vector__XXX
 SG_ EPBL_a093_VEH_vehNm m93 : 19|1@1+ (1,0) [0|1] "" Vector__XXX
 SG_ EPBL_a094_VEH_sysStatus m94 : 16|1@1+ (1,0) [0|1] "" Vector__XXX
 SG_ EPBL_a094_PARTY_sysStatus m94 : 17|1@1+ (1,0) [0|1] "" Vector__XXX
 SG_ EPBL_a095_PT_ptNm m95 : 16|1@1+ (1,0) [0|1] "" Vector__XXX
 SG_ EPBL_a095_PT_status m95 : 17|1@1+ (1,0) [0|1] "" Vector__XXX
 SG_ EPBL_a096_VEH_status m96 : 16|1@1+ (1,0) [0|1] "" Vector__XXX
 SG_ EPBL_a096_CH_status m96 : 17|1@1+ (1,0) [0|1] "" Vector__XXX
 SG_ EPBL_a098_CH_torque m98 : 16|1@1+ (1,0) [0|1] "" Vector__XXX
 SG_ EPBL_a098_VEH_hvStatus m98 : 17|1@1+ (1,0) [0|1] "" Vector__XXX
 SG_ EPBL_a098_VEH_status m98 : 18|1@1+ (1,0) [0|1] "" Vector__XXX
 SG_ EPBL_a098_VEH_thermalControl m98 : 19|1@1+ (1,0) [0|1] "" Vector__XXX
 SG_ EPBL_a098_VEH_temperature m98 : 20|1@1+ (1,0) [0|1] "" Vector__XXX
 SG_ EPBL_a098_VEH_torque m98 : 21|1@1+ (1,0) [0|1] "" Vector__XXX
 SG_ EPBL_a098_PARTY_status m98 : 22|1@1+ (1,0) [0|1] "" Vector__XXX
 SG_ EPBL_a098_PARTY_temperature m98 : 23|1@1+ (1,0) [0|1] "" Vector__XXX
 SG_ EPBL_a098_PARTY_thermalControl m98 : 24|1@1+ (1,0) [0|1] "" Vector__XXX
 SG_ EPBL_a098_PARTY_torque m98 : 25|1@1+ (1,0) [0|1] "" Vector__XXX
 SG_ EPBL_a098_PT_thermalControl m98 : 26|1@1+ (1,0) [0|1] "" Vector__XXX
 SG_ EPBL_a098_PT_temperature m98 : 27|1@1+ (1,0) [0|1] "" Vector__XXX
 SG_ EPBL_a099_VEH_oocStatus m99 : 16|1@1+ (1,0) [0|1] "" Vector__XXX
 SG_ EPBL_a100_VEH m100 : 16|1@1+ (1,0) [0|1] "" Vector__XXX
 SG_ EPBL_a100_PARTY m100 : 17|1@1+ (1,0) [0|1] "" Vector__XXX
 SG_ EPBL_a100_PT m100 : 18|1@1+ (1,0) [0|1] "" Vector__XXX
 SG_ EPBL_a100_CH m100 : 19|1@1+ (1,0) [0|1] "" Vector__XXX
 SG_ EPBL_a100_OBD m100 : 20|1@1+ (1,0) [0|1] "" Vector__XXX
 SG_ EPBL_a101_VEH_state m101 : 16|1@1+ (1,0) [0|1] "" Vector__XXX
 SG_ EPBL_a101_PARTY_locState m101 : 17|1@1+ (1,0) [0|1] "" Vector__XXX
 SG_ EPBL_a101_LIPC_externalWatchdogH m101 : 18|1@1+ (1,0) [0|1] "" Vector__XXX
 SG_ EPBL_a101_VEH_locState m101 : 19|1@1+ (1,0) [0|1] "" Vector__XXX
 SG_ EPBL_a101_BDY_locState m101 : 20|1@1+ (1,0) [0|1] "" Vector__XXX
 SG_ EPBL_a102_VEH_faultsAndExtras m102 : 16|1@1+ (1,0) [0|1] "" Vector__XXX
 SG_ EPBL_a102_VEH_feedbackStatus m102 : 17|1@1+ (1,0) [0|1] "" Vector__XXX
 SG_ EPBL_a102_VEH_sensorStatus m102 : 18|1@1+ (1,0) [0|1] "" Vector__XXX
 SG_ EPBL_a102_VEH_rods m102 : 19|1@1+ (1,0) [0|1] "" Vector__XXX
 SG_ EPBL_a103_VEH_hvsNm m103 : 16|1@1+ (1,0) [0|1] "" Vector__XXX
 SG_ EPBL_a103_VEH_vehNm m103 : 17|1@1+ (1,0) [0|1] "" Vector__XXX
 SG_ EPBL_a103_VEH_status m103 : 18|1@1+ (1,0) [0|1] "" Vector__XXX
 SG_ EPBL_a103_PT_ptNm m103 : 19|1@1+ (1,0) [0|1] "" Vector__XXX
 SG_ EPBL_a103_PT_status m103 : 20|1@1+ (1,0) [0|1] "" Vector__XXX
 SG_ EPBL_a103_VEH_evseStatus m103 : 21|1@1+ (1,0) [0|1] "" Vector__XXX
 SG_ EPBL_a105_VEH_states m105 : 16|1@1+ (1,0) [0|1] "" Vector__XXX
 SG_ EPBL_a105_VEH_chNm m105 : 17|1@1+ (1,0) [0|1] "" Vector__XXX
 SG_ EPBL_a105_VEH_dampingStates m105 : 18|1@1+ (1,0) [0|1] "" Vector__XXX
 SG_ EPBL_a106_VEH_dcdcStatus m106 : 16|1@1+ (1,0) [0|1] "" Vector__XXX
 SG_ EPBL_a106_VEH_thermalControl m106 : 17|1@1+ (1,0) [0|1] "" Vector__XXX
 SG_ EPBL_a106_VEH_thermalInterface m106 : 18|1@1+ (1,0) [0|1] "" Vector__XXX
 SG_ EPBL_a106_VEH_dcdcRailStatus m106 : 19|1@1+ (1,0) [0|1] "" Vector__XXX
 SG_ EPBL_a106_CH_dcdcRailStatus m106 : 20|1@1+ (1,0) [0|1] "" Vector__XXX
 SG_ EPBL_a106_CH_alertMatrix m106 : 21|1@1+ (1,0) [0|1] "" Vector__XXX
 SG_ EPBL_a107_VEH_hvsNm m107 : 16|1@1+ (1,0) [0|1] "" Vector__XXX
 SG_ EPBL_a107_VEH_vehNm m107 : 17|1@1+ (1,0) [0|1] "" Vector__XXX
 SG_ EPBL_a107_VEH_status m107 : 18|1@1+ (1,0) [0|1] "" Vector__XXX
 SG_ EPBL_a107_VEH_thermalStatus m107 : 19|1@1+ (1,0) [0|1] "" Vector__XXX
 SG_ EPBL_a107_VEH_thermalStatus2 m107 : 20|1@1+ (1,0) [0|1] "" Vector__XXX
 SG_ EPBL_a107_VEH_bmbMinMax m107 : 21|1@1+ (1,0) [0|1] "" Vector__XXX
 SG_ EPBL_a107_VEH_powerAvailable m107 : 22|1@1+ (1,0) [0|1] "" Vector__XXX
 SG_ EPBL_a107_PT_ptNm m107 : 23|1@1+ (1,0) [0|1] "" Vector__XXX
 SG_ EPBL_a107_PT_status m107 : 24|1@1+ (1,0) [0|1] "" Vector__XXX
 SG_ EPBL_a107_PT_thermalStatus m107 : 25|1@1+ (1,0) [0|1] "" Vector__XXX
 SG_ EPBL_a107_PT_socStatus m107 : 26|1@1+ (1,0) [0|1] "" Vector__XXX
 SG_ EPBL_a107_VEH_socStatus m107 : 27|1@1+ (1,0) [0|1] "" Vector__XXX
 SG_ EPBL_a107_VEH_packConfig m107 : 28|1@1+ (1,0) [0|1] "" Vector__XXX
 SG_ EPBL_a107_VEH_energyStatus m107 : 29|1@1+ (1,0) [0|1] "" Vector__XXX
 SG_ EPBL_a107_VEH_chargeInfo m107 : 30|1@1+ (1,0) [0|1] "" Vector__XXX
 SG_ EPBL_a108_VEH_hvStatus m108 : 16|1@1+ (1,0) [0|1] "" Vector__XXX
 SG_ EPBL_a108_VEH_temperature m108 : 17|1@1+ (1,0) [0|1] "" Vector__XXX
 SG_ EPBL_a108_VEH_thermalControl m108 : 18|1@1+ (1,0) [0|1] "" Vector__XXX
 SG_ EPBL_a108_VEH_torque m108 : 19|1@1+ (1,0) [0|1] "" Vector__XXX
 SG_ EPBL_a108_VEH_status m108 : 20|1@1+ (1,0) [0|1] "" Vector__XXX
 SG_ EPBL_a108_PARTY_torque m108 : 21|1@1+ (1,0) [0|1] "" Vector__XXX
 SG_ EPBL_a108_PARTY_status m108 : 22|1@1+ (1,0) [0|1] "" Vector__XXX
 SG_ EPBL_a108_PARTY_temperature m108 : 23|1@1+ (1,0) [0|1] "" Vector__XXX
 SG_ EPBL_a108_PARTY_thermalControl m108 : 24|1@1+ (1,0) [0|1] "" Vector__XXX
 SG_ EPBL_a108_PT_temperature m108 : 25|1@1+ (1,0) [0|1] "" Vector__XXX
 SG_ EPBL_a108_PT_thermalControl m108 : 26|1@1+ (1,0) [0|1] "" Vector__XXX
 SG_ EPBL_a109_PARTY_status m109 : 16|1@1+ (1,0) [0|1] "" Vector__XXX
 SG_ EPBL_a109_PARTY_inertial2 m109 : 17|1@1+ (1,0) [0|1] "" Vector__XXX
 SG_ EPBL_a109_PARTY_nearDeploy m109 : 18|1@1+ (1,0) [0|1] "" Vector__XXX
 SG_ EPBL_a109_PARTY_collision m109 : 19|1@1+ (1,0) [0|1] "" Vector__XXX
 SG_ EPBL_a109_VEH_status m109 : 20|1@1+ (1,0) [0|1] "" Vector__XXX
 SG_ EPBL_a109_VEH_imuOffsets m109 : 21|1@1+ (1,0) [0|1] "" Vector__XXX
 SG_ EPBL_a109_PARTY_inertial1 m109 : 22|1@1+ (1,0) [0|1] "" Vector__XXX
 SG_ EPBL_a109_BDY_imuOffsets m109 : 23|1@1+ (1,0) [0|1] "" Vector__XXX
 SG_ EPBL_a109_BDY_inertial1 m109 : 24|1@1+ (1,0) [0|1] "" Vector__XXX
 SG_ EPBL_a109_BDY_inertial2 m109 : 25|1@1+ (1,0) [0|1] "" Vector__XXX
 SG_ EPBL_a109_BDY_status m109 : 26|1@1+ (1,0) [0|1] "" Vector__XXX
 SG_ EPBL_a109_VEH_inertial1 m109 : 27|1@1+ (1,0) [0|1] "" Vector__XXX
 SG_ EPBL_a109_VEH_inertial2 m109 : 28|1@1+ (1,0) [0|1] "" Vector__XXX
 SG_ EPBL_a109_CH_inertial1 m109 : 29|1@1+ (1,0) [0|1] "" Vector__XXX
 SG_ EPBL_a109_CH_inertial2 m109 : 30|1@1+ (1,0) [0|1] "" Vector__XXX
 SG_ EPBL_a109_CH_status m109 : 31|1@1+ (1,0) [0|1] "" Vector__XXX
 SG_ EPBL_a110_VEH_carState m110 : 16|1@1+ (1,0) [0|1] "" Vector__XXX
 SG_ EPBL_a110_VEH_carConfig m110 : 17|1@1+ (1,0) [0|1] "" Vector__XXX
 SG_ EPBL_a110_VEH_time m110 : 18|1@1+ (1,0) [0|1] "" Vector__XXX
 SG_ EPBL_a110_VEH_updateStatus m110 : 19|1@1+ (1,0) [0|1] "" Vector__XXX
 SG_ EPBL_a110_VEH_vehNm m110 : 20|1@1+ (1,0) [0|1] "" Vector__XXX
 SG_ EPBL_a110_VEH_mismatchFault m110 : 21|1@1+ (1,0) [0|1] "" Vector__XXX
 SG_ EPBL_a110_VEH_vin m110 : 22|1@1+ (1,0) [0|1] "" Vector__XXX
 SG_ EPBL_a110_VEH_bmpDebug m110 : 23|1@1+ (1,0) [0|1] "" Vector__XXX
 SG_ EPBL_a110_VEH_gearControl m110 : 24|1@1+ (1,0) [0|1] "" Vector__XXX
 SG_ EPBL_a110_VEH_canLogAvailability m110 : 25|1@1+ (1,0) [0|1] "" Vector__XXX
 SG_ EPBL_a110_CH_airbagCutoffStatus m110 : 26|1@1+ (1,0) [0|1] "" Vector__XXX
 SG_ EPBL_a110_CH_carConfig m110 : 27|1@1+ (1,0) [0|1] "" Vector__XXX
 SG_ EPBL_a110_CH_carState m110 : 28|1@1+ (1,0) [0|1] "" Vector__XXX
 SG_ EPBL_a110_CH_vin m110 : 29|1@1+ (1,0) [0|1] "" Vector__XXX
 SG_ EPBL_a110_CH_chNm m110 : 30|1@1+ (1,0) [0|1] "" Vector__XXX
 SG_ EPBL_a110_CH_epochTimeGtw m110 : 31|1@1+ (1,0) [0|1] "" Vector__XXX
 SG_ EPBL_a111_VEH_internalStatus m111 : 16|1@1+ (1,0) [0|1] "" Vector__XXX
 SG_ EPBL_a111_VEH_status m111 : 17|1@1+ (1,0) [0|1] "" Vector__XXX
 SG_ EPBL_a111_VEH_vehNm m111 : 18|1@1+ (1,0) [0|1] "" Vector__XXX
 SG_ EPBL_a111_RIPC_LVPowerState m111 : 19|1@1+ (1,0) [0|1] "" Vector__XXX
 SG_ EPBL_a111_RIPC_epbPrivateState m111 : 20|1@1+ (1,0) [0|1] "" Vector__XXX
 SG_ EPBL_a111_RIPC_railStatus m111 : 21|1@1+ (1,0) [0|1] "" Vector__XXX
 SG_ EPBL_a111_RIPC_remoteADC m111 : 22|1@1+ (1,0) [0|1] "" Vector__XXX
 SG_ EPBL_a111_RIPC_switchStatus m111 : 23|1@1+ (1,0) [0|1] "" Vector__XXX
 SG_ EPBL_a111_VEH_LVPowerState m111 : 24|1@1+ (1,0) [0|1] "" Vector__XXX
 SG_ EPBL_a111_VEH_seatStatus m111 : 25|1@1+ (1,0) [0|1] "" Vector__XXX
 SG_ EPBL_a111_PARTY_status m111 : 26|1@1+ (1,0) [0|1] "" Vector__XXX
 SG_ EPBL_a111_CH_status m111 : 27|1@1+ (1,0) [0|1] "" Vector__XXX
 SG_ EPBL_a111_VEH_seatStatus3 m111 : 28|1@1+ (1,0) [0|1] "" Vector__XXX
 SG_ EPBL_a112_VEH_internalStatus m112 : 16|1@1+ (1,0) [0|1] "" Vector__XXX
 SG_ EPBL_a112_VEH_status m112 : 17|1@1+ (1,0) [0|1] "" Vector__XXX
 SG_ EPBL_a112_VEH_vehNm m112 : 18|1@1+ (1,0) [0|1] "" Vector__XXX
 SG_ EPBL_a112_LIPC_LVPowerState m112 : 19|1@1+ (1,0) [0|1] "" Vector__XXX
 SG_ EPBL_a112_LIPC_epbPrivateState m112 : 20|1@1+ (1,0) [0|1] "" Vector__XXX
 SG_ EPBL_a112_LIPC_railStatus m112 : 21|1@1+ (1,0) [0|1] "" Vector__XXX
 SG_ EPBL_a112_LIPC_remoteADC m112 : 22|1@1+ (1,0) [0|1] "" Vector__XXX
 SG_ EPBL_a112_LIPC_switchStatus m112 : 23|1@1+ (1,0) [0|1] "" Vector__XXX
 SG_ EPBL_a112_VEH_LVPowerState m112 : 24|1@1+ (1,0) [0|1] "" Vector__XXX
 SG_ EPBL_a112_PARTY_status m112 : 25|1@1+ (1,0) [0|1] "" Vector__XXX
 SG_ EPBL_a112_CH_status m112 : 26|1@1+ (1,0) [0|1] "" Vector__XXX
 SG_ EPBL_a114_PARTY_status m114 : 16|1@1+ (1,0) [0|1] "" Vector__XXX
 SG_ EPBL_a114_PARTY_wheelSpeeds m114 : 17|1@1+ (1,0) [0|1] "" Vector__XXX
 SG_ EPBL_a114_VEH_wheelSpeeds m114 : 18|1@1+ (1,0) [0|1] "" Vector__XXX
 SG_ EPBL_a114_CH_wheelSpeeds m114 : 19|1@1+ (1,0) [0|1] "" Vector__XXX
 SG_ EPBL_a114_PARTY_party3 m114 : 20|1@1+ (1,0) [0|1] "" Vector__XXX
 SG_ EPBL_a114_VEH_party3 m114 : 21|1@1+ (1,0) [0|1] "" Vector__XXX
 SG_ EPBL_a114_VEH_status m114 : 22|1@1+ (1,0) [0|1] "" Vector__XXX
 SG_ EPBL_a114_PARTY_wheelRotation m114 : 23|1@1+ (1,0) [0|1] "" Vector__XXX
 SG_ EPBL_a114_CH_wheelRotation m114 : 24|1@1+ (1,0) [0|1] "" Vector__XXX
 SG_ EPBL_a114_VEH_wheelRotation m114 : 25|1@1+ (1,0) [0|1] "" Vector__XXX
 SG_ EPBL_a114_PARTY_brakeTorque m114 : 26|1@1+ (1,0) [0|1] "" Vector__XXX
 SG_ EPBL_a114_PARTY_offsets m114 : 27|1@1+ (1,0) [0|1] "" Vector__XXX
 SG_ EPBL_a114_BDY_offsets m114 : 28|1@1+ (1,0) [0|1] "" Vector__XXX
 SG_ EPBL_a114_BDY_party3 m114 : 29|1@1+ (1,0) [0|1] "" Vector__XXX
 SG_ EPBL_a114_BDY_status m114 : 30|1@1+ (1,0) [0|1] "" Vector__XXX
 SG_ EPBL_a114_BDY_wheelRotation m114 : 31|1@1+ (1,0) [0|1] "" Vector__XXX
 SG_ EPBL_a114_BDY_wheelSpeeds m114 : 32|1@1+ (1,0) [0|1] "" Vector__XXX
 SG_ EPBL_a114_CH_party1 m114 : 33|1@1+ (1,0) [0|1] "" Vector__XXX
 SG_ EPBL_a114_CH_party3 m114 : 34|1@1+ (1,0) [0|1] "" Vector__XXX
 SG_ EPBL_a114_CH_status m114 : 35|1@1+ (1,0) [0|1] "" Vector__XXX
 SG_ EPBL_a115_VEH_vehNm m115 : 16|1@1+ (1,0) [0|1] "" Vector__XXX
 SG_ EPBL_a115_VEH_authentication m115 : 17|1@1+ (1,0) [0|1] "" Vector__XXX
 SG_ EPBL_a115_VEH_BLEResetRequest m115 : 18|1@1+ (1,0) [0|1] "" Vector__XXX
 SG_ EPBL_a115_VEH_requests m115 : 19|1@1+ (1,0) [0|1] "" Vector__XXX
 SG_ EPBL_a115_VEH_requests2 m115 : 20|1@1+ (1,0) [0|1] "" Vector__XXX
 SG_ EPBL_a115_REM_authentication m115 : 21|1@1+ (1,0) [0|1] "" Vector__XXX
 SG_ EPBL_a115_UI_corianderVehicleCon m115 : 22|1@1+ (1,0) [0|1] "" Vector__XXX
 SG_ EPBL_a115_CH_TPMSDisplay m115 : 23|1@1+ (1,0) [0|1] "" Vector__XXX
 SG_ EPBL_a116_PARTY_epbmStatus m116 : 16|1@1+ (1,0) [0|1] "" Vector__XXX
 SG_ EPBL_a116_VEH_vehNm m116 : 17|1@1+ (1,0) [0|1] "" Vector__XXX
 SG_ EPBL_a116_VEH_hvacRequest m116 : 18|1@1+ (1,0) [0|1] "" Vector__XXX
 SG_ EPBL_a116_VEH_hvacStatus m116 : 19|1@1+ (1,0) [0|1] "" Vector__XXX
 SG_ EPBL_a116_VEH_LVPowerState m116 : 20|1@1+ (1,0) [0|1] "" Vector__XXX
 SG_ EPBL_a116_VEH_lightStatus m116 : 21|1@1+ (1,0) [0|1] "" Vector__XXX
 SG_ EPBL_a116_VEH_seatStatus m116 : 22|1@1+ (1,0) [0|1] "" Vector__XXX
 SG_ EPBL_a116_VEH_thsStatus m116 : 23|1@1+ (1,0) [0|1] "" Vector__XXX
 SG_ EPBL_a116_VEH_doorStatus m116 : 24|1@1+ (1,0) [0|1] "" Vector__XXX
 SG_ EPBL_a116_VEH_seatHeatStatus m116 : 25|1@1+ (1,0) [0|1] "" Vector__XXX
 SG_ EPBL_a116_VEH_restraintStatus m116 : 26|1@1+ (1,0) [0|1] "" Vector__XXX
 SG_ EPBL_a116_VEH_switchStatus m116 : 27|1@1+ (1,0) [0|1] "" Vector__XXX
 SG_ EPBL_a116_VEH_logging1Hz m116 : 28|1@1+ (1,0) [0|1] "" Vector__XXX
 SG_ EPBL_a116_VEH_seatStatus2 m116 : 29|1@1+ (1,0) [0|1] "" Vector__XXX
 SG_ EPBL_a116_VEH_status m116 : 30|1@1+ (1,0) [0|1] "" Vector__XXX
 SG_ EPBL_a116_VEH_thermalCommand m116 : 31|1@1+ (1,0) [0|1] "" Vector__XXX
 SG_ EPBL_a116_VEH_windowStatus m116 : 32|1@1+ (1,0) [0|1] "" Vector__XXX
 SG_ EPBL_a116_PARTY_restraintStatus m116 : 33|1@1+ (1,0) [0|1] "" Vector__XXX
 SG_ EPBL_a116_PARTY_doorStatus m116 : 34|1@1+ (1,0) [0|1] "" Vector__XXX
 SG_ EPBL_a116_BDY_epbmStatus m116 : 35|1@1+ (1,0) [0|1] "" Vector__XXX
 SG_ EPBL_a116_BDY_restraintStatus m116 : 36|1@1+ (1,0) [0|1] "" Vector__XXX
 SG_ EPBL_a116_VEH_hvacStatus2 m116 : 63|1@1+ (1,0) [0|1] "" Vector__XXX
 SG_ EPBL_a117_BDY_epbmStatus m117 : 16|1@1+ (1,0) [0|1] "" Vector__XXX
 SG_ EPBL_a117_BDY_restraintStatus m117 : 17|1@1+ (1,0) [0|1] "" Vector__XXX
 SG_ EPBL_a117_VEH_prndStatus m117 : 18|1@1+ (1,0) [0|1] "" Vector__XXX
 SG_ EPBL_a117_PARTY_epbmStatus m117 : 19|1@1+ (1,0) [0|1] "" Vector__XXX
 SG_ EPBL_a117_VEH_vehNm m117 : 20|1@1+ (1,0) [0|1] "" Vector__XXX
 SG_ EPBL_a117_VEH_hvacBlowerFdb m117 : 21|1@1+ (1,0) [0|1] "" Vector__XXX
 SG_ EPBL_a117_VEH_LVPowerState m117 : 22|1@1+ (1,0) [0|1] "" Vector__XXX
 SG_ EPBL_a117_VEH_restraintStatus m117 : 23|1@1+ (1,0) [0|1] "" Vector__XXX
 SG_ EPBL_a117_VEH_lightStatus m117 : 24|1@1+ (1,0) [0|1] "" Vector__XXX
 SG_ EPBL_a117_VEH_seatStatus m117 : 25|1@1+ (1,0) [0|1] "" Vector__XXX
 SG_ EPBL_a117_BDY_falconSwitchStatus m117 : 26|1@1+ (1,0) [0|1] "" Vector__XXX
 SG_ EPBL_a117_VEH_doorStatus m117 : 27|1@1+ (1,0) [0|1] "" Vector__XXX
 SG_ EPBL_a117_VEH_doorStatus2 m117 : 28|1@1+ (1,0) [0|1] "" Vector__XXX
 SG_ EPBL_a117_VEH_windowStatus m117 : 29|1@1+ (1,0) [0|1] "" Vector__XXX
 SG_ EPBL_a117_VEH_switchStatus m117 : 30|1@1+ (1,0) [0|1] "" Vector__XXX
 SG_ EPBL_a117_VEH_intrusionSensorSta m117 : 31|1@1+ (1,0) [0|1] "" Vector__XXX
 SG_ EPBL_a117_VEH_liftgateStatus m117 : 32|1@1+ (1,0) [0|1] "" Vector__XXX
 SG_ EPBL_a117_VEH_seatStatus2 m117 : 33|1@1+ (1,0) [0|1] "" Vector__XXX
 SG_ EPBL_a117_PARTY_restraintStatus m117 : 34|1@1+ (1,0) [0|1] "" Vector__XXX
 SG_ EPBL_a117_VEH_thermalStatus m117 : 35|1@1+ (1,0) [0|1] "" Vector__XXX
 SG_ EPBL_a117_PARTY_doorStatus m117 : 36|1@1+ (1,0) [0|1] "" Vector__XXX
 SG_ EPBL_a117_VEH_status m117 : 37|1@1+ (1,0) [0|1] "" Vector__XXX
 SG_ EPBL_a117_PARTY_prndStatus m117 : 38|1@1+ (1,0) [0|1] "" Vector__XXX
 SG_ EPBL_a118_VEH_vehNm m118 : 16|1@1+ (1,0) [0|1] "" Vector__XXX
 SG_ EPBL_a118_VEH_lighting m118 : 17|1@1+ (1,0) [0|1] "" Vector__XXX
 SG_ EPBL_a118_VEH_sensors m118 : 18|1@1+ (1,0) [0|1] "" Vector__XXX
 SG_ EPBL_a118_VEH_status m118 : 19|1@1+ (1,0) [0|1] "" Vector__XXX
 SG_ EPBL_a118_VEH_okToUseHighPwr m118 : 20|1@1+ (1,0) [0|1] "" Vector__XXX
 SG_ EPBL_a118_VEH_LVPowerState m118 : 21|1@1+ (1,0) [0|1] "" Vector__XXX
 SG_ EPBL_a118_VEH_coolant m118 : 22|1@1+ (1,0) [0|1] "" Vector__XXX
 SG_ EPBL_a118_VEH_vehicleStatus m118 : 23|1@1+ (1,0) [0|1] "" Vector__XXX
 SG_ EPBL_a118_VEH_12VBatteryStatus m118 : 24|1@1+ (1,0) [0|1] "" Vector__XXX
 SG_ EPBL_a118_VEH_systemStatus m118 : 25|1@1+ (1,0) [0|1] "" Vector__XXX
 SG_ EPBL_a118_PARTY_LVPowerState m118 : 26|1@1+ (1,0) [0|1] "" Vector__XXX
 SG_ EPBL_a118_PARTY_outputPowerStatu m118 : 27|1@1+ (1,0) [0|1] "" Vector__XXX
 SG_ EPBL_a118_PARTY_vehicleTime m118 : 28|1@1+ (1,0) [0|1] "" Vector__XXX
 SG_ EPBL_a118_VEH_thermalCommand m118 : 29|1@1+ (1,0) [0|1] "" Vector__XXX
 SG_ EPBL_a118_CH_LVPowerState m118 : 30|1@1+ (1,0) [0|1] "" Vector__XXX
 SG_ EPBL_a118_PARTY_sensors m118 : 31|1@1+ (1,0) [0|1] "" Vector__XXX
 SG_ EPBL_a118_CH_sensors m118 : 32|1@1+ (1,0) [0|1] "" Vector__XXX
 SG_ EPBL_a118_VEH_interNodeResistanc m118 : 33|1@1+ (1,0) [0|1] "" Vector__XXX
 SG_ EPBL_a118_CH_lighting m118 : 34|1@1+ (1,0) [0|1] "" Vector__XXX
 SG_ EPBL_a118_VEH_lightStatus m118 : 35|1@1+ (1,0) [0|1] "" Vector__XXX
 SG_ EPBL_a118_PARTY_vehNm m118 : 36|1@1+ (1,0) [0|1] "" Vector__XXX
 SG_ EPBL_a118_CH_12VBatteryStatus m118 : 37|1@1+ (1,0) [0|1] "" Vector__XXX
 SG_ EPBL_a118_CH_LVBMS_statusHigh m118 : 38|1@1+ (1,0) [0|1] "" Vector__XXX
 SG_ EPBL_a118_CH_alertMatrix m118 : 39|1@1+ (1,0) [0|1] "" Vector__XXX
 SG_ EPBL_a118_BDY_outputPowerStatus m118 : 40|1@1+ (1,0) [0|1] "" Vector__XXX
 SG_ EPBL_a118_BDY_vehicleTime m118 : 41|1@1+ (1,0) [0|1] "" Vector__XXX
 SG_ EPBL_a118_PARTY_AP_vehicleState1 m118 : 42|1@1+ (1,0) [0|1] "" Vector__XXX
 SG_ EPBL_a118_BDY_AP_vehicleState1Hz m118 : 43|1@1+ (1,0) [0|1] "" Vector__XXX
 SG_ EPBL_a119_VEH_steerAngle m119 : 16|1@1+ (1,0) [0|1] "" Vector__XXX
 SG_ EPBL_a119_VEH_leftStalk m119 : 17|1@1+ (1,0) [0|1] "" Vector__XXX
 SG_ EPBL_a119_VEH_rightStalk m119 : 18|1@1+ (1,0) [0|1] "" Vector__XXX
 SG_ EPBL_a119_PARTY_rightStalk m119 : 19|1@1+ (1,0) [0|1] "" Vector__XXX
 SG_ EPBL_a119_CH_steerAngle m119 : 20|1@1+ (1,0) [0|1] "" Vector__XXX
 SG_ EPBL_a119_PARTY_steerAngle m119 : 21|1@1+ (1,0) [0|1] "" Vector__XXX
 SG_ EPBL_a120_PARTY_chassisCntl m120 : 16|1@1+ (1,0) [0|1] "" Vector__XXX
 SG_ EPBL_a120_VEH_systemStatus m120 : 17|1@1+ (1,0) [0|1] "" Vector__XXX
 SG_ EPBL_a120_CH_chassisCntl m120 : 18|1@1+ (1,0) [0|1] "" Vector__XXX
 SG_ EPBL_a120_PARTY_systemStatus m120 : 19|1@1+ (1,0) [0|1] "" Vector__XXX
 SG_ EPBL_a120_PARTY_torque m120 : 20|1@1+ (1,0) [0|1] "" Vector__XXX
 SG_ EPBL_a120_VEH_torque m120 : 21|1@1+ (1,0) [0|1] "" Vector__XXX
 SG_ EPBL_a120_PARTY_locStatus m120 : 22|1@1+ (1,0) [0|1] "" Vector__XXX
 SG_ EPBL_a120_PARTY_speed m120 : 23|1@1+ (1,0) [0|1] "" Vector__XXX
 SG_ EPBL_a120_VEH_speed m120 : 24|1@1+ (1,0) [0|1] "" Vector__XXX
 SG_ EPBL_a120_PARTY_status m120 : 25|1@1+ (1,0) [0|1] "" Vector__XXX
 SG_ EPBL_a120_PT_speed m120 : 26|1@1+ (1,0) [0|1] "" Vector__XXX
 SG_ EPBL_a120_PT_systemStatus m120 : 27|1@1+ (1,0) [0|1] "" Vector__XXX
 SG_ EPBL_a120_PARTY_vehicleEstimates m120 : 28|1@1+ (1,0) [0|1] "" Vector__XXX
 SG_ EPBL_a120_VEH_aggregatedAxleSpee m120 : 29|1@1+ (1,0) [0|1] "" Vector__XXX
 SG_ EPBL_a120_PARTY_aggregatedAxleSp m120 : 30|1@1+ (1,0) [0|1] "" Vector__XXX
 SG_ EPBL_a120_VEH_systemPower m120 : 31|1@1+ (1,0) [0|1] "" Vector__XXX
 SG_ EPBL_a120_PT_systemPower m120 : 32|1@1+ (1,0) [0|1] "" Vector__XXX
 SG_ EPBL_a120_PARTY_stalklessInterfa m120 : 33|1@1+ (1,0) [0|1] "" Vector__XXX
 SG_ EPBL_a120_CH_speed m120 : 34|1@1+ (1,0) [0|1] "" Vector__XXX
 SG_ EPBL_a120_VEH_estimatedBrakeTemp m120 : 35|1@1+ (1,0) [0|1] "" Vector__XXX
 SG_ EPBL_a120_PARTY_prndControl m120 : 36|1@1+ (1,0) [0|1] "" Vector__XXX
 SG_ EPBL_a120_PARTY_locStatus2 m120 : 37|1@1+ (1,0) [0|1] "" Vector__XXX
 SG_ EPBL_a120_VEH_chassisCntl m120 : 38|1@1+ (1,0) [0|1] "" Vector__XXX
 SG_ EPBL_a120_VEH_locStatus m120 : 39|1@1+ (1,0) [0|1] "" Vector__XXX
 SG_ EPBL_a120_VEH_locStatus2 m120 : 40|1@1+ (1,0) [0|1] "" Vector__XXX
 SG_ EPBL_a120_VEH_prndControl m120 : 41|1@1+ (1,0) [0|1] "" Vector__XXX
 SG_ EPBL_a120_VEH_vehicleEstimates m120 : 42|1@1+ (1,0) [0|1] "" Vector__XXX
 SG_ EPBL_a122_filteredCurrentCal m122 : 16|12@1+ (0.01,0) [0|40.95] "A" Vector__XXX
 SG_ EPBL_a123_filteredCurrentCal m123 : 16|12@1+ (0.01,0) [0|40.95] "A" Vector__XXX
 SG_ EPBL_a124_calOutOfBoundsData m124 : 16|1@1+ (1,0) [0|1] "" Vector__XXX
 SG_ EPBL_a125_pvFilt m125 : 16|12@1+ (0.005443676,0) [0|22.29185322] "V" Vector__XXX
 SG_ EPBL_a125_nvFilt m125 : 28|12@1+ (0.005443676,0) [0|22.29185322] "V" Vector__XXX
 SG_ EPBL_a125_12vFilt m125 : 40|12@1+ (0.005443676,0) [0|22.29185322] "V" Vector__XXX
 SG_ EPBL_a126_pvFilt m126 : 16|12@1+ (0.005443676,0) [0|22.29185322] "V" Vector__XXX
 SG_ EPBL_a126_nvFilt m126 : 28|12@1+ (0.005443676,0) [0|22.29185322] "V" Vector__XXX
 SG_ EPBL_a126_12vFilt m126 : 40|12@1+ (0.005443676,0) [0|22.29185322] "V" Vector__XXX
 SG_ EPBL_a127_pvFilt m127 : 16|12@1+ (0.005443676,0) [0|22.29185322] "V" Vector__XXX
 SG_ EPBL_a127_nvFilt m127 : 28|12@1+ (0.005443676,0) [0|22.29185322] "V" Vector__XXX
 SG_ EPBL_a127_12vFilt m127 : 40|12@1+ (0.005443676,0) [0|22.29185322] "V" Vector__XXX
 SG_ EPBL_a128_pvFilt m128 : 16|12@1+ (0.005443676,0) [0|22.29185322] "V" Vector__XXX
 SG_ EPBL_a128_nvFilt m128 : 28|12@1+ (0.005443676,0) [0|22.29185322] "V" Vector__XXX
 SG_ EPBL_a128_12vFilt m128 : 40|12@1+ (0.005443676,0) [0|22.29185322] "V" Vector__XXX
 SG_ EPBL_a129_VEH_occupancy m129 : 16|1@1+ (1,0) [0|1] "" Vector__XXX
 SG_ EPBL_a130_PARTY_status m130 : 16|1@1+ (1,0) [0|1] "" Vector__XXX
 SG_ EPBL_a130_VEH_status m130 : 17|1@1+ (1,0) [0|1] "" Vector__XXX
 SG_ EPBL_a131_PARTY_actuation m131 : 16|1@1+ (1,0) [0|1] "" Vector__XXX
 SG_ EPBL_a131_CH_actuation m131 : 17|1@1+ (1,0) [0|1] "" Vector__XXX
 SG_ EPBL_a134_pvFilt m134 : 16|12@1+ (0.005443676,0) [0|22.29185322] "V" Vector__XXX
 SG_ EPBL_a134_nvFilt m134 : 28|12@1+ (0.005443676,0) [0|22.29185322] "V" Vector__XXX
 SG_ EPBL_a134_12vFilt m134 : 40|12@1+ (0.005443676,0) [0|22.29185322] "V" Vector__XXX
 SG_ EPBL_a135_pvFilt m135 : 16|12@1+ (0.005443676,0) [0|22.29185322] "V" Vector__XXX
 SG_ EPBL_a135_nvFilt m135 : 28|12@1+ (0.005443676,0) [0|22.29185322] "V" Vector__XXX
 SG_ EPBL_a135_12vFilt m135 : 40|12@1+ (0.005443676,0) [0|22.29185322] "V" Vector__XXX
 SG_ EPBL_a136_pvFilt m136 : 16|12@1+ (0.005443676,0) [0|22.29185322] "V" Vector__XXX
 SG_ EPBL_a136_nvFilt m136 : 28|12@1+ (0.005443676,0) [0|22.29185322] "V" Vector__XXX
 SG_ EPBL_a136_12vFilt m136 : 40|12@1+ (0.005443676,0) [0|22.29185322] "V" Vector__XXX
 SG_ EPBL_a137_pvFilt m137 : 16|12@1+ (0.005443676,0) [0|22.29185322] "V" Vector__XXX
 SG_ EPBL_a137_nvFilt m137 : 28|12@1+ (0.005443676,0) [0|22.29185322] "V" Vector__XXX
 SG_ EPBL_a137_12vFilt m137 : 40|12@1+ (0.005443676,0) [0|22.29185322] "V" Vector__XXX
 SG_ EPBL_a138_localState m138 : 16|3@1+ (1,0) [0|7] "" Vector__XXX
 SG_ EPBL_a138_monitorState m138 : 19|3@1+ (1,0) [0|7] "" Vector__XXX
 SG_ EPBL_a139_localState m139 : 16|3@1+ (1,0) [0|7] "" Vector__XXX
 SG_ EPBL_a139_monitorState m139 : 19|3@1+ (1,0) [0|7] "" Vector__XXX
 SG_ EPBL_a141_fromState m141 : 16|5@1+ (1,0) [0|31] "" Vector__XXX
 SG_ EPBL_a141_toState m141 : 24|5@1+ (1,0) [0|31] "" Vector__XXX
 SG_ EPBL_a170_pvFilt m170 : 16|12@1+ (0.005443676,0) [0|22.29185322] "V" Vector__XXX
 SG_ EPBL_a170_nvFilt m170 : 28|12@1+ (0.005443676,0) [0|22.29185322] "V" Vector__XXX
 SG_ EPBL_a170_12vFilt m170 : 40|12@1+ (0.005443676,0) [0|22.29185322] "V" Vector__XXX
 SG_ EPBL_a171_pvFilt m171 : 16|12@1+ (0.005443676,0) [0|22.29185322] "V" Vector__XXX
 SG_ EPBL_a171_nvFilt m171 : 28|12@1+ (0.005443676,0) [0|22.29185322] "V" Vector__XXX
 SG_ EPBL_a171_12vFilt m171 : 40|12@1+ (0.005443676,0) [0|22.29185322] "V" Vector__XXX
 SG_ EPBL_a174_esmState m174 : 16|5@1+ (1,0) [0|31] "" Vector__XXX
 SG_ EPBL_a174_esmStateRequest m174 : 24|5@1+ (1,0) [0|31] "" Vector__XXX
 SG_ EPBL_a174_faultStatus m174 : 29|2@1+ (1,0) [0|3] "" Vector__XXX
 SG_ EPBL_a174_monitorUnitStatus m174 : 32|5@1+ (1,0) [0|31] "" Vector__XXX
 SG_ EPBL_a174_monitorFaultStatus m174 : 37|2@1+ (1,0) [0|3] "" Vector__XXX
 SG_ EPBL_a174_csmFaultReason m174 : 40|5@1+ (1,0) [0|31] "" Vector__XXX
 SG_ EPBL_a174_esmOpTrigger m174 : 48|6@1+ (1,0) [0|63] "" Vector__XXX
 SG_ EPBL_a174_nonterminalReason m174 : 56|5@1+ (1,0) [0|31] "" Vector__XXX
 SG_ EPBL_a175_esmState m175 : 16|5@1+ (1,0) [0|31] "" Vector__XXX
 SG_ EPBL_a175_esmStateRequest m175 : 24|5@1+ (1,0) [0|31] "" Vector__XXX
 SG_ EPBL_a175_faultStatus m175 : 29|2@1+ (1,0) [0|3] "" Vector__XXX
 SG_ EPBL_a175_monitorUnitStatus m175 : 32|5@1+ (1,0) [0|31] "" Vector__XXX
 SG_ EPBL_a175_monitorFaultStatus m175 : 37|2@1+ (1,0) [0|3] "" Vector__XXX
 SG_ EPBL_a175_csmFaultReason m175 : 40|5@1+ (1,0) [0|31] "" Vector__XXX
 SG_ EPBL_a175_esmOpTrigger m175 : 48|6@1+ (1,0) [0|63] "" Vector__XXX
 SG_ EPBL_a175_nonterminalReason m175 : 56|5@1+ (1,0) [0|31] "" Vector__XXX
 SG_ EPBL_a176_esmState m176 : 16|5@1+ (1,0) [0|31] "" Vector__XXX
 SG_ EPBL_a176_esmStateRequest m176 : 24|5@1+ (1,0) [0|31] "" Vector__XXX
 SG_ EPBL_a176_faultStatus m176 : 29|2@1+ (1,0) [0|3] "" Vector__XXX
 SG_ EPBL_a176_monitorUnitStatus m176 : 32|5@1+ (1,0) [0|31] "" Vector__XXX
 SG_ EPBL_a176_monitorFaultStatus m176 : 37|2@1+ (1,0) [0|3] "" Vector__XXX
 SG_ EPBL_a176_csmFaultReason m176 : 40|5@1+ (1,0) [0|31] "" Vector__XXX
 SG_ EPBL_a176_esmOpTrigger m176 : 48|6@1+ (1,0) [0|63] "" Vector__XXX
 SG_ EPBL_a176_nonterminalReason m176 : 56|5@1+ (1,0) [0|31] "" Vector__XXX
 SG_ EPBL_a177_esmState m177 : 16|5@1+ (1,0) [0|31] "" Vector__XXX
 SG_ EPBL_a177_esmStateRequest m177 : 24|5@1+ (1,0) [0|31] "" Vector__XXX
 SG_ EPBL_a177_faultStatus m177 : 29|2@1+ (1,0) [0|3] "" Vector__XXX
 SG_ EPBL_a177_monitorUnitStatus m177 : 32|5@1+ (1,0) [0|31] "" Vector__XXX
 SG_ EPBL_a177_monitorFaultStatus m177 : 37|2@1+ (1,0) [0|3] "" Vector__XXX
 SG_ EPBL_a177_csmFaultReason m177 : 40|5@1+ (1,0) [0|31] "" Vector__XXX
 SG_ EPBL_a177_esmOpTrigger m177 : 48|6@1+ (1,0) [0|63] "" Vector__XXX
 SG_ EPBL_a177_nonterminalReason m177 : 56|5@1+ (1,0) [0|31] "" Vector__XXX
 SG_ EPBL_a178_localCaliperState m178 : 16|3@1+ (1,0) [0|7] "" Vector__XXX
 SG_ EPBL_a178_monitorCaliperState m178 : 19|3@1+ (1,0) [0|7] "" Vector__XXX
 SG_ EPBL_a179_esmState m179 : 16|5@1+ (1,0) [0|31] "" Vector__XXX
 SG_ EPBL_a179_esmStateRequest m179 : 24|5@1+ (1,0) [0|31] "" Vector__XXX
 SG_ EPBL_a179_faultStatus m179 : 29|2@1+ (1,0) [0|3] "" Vector__XXX
 SG_ EPBL_a179_monitorUnitStatus m179 : 32|5@1+ (1,0) [0|31] "" Vector__XXX
 SG_ EPBL_a179_monitorFaultStatus m179 : 37|2@1+ (1,0) [0|3] "" Vector__XXX
 SG_ EPBL_a179_csmFaultReason m179 : 40|5@1+ (1,0) [0|31] "" Vector__XXX
 SG_ EPBL_a179_esmOpTrigger m179 : 48|6@1+ (1,0) [0|63] "" Vector__XXX
 SG_ EPBL_a179_nonterminalReason m179 : 56|5@1+ (1,0) [0|31] "" Vector__XXX
 SG_ EPBL_a180_esmOpTrigger m180 : 16|6@1+ (1,0) [0|63] "" Vector__XXX
 SG_ EPBL_a180_previousState m180 : 24|5@1+ (1,0) [0|31] "" Vector__XXX
 SG_ EPBL_a180_nextState m180 : 32|5@1+ (1,0) [0|31] "" Vector__XXX
 SG_ EPBL_a180_panicModeLatched m180 : 37|1@1+ (1,0) [0|1] "" Vector__XXX
 SG_ EPBL_a180_activeDecelRequest m180 : 38|1@1+ (1,0) [0|1] "" Vector__XXX
 SG_ EPBL_a181_grade m181 : 16|7@1- (1,0) [-64|63] "%" Vector__XXX
 SG_ EPBL_a181_vcTrailerDetected m181 : 23|1@1+ (1,0) [0|1] "" Vector__XXX
 SG_ EPBL_a181_uiTrailerDetected m181 : 24|1@1+ (1,0) [0|1] "" Vector__XXX
 SG_ EPBL_a181_trailerDetected m181 : 25|1@1+ (1,0) [0|1] "" Vector__XXX
 SG_ EPBL_a182_epbSystemStatus m182 : 16|4@1+ (1,0) [0|15] "" Vector__XXX
 SG_ EPBL_a182_grade m182 : 24|7@1- (1,0) [-64|63] "%" Vector__XXX
 SG_ EPBL_a182_temperature m182 : 32|8@1+ (0.5,-40) [-40|87.5] "deg C" Vector__XXX
 SG_ EPBL_a182_vcTrailerDetected m182 : 40|1@1+ (1,0) [0|1] "" Vector__XXX
 SG_ EPBL_a182_uiTrailerDetected m182 : 41|1@1+ (1,0) [0|1] "" Vector__XXX
 SG_ EPBL_a182_trailerDetected m182 : 42|1@1+ (1,0) [0|1] "" Vector__XXX
 SG_ EPBL_a183_isRetransmit m183 : 16|1@1+ (1,0) [0|1] "" Vector__XXX
 SG_ EPBL_a183_localCdpState m183 : 17|2@1+ (1,0) [0|3] "" Vector__XXX
 SG_ EPBL_a183_remoteCdpState m183 : 19|2@1+ (1,0) [0|3] "" Vector__XXX
 SG_ EPBL_a183_espCdpStatus m183 : 21|2@1+ (1,0) [0|3] "" Vector__XXX
 SG_ EPBL_a183_esmState m183 : 24|5@1+ (1,0) [0|31] "" Vector__XXX
 SG_ EPBL_a183_esmStateRequest m183 : 32|5@1+ (1,0) [0|31] "" Vector__XXX
 SG_ EPBL_a183_esmOperationTrigger m183 : 40|6@1+ (1,0) [0|63] "" Vector__XXX
 SG_ EPBL_a183_cdpNotStopping m183 : 46|1@1+ (1,0) [0|1] "" Vector__XXX
 SG_ EPBL_a183_cdpNotStarting m183 : 47|1@1+ (1,0) [0|1] "" Vector__XXX
 SG_ EPBL_a183_remoteEpbDynamic m183 : 48|1@1+ (1,0) [0|1] "" Vector__XXX
 SG_ EPBL_a183_localEpbDynamic m183 : 49|1@1+ (1,0) [0|1] "" Vector__XXX
 SG_ EPBL_a183_epbmInvalidated m183 : 50|1@1+ (1,0) [0|1] "" Vector__XXX
 SG_ EPBL_a183_espConfirmedInvalid m183 : 51|1@1+ (1,0) [0|1] "" Vector__XXX
 SG_ EPBL_a183_brakeFluidConfirmedLow m183 : 52|1@1+ (1,0) [0|1] "" Vector__XXX
 SG_ EPBL_a183_lastRemoteEpbDynamic m183 : 53|1@1+ (1,0) [0|1] "" Vector__XXX
 SG_ EPBL_a183_lastLocalEpbDynamic m183 : 54|1@1+ (1,0) [0|1] "" Vector__XXX
 SG_ EPBL_a183_cdpCannotBeCommanded m183 : 55|1@1+ (1,0) [0|1] "" Vector__XXX
 SG_ EPBL_a183_remoteEpbStatusUnsure m183 : 56|1@1+ (1,0) [0|1] "" Vector__XXX
 SG_ EPBL_a183_lastLowBrakeFluid m183 : 57|1@1+ (1,0) [0|1] "" Vector__XXX
 SG_ EPBL_a183_espInvalidOrUnsure m183 : 58|1@1+ (1,0) [0|1] "" Vector__XXX
 SG_ EPBL_a183_lastFactoryMode m183 : 59|1@1+ (1,0) [0|1] "" Vector__XXX
 SG_ EPBL_a183_redundantBrakingEnable m183 : 60|1@1+ (1,0) [0|1] "" Vector__XXX
 SG_ EPBL_a184_esmOpTrigger m184 : 16|6@1+ (1,0) [0|63] "" Vector__XXX
 SG_ EPBL_a184_previousState m184 : 24|5@1+ (1,0) [0|31] "" Vector__XXX
 SG_ EPBL_a184_nextState m184 : 32|5@1+ (1,0) [0|31] "" Vector__XXX
 SG_ EPBL_a184_panicModeLatched m184 : 37|1@1+ (1,0) [0|1] "" Vector__XXX
 SG_ EPBL_a184_activeDecelRequest m184 : 38|1@1+ (1,0) [0|1] "" Vector__XXX
 SG_ EPBL_a187_esmOpTrigger m187 : 16|6@1+ (1,0) [0|63] "" Vector__XXX
 SG_ EPBL_a187_previousState m187 : 24|5@1+ (1,0) [0|31] "" Vector__XXX
 SG_ EPBL_a187_nextState m187 : 32|5@1+ (1,0) [0|31] "" Vector__XXX
 SG_ EPBL_a187_panicModeLatched m187 : 37|1@1+ (1,0) [0|1] "" Vector__XXX
 SG_ EPBL_a187_activeDecelRequest m187 : 38|1@1+ (1,0) [0|1] "" Vector__XXX
 SG_ EPBL_a188_esmOpTrigger m188 : 16|6@1+ (1,0) [0|63] "" Vector__XXX
 SG_ EPBL_a188_previousState m188 : 24|5@1+ (1,0) [0|31] "" Vector__XXX
 SG_ EPBL_a188_nextState m188 : 32|5@1+ (1,0) [0|31] "" Vector__XXX
 SG_ EPBL_a188_panicModeLatched m188 : 37|1@1+ (1,0) [0|1] "" Vector__XXX
 SG_ EPBL_a188_activeDecelRequest m188 : 38|1@1+ (1,0) [0|1] "" Vector__XXX
 SG_ EPBL_a189_esmOpTrigger m189 : 16|6@1+ (1,0) [0|63] "" Vector__XXX
 SG_ EPBL_a189_previousState m189 : 24|5@1+ (1,0) [0|31] "" Vector__XXX
 SG_ EPBL_a189_nextState m189 : 32|5@1+ (1,0) [0|31] "" Vector__XXX
 SG_ EPBL_a189_panicModeLatched m189 : 37|1@1+ (1,0) [0|1] "" Vector__XXX
 SG_ EPBL_a189_activeDecelRequest m189 : 38|1@1+ (1,0) [0|1] "" Vector__XXX
 SG_ EPBL_a190_esmState m190 : 16|5@1+ (1,0) [0|31] "" Vector__XXX
 SG_ EPBL_a190_esmStateRequest m190 : 24|5@1+ (1,0) [0|31] "" Vector__XXX
 SG_ EPBL_a190_faultStatus m190 : 29|2@1+ (1,0) [0|3] "" Vector__XXX
 SG_ EPBL_a190_monitorUnitStatus m190 : 32|5@1+ (1,0) [0|31] "" Vector__XXX
 SG_ EPBL_a190_monitorFaultStatus m190 : 37|2@1+ (1,0) [0|3] "" Vector__XXX
 SG_ EPBL_a190_csmFaultReason m190 : 40|5@1+ (1,0) [0|31] "" Vector__XXX
 SG_ EPBL_a190_esmOpTrigger m190 : 48|6@1+ (1,0) [0|63] "" Vector__XXX
 SG_ EPBL_a190_nonterminalReason m190 : 56|5@1+ (1,0) [0|31] "" Vector__XXX
 SG_ EPBL_a191_esmState m191 : 16|5@1+ (1,0) [0|31] "" Vector__XXX
 SG_ EPBL_a191_esmStateRequest m191 : 24|5@1+ (1,0) [0|31] "" Vector__XXX
 SG_ EPBL_a191_faultStatus m191 : 29|2@1+ (1,0) [0|3] "" Vector__XXX
 SG_ EPBL_a191_monitorUnitStatus m191 : 32|5@1+ (1,0) [0|31] "" Vector__XXX
 SG_ EPBL_a191_monitorFaultStatus m191 : 37|2@1+ (1,0) [0|3] "" Vector__XXX
 SG_ EPBL_a191_csmFaultReason m191 : 40|5@1+ (1,0) [0|31] "" Vector__XXX
 SG_ EPBL_a191_esmOpTrigger m191 : 48|6@1+ (1,0) [0|63] "" Vector__XXX
 SG_ EPBL_a191_nonterminalReason m191 : 56|5@1+ (1,0) [0|31] "" Vector__XXX
 SG_ EPBL_a202_localEpbConfig m202 : 16|4@1+ (1,0) [0|15] "" Vector__XXX
 SG_ EPBL_a202_remoteEpbConfig m202 : 20|4@1+ (1,0) [0|15] "" Vector__XXX
 SG_ EPBL_a203_gtwConfig m203 : 16|4@1+ (1,0) [0|15] "" Vector__XXX
 SG_ EPBL_a203_epbConfig m203 : 20|4@1+ (1,0) [0|15] "" Vector__XXX
 SG_ EPBL_a210_driverLeftForScore m210 : 16|1@1+ (1,0) [0|1] "" Vector__XXX
 SG_ EPBL_a210_driverLeftForAllSensor m210 : 17|1@1+ (1,0) [0|1] "" Vector__XXX
 SG_ EPBL_a210_driverLeftForDoorOpen m210 : 18|1@1+ (1,0) [0|1] "" Vector__XXX
 SG_ EPBL_a210_driverLeftForUnbuckled m210 : 19|1@1+ (1,0) [0|1] "" Vector__XXX
 SG_ EPBL_a210_driverLeftForInactivit m210 : 20|1@1+ (1,0) [0|1] "" Vector__XXX
 SG_ EPBL_a210_driverIsLeavingSpeedCl m210 : 21|3@1+ (1,0) [0|7] "" Vector__XXX
 SG_ EPBL_a210_localDriverIsLeaving m210 : 24|1@1+ (1,0) [0|1] "" Vector__XXX
 SG_ EPBL_a210_localDriverIsLeavingAn m210 : 25|1@1+ (1,0) [0|1] "" Vector__XXX
 SG_ EPBL_a210_remoteDriverIsLeaving m210 : 26|1@1+ (1,0) [0|1] "" Vector__XXX
 SG_ EPBL_a210_remoteDriverIsLeavingA m210 : 27|1@1+ (1,0) [0|1] "" Vector__XXX
 SG_ EPBL_a210_primaryDriverDoorClose m210 : 28|2@1+ (1,0) [0|3] "" Vector__XXX
 SG_ EPBL_a210_secondaryDriverDoorClo m210 : 30|2@1+ (1,0) [0|3] "" Vector__XXX
 SG_ EPBL_a210_driverBuckled m210 : 32|2@1+ (1,0) [0|3] "" Vector__XXX
 SG_ EPBL_a210_driverSeated m210 : 34|2@1+ (1,0) [0|3] "" Vector__XXX
 SG_ EPBL_a225_esmOpTrigger m225 : 16|6@1+ (1,0) [0|63] "" Vector__XXX
 SG_ EPBL_a225_previousState m225 : 24|5@1+ (1,0) [0|31] "" Vector__XXX
 SG_ EPBL_a225_nextState m225 : 32|5@1+ (1,0) [0|31] "" Vector__XXX
 SG_ EPBL_a225_panicModeLatched m225 : 37|1@1+ (1,0) [0|1] "" Vector__XXX
 SG_ EPBL_a225_activeDecelRequest m225 : 38|1@1+ (1,0) [0|1] "" Vector__XXX
 SG_ EPBL_a241_desiredState m241 : 16|1@1+ (1,0) [0|1] "" Vector__XXX
 SG_ EPBL_a241_currentState m241 : 17|1@1+ (1,0) [0|1] "" Vector__XXX
 SG_ EPBL_a241_diKeepAlive m241 : 18|1@1+ (1,0) [0|1] "" Vector__XXX
 SG_ EPBL_a241_epbSysStatus m241 : 19|4@1+ (1,0) [0|15] "" Vector__XXX
 SG_ EPBL_a241_vehiclePowerState m241 : 24|2@1+ (1,0) [0|3] "" Vector__XXX
 SG_ EPBL_a241_highCurrent m241 : 26|1@1+ (1,0) [0|1] "" Vector__XXX
 SG_ EPBL_a241_monitorDataGood m241 : 27|1@1+ (1,0) [0|1] "" Vector__XXX
 SG_ EPBL_a241_hasLockoutRequest m241 : 28|1@1+ (1,0) [0|1] "" Vector__XXX
 SG_ EPBL_a242_hvcDesiredState m242 : 16|1@1+ (1,0) [0|1] "" Vector__XXX
 SG_ EPBL_a242_hvcCurrentState m242 : 17|1@1+ (1,0) [0|1] "" Vector__XXX
 SG_ EPBL_a242_contDesiredState m242 : 18|1@1+ (1,0) [0|1] "" Vector__XXX
 SG_ EPBL_a242_contCurrentState m242 : 19|1@1+ (1,0) [0|1] "" Vector__XXX
 SG_ EPBL_a242_hvState m242 : 20|3@1+ (1,0) [0|7] "" Vector__XXX
 SG_ EPBL_a242_vehiclePowerState m242 : 24|2@1+ (1,0) [0|3] "" Vector__XXX
 SG_ EPBL_a242_highCurrent m242 : 26|1@1+ (1,0) [0|1] "" Vector__XXX
 SG_ EPBL_a242_monitorDataGood m242 : 27|1@1+ (1,0) [0|1] "" Vector__XXX
 SG_ EPBL_a242_hasLockoutRequest m242 : 28|1@1+ (1,0) [0|1] "" Vector__XXX
 SG_ EPBL_a243_brakeMasterCylPress m243 : 16|1@1+ (1,0) [0|1] "" Vector__XXX
 SG_ EPBL_a243_brakeMasterCylPressQF m243 : 17|1@1+ (1,0) [0|1] "" Vector__XXX
 SG_ EPBL_a243_drivetrainType m243 : 18|1@1+ (1,0) [0|1] "" Vector__XXX
 SG_ EPBL_a243_DIR1torqueActual m243 : 19|1@1+ (1,0) [0|1] "" Vector__XXX
 SG_ EPBL_a243_DIR2torqueActual m243 : 20|1@1+ (1,0) [0|1] "" Vector__XXX
 SG_ EPBL_a243_DIFtorqueActual m243 : 21|1@1+ (1,0) [0|1] "" Vector__XXX
 SG_ EPBL_a243_vehicleSpeed m243 : 22|1@1+ (1,0) [0|1] "" Vector__XXX
 SG_ EPBL_a243_tempAmbient m243 : 23|1@1+ (1,0) [0|1] "" Vector__XXX
 SG_ EPBL_a243_thermistorTMin m243 : 24|1@1+ (1,0) [0|1] "" Vector__XXX
 SG_ EPBL_a243_wiperSpeed m243 : 25|1@1+ (1,0) [0|1] "" Vector__XXX
 SG_ EPBL_a243_vehiclePowerState m243 : 26|1@1+ (1,0) [0|1] "" Vector__XXX
 SG_ EPBL_a243_brakeDiscWipingActive m243 : 27|1@1+ (1,0) [0|1] "" Vector__XXX
 SG_ EPBL_a244_permissiveMode m244 : 16|1@1+ (1,0) [0|1] "" Vector__XXX
 SG_ EPBL_a246_previousState m246 : 16|5@1+ (1,0) [0|31] "" Vector__XXX
 SG_ EPBL_a246_nextState m246 : 24|5@1+ (1,0) [0|31] "" Vector__XXX
 SG_ EPBL_a246_esmStateRequest m246 : 32|5@1+ (1,0) [0|31] "" Vector__XXX
 SG_ EPBL_a246_faultStatus m246 : 37|2@1+ (1,0) [0|3] "" Vector__XXX
 SG_ EPBL_a246_esmOpTrigger m246 : 40|6@1+ (1,0) [0|63] "" Vector__XXX
 SG_ EPBL_a247_esmState m247 : 16|5@1+ (1,0) [0|31] "" Vector__XXX
 SG_ EPBL_a247_esmStateRequest m247 : 24|5@1+ (1,0) [0|31] "" Vector__XXX
 SG_ EPBL_a247_faultStatus m247 : 29|2@1+ (1,0) [0|3] "" Vector__XXX
 SG_ EPBL_a247_monitorUnitStatus m247 : 32|5@1+ (1,0) [0|31] "" Vector__XXX
 SG_ EPBL_a247_monitorFaultStatus m247 : 37|2@1+ (1,0) [0|3] "" Vector__XXX
 SG_ EPBL_a247_csmFaultReason m247 : 40|5@1+ (1,0) [0|31] "" Vector__XXX
 SG_ EPBL_a247_esmOpTrigger m247 : 48|6@1+ (1,0) [0|63] "" Vector__XXX
 SG_ EPBL_a247_nonterminalReason m247 : 56|5@1+ (1,0) [0|31] "" Vector__XXX
 SG_ EPBL_a248_esmState m248 : 16|5@1+ (1,0) [0|31] "" Vector__XXX
 SG_ EPBL_a248_esmStateRequest m248 : 24|5@1+ (1,0) [0|31] "" Vector__XXX
 SG_ EPBL_a248_faultStatus m248 : 29|2@1+ (1,0) [0|3] "" Vector__XXX
 SG_ EPBL_a248_monitorUnitStatus m248 : 32|5@1+ (1,0) [0|31] "" Vector__XXX
 SG_ EPBL_a248_monitorFaultStatus m248 : 37|2@1+ (1,0) [0|3] "" Vector__XXX
 SG_ EPBL_a248_csmFaultReason m248 : 40|5@1+ (1,0) [0|31] "" Vector__XXX
 SG_ EPBL_a248_esmOpTrigger m248 : 48|6@1+ (1,0) [0|63] "" Vector__XXX
 SG_ EPBL_a248_nonterminalReason m248 : 56|5@1+ (1,0) [0|31] "" Vector__XXX
 SG_ EPBL_a249_previousState m249 : 16|5@1+ (1,0) [0|31] "" Vector__XXX
 SG_ EPBL_a249_nextState m249 : 24|5@1+ (1,0) [0|31] "" Vector__XXX
 SG_ EPBL_a249_esmStateRequest m249 : 32|5@1+ (1,0) [0|31] "" Vector__XXX
 SG_ EPBL_a249_faultStatus m249 : 37|2@1+ (1,0) [0|3] "" Vector__XXX
 SG_ EPBL_a249_esmOpTrigger m249 : 40|6@1+ (1,0) [0|63] "" Vector__XXX
 SG_ EPBL_a250_esmSpeedClass m250 : 16|3@1+ (1,0) [0|7] "" Vector__XXX
 SG_ EPBL_a250_esmOperationTrigger m250 : 24|6@1+ (1,0) [0|63] "" Vector__XXX
 SG_ EPBL_a250_isJumpPostTripped m250 : 30|1@1+ (1,0) [0|1] "" Vector__XXX
 SG_ EPBL_a251_currentVariance m251 : 16|12@1+ (0.01,0) [0|40.95] "A" Vector__XXX
 SG_ EPBL_a251_pistonPosition m251 : 32|13@1- (9.76801,0) [-40009.76896|40000.00095] "vCounts" Vector__XXX
 SG_ EPBL_a251_temperature m251 : 45|9@1- (0.5,-40) [-168|87.5] "deg C" Vector__XXX
 SG_ EPBL_a272_expectedState m272 : 16|2@1+ (1,0) [0|3] "" Vector__XXX
 SG_ EPBL_a272_actualState m272 : 18|2@1+ (1,0) [0|3] "" Vector__XXX
 SG_ EPBL_a300_harnessId m300 : 16|8@1+ (1,0) [0|255] "" Vector__XXX
 SG_ EPBL_a300_subUsageId m300 : 24|8@1+ (1,0) [0|255] "" Vector__XXX
 SG_ EPBL_a301_setSpeed m301 : 16|16@1+ (0.05,0) [0|3276.75] "kph" Vector__XXX
 SG_ EPBL_a301_oocConfidence m301 : 32|12@1+ (1,0) [0|4095] "" Vector__XXX
 SG_ EPBL_a301_oocDistanceFiltered m301 : 48|16@1+ (0.01,0) [0|655.35] "cm" Vector__XXX
 SG_ EPBL_a302_pistonPosition m302 : 16|13@1- (9.76801,0) [-40009.76896|40000.00095] "vCounts" Vector__XXX
 SG_ EPBL_a302_deltaCurrent m302 : 32|15@1+ (0.01,0) [0|327.67] "A/s" Vector__XXX
 SG_ EPBL_a303_currentVariance m303 : 16|12@1+ (0.01,0) [0|40.95] "A" Vector__XXX
 SG_ EPBL_a303_pistonPosition m303 : 32|13@1- (9.76801,0) [-40009.76896|40000.00095] "vCounts" Vector__XXX
 SG_ EPBL_a303_temperature m303 : 45|9@1- (0.5,-40) [-168|87.5] "deg C" Vector__XXX
 SG_ EPBL_a350_ensPeriod m350 : 16|16@1+ (0.0001,0) [0|6.5535] "s" Vector__XXX
 SG_ EPBL_a350_ensDuty m350 : 32|10@1+ (0.00098,0) [0|1.00254] "%" Vector__XXX
 SG_ EPBL_a350_ensTimedOut m350 : 42|1@1+ (1,0) [0|1] "" Vector__XXX
 SG_ EPBL_a355_brakeHwConfig m355 : 16|4@1+ (1,0) [0|15] "" Vector__XXX
 SG_ EPBL_a355_epbHwConfig m355 : 20|4@1+ (1,0) [0|15] "" Vector__XXX
 SG_ EPBL_a357_epbSystemStatus m357 : 16|4@1+ (1,0) [0|15] "" Vector__XXX
 SG_ EPBL_a357_grade m357 : 24|7@1- (1,0) [-64|63] "%" Vector__XXX
 SG_ EPBL_a357_ambientTemp m357 : 32|8@1+ (0.5,-40) [-40|87.5] "deg C" Vector__XXX
 SG_ EPBL_a357_brakeTemp m357 : 40|11@1+ (1,-40) [-40|2007] "deg C" Vector__XXX
 SG_ EPBL_a357_vcTrailerDetected m357 : 51|1@1+ (1,0) [0|1] "" Vector__XXX
 SG_ EPBL_a357_uiTrailerDetected m357 : 52|1@1+ (1,0) [0|1] "" Vector__XXX
 SG_ EPBL_a357_trailerDetected m357 : 53|1@1+ (1,0) [0|1] "" Vector__XXX
 SG_ EPBL_a358_epbSystemStatus m358 : 16|4@1+ (1,0) [0|15] "" Vector__XXX
 SG_ EPBL_a358_grade m358 : 24|7@1- (1,0) [-64|63] "%" Vector__XXX
 SG_ EPBL_a358_ambientTemp m358 : 32|8@1+ (0.5,-40) [-40|87.5] "deg C" Vector__XXX
 SG_ EPBL_a358_brakeTemp m358 : 40|11@1+ (1,-40) [-40|2007] "deg C" Vector__XXX
 SG_ EPBL_a358_vcTrailerDetected m358 : 51|1@1+ (1,0) [0|1] "" Vector__XXX
 SG_ EPBL_a358_uiTrailerDetected m358 : 52|1@1+ (1,0) [0|1] "" Vector__XXX
 SG_ EPBL_a358_trailerDetected m358 : 53|1@1+ (1,0) [0|1] "" Vector__XXX
 SG_ EPBL_a365_epbSystemStatus m365 : 16|4@1+ (1,0) [0|15] "" Vector__XXX
 SG_ EPBL_a365_grade m365 : 24|7@1- (1,0) [-64|63] "%" Vector__XXX
 SG_ EPBL_a365_ambientTemp m365 : 32|8@1+ (0.5,-40) [-40|87.5] "deg C" Vector__XXX
 SG_ EPBL_a365_vcTrailerDetected m365 : 40|1@1+ (1,0) [0|1] "" Vector__XXX
 SG_ EPBL_a365_uiTrailerDetected m365 : 41|1@1+ (1,0) [0|1] "" Vector__XXX
 SG_ EPBL_a365_trailerDetected m365 : 42|1@1+ (1,0) [0|1] "" Vector__XXX
 SG_ EPBL_a366_epbSystemStatus m366 : 16|4@1+ (1,0) [0|15] "" Vector__XXX
 SG_ EPBL_a366_grade m366 : 24|7@1- (1,0) [-64|63] "%" Vector__XXX
 SG_ EPBL_a366_ambientTemp m366 : 32|8@1+ (0.5,-40) [-40|87.5] "deg C" Vector__XXX
 SG_ EPBL_a366_vcTrailerDetected m366 : 40|1@1+ (1,0) [0|1] "" Vector__XXX
 SG_ EPBL_a366_uiTrailerDetected m366 : 41|1@1+ (1,0) [0|1] "" Vector__XXX
 SG_ EPBL_a366_trailerDetected m366 : 42|1@1+ (1,0) [0|1] "" Vector__XXX

BO_TX_BU_ 1480 : EPBL;
CM_ BO_ 1480 "Left electric parking brake message: alert log";
CM_ SG_ 1480 EPBL_alertID "Left electric parking brake: alert ID";
CM_ SG_ 1480 EPBL_alertState "Left electric parking brake: alert state";
CM_ SG_ 1480 EPBL_a001_InternalWatchdog "Left electric parking brake: a001 internal watchdog";
CM_ SG_ 1480 EPBL_a002_CPUUndervoltage "Left electric parking brake: a002 CPU undervoltage";
CM_ SG_ 1480 EPBL_a002_PowerOnReset "Left electric parking brake: a002 power on reset";
CM_ SG_ 1480 EPBL_a015_NVMMMemOverflow "Left electric parking brake: a015 NVMM mem overflow";
CM_ SG_ 1480 EPBL_a015_NVMMFilesystemError "Left electric parking brake: a015 NVMM filesystem error";
CM_ SG_ 1480 EPBL_a015_NVMMRecordIDError "Left electric parking brake: a015 NVMM record ID error";
CM_ SG_ 1480 EPBL_a057_VEH_cpControl "Left electric parking brake: a057 VEH cp control";
CM_ SG_ 1480 EPBL_a059_voltageDrop "Left electric parking brake: a059 voltage drop";
CM_ SG_ 1480 EPBL_a059_resistanceEstimate "Left electric parking brake: a059 resistance estimate";
CM_ SG_ 1480 EPBL_a059_current "Left electric parking brake: a059 current";
CM_ SG_ 1480 EPBL_a063_switchChannel "Left electric parking brake: a063 switch channel";
CM_ SG_ 1480 EPBL_a063_switchType "Left electric parking brake: a063 switch type";
CM_ SG_ 1480 EPBL_a063_ADCVoltage "Left electric parking brake: a063 ADC voltage";
CM_ SG_ 1480 EPBL_a063_disconnected "Left electric parking brake: a063 disconnected";
CM_ SG_ 1480 EPBL_a063_indeterminate "Left electric parking brake: a063 indeterminate";
CM_ SG_ 1480 EPBL_a063_stuckActive "Left electric parking brake: a063 stuck active";
CM_ SG_ 1480 EPBL_a063_faulted "Left electric parking brake: a063 faulted";
CM_ SG_ 1480 EPBL_a081_VEH_defogInfoMessage "Left electric parking brake: a081 VEH defog info message";
CM_ SG_ 1480 EPBL_a082_RIPC_epbPrivateState "Left electric parking brake: a082 RIPC epb private state";
CM_ SG_ 1480 EPBL_a082_RIPC_remoteHSD "Left electric parking brake: a082 RIPC remote HSD";
CM_ SG_ 1480 EPBL_a082_RIPC_railStatus "Left electric parking brake: a082 RIPC rail status";
CM_ SG_ 1480 EPBL_a082_RIPC_remoteMux "Left electric parking brake: a082 RIPC remote mux";
CM_ SG_ 1480 EPBL_a082_RIPC_remoteCurrent "Left electric parking brake: a082 RIPC remote current";
CM_ SG_ 1480 EPBL_a083_LIPC_epbPrivateState "Left electric parking brake: a083 LIPC epb private state";
CM_ SG_ 1480 EPBL_a083_LIPC_remoteHSD "Left electric parking brake: a083 LIPC remote HSD";
CM_ SG_ 1480 EPBL_a083_LIPC_railStatus "Left electric parking brake: a083 LIPC rail status";
CM_ SG_ 1480 EPBL_a083_LIPC_HSDFaults "Left electric parking brake: a083 LIPC HSD faults";
CM_ SG_ 1480 EPBL_a083_LIPC_remoteCurrent "Left electric parking brake: a083 LIPC remote current";
CM_ SG_ 1480 EPBL_a084_CH_StatusC "Left electric parking brake: a084 CH status c";
CM_ SG_ 1480 EPBL_a085_PARTY_buttonStatus "Left electric parking brake: a085 PARTY button status";
CM_ SG_ 1480 EPBL_a086_VEH_LVBMS_statusHigh "Left electric parking brake: a086 VEH LVBMS status high";
CM_ SG_ 1480 EPBL_a086_VEH_LVBMS_statusLow "Left electric parking brake: a086 VEH LVBMS status low";
CM_ SG_ 1480 EPBL_a086_VEH_status "Left electric parking brake: a086 VEH status";
CM_ SG_ 1480 EPBL_a086_VEH_12VBatteryStatus "Left electric parking brake: a086 VEH 12 v battery status";
CM_ SG_ 1480 EPBL_a086_VEH_LVPowerState "Left electric parking brake: a086 VEH LV power state";
CM_ SG_ 1480 EPBL_a086_VEH_lightStatus "Left electric parking brake: a086 VEH light status";
CM_ SG_ 1480 EPBL_a086_VEH_systemStatus "Left electric parking brake: a086 VEH system status";
CM_ SG_ 1480 EPBL_a086_VEH_thermalStatus "Left electric parking brake: a086 VEH thermal status";
CM_ SG_ 1480 EPBL_a086_VEH_vehNm "Left electric parking brake: a086 VEH veh nm";
CM_ SG_ 1480 EPBL_a087_VEH_temperature "Left electric parking brake: a087 VEH temperature";
CM_ SG_ 1480 EPBL_a087_VEH_thermalControl "Left electric parking brake: a087 VEH thermal control";
CM_ SG_ 1480 EPBL_a087_VEH_torque "Left electric parking brake: a087 VEH torque";
CM_ SG_ 1480 EPBL_a087_VEH_status "Left electric parking brake: a087 VEH status";
CM_ SG_ 1480 EPBL_a087_PARTY_torque "Left electric parking brake: a087 PARTY torque";
CM_ SG_ 1480 EPBL_a087_PARTY_status "Left electric parking brake: a087 PARTY status";
CM_ SG_ 1480 EPBL_a087_PARTY_temperature "Left electric parking brake: a087 PARTY temperature";
CM_ SG_ 1480 EPBL_a087_PARTY_thermalControl "Left electric parking brake: a087 PARTY thermal control";
CM_ SG_ 1480 EPBL_a088_VEH_temperature "Left electric parking brake: a088 VEH temperature";
CM_ SG_ 1480 EPBL_a088_VEH_thermalControl "Left electric parking brake: a088 VEH thermal control";
CM_ SG_ 1480 EPBL_a088_VEH_torque "Left electric parking brake: a088 VEH torque";
CM_ SG_ 1480 EPBL_a088_VEH_status "Left electric parking brake: a088 VEH status";
CM_ SG_ 1480 EPBL_a088_PARTY_torque "Left electric parking brake: a088 PARTY torque";
CM_ SG_ 1480 EPBL_a088_PARTY_status "Left electric parking brake: a088 PARTY status";
CM_ SG_ 1480 EPBL_a088_PARTY_temperature "Left electric parking brake: a088 PARTY temperature";
CM_ SG_ 1480 EPBL_a088_PARTY_thermalControl "Left electric parking brake: a088 PARTY thermal control";
CM_ SG_ 1480 EPBL_a089_PARTY_party1 "Left electric parking brake: a089 PARTY party1";
CM_ SG_ 1480 EPBL_a089_PARTY_status "Left electric parking brake: a089 PARTY status";
CM_ SG_ 1480 EPBL_a089_VEH_status "Left electric parking brake: a089 VEH status";
CM_ SG_ 1480 EPBL_a089_BDY_party1 "Left electric parking brake: a089 BDY party1";
CM_ SG_ 1480 EPBL_a089_BDY_status "Left electric parking brake: a089 BDY status";
CM_ SG_ 1480 EPBL_a089_CH_status "Left electric parking brake: a089 CH status";
CM_ SG_ 1480 EPBL_a089_CH_party1 "Left electric parking brake: a089 CH party1";
CM_ SG_ 1480 EPBL_a089_CH_party3 "Left electric parking brake: a089 CH party3";
CM_ SG_ 1480 EPBL_a089_VEH_party1 "Left electric parking brake: a089 VEH party1";
CM_ SG_ 1480 EPBL_a089_VEH_party3 "Left electric parking brake: a089 VEH party3";
CM_ SG_ 1480 EPBL_a091_VEH_faultsAndExtras "Left electric parking brake: a091 VEH faults and extras";
CM_ SG_ 1480 EPBL_a091_VEH_info "Left electric parking brake: a091 VEH info";
CM_ SG_ 1480 EPBL_a091_VEH_state "Left electric parking brake: a091 VEH state";
CM_ SG_ 1480 EPBL_a092_VEH_restraintStatus "Left electric parking brake: a092 VEH restraint status";
CM_ SG_ 1480 EPBL_a092_VEH_switchStatus "Left electric parking brake: a092 VEH switch status";
CM_ SG_ 1480 EPBL_a092_VEH_seatStatus2 "Left electric parking brake: a092 VEH seat status2";
CM_ SG_ 1480 EPBL_a092_VEH_vehNm "Left electric parking brake: a092 VEH veh nm";
CM_ SG_ 1480 EPBL_a093_VEH_restraintStatus "Left electric parking brake: a093 VEH restraint status";
CM_ SG_ 1480 EPBL_a093_VEH_switchStatus "Left electric parking brake: a093 VEH switch status";
CM_ SG_ 1480 EPBL_a093_VEH_seatStatus2 "Left electric parking brake: a093 VEH seat status2";
CM_ SG_ 1480 EPBL_a093_VEH_vehNm "Left electric parking brake: a093 VEH veh nm";
CM_ SG_ 1480 EPBL_a094_VEH_sysStatus "Left electric parking brake: a094 VEH sys status";
CM_ SG_ 1480 EPBL_a094_PARTY_sysStatus "Left electric parking brake: a094 PARTY sys status";
CM_ SG_ 1480 EPBL_a095_PT_ptNm "Left electric parking brake: a095 PT pt nm";
CM_ SG_ 1480 EPBL_a095_PT_status "Left electric parking brake: a095 PT status";
CM_ SG_ 1480 EPBL_a096_VEH_status "Left electric parking brake: a096 VEH status";
CM_ SG_ 1480 EPBL_a096_CH_status "Left electric parking brake: a096 CH status";
CM_ SG_ 1480 EPBL_a098_CH_torque "Left electric parking brake: a098 CH torque";
CM_ SG_ 1480 EPBL_a098_VEH_hvStatus "Left electric parking brake: a098 VEH hv status";
CM_ SG_ 1480 EPBL_a098_VEH_status "Left electric parking brake: a098 VEH status";
CM_ SG_ 1480 EPBL_a098_VEH_thermalControl "Left electric parking brake: a098 VEH thermal control";
CM_ SG_ 1480 EPBL_a098_VEH_temperature "Left electric parking brake: a098 VEH temperature";
CM_ SG_ 1480 EPBL_a098_VEH_torque "Left electric parking brake: a098 VEH torque";
CM_ SG_ 1480 EPBL_a098_PARTY_status "Left electric parking brake: a098 PARTY status";
CM_ SG_ 1480 EPBL_a098_PARTY_temperature "Left electric parking brake: a098 PARTY temperature";
CM_ SG_ 1480 EPBL_a098_PARTY_thermalControl "Left electric parking brake: a098 PARTY thermal control";
CM_ SG_ 1480 EPBL_a098_PARTY_torque "Left electric parking brake: a098 PARTY torque";
CM_ SG_ 1480 EPBL_a098_PT_thermalControl "Left electric parking brake: a098 PT thermal control";
CM_ SG_ 1480 EPBL_a098_PT_temperature "Left electric parking brake: a098 PT temperature";
CM_ SG_ 1480 EPBL_a099_VEH_oocStatus "Left electric parking brake: a099 VEH ooc status";
CM_ SG_ 1480 EPBL_a100_VEH "Left electric parking brake: a100 VEH";
CM_ SG_ 1480 EPBL_a100_PARTY "Left electric parking brake: a100 PARTY";
CM_ SG_ 1480 EPBL_a100_PT "Left electric parking brake: a100 PT";
CM_ SG_ 1480 EPBL_a100_CH "Left electric parking brake: a100 CH";
CM_ SG_ 1480 EPBL_a100_OBD "Left electric parking brake: a100 OBD";
CM_ SG_ 1480 EPBL_a101_VEH_state "Left electric parking brake: a101 VEH state";
CM_ SG_ 1480 EPBL_a101_PARTY_locState "Left electric parking brake: a101 PARTY loc state";
CM_ SG_ 1480 EPBL_a101_LIPC_externalWatchdogH "Left electric parking brake: a101 LIPC external watchdog heart beat";
CM_ SG_ 1480 EPBL_a101_VEH_locState "Left electric parking brake: a101 VEH loc state";
CM_ SG_ 1480 EPBL_a101_BDY_locState "Left electric parking brake: a101 BDY loc state";
CM_ SG_ 1480 EPBL_a102_VEH_faultsAndExtras "Left electric parking brake: a102 VEH faults and extras";
CM_ SG_ 1480 EPBL_a102_VEH_feedbackStatus "Left electric parking brake: a102 VEH feedback status";
CM_ SG_ 1480 EPBL_a102_VEH_sensorStatus "Left electric parking brake: a102 VEH sensor status";
CM_ SG_ 1480 EPBL_a102_VEH_rods "Left electric parking brake: a102 VEH rods";
CM_ SG_ 1480 EPBL_a103_VEH_hvsNm "Left electric parking brake: a103 VEH hvs nm";
CM_ SG_ 1480 EPBL_a103_VEH_vehNm "Left electric parking brake: a103 VEH veh nm";
CM_ SG_ 1480 EPBL_a103_VEH_status "Left electric parking brake: a103 VEH status";
CM_ SG_ 1480 EPBL_a103_PT_ptNm "Left electric parking brake: a103 PT pt nm";
CM_ SG_ 1480 EPBL_a103_PT_status "Left electric parking brake: a103 PT status";
CM_ SG_ 1480 EPBL_a103_VEH_evseStatus "Left electric parking brake: a103 VEH evse status";
CM_ SG_ 1480 EPBL_a105_VEH_states "Left electric parking brake: a105 VEH states";
CM_ SG_ 1480 EPBL_a105_VEH_chNm "Left electric parking brake: a105 VEH ch nm";
CM_ SG_ 1480 EPBL_a105_VEH_dampingStates "Left electric parking brake: a105 VEH damping states";
CM_ SG_ 1480 EPBL_a106_VEH_dcdcStatus "Left electric parking brake: a106 VEH dcdc status";
CM_ SG_ 1480 EPBL_a106_VEH_thermalControl "Left electric parking brake: a106 VEH thermal control";
CM_ SG_ 1480 EPBL_a106_VEH_thermalInterface "Left electric parking brake: a106 VEH thermal interface";
CM_ SG_ 1480 EPBL_a106_VEH_dcdcRailStatus "Left electric parking brake: a106 VEH dcdc rail status";
CM_ SG_ 1480 EPBL_a106_CH_dcdcRailStatus "Left electric parking brake: a106 CH dcdc rail status";
CM_ SG_ 1480 EPBL_a106_CH_alertMatrix "Left electric parking brake: a106 CH alert matrix";
CM_ SG_ 1480 EPBL_a107_VEH_hvsNm "Left electric parking brake: a107 VEH hvs nm";
CM_ SG_ 1480 EPBL_a107_VEH_vehNm "Left electric parking brake: a107 VEH veh nm";
CM_ SG_ 1480 EPBL_a107_VEH_status "Left electric parking brake: a107 VEH status";
CM_ SG_ 1480 EPBL_a107_VEH_thermalStatus "Left electric parking brake: a107 VEH thermal status";
CM_ SG_ 1480 EPBL_a107_VEH_thermalStatus2 "Left electric parking brake: a107 VEH thermal status2";
CM_ SG_ 1480 EPBL_a107_VEH_bmbMinMax "Left electric parking brake: a107 VEH bmb min max";
CM_ SG_ 1480 EPBL_a107_VEH_powerAvailable "Left electric parking brake: a107 VEH power available";
CM_ SG_ 1480 EPBL_a107_PT_ptNm "Left electric parking brake: a107 PT pt nm";
CM_ SG_ 1480 EPBL_a107_PT_status "Left electric parking brake: a107 PT status";
CM_ SG_ 1480 EPBL_a107_PT_thermalStatus "Left electric parking brake: a107 PT thermal status";
CM_ SG_ 1480 EPBL_a107_PT_socStatus "Left electric parking brake: a107 PT soc status";
CM_ SG_ 1480 EPBL_a107_VEH_socStatus "Left electric parking brake: a107 VEH soc status";
CM_ SG_ 1480 EPBL_a107_VEH_packConfig "Left electric parking brake: a107 VEH pack config";
CM_ SG_ 1480 EPBL_a107_VEH_energyStatus "Left electric parking brake: a107 VEH energy status";
CM_ SG_ 1480 EPBL_a107_VEH_chargeInfo "Left electric parking brake: a107 VEH charge info";
CM_ SG_ 1480 EPBL_a108_VEH_hvStatus "Left electric parking brake: a108 VEH hv status";
CM_ SG_ 1480 EPBL_a108_VEH_temperature "Left electric parking brake: a108 VEH temperature";
CM_ SG_ 1480 EPBL_a108_VEH_thermalControl "Left electric parking brake: a108 VEH thermal control";
CM_ SG_ 1480 EPBL_a108_VEH_torque "Left electric parking brake: a108 VEH torque";
CM_ SG_ 1480 EPBL_a108_VEH_status "Left electric parking brake: a108 VEH status";
CM_ SG_ 1480 EPBL_a108_PARTY_torque "Left electric parking brake: a108 PARTY torque";
CM_ SG_ 1480 EPBL_a108_PARTY_status "Left electric parking brake: a108 PARTY status";
CM_ SG_ 1480 EPBL_a108_PARTY_temperature "Left electric parking brake: a108 PARTY temperature";
CM_ SG_ 1480 EPBL_a108_PARTY_thermalControl "Left electric parking brake: a108 PARTY thermal control";
CM_ SG_ 1480 EPBL_a108_PT_temperature "Left electric parking brake: a108 PT temperature";
CM_ SG_ 1480 EPBL_a108_PT_thermalControl "Left electric parking brake: a108 PT thermal control";
CM_ SG_ 1480 EPBL_a109_PARTY_status "Left electric parking brake: a109 PARTY status";
CM_ SG_ 1480 EPBL_a109_PARTY_inertial2 "Left electric parking brake: a109 PARTY inertial2";
CM_ SG_ 1480 EPBL_a109_PARTY_nearDeploy "Left electric parking brake: a109 PARTY near deploy";
CM_ SG_ 1480 EPBL_a109_PARTY_collision "Left electric parking brake: a109 PARTY collision";
CM_ SG_ 1480 EPBL_a109_VEH_status "Left electric parking brake: a109 VEH status";
CM_ SG_ 1480 EPBL_a109_VEH_imuOffsets "Left electric parking brake: a109 VEH imu offsets";
CM_ SG_ 1480 EPBL_a109_PARTY_inertial1 "Left electric parking brake: a109 PARTY inertial1";
CM_ SG_ 1480 EPBL_a109_BDY_imuOffsets "Left electric parking brake: a109 BDY imu offsets";
CM_ SG_ 1480 EPBL_a109_BDY_inertial1 "Left electric parking brake: a109 BDY inertial1";
CM_ SG_ 1480 EPBL_a109_BDY_inertial2 "Left electric parking brake: a109 BDY inertial2";
CM_ SG_ 1480 EPBL_a109_BDY_status "Left electric parking brake: a109 BDY status";
CM_ SG_ 1480 EPBL_a109_VEH_inertial1 "Left electric parking brake: a109 VEH inertial1";
CM_ SG_ 1480 EPBL_a109_VEH_inertial2 "Left electric parking brake: a109 VEH inertial2";
CM_ SG_ 1480 EPBL_a109_CH_inertial1 "Left electric parking brake: a109 CH inertial1";
CM_ SG_ 1480 EPBL_a109_CH_inertial2 "Left electric parking brake: a109 CH inertial2";
CM_ SG_ 1480 EPBL_a109_CH_status "Left electric parking brake: a109 CH status";
CM_ SG_ 1480 EPBL_a110_VEH_carState "Left electric parking brake: a110 VEH car state";
CM_ SG_ 1480 EPBL_a110_VEH_carConfig "Left electric parking brake: a110 VEH car config";
CM_ SG_ 1480 EPBL_a110_VEH_time "Left electric parking brake: a110 VEH time";
CM_ SG_ 1480 EPBL_a110_VEH_updateStatus "Left electric parking brake: a110 VEH update status";
CM_ SG_ 1480 EPBL_a110_VEH_vehNm "Left electric parking brake: a110 VEH veh nm";
CM_ SG_ 1480 EPBL_a110_VEH_mismatchFault "Left electric parking brake: a110 VEH mismatch fault";
CM_ SG_ 1480 EPBL_a110_VEH_vin "Left electric parking brake: a110 VEH vin";
CM_ SG_ 1480 EPBL_a110_VEH_bmpDebug "Left electric parking brake: a110 VEH bmp debug";
CM_ SG_ 1480 EPBL_a110_VEH_gearControl "Left electric parking brake: a110 VEH gear control";
CM_ SG_ 1480 EPBL_a110_VEH_canLogAvailability "Left electric parking brake: a110 VEH can log availability";
CM_ SG_ 1480 EPBL_a110_CH_airbagCutoffStatus "Left electric parking brake: a110 CH airbag cutoff status";
CM_ SG_ 1480 EPBL_a110_CH_carConfig "Left electric parking brake: a110 CH car config";
CM_ SG_ 1480 EPBL_a110_CH_carState "Left electric parking brake: a110 CH car state";
CM_ SG_ 1480 EPBL_a110_CH_vin "Left electric parking brake: a110 CH vin";
CM_ SG_ 1480 EPBL_a110_CH_chNm "Left electric parking brake: a110 CH ch nm";
CM_ SG_ 1480 EPBL_a110_CH_epochTimeGtw "Left electric parking brake: a110 CH epoch time gtw";
CM_ SG_ 1480 EPBL_a111_VEH_internalStatus "Left electric parking brake: a111 VEH internal status";
CM_ SG_ 1480 EPBL_a111_VEH_status "Left electric parking brake: a111 VEH status";
CM_ SG_ 1480 EPBL_a111_VEH_vehNm "Left electric parking brake: a111 VEH veh nm";
CM_ SG_ 1480 EPBL_a111_RIPC_LVPowerState "Left electric parking brake: a111 RIPC LV power state";
CM_ SG_ 1480 EPBL_a111_RIPC_epbPrivateState "Left electric parking brake: a111 RIPC epb private state";
CM_ SG_ 1480 EPBL_a111_RIPC_railStatus "Left electric parking brake: a111 RIPC rail status";
CM_ SG_ 1480 EPBL_a111_RIPC_remoteADC "Left electric parking brake: a111 RIPC remote ADC";
CM_ SG_ 1480 EPBL_a111_RIPC_switchStatus "Left electric parking brake: a111 RIPC switch status";
CM_ SG_ 1480 EPBL_a111_VEH_LVPowerState "Left electric parking brake: a111 VEH LV power state";
CM_ SG_ 1480 EPBL_a111_VEH_seatStatus "Left electric parking brake: a111 VEH seat status";
CM_ SG_ 1480 EPBL_a111_PARTY_status "Left electric parking brake: a111 PARTY status";
CM_ SG_ 1480 EPBL_a111_CH_status "Left electric parking brake: a111 CH status";
CM_ SG_ 1480 EPBL_a111_VEH_seatStatus3 "Left electric parking brake: a111 VEH seat status3";
CM_ SG_ 1480 EPBL_a112_VEH_internalStatus "Left electric parking brake: a112 VEH internal status";
CM_ SG_ 1480 EPBL_a112_VEH_status "Left electric parking brake: a112 VEH status";
CM_ SG_ 1480 EPBL_a112_VEH_vehNm "Left electric parking brake: a112 VEH veh nm";
CM_ SG_ 1480 EPBL_a112_LIPC_LVPowerState "Left electric parking brake: a112 LIPC LV power state";
CM_ SG_ 1480 EPBL_a112_LIPC_epbPrivateState "Left electric parking brake: a112 LIPC epb private state";
CM_ SG_ 1480 EPBL_a112_LIPC_railStatus "Left electric parking brake: a112 LIPC rail status";
CM_ SG_ 1480 EPBL_a112_LIPC_remoteADC "Left electric parking brake: a112 LIPC remote ADC";
CM_ SG_ 1480 EPBL_a112_LIPC_switchStatus "Left electric parking brake: a112 LIPC switch status";
CM_ SG_ 1480 EPBL_a112_VEH_LVPowerState "Left electric parking brake: a112 VEH LV power state";
CM_ SG_ 1480 EPBL_a112_PARTY_status "Left electric parking brake: a112 PARTY status";
CM_ SG_ 1480 EPBL_a112_CH_status "Left electric parking brake: a112 CH status";
CM_ SG_ 1480 EPBL_a114_PARTY_status "Left electric parking brake: a114 PARTY status";
CM_ SG_ 1480 EPBL_a114_PARTY_wheelSpeeds "Left electric parking brake: a114 PARTY wheel speeds";
CM_ SG_ 1480 EPBL_a114_VEH_wheelSpeeds "Left electric parking brake: a114 VEH wheel speeds";
CM_ SG_ 1480 EPBL_a114_CH_wheelSpeeds "Left electric parking brake: a114 CH wheel speeds";
CM_ SG_ 1480 EPBL_a114_PARTY_party3 "Left electric parking brake: a114 PARTY party3";
CM_ SG_ 1480 EPBL_a114_VEH_party3 "Left electric parking brake: a114 VEH party3";
CM_ SG_ 1480 EPBL_a114_VEH_status "Left electric parking brake: a114 VEH status";
CM_ SG_ 1480 EPBL_a114_PARTY_wheelRotation "Left electric parking brake: a114 PARTY wheel rotation";
CM_ SG_ 1480 EPBL_a114_CH_wheelRotation "Left electric parking brake: a114 CH wheel rotation";
CM_ SG_ 1480 EPBL_a114_VEH_wheelRotation "Left electric parking brake: a114 VEH wheel rotation";
CM_ SG_ 1480 EPBL_a114_PARTY_brakeTorque "Left electric parking brake: a114 PARTY brake torque";
CM_ SG_ 1480 EPBL_a114_PARTY_offsets "Left electric parking brake: a114 PARTY offsets";
CM_ SG_ 1480 EPBL_a114_BDY_offsets "Left electric parking brake: a114 BDY offsets";
CM_ SG_ 1480 EPBL_a114_BDY_party3 "Left electric parking brake: a114 BDY party3";
CM_ SG_ 1480 EPBL_a114_BDY_status "Left electric parking brake: a114 BDY status";
CM_ SG_ 1480 EPBL_a114_BDY_wheelRotation "Left electric parking brake: a114 BDY wheel rotation";
CM_ SG_ 1480 EPBL_a114_BDY_wheelSpeeds "Left electric parking brake: a114 BDY wheel speeds";
CM_ SG_ 1480 EPBL_a114_CH_party1 "Left electric parking brake: a114 CH party1";
CM_ SG_ 1480 EPBL_a114_CH_party3 "Left electric parking brake: a114 CH party3";
CM_ SG_ 1480 EPBL_a114_CH_status "Left electric parking brake: a114 CH status";
CM_ SG_ 1480 EPBL_a115_VEH_vehNm "Left electric parking brake: a115 VEH veh nm";
CM_ SG_ 1480 EPBL_a115_VEH_authentication "Left electric parking brake: a115 VEH authentication";
CM_ SG_ 1480 EPBL_a115_VEH_BLEResetRequest "Left electric parking brake: a115 VEH BLE reset request";
CM_ SG_ 1480 EPBL_a115_VEH_requests "Left electric parking brake: a115 VEH requests";
CM_ SG_ 1480 EPBL_a115_VEH_requests2 "Left electric parking brake: a115 VEH requests2";
CM_ SG_ 1480 EPBL_a115_REM_authentication "Left electric parking brake: a115 REM authentication";
CM_ SG_ 1480 EPBL_a115_UI_corianderVehicleCon "Left electric parking brake: a115 UI coriander vehicle control";
CM_ SG_ 1480 EPBL_a115_CH_TPMSDisplay "Left electric parking brake: a115 CH TPMS display";
CM_ SG_ 1480 EPBL_a116_PARTY_epbmStatus "Left electric parking brake: a116 PARTY epbm status";
CM_ SG_ 1480 EPBL_a116_VEH_vehNm "Left electric parking brake: a116 VEH veh nm";
CM_ SG_ 1480 EPBL_a116_VEH_hvacRequest "Left electric parking brake: a116 VEH hvac request";
CM_ SG_ 1480 EPBL_a116_VEH_hvacStatus "Left electric parking brake: a116 VEH hvac status";
CM_ SG_ 1480 EPBL_a116_VEH_LVPowerState "Left electric parking brake: a116 VEH LV power state";
CM_ SG_ 1480 EPBL_a116_VEH_lightStatus "Left electric parking brake: a116 VEH light status";
CM_ SG_ 1480 EPBL_a116_VEH_seatStatus "Left electric parking brake: a116 VEH seat status";
CM_ SG_ 1480 EPBL_a116_VEH_thsStatus "Left electric parking brake: a116 VEH ths status";
CM_ SG_ 1480 EPBL_a116_VEH_doorStatus "Left electric parking brake: a116 VEH door status";
CM_ SG_ 1480 EPBL_a116_VEH_seatHeatStatus "Left electric parking brake: a116 VEH seat heat status";
CM_ SG_ 1480 EPBL_a116_VEH_restraintStatus "Left electric parking brake: a116 VEH restraint status";
CM_ SG_ 1480 EPBL_a116_VEH_switchStatus "Left electric parking brake: a116 VEH switch status";
CM_ SG_ 1480 EPBL_a116_VEH_logging1Hz "Left electric parking brake: a116 VEH logging1 hz";
CM_ SG_ 1480 EPBL_a116_VEH_seatStatus2 "Left electric parking brake: a116 VEH seat status2";
CM_ SG_ 1480 EPBL_a116_VEH_status "Left electric parking brake: a116 VEH status";
CM_ SG_ 1480 EPBL_a116_VEH_thermalCommand "Left electric parking brake: a116 VEH thermal command";
CM_ SG_ 1480 EPBL_a116_VEH_windowStatus "Left electric parking brake: a116 VEH window status";
CM_ SG_ 1480 EPBL_a116_PARTY_restraintStatus "Left electric parking brake: a116 PARTY restraint status";
CM_ SG_ 1480 EPBL_a116_PARTY_doorStatus "Left electric parking brake: a116 PARTY door status";
CM_ SG_ 1480 EPBL_a116_BDY_epbmStatus "Left electric parking brake: a116 BDY epbm status";
CM_ SG_ 1480 EPBL_a116_BDY_restraintStatus "Left electric parking brake: a116 BDY restraint status";
CM_ SG_ 1480 EPBL_a116_VEH_hvacStatus2 "Left electric parking brake: a116 VEH hvac status2";
CM_ SG_ 1480 EPBL_a117_BDY_epbmStatus "Left electric parking brake: a117 BDY epbm status";
CM_ SG_ 1480 EPBL_a117_BDY_restraintStatus "Left electric parking brake: a117 BDY restraint status";
CM_ SG_ 1480 EPBL_a117_VEH_prndStatus "Left electric parking brake: a117 VEH prnd status";
CM_ SG_ 1480 EPBL_a117_PARTY_epbmStatus "Left electric parking brake: a117 PARTY epbm status";
CM_ SG_ 1480 EPBL_a117_VEH_vehNm "Left electric parking brake: a117 VEH veh nm";
CM_ SG_ 1480 EPBL_a117_VEH_hvacBlowerFdb "Left electric parking brake: a117 VEH hvac blower fdb";
CM_ SG_ 1480 EPBL_a117_VEH_LVPowerState "Left electric parking brake: a117 VEH LV power state";
CM_ SG_ 1480 EPBL_a117_VEH_restraintStatus "Left electric parking brake: a117 VEH restraint status";
CM_ SG_ 1480 EPBL_a117_VEH_lightStatus "Left electric parking brake: a117 VEH light status";
CM_ SG_ 1480 EPBL_a117_VEH_seatStatus "Left electric parking brake: a117 VEH seat status";
CM_ SG_ 1480 EPBL_a117_BDY_falconSwitchStatus "Left electric parking brake: a117 BDY falcon switch status";
CM_ SG_ 1480 EPBL_a117_VEH_doorStatus "Left electric parking brake: a117 VEH door status";
CM_ SG_ 1480 EPBL_a117_VEH_doorStatus2 "Left electric parking brake: a117 VEH door status2";
CM_ SG_ 1480 EPBL_a117_VEH_windowStatus "Left electric parking brake: a117 VEH window status";
CM_ SG_ 1480 EPBL_a117_VEH_switchStatus "Left electric parking brake: a117 VEH switch status";
CM_ SG_ 1480 EPBL_a117_VEH_intrusionSensorSta "Left electric parking brake: a117 VEH intrusion sensor status";
CM_ SG_ 1480 EPBL_a117_VEH_liftgateStatus "Left electric parking brake: a117 VEH liftgate status";
CM_ SG_ 1480 EPBL_a117_VEH_seatStatus2 "Left electric parking brake: a117 VEH seat status2";
CM_ SG_ 1480 EPBL_a117_PARTY_restraintStatus "Left electric parking brake: a117 PARTY restraint status";
CM_ SG_ 1480 EPBL_a117_VEH_thermalStatus "Left electric parking brake: a117 VEH thermal status";
CM_ SG_ 1480 EPBL_a117_PARTY_doorStatus "Left electric parking brake: a117 PARTY door status";
CM_ SG_ 1480 EPBL_a117_VEH_status "Left electric parking brake: a117 VEH status";
CM_ SG_ 1480 EPBL_a117_PARTY_prndStatus "Left electric parking brake: a117 PARTY prnd status";
CM_ SG_ 1480 EPBL_a118_VEH_vehNm "Left electric parking brake: a118 VEH veh nm";
CM_ SG_ 1480 EPBL_a118_VEH_lighting "Left electric parking brake: a118 VEH lighting";
CM_ SG_ 1480 EPBL_a118_VEH_sensors "Left electric parking brake: a118 VEH sensors";
CM_ SG_ 1480 EPBL_a118_VEH_status "Left electric parking brake: a118 VEH status";
CM_ SG_ 1480 EPBL_a118_VEH_okToUseHighPwr "Left electric parking brake: a118 VEH ok to use high pwr";
CM_ SG_ 1480 EPBL_a118_VEH_LVPowerState "Left electric parking brake: a118 VEH LV power state";
CM_ SG_ 1480 EPBL_a118_VEH_coolant "Left electric parking brake: a118 VEH coolant";
CM_ SG_ 1480 EPBL_a118_VEH_vehicleStatus "Left electric parking brake: a118 VEH vehicle status";
CM_ SG_ 1480 EPBL_a118_VEH_12VBatteryStatus "Left electric parking brake: a118 VEH 12 v battery status";
CM_ SG_ 1480 EPBL_a118_VEH_systemStatus "Left electric parking brake: a118 VEH system status";
CM_ SG_ 1480 EPBL_a118_PARTY_LVPowerState "Left electric parking brake: a118 PARTY LV power state";
CM_ SG_ 1480 EPBL_a118_PARTY_outputPowerStatu "Left electric parking brake: a118 PARTY output power status";
CM_ SG_ 1480 EPBL_a118_PARTY_vehicleTime "Left electric parking brake: a118 PARTY vehicle time";
CM_ SG_ 1480 EPBL_a118_VEH_thermalCommand "Left electric parking brake: a118 VEH thermal command";
CM_ SG_ 1480 EPBL_a118_CH_LVPowerState "Left electric parking brake: a118 CH LV power state";
CM_ SG_ 1480 EPBL_a118_PARTY_sensors "Left electric parking brake: a118 PARTY sensors";
CM_ SG_ 1480 EPBL_a118_CH_sensors "Left electric parking brake: a118 CH sensors";
CM_ SG_ 1480 EPBL_a118_VEH_interNodeResistanc "Left electric parking brake: a118 VEH inter node resistance";
CM_ SG_ 1480 EPBL_a118_CH_lighting "Left electric parking brake: a118 CH lighting";
CM_ SG_ 1480 EPBL_a118_VEH_lightStatus "Left electric parking brake: a118 VEH light status";
CM_ SG_ 1480 EPBL_a118_PARTY_vehNm "Left electric parking brake: a118 PARTY veh nm";
CM_ SG_ 1480 EPBL_a118_CH_12VBatteryStatus "Left electric parking brake: a118 CH 12 v battery status";
CM_ SG_ 1480 EPBL_a118_CH_LVBMS_statusHigh "Left electric parking brake: a118 CH LVBMS status high";
CM_ SG_ 1480 EPBL_a118_CH_alertMatrix "Left electric parking brake: a118 CH alert matrix";
CM_ SG_ 1480 EPBL_a118_BDY_outputPowerStatus "Left electric parking brake: a118 BDY output power status";
CM_ SG_ 1480 EPBL_a118_BDY_vehicleTime "Left electric parking brake: a118 BDY vehicle time";
CM_ SG_ 1480 EPBL_a118_PARTY_AP_vehicleState1 "Left electric parking brake: a118 PARTY AP vehicle state1 hz muxed";
CM_ SG_ 1480 EPBL_a118_BDY_AP_vehicleState1Hz "Left electric parking brake: a118 BDY AP vehicle state1 hz muxed";
CM_ SG_ 1480 EPBL_a119_VEH_steerAngle "Left electric parking brake: a119 VEH steer angle";
CM_ SG_ 1480 EPBL_a119_VEH_leftStalk "Left electric parking brake: a119 VEH left stalk";
CM_ SG_ 1480 EPBL_a119_VEH_rightStalk "Left electric parking brake: a119 VEH right stalk";
CM_ SG_ 1480 EPBL_a119_PARTY_rightStalk "Left electric parking brake: a119 PARTY right stalk";
CM_ SG_ 1480 EPBL_a119_CH_steerAngle "Left electric parking brake: a119 CH steer angle";
CM_ SG_ 1480 EPBL_a119_PARTY_steerAngle "Left electric parking brake: a119 PARTY steer angle";
CM_ SG_ 1480 EPBL_a120_PARTY_chassisCntl "Left electric parking brake: a120 PARTY chassis cntl";
CM_ SG_ 1480 EPBL_a120_VEH_systemStatus "Left electric parking brake: a120 VEH system status";
CM_ SG_ 1480 EPBL_a120_CH_chassisCntl "Left electric parking brake: a120 CH chassis cntl";
CM_ SG_ 1480 EPBL_a120_PARTY_systemStatus "Left electric parking brake: a120 PARTY system status";
CM_ SG_ 1480 EPBL_a120_PARTY_torque "Left electric parking brake: a120 PARTY torque";
CM_ SG_ 1480 EPBL_a120_VEH_torque "Left electric parking brake: a120 VEH torque";
CM_ SG_ 1480 EPBL_a120_PARTY_locStatus "Left electric parking brake: a120 PARTY loc status";
CM_ SG_ 1480 EPBL_a120_PARTY_speed "Left electric parking brake: a120 PARTY speed";
CM_ SG_ 1480 EPBL_a120_VEH_speed "Left electric parking brake: a120 VEH speed";
CM_ SG_ 1480 EPBL_a120_PARTY_status "Left electric parking brake: a120 PARTY status";
CM_ SG_ 1480 EPBL_a120_PT_speed "Left electric parking brake: a120 PT speed";
CM_ SG_ 1480 EPBL_a120_PT_systemStatus "Left electric parking brake: a120 PT system status";
CM_ SG_ 1480 EPBL_a120_PARTY_vehicleEstimates "Left electric parking brake: a120 PARTY vehicle estimates";
CM_ SG_ 1480 EPBL_a120_VEH_aggregatedAxleSpee "Left electric parking brake: a120 VEH aggregated axle speed";
CM_ SG_ 1480 EPBL_a120_PARTY_aggregatedAxleSp "Left electric parking brake: a120 PARTY aggregated axle speed";
CM_ SG_ 1480 EPBL_a120_VEH_systemPower "Left electric parking brake: a120 VEH system power";
CM_ SG_ 1480 EPBL_a120_PT_systemPower "Left electric parking brake: a120 PT system power";
CM_ SG_ 1480 EPBL_a120_PARTY_stalklessInterfa "Left electric parking brake: a120 PARTY stalkless interfaces";
CM_ SG_ 1480 EPBL_a120_CH_speed "Left electric parking brake: a120 CH speed";
CM_ SG_ 1480 EPBL_a120_VEH_estimatedBrakeTemp "Left electric parking brake: a120 VEH estimated brake temp";
CM_ SG_ 1480 EPBL_a120_PARTY_prndControl "Left electric parking brake: a120 PARTY prnd control";
CM_ SG_ 1480 EPBL_a120_PARTY_locStatus2 "Left electric parking brake: a120 PARTY loc status2";
CM_ SG_ 1480 EPBL_a120_VEH_chassisCntl "Left electric parking brake: a120 VEH chassis cntl";
CM_ SG_ 1480 EPBL_a120_VEH_locStatus "Left electric parking brake: a120 VEH loc status";
CM_ SG_ 1480 EPBL_a120_VEH_locStatus2 "Left electric parking brake: a120 VEH loc status2";
CM_ SG_ 1480 EPBL_a120_VEH_prndControl "Left electric parking brake: a120 VEH prnd control";
CM_ SG_ 1480 EPBL_a120_VEH_vehicleEstimates "Left electric parking brake: a120 VEH vehicle estimates";
CM_ SG_ 1480 EPBL_a122_filteredCurrentCal "Left electric parking brake: a122 filtered current cal";
CM_ SG_ 1480 EPBL_a123_filteredCurrentCal "Left electric parking brake: a123 filtered current cal";
CM_ SG_ 1480 EPBL_a124_calOutOfBoundsData "Left electric parking brake: a124 cal out of bounds data";
CM_ SG_ 1480 EPBL_a125_pvFilt "Left electric parking brake: a125 pv filt";
CM_ SG_ 1480 EPBL_a125_nvFilt "Left electric parking brake: a125 nv filt";
CM_ SG_ 1480 EPBL_a125_12vFilt "Left electric parking brake: a125 12v filt";
CM_ SG_ 1480 EPBL_a126_pvFilt "Left electric parking brake: a126 pv filt";
CM_ SG_ 1480 EPBL_a126_nvFilt "Left electric parking brake: a126 nv filt";
CM_ SG_ 1480 EPBL_a126_12vFilt "Left electric parking brake: a126 12v filt";
CM_ SG_ 1480 EPBL_a127_pvFilt "Left electric parking brake: a127 pv filt";
CM_ SG_ 1480 EPBL_a127_nvFilt "Left electric parking brake: a127 nv filt";
CM_ SG_ 1480 EPBL_a127_12vFilt "Left electric parking brake: a127 12v filt";
CM_ SG_ 1480 EPBL_a128_pvFilt "Left electric parking brake: a128 pv filt";
CM_ SG_ 1480 EPBL_a128_nvFilt "Left electric parking brake: a128 nv filt";
CM_ SG_ 1480 EPBL_a128_12vFilt "Left electric parking brake: a128 12v filt";
CM_ SG_ 1480 EPBL_a129_VEH_occupancy "Left electric parking brake: a129 VEH occupancy";
CM_ SG_ 1480 EPBL_a130_PARTY_status "Left electric parking brake: a130 PARTY status";
CM_ SG_ 1480 EPBL_a130_VEH_status "Left electric parking brake: a130 VEH status";
CM_ SG_ 1480 EPBL_a131_PARTY_actuation "Left electric parking brake: a131 PARTY actuation";
CM_ SG_ 1480 EPBL_a131_CH_actuation "Left electric parking brake: a131 CH actuation";
CM_ SG_ 1480 EPBL_a134_pvFilt "Left electric parking brake: a134 pv filt";
CM_ SG_ 1480 EPBL_a134_nvFilt "Left electric parking brake: a134 nv filt";
CM_ SG_ 1480 EPBL_a134_12vFilt "Left electric parking brake: a134 12v filt";
CM_ SG_ 1480 EPBL_a135_pvFilt "Left electric parking brake: a135 pv filt";
CM_ SG_ 1480 EPBL_a135_nvFilt "Left electric parking brake: a135 nv filt";
CM_ SG_ 1480 EPBL_a135_12vFilt "Left electric parking brake: a135 12v filt";
CM_ SG_ 1480 EPBL_a136_pvFilt "Left electric parking brake: a136 pv filt";
CM_ SG_ 1480 EPBL_a136_nvFilt "Left electric parking brake: a136 nv filt";
CM_ SG_ 1480 EPBL_a136_12vFilt "Left electric parking brake: a136 12v filt";
CM_ SG_ 1480 EPBL_a137_pvFilt "Left electric parking brake: a137 pv filt";
CM_ SG_ 1480 EPBL_a137_nvFilt "Left electric parking brake: a137 nv filt";
CM_ SG_ 1480 EPBL_a137_12vFilt "Left electric parking brake: a137 12v filt";
CM_ SG_ 1480 EPBL_a138_localState "Left electric parking brake: a138 local state";
CM_ SG_ 1480 EPBL_a138_monitorState "Left electric parking brake: a138 monitor state";
CM_ SG_ 1480 EPBL_a139_localState "Left electric parking brake: a139 local state";
CM_ SG_ 1480 EPBL_a139_monitorState "Left electric parking brake: a139 monitor state";
CM_ SG_ 1480 EPBL_a141_fromState "Left electric parking brake: a141 from state";
CM_ SG_ 1480 EPBL_a141_toState "Left electric parking brake: a141 to state";
CM_ SG_ 1480 EPBL_a170_pvFilt "Left electric parking brake: a170 pv filt";
CM_ SG_ 1480 EPBL_a170_nvFilt "Left electric parking brake: a170 nv filt";
CM_ SG_ 1480 EPBL_a170_12vFilt "Left electric parking brake: a170 12v filt";
CM_ SG_ 1480 EPBL_a171_pvFilt "Left electric parking brake: a171 pv filt";
CM_ SG_ 1480 EPBL_a171_nvFilt "Left electric parking brake: a171 nv filt";
CM_ SG_ 1480 EPBL_a171_12vFilt "Left electric parking brake: a171 12v filt";
CM_ SG_ 1480 EPBL_a174_esmState "Left electric parking brake: a174 esm state";
CM_ SG_ 1480 EPBL_a174_esmStateRequest "Left electric parking brake: a174 esm state request";
CM_ SG_ 1480 EPBL_a174_faultStatus "Left electric parking brake: a174 fault status";
CM_ SG_ 1480 EPBL_a174_monitorUnitStatus "Left electric parking brake: a174 monitor unit status";
CM_ SG_ 1480 EPBL_a174_monitorFaultStatus "Left electric parking brake: a174 monitor fault status";
CM_ SG_ 1480 EPBL_a174_csmFaultReason "Left electric parking brake: a174 csm fault reason";
CM_ SG_ 1480 EPBL_a174_esmOpTrigger "Left electric parking brake: a174 esm op trigger";
CM_ SG_ 1480 EPBL_a174_nonterminalReason "Left electric parking brake: a174 nonterminal reason";
CM_ SG_ 1480 EPBL_a175_esmState "Left electric parking brake: a175 esm state";
CM_ SG_ 1480 EPBL_a175_esmStateRequest "Left electric parking brake: a175 esm state request";
CM_ SG_ 1480 EPBL_a175_faultStatus "Left electric parking brake: a175 fault status";
CM_ SG_ 1480 EPBL_a175_monitorUnitStatus "Left electric parking brake: a175 monitor unit status";
CM_ SG_ 1480 EPBL_a175_monitorFaultStatus "Left electric parking brake: a175 monitor fault status";
CM_ SG_ 1480 EPBL_a175_csmFaultReason "Left electric parking brake: a175 csm fault reason";
CM_ SG_ 1480 EPBL_a175_esmOpTrigger "Left electric parking brake: a175 esm op trigger";
CM_ SG_ 1480 EPBL_a175_nonterminalReason "Left electric parking brake: a175 nonterminal reason";
CM_ SG_ 1480 EPBL_a176_esmState "Left electric parking brake: a176 esm state";
CM_ SG_ 1480 EPBL_a176_esmStateRequest "Left electric parking brake: a176 esm state request";
CM_ SG_ 1480 EPBL_a176_faultStatus "Left electric parking brake: a176 fault status";
CM_ SG_ 1480 EPBL_a176_monitorUnitStatus "Left electric parking brake: a176 monitor unit status";
CM_ SG_ 1480 EPBL_a176_monitorFaultStatus "Left electric parking brake: a176 monitor fault status";
CM_ SG_ 1480 EPBL_a176_csmFaultReason "Left electric parking brake: a176 csm fault reason";
CM_ SG_ 1480 EPBL_a176_esmOpTrigger "Left electric parking brake: a176 esm op trigger";
CM_ SG_ 1480 EPBL_a176_nonterminalReason "Left electric parking brake: a176 nonterminal reason";
CM_ SG_ 1480 EPBL_a177_esmState "Left electric parking brake: a177 esm state";
CM_ SG_ 1480 EPBL_a177_esmStateRequest "Left electric parking brake: a177 esm state request";
CM_ SG_ 1480 EPBL_a177_faultStatus "Left electric parking brake: a177 fault status";
CM_ SG_ 1480 EPBL_a177_monitorUnitStatus "Left electric parking brake: a177 monitor unit status";
CM_ SG_ 1480 EPBL_a177_monitorFaultStatus "Left electric parking brake: a177 monitor fault status";
CM_ SG_ 1480 EPBL_a177_csmFaultReason "Left electric parking brake: a177 csm fault reason";
CM_ SG_ 1480 EPBL_a177_esmOpTrigger "Left electric parking brake: a177 esm op trigger";
CM_ SG_ 1480 EPBL_a177_nonterminalReason "Left electric parking brake: a177 nonterminal reason";
CM_ SG_ 1480 EPBL_a178_localCaliperState "Left electric parking brake: a178 local caliper state";
CM_ SG_ 1480 EPBL_a178_monitorCaliperState "Left electric parking brake: a178 monitor caliper state";
CM_ SG_ 1480 EPBL_a179_esmState "Left electric parking brake: a179 esm state";
CM_ SG_ 1480 EPBL_a179_esmStateRequest "Left electric parking brake: a179 esm state request";
CM_ SG_ 1480 EPBL_a179_faultStatus "Left electric parking brake: a179 fault status";
CM_ SG_ 1480 EPBL_a179_monitorUnitStatus "Left electric parking brake: a179 monitor unit status";
CM_ SG_ 1480 EPBL_a179_monitorFaultStatus "Left electric parking brake: a179 monitor fault status";
CM_ SG_ 1480 EPBL_a179_csmFaultReason "Left electric parking brake: a179 csm fault reason";
CM_ SG_ 1480 EPBL_a179_esmOpTrigger "Left electric parking brake: a179 esm op trigger";
CM_ SG_ 1480 EPBL_a179_nonterminalReason "Left electric parking brake: a179 nonterminal reason";
CM_ SG_ 1480 EPBL_a180_esmOpTrigger "Left electric parking brake: a180 esm op trigger";
CM_ SG_ 1480 EPBL_a180_previousState "Left electric parking brake: a180 previous state";
CM_ SG_ 1480 EPBL_a180_nextState "Left electric parking brake: a180 next state";
CM_ SG_ 1480 EPBL_a180_panicModeLatched "Left electric parking brake: a180 panic mode latched";
CM_ SG_ 1480 EPBL_a180_activeDecelRequest "Left electric parking brake: a180 active decel request";
CM_ SG_ 1480 EPBL_a181_grade "Left electric parking brake: a181 grade";
CM_ SG_ 1480 EPBL_a181_vcTrailerDetected "Left electric parking brake: a181 vc trailer detected";
CM_ SG_ 1480 EPBL_a181_uiTrailerDetected "Left electric parking brake: a181 ui trailer detected";
CM_ SG_ 1480 EPBL_a181_trailerDetected "Left electric parking brake: a181 trailer detected";
CM_ SG_ 1480 EPBL_a182_epbSystemStatus "Left electric parking brake: a182 epb system status";
CM_ SG_ 1480 EPBL_a182_grade "Left electric parking brake: a182 grade";
CM_ SG_ 1480 EPBL_a182_temperature "Left electric parking brake: a182 temperature";
CM_ SG_ 1480 EPBL_a182_vcTrailerDetected "Left electric parking brake: a182 vc trailer detected";
CM_ SG_ 1480 EPBL_a182_uiTrailerDetected "Left electric parking brake: a182 ui trailer detected";
CM_ SG_ 1480 EPBL_a182_trailerDetected "Left electric parking brake: a182 trailer detected";
CM_ SG_ 1480 EPBL_a183_isRetransmit "Left electric parking brake: a183 is retransmit";
CM_ SG_ 1480 EPBL_a183_localCdpState "Left electric parking brake: a183 local cdp state";
CM_ SG_ 1480 EPBL_a183_remoteCdpState "Left electric parking brake: a183 remote cdp state";
CM_ SG_ 1480 EPBL_a183_espCdpStatus "Left electric parking brake: a183 esp cdp status";
CM_ SG_ 1480 EPBL_a183_esmState "Left electric parking brake: a183 esm state";
CM_ SG_ 1480 EPBL_a183_esmStateRequest "Left electric parking brake: a183 esm state request";
CM_ SG_ 1480 EPBL_a183_esmOperationTrigger "Left electric parking brake: a183 esm operation trigger";
CM_ SG_ 1480 EPBL_a183_cdpNotStopping "Left electric parking brake: a183 cdp not stopping";
CM_ SG_ 1480 EPBL_a183_cdpNotStarting "Left electric parking brake: a183 cdp not starting";
CM_ SG_ 1480 EPBL_a183_remoteEpbDynamic "Left electric parking brake: a183 remote epb dynamic";
CM_ SG_ 1480 EPBL_a183_localEpbDynamic "Left electric parking brake: a183 local epb dynamic";
CM_ SG_ 1480 EPBL_a183_epbmInvalidated "Left electric parking brake: a183 epbm invalidated";
CM_ SG_ 1480 EPBL_a183_espConfirmedInvalid "Left electric parking brake: a183 esp confirmed invalid";
CM_ SG_ 1480 EPBL_a183_brakeFluidConfirmedLow "Left electric parking brake: a183 brake fluid confirmed low";
CM_ SG_ 1480 EPBL_a183_lastRemoteEpbDynamic "Left electric parking brake: a183 last remote epb dynamic";
CM_ SG_ 1480 EPBL_a183_lastLocalEpbDynamic "Left electric parking brake: a183 last local epb dynamic";
CM_ SG_ 1480 EPBL_a183_cdpCannotBeCommanded "Left electric parking brake: a183 cdp cannot be commanded";
CM_ SG_ 1480 EPBL_a183_remoteEpbStatusUnsure "Left electric parking brake: a183 remote epb status unsure";
CM_ SG_ 1480 EPBL_a183_lastLowBrakeFluid "Left electric parking brake: a183 last low brake fluid";
CM_ SG_ 1480 EPBL_a183_espInvalidOrUnsure "Left electric parking brake: a183 esp invalid or unsure";
CM_ SG_ 1480 EPBL_a183_lastFactoryMode "Left electric parking brake: a183 last factory mode";
CM_ SG_ 1480 EPBL_a183_redundantBrakingEnable "Left electric parking brake: a183 redundant braking enabled";
CM_ SG_ 1480 EPBL_a184_esmOpTrigger "Left electric parking brake: a184 esm op trigger";
CM_ SG_ 1480 EPBL_a184_previousState "Left electric parking brake: a184 previous state";
CM_ SG_ 1480 EPBL_a184_nextState "Left electric parking brake: a184 next state";
CM_ SG_ 1480 EPBL_a184_panicModeLatched "Left electric parking brake: a184 panic mode latched";
CM_ SG_ 1480 EPBL_a184_activeDecelRequest "Left electric parking brake: a184 active decel request";
CM_ SG_ 1480 EPBL_a187_esmOpTrigger "Left electric parking brake: a187 esm op trigger";
CM_ SG_ 1480 EPBL_a187_previousState "Left electric parking brake: a187 previous state";
CM_ SG_ 1480 EPBL_a187_nextState "Left electric parking brake: a187 next state";
CM_ SG_ 1480 EPBL_a187_panicModeLatched "Left electric parking brake: a187 panic mode latched";
CM_ SG_ 1480 EPBL_a187_activeDecelRequest "Left electric parking brake: a187 active decel request";
CM_ SG_ 1480 EPBL_a188_esmOpTrigger "Left electric parking brake: a188 esm op trigger";
CM_ SG_ 1480 EPBL_a188_previousState "Left electric parking brake: a188 previous state";
CM_ SG_ 1480 EPBL_a188_nextState "Left electric parking brake: a188 next state";
CM_ SG_ 1480 EPBL_a188_panicModeLatched "Left electric parking brake: a188 panic mode latched";
CM_ SG_ 1480 EPBL_a188_activeDecelRequest "Left electric parking brake: a188 active decel request";
CM_ SG_ 1480 EPBL_a189_esmOpTrigger "Left electric parking brake: a189 esm op trigger";
CM_ SG_ 1480 EPBL_a189_previousState "Left electric parking brake: a189 previous state";
CM_ SG_ 1480 EPBL_a189_nextState "Left electric parking brake: a189 next state";
CM_ SG_ 1480 EPBL_a189_panicModeLatched "Left electric parking brake: a189 panic mode latched";
CM_ SG_ 1480 EPBL_a189_activeDecelRequest "Left electric parking brake: a189 active decel request";
CM_ SG_ 1480 EPBL_a190_esmState "Left electric parking brake: a190 esm state";
CM_ SG_ 1480 EPBL_a190_esmStateRequest "Left electric parking brake: a190 esm state request";
CM_ SG_ 1480 EPBL_a190_faultStatus "Left electric parking brake: a190 fault status";
CM_ SG_ 1480 EPBL_a190_monitorUnitStatus "Left electric parking brake: a190 monitor unit status";
CM_ SG_ 1480 EPBL_a190_monitorFaultStatus "Left electric parking brake: a190 monitor fault status";
CM_ SG_ 1480 EPBL_a190_csmFaultReason "Left electric parking brake: a190 csm fault reason";
CM_ SG_ 1480 EPBL_a190_esmOpTrigger "Left electric parking brake: a190 esm op trigger";
CM_ SG_ 1480 EPBL_a190_nonterminalReason "Left electric parking brake: a190 nonterminal reason";
CM_ SG_ 1480 EPBL_a191_esmState "Left electric parking brake: a191 esm state";
CM_ SG_ 1480 EPBL_a191_esmStateRequest "Left electric parking brake: a191 esm state request";
CM_ SG_ 1480 EPBL_a191_faultStatus "Left electric parking brake: a191 fault status";
CM_ SG_ 1480 EPBL_a191_monitorUnitStatus "Left electric parking brake: a191 monitor unit status";
CM_ SG_ 1480 EPBL_a191_monitorFaultStatus "Left electric parking brake: a191 monitor fault status";
CM_ SG_ 1480 EPBL_a191_csmFaultReason "Left electric parking brake: a191 csm fault reason";
CM_ SG_ 1480 EPBL_a191_esmOpTrigger "Left electric parking brake: a191 esm op trigger";
CM_ SG_ 1480 EPBL_a191_nonterminalReason "Left electric parking brake: a191 nonterminal reason";
CM_ SG_ 1480 EPBL_a202_localEpbConfig "Left electric parking brake: a202 local epb config";
CM_ SG_ 1480 EPBL_a202_remoteEpbConfig "Left electric parking brake: a202 remote epb config";
CM_ SG_ 1480 EPBL_a203_gtwConfig "Left electric parking brake: a203 gtw config";
CM_ SG_ 1480 EPBL_a203_epbConfig "Left electric parking brake: a203 epb config";
CM_ SG_ 1480 EPBL_a210_driverLeftForScore "Left electric parking brake: a210 driver left for score";
CM_ SG_ 1480 EPBL_a210_driverLeftForAllSensor "Left electric parking brake: a210 driver left for all sensors";
CM_ SG_ 1480 EPBL_a210_driverLeftForDoorOpen "Left electric parking brake: a210 driver left for door open";
CM_ SG_ 1480 EPBL_a210_driverLeftForUnbuckled "Left electric parking brake: a210 driver left for unbuckled";
CM_ SG_ 1480 EPBL_a210_driverLeftForInactivit "Left electric parking brake: a210 driver left for inactivity";
CM_ SG_ 1480 EPBL_a210_driverIsLeavingSpeedCl "Left electric parking brake: a210 driver is leaving speed class";
CM_ SG_ 1480 EPBL_a210_localDriverIsLeaving "Left electric parking brake: a210 local driver is leaving";
CM_ SG_ 1480 EPBL_a210_localDriverIsLeavingAn "Left electric parking brake: a210 local driver is leaving any speed";
CM_ SG_ 1480 EPBL_a210_remoteDriverIsLeaving "Left electric parking brake: a210 remote driver is leaving";
CM_ SG_ 1480 EPBL_a210_remoteDriverIsLeavingA "Left electric parking brake: a210 remote driver is leaving any speed";
CM_ SG_ 1480 EPBL_a210_primaryDriverDoorClose "Left electric parking brake: a210 primary driver door closed; raw 2 = signal not available (SNA)";
CM_ SG_ 1480 EPBL_a210_secondaryDriverDoorClo "Left electric parking brake: a210 secondary driver door closed; raw 2 = signal not available (SNA)";
CM_ SG_ 1480 EPBL_a210_driverBuckled "Left electric parking brake: a210 driver buckled; raw 2 = signal not available (SNA)";
CM_ SG_ 1480 EPBL_a210_driverSeated "Left electric parking brake: a210 driver seated; raw 2 = signal not available (SNA)";
CM_ SG_ 1480 EPBL_a225_esmOpTrigger "Left electric parking brake: a225 esm op trigger";
CM_ SG_ 1480 EPBL_a225_previousState "Left electric parking brake: a225 previous state";
CM_ SG_ 1480 EPBL_a225_nextState "Left electric parking brake: a225 next state";
CM_ SG_ 1480 EPBL_a225_panicModeLatched "Left electric parking brake: a225 panic mode latched";
CM_ SG_ 1480 EPBL_a225_activeDecelRequest "Left electric parking brake: a225 active decel request";
CM_ SG_ 1480 EPBL_a241_desiredState "Left electric parking brake: a241 desired state";
CM_ SG_ 1480 EPBL_a241_currentState "Left electric parking brake: a241 current state";
CM_ SG_ 1480 EPBL_a241_diKeepAlive "Left electric parking brake: a241 di keep alive";
CM_ SG_ 1480 EPBL_a241_epbSysStatus "Left electric parking brake: a241 epb sys status";
CM_ SG_ 1480 EPBL_a241_vehiclePowerState "Left electric parking brake: a241 vehicle power state";
CM_ SG_ 1480 EPBL_a241_highCurrent "Left electric parking brake: a241 high current";
CM_ SG_ 1480 EPBL_a241_monitorDataGood "Left electric parking brake: a241 monitor data good";
CM_ SG_ 1480 EPBL_a241_hasLockoutRequest "Left electric parking brake: a241 has lockout request";
CM_ SG_ 1480 EPBL_a242_hvcDesiredState "Left electric parking brake: a242 hvc desired state";
CM_ SG_ 1480 EPBL_a242_hvcCurrentState "Left electric parking brake: a242 hvc current state";
CM_ SG_ 1480 EPBL_a242_contDesiredState "Left electric parking brake: a242 cont desired state";
CM_ SG_ 1480 EPBL_a242_contCurrentState "Left electric parking brake: a242 cont current state";
CM_ SG_ 1480 EPBL_a242_hvState "Left electric parking brake: a242 hv state";
CM_ SG_ 1480 EPBL_a242_vehiclePowerState "Left electric parking brake: a242 vehicle power state";
CM_ SG_ 1480 EPBL_a242_highCurrent "Left electric parking brake: a242 high current";
CM_ SG_ 1480 EPBL_a242_monitorDataGood "Left electric parking brake: a242 monitor data good";
CM_ SG_ 1480 EPBL_a242_hasLockoutRequest "Left electric parking brake: a242 has lockout request";
CM_ SG_ 1480 EPBL_a243_brakeMasterCylPress "Left electric parking brake: a243 brake master cyl press";
CM_ SG_ 1480 EPBL_a243_brakeMasterCylPressQF "Left electric parking brake: a243 brake master cyl press QF";
CM_ SG_ 1480 EPBL_a243_drivetrainType "Left electric parking brake: a243 drivetrain type";
CM_ SG_ 1480 EPBL_a243_DIR1torqueActual "Left electric parking brake: a243 dir1torque actual";
CM_ SG_ 1480 EPBL_a243_DIR2torqueActual "Left electric parking brake: a243 dir2torque actual";
CM_ SG_ 1480 EPBL_a243_DIFtorqueActual "Left electric parking brake: a243 DI ftorque actual";
CM_ SG_ 1480 EPBL_a243_vehicleSpeed "Left electric parking brake: a243 vehicle speed";
CM_ SG_ 1480 EPBL_a243_tempAmbient "Left electric parking brake: a243 temp ambient";
CM_ SG_ 1480 EPBL_a243_thermistorTMin "Left electric parking brake: a243 thermistor t min";
CM_ SG_ 1480 EPBL_a243_wiperSpeed "Left electric parking brake: a243 wiper speed";
CM_ SG_ 1480 EPBL_a243_vehiclePowerState "Left electric parking brake: a243 vehicle power state";
CM_ SG_ 1480 EPBL_a243_brakeDiscWipingActive "Left electric parking brake: a243 brake disc wiping active";
CM_ SG_ 1480 EPBL_a244_permissiveMode "Left electric parking brake: a244 permissive mode";
CM_ SG_ 1480 EPBL_a246_previousState "Left electric parking brake: a246 previous state";
CM_ SG_ 1480 EPBL_a246_nextState "Left electric parking brake: a246 next state";
CM_ SG_ 1480 EPBL_a246_esmStateRequest "Left electric parking brake: a246 esm state request";
CM_ SG_ 1480 EPBL_a246_faultStatus "Left electric parking brake: a246 fault status";
CM_ SG_ 1480 EPBL_a246_esmOpTrigger "Left electric parking brake: a246 esm op trigger";
CM_ SG_ 1480 EPBL_a247_esmState "Left electric parking brake: a247 esm state";
CM_ SG_ 1480 EPBL_a247_esmStateRequest "Left electric parking brake: a247 esm state request";
CM_ SG_ 1480 EPBL_a247_faultStatus "Left electric parking brake: a247 fault status";
CM_ SG_ 1480 EPBL_a247_monitorUnitStatus "Left electric parking brake: a247 monitor unit status";
CM_ SG_ 1480 EPBL_a247_monitorFaultStatus "Left electric parking brake: a247 monitor fault status";
CM_ SG_ 1480 EPBL_a247_csmFaultReason "Left electric parking brake: a247 csm fault reason";
CM_ SG_ 1480 EPBL_a247_esmOpTrigger "Left electric parking brake: a247 esm op trigger";
CM_ SG_ 1480 EPBL_a247_nonterminalReason "Left electric parking brake: a247 nonterminal reason";
CM_ SG_ 1480 EPBL_a248_esmState "Left electric parking brake: a248 esm state";
CM_ SG_ 1480 EPBL_a248_esmStateRequest "Left electric parking brake: a248 esm state request";
CM_ SG_ 1480 EPBL_a248_faultStatus "Left electric parking brake: a248 fault status";
CM_ SG_ 1480 EPBL_a248_monitorUnitStatus "Left electric parking brake: a248 monitor unit status";
CM_ SG_ 1480 EPBL_a248_monitorFaultStatus "Left electric parking brake: a248 monitor fault status";
CM_ SG_ 1480 EPBL_a248_csmFaultReason "Left electric parking brake: a248 csm fault reason";
CM_ SG_ 1480 EPBL_a248_esmOpTrigger "Left electric parking brake: a248 esm op trigger";
CM_ SG_ 1480 EPBL_a248_nonterminalReason "Left electric parking brake: a248 nonterminal reason";
CM_ SG_ 1480 EPBL_a249_previousState "Left electric parking brake: a249 previous state";
CM_ SG_ 1480 EPBL_a249_nextState "Left electric parking brake: a249 next state";
CM_ SG_ 1480 EPBL_a249_esmStateRequest "Left electric parking brake: a249 esm state request";
CM_ SG_ 1480 EPBL_a249_faultStatus "Left electric parking brake: a249 fault status";
CM_ SG_ 1480 EPBL_a249_esmOpTrigger "Left electric parking brake: a249 esm op trigger";
CM_ SG_ 1480 EPBL_a250_esmSpeedClass "Left electric parking brake: a250 esm speed class";
CM_ SG_ 1480 EPBL_a250_esmOperationTrigger "Left electric parking brake: a250 esm operation trigger";
CM_ SG_ 1480 EPBL_a250_isJumpPostTripped "Left electric parking brake: a250 is jump post tripped";
CM_ SG_ 1480 EPBL_a251_currentVariance "Left electric parking brake: a251 current variance";
CM_ SG_ 1480 EPBL_a251_pistonPosition "Left electric parking brake: a251 piston position";
CM_ SG_ 1480 EPBL_a251_temperature "Left electric parking brake: a251 temperature";
CM_ SG_ 1480 EPBL_a272_expectedState "Left electric parking brake: a272 expected state";
CM_ SG_ 1480 EPBL_a272_actualState "Left electric parking brake: a272 actual state";
CM_ SG_ 1480 EPBL_a300_harnessId "Left electric parking brake: a300 harness id";
CM_ SG_ 1480 EPBL_a300_subUsageId "Left electric parking brake: a300 sub usage id";
CM_ SG_ 1480 EPBL_a301_setSpeed "Left electric parking brake: a301 set speed";
CM_ SG_ 1480 EPBL_a301_oocConfidence "Left electric parking brake: a301 ooc confidence";
CM_ SG_ 1480 EPBL_a301_oocDistanceFiltered "Left electric parking brake: a301 ooc distance filtered";
CM_ SG_ 1480 EPBL_a302_pistonPosition "Left electric parking brake: a302 piston position";
CM_ SG_ 1480 EPBL_a302_deltaCurrent "Left electric parking brake: a302 delta current";
CM_ SG_ 1480 EPBL_a303_currentVariance "Left electric parking brake: a303 current variance";
CM_ SG_ 1480 EPBL_a303_pistonPosition "Left electric parking brake: a303 piston position";
CM_ SG_ 1480 EPBL_a303_temperature "Left electric parking brake: a303 temperature";
CM_ SG_ 1480 EPBL_a350_ensPeriod "Left electric parking brake: a350 ens period";
CM_ SG_ 1480 EPBL_a350_ensDuty "Left electric parking brake: a350 ens duty";
CM_ SG_ 1480 EPBL_a350_ensTimedOut "Left electric parking brake: a350 ens timed out";
CM_ SG_ 1480 EPBL_a355_brakeHwConfig "Left electric parking brake: a355 brake hw config";
CM_ SG_ 1480 EPBL_a355_epbHwConfig "Left electric parking brake: a355 epb hw config";
CM_ SG_ 1480 EPBL_a357_epbSystemStatus "Left electric parking brake: a357 epb system status";
CM_ SG_ 1480 EPBL_a357_grade "Left electric parking brake: a357 grade";
CM_ SG_ 1480 EPBL_a357_ambientTemp "Left electric parking brake: a357 ambient temp";
CM_ SG_ 1480 EPBL_a357_brakeTemp "Left electric parking brake: a357 brake temp";
CM_ SG_ 1480 EPBL_a357_vcTrailerDetected "Left electric parking brake: a357 vc trailer detected";
CM_ SG_ 1480 EPBL_a357_uiTrailerDetected "Left electric parking brake: a357 ui trailer detected";
CM_ SG_ 1480 EPBL_a357_trailerDetected "Left electric parking brake: a357 trailer detected";
CM_ SG_ 1480 EPBL_a358_epbSystemStatus "Left electric parking brake: a358 epb system status";
CM_ SG_ 1480 EPBL_a358_grade "Left electric parking brake: a358 grade";
CM_ SG_ 1480 EPBL_a358_ambientTemp "Left electric parking brake: a358 ambient temp";
CM_ SG_ 1480 EPBL_a358_brakeTemp "Left electric parking brake: a358 brake temp";
CM_ SG_ 1480 EPBL_a358_vcTrailerDetected "Left electric parking brake: a358 vc trailer detected";
CM_ SG_ 1480 EPBL_a358_uiTrailerDetected "Left electric parking brake: a358 ui trailer detected";
CM_ SG_ 1480 EPBL_a358_trailerDetected "Left electric parking brake: a358 trailer detected";
CM_ SG_ 1480 EPBL_a365_epbSystemStatus "Left electric parking brake: a365 epb system status";
CM_ SG_ 1480 EPBL_a365_grade "Left electric parking brake: a365 grade";
CM_ SG_ 1480 EPBL_a365_ambientTemp "Left electric parking brake: a365 ambient temp";
CM_ SG_ 1480 EPBL_a365_vcTrailerDetected "Left electric parking brake: a365 vc trailer detected";
CM_ SG_ 1480 EPBL_a365_uiTrailerDetected "Left electric parking brake: a365 ui trailer detected";
CM_ SG_ 1480 EPBL_a365_trailerDetected "Left electric parking brake: a365 trailer detected";
CM_ SG_ 1480 EPBL_a366_epbSystemStatus "Left electric parking brake: a366 epb system status";
CM_ SG_ 1480 EPBL_a366_grade "Left electric parking brake: a366 grade";
CM_ SG_ 1480 EPBL_a366_ambientTemp "Left electric parking brake: a366 ambient temp";
CM_ SG_ 1480 EPBL_a366_vcTrailerDetected "Left electric parking brake: a366 vc trailer detected";
CM_ SG_ 1480 EPBL_a366_uiTrailerDetected "Left electric parking brake: a366 ui trailer detected";
CM_ SG_ 1480 EPBL_a366_trailerDetected "Left electric parking brake: a366 trailer detected";
BA_DEF_ BO_ "GenMsgCycleTime" INT 0 3600000;
BA_DEF_ BO_ "GenMsgSendType" ENUM "Cyclic","NotUsed","NotUsed","NotUsed","NotUsed","NotUsed","NotUsed","IfActive","NoMsgSendType","NotUsed";
BA_DEF_ BO_ "VFrameFormat" ENUM "StandardCAN","ExtendedCAN","reserved","J1939PG","reserved","reserved","reserved","reserved","reserved","reserved","reserved","reserved","reserved","reserved","StandardCAN_FD","ExtendedCAN_FD";
BA_DEF_ BO_ "CANFD_BRS" ENUM "0","1";
BA_DEF_ SG_ "GenSigSNA" STRING;
BA_DEF_ SG_ "SystemSignalLongSymbol" STRING;
BA_DEF_ SG_ "Confidence" ENUM "validated","plausible","layout-only","contradicted";
BA_DEF_DEF_ "GenMsgCycleTime" 0;
BA_DEF_DEF_ "GenMsgSendType" "NoMsgSendType";
BA_DEF_DEF_ "VFrameFormat" "StandardCAN";
BA_DEF_DEF_ "CANFD_BRS" "1";
BA_DEF_DEF_ "GenSigSNA" "";
BA_DEF_DEF_ "SystemSignalLongSymbol" "";
BA_DEF_DEF_ "Confidence" "layout-only";
BA_ "Confidence" SG_ 1480 EPBL_alertID 1;
BA_ "Confidence" SG_ 1480 EPBL_alertState 1;
BA_ "Confidence" SG_ 1480 EPBL_a059_voltageDrop 1;
BA_ "Confidence" SG_ 1480 EPBL_a059_resistanceEstimate 1;
BA_ "Confidence" SG_ 1480 EPBL_a059_current 1;
BA_ "Confidence" SG_ 1480 EPBL_a063_ADCVoltage 1;
BA_ "SystemSignalLongSymbol" SG_ 1480 EPBL_a101_LIPC_externalWatchdogH "EPBL_a101_LIPC_externalWatchdogHeartBeat";
BA_ "Confidence" SG_ 1480 EPBL_a110_VEH_carState 1;
BA_ "Confidence" SG_ 1480 EPBL_a110_VEH_carConfig 1;
BA_ "Confidence" SG_ 1480 EPBL_a110_VEH_time 1;
BA_ "Confidence" SG_ 1480 EPBL_a110_VEH_updateStatus 1;
BA_ "Confidence" SG_ 1480 EPBL_a110_VEH_vehNm 1;
BA_ "Confidence" SG_ 1480 EPBL_a110_VEH_mismatchFault 1;
BA_ "Confidence" SG_ 1480 EPBL_a110_VEH_vin 1;
BA_ "Confidence" SG_ 1480 EPBL_a110_VEH_bmpDebug 1;
BA_ "Confidence" SG_ 1480 EPBL_a110_VEH_gearControl 1;
BA_ "Confidence" SG_ 1480 EPBL_a110_VEH_canLogAvailability 1;
BA_ "Confidence" SG_ 1480 EPBL_a110_CH_airbagCutoffStatus 1;
BA_ "Confidence" SG_ 1480 EPBL_a110_CH_carConfig 1;
BA_ "Confidence" SG_ 1480 EPBL_a110_CH_carState 1;
BA_ "Confidence" SG_ 1480 EPBL_a110_CH_vin 1;
BA_ "Confidence" SG_ 1480 EPBL_a110_CH_chNm 1;
BA_ "Confidence" SG_ 1480 EPBL_a110_CH_epochTimeGtw 1;
BA_ "SystemSignalLongSymbol" SG_ 1480 EPBL_a115_UI_corianderVehicleCon "EPBL_a115_UI_corianderVehicleControl";
BA_ "SystemSignalLongSymbol" SG_ 1480 EPBL_a117_VEH_intrusionSensorSta "EPBL_a117_VEH_intrusionSensorStatus";
BA_ "SystemSignalLongSymbol" SG_ 1480 EPBL_a118_PARTY_outputPowerStatu "EPBL_a118_PARTY_outputPowerStatus";
BA_ "SystemSignalLongSymbol" SG_ 1480 EPBL_a118_VEH_interNodeResistanc "EPBL_a118_VEH_interNodeResistance";
BA_ "SystemSignalLongSymbol" SG_ 1480 EPBL_a118_PARTY_AP_vehicleState1 "EPBL_a118_PARTY_AP_vehicleState1HzMuxed";
BA_ "SystemSignalLongSymbol" SG_ 1480 EPBL_a118_BDY_AP_vehicleState1Hz "EPBL_a118_BDY_AP_vehicleState1HzMuxed";
BA_ "SystemSignalLongSymbol" SG_ 1480 EPBL_a120_VEH_aggregatedAxleSpee "EPBL_a120_VEH_aggregatedAxleSpeed";
BA_ "SystemSignalLongSymbol" SG_ 1480 EPBL_a120_PARTY_aggregatedAxleSp "EPBL_a120_PARTY_aggregatedAxleSpeed";
BA_ "SystemSignalLongSymbol" SG_ 1480 EPBL_a120_PARTY_stalklessInterfa "EPBL_a120_PARTY_stalklessInterfaces";
BA_ "Confidence" SG_ 1480 EPBL_a122_filteredCurrentCal 1;
BA_ "Confidence" SG_ 1480 EPBL_a123_filteredCurrentCal 1;
BA_ "Confidence" SG_ 1480 EPBL_a125_pvFilt 1;
BA_ "Confidence" SG_ 1480 EPBL_a125_nvFilt 1;
BA_ "Confidence" SG_ 1480 EPBL_a125_12vFilt 1;
BA_ "Confidence" SG_ 1480 EPBL_a126_pvFilt 1;
BA_ "Confidence" SG_ 1480 EPBL_a126_nvFilt 1;
BA_ "Confidence" SG_ 1480 EPBL_a126_12vFilt 1;
BA_ "Confidence" SG_ 1480 EPBL_a127_pvFilt 1;
BA_ "Confidence" SG_ 1480 EPBL_a127_nvFilt 1;
BA_ "Confidence" SG_ 1480 EPBL_a127_12vFilt 1;
BA_ "Confidence" SG_ 1480 EPBL_a128_pvFilt 1;
BA_ "Confidence" SG_ 1480 EPBL_a128_nvFilt 1;
BA_ "Confidence" SG_ 1480 EPBL_a128_12vFilt 1;
BA_ "Confidence" SG_ 1480 EPBL_a134_pvFilt 1;
BA_ "Confidence" SG_ 1480 EPBL_a134_nvFilt 1;
BA_ "Confidence" SG_ 1480 EPBL_a134_12vFilt 1;
BA_ "Confidence" SG_ 1480 EPBL_a135_pvFilt 1;
BA_ "Confidence" SG_ 1480 EPBL_a135_nvFilt 1;
BA_ "Confidence" SG_ 1480 EPBL_a135_12vFilt 1;
BA_ "Confidence" SG_ 1480 EPBL_a136_pvFilt 1;
BA_ "Confidence" SG_ 1480 EPBL_a136_nvFilt 1;
BA_ "Confidence" SG_ 1480 EPBL_a136_12vFilt 1;
BA_ "Confidence" SG_ 1480 EPBL_a137_pvFilt 1;
BA_ "Confidence" SG_ 1480 EPBL_a137_nvFilt 1;
BA_ "Confidence" SG_ 1480 EPBL_a137_12vFilt 1;
BA_ "Confidence" SG_ 1480 EPBL_a138_localState 1;
BA_ "Confidence" SG_ 1480 EPBL_a138_monitorState 1;
BA_ "Confidence" SG_ 1480 EPBL_a139_localState 1;
BA_ "Confidence" SG_ 1480 EPBL_a139_monitorState 1;
BA_ "Confidence" SG_ 1480 EPBL_a141_fromState 1;
BA_ "Confidence" SG_ 1480 EPBL_a141_toState 1;
BA_ "Confidence" SG_ 1480 EPBL_a170_pvFilt 1;
BA_ "Confidence" SG_ 1480 EPBL_a170_nvFilt 1;
BA_ "Confidence" SG_ 1480 EPBL_a170_12vFilt 1;
BA_ "Confidence" SG_ 1480 EPBL_a171_pvFilt 1;
BA_ "Confidence" SG_ 1480 EPBL_a171_nvFilt 1;
BA_ "Confidence" SG_ 1480 EPBL_a171_12vFilt 1;
BA_ "Confidence" SG_ 1480 EPBL_a174_esmState 1;
BA_ "Confidence" SG_ 1480 EPBL_a174_esmStateRequest 1;
BA_ "Confidence" SG_ 1480 EPBL_a174_faultStatus 1;
BA_ "Confidence" SG_ 1480 EPBL_a174_monitorUnitStatus 1;
BA_ "Confidence" SG_ 1480 EPBL_a174_monitorFaultStatus 1;
BA_ "Confidence" SG_ 1480 EPBL_a174_csmFaultReason 1;
BA_ "Confidence" SG_ 1480 EPBL_a174_esmOpTrigger 1;
BA_ "Confidence" SG_ 1480 EPBL_a174_nonterminalReason 1;
BA_ "Confidence" SG_ 1480 EPBL_a175_esmState 1;
BA_ "Confidence" SG_ 1480 EPBL_a175_esmStateRequest 1;
BA_ "Confidence" SG_ 1480 EPBL_a175_faultStatus 1;
BA_ "Confidence" SG_ 1480 EPBL_a175_monitorUnitStatus 1;
BA_ "Confidence" SG_ 1480 EPBL_a175_monitorFaultStatus 1;
BA_ "Confidence" SG_ 1480 EPBL_a175_csmFaultReason 1;
BA_ "Confidence" SG_ 1480 EPBL_a175_esmOpTrigger 1;
BA_ "Confidence" SG_ 1480 EPBL_a175_nonterminalReason 1;
BA_ "Confidence" SG_ 1480 EPBL_a176_esmState 1;
BA_ "Confidence" SG_ 1480 EPBL_a176_esmStateRequest 1;
BA_ "Confidence" SG_ 1480 EPBL_a176_faultStatus 1;
BA_ "Confidence" SG_ 1480 EPBL_a176_monitorUnitStatus 1;
BA_ "Confidence" SG_ 1480 EPBL_a176_monitorFaultStatus 1;
BA_ "Confidence" SG_ 1480 EPBL_a176_csmFaultReason 1;
BA_ "Confidence" SG_ 1480 EPBL_a176_esmOpTrigger 1;
BA_ "Confidence" SG_ 1480 EPBL_a176_nonterminalReason 1;
BA_ "Confidence" SG_ 1480 EPBL_a177_esmState 1;
BA_ "Confidence" SG_ 1480 EPBL_a177_esmStateRequest 1;
BA_ "Confidence" SG_ 1480 EPBL_a177_faultStatus 1;
BA_ "Confidence" SG_ 1480 EPBL_a177_monitorUnitStatus 1;
BA_ "Confidence" SG_ 1480 EPBL_a177_monitorFaultStatus 1;
BA_ "Confidence" SG_ 1480 EPBL_a177_csmFaultReason 1;
BA_ "Confidence" SG_ 1480 EPBL_a177_esmOpTrigger 1;
BA_ "Confidence" SG_ 1480 EPBL_a177_nonterminalReason 1;
BA_ "Confidence" SG_ 1480 EPBL_a178_localCaliperState 1;
BA_ "Confidence" SG_ 1480 EPBL_a178_monitorCaliperState 1;
BA_ "Confidence" SG_ 1480 EPBL_a179_esmState 1;
BA_ "Confidence" SG_ 1480 EPBL_a179_esmStateRequest 1;
BA_ "Confidence" SG_ 1480 EPBL_a179_faultStatus 1;
BA_ "Confidence" SG_ 1480 EPBL_a179_monitorUnitStatus 1;
BA_ "Confidence" SG_ 1480 EPBL_a179_monitorFaultStatus 1;
BA_ "Confidence" SG_ 1480 EPBL_a179_csmFaultReason 1;
BA_ "Confidence" SG_ 1480 EPBL_a179_esmOpTrigger 1;
BA_ "Confidence" SG_ 1480 EPBL_a179_nonterminalReason 1;
BA_ "Confidence" SG_ 1480 EPBL_a180_esmOpTrigger 1;
BA_ "Confidence" SG_ 1480 EPBL_a180_previousState 1;
BA_ "Confidence" SG_ 1480 EPBL_a180_nextState 1;
BA_ "Confidence" SG_ 1480 EPBL_a181_grade 1;
BA_ "Confidence" SG_ 1480 EPBL_a182_epbSystemStatus 1;
BA_ "Confidence" SG_ 1480 EPBL_a182_grade 1;
BA_ "Confidence" SG_ 1480 EPBL_a182_temperature 1;
BA_ "Confidence" SG_ 1480 EPBL_a183_localCdpState 1;
BA_ "Confidence" SG_ 1480 EPBL_a183_remoteCdpState 1;
BA_ "Confidence" SG_ 1480 EPBL_a183_espCdpStatus 1;
BA_ "Confidence" SG_ 1480 EPBL_a183_esmState 1;
BA_ "Confidence" SG_ 1480 EPBL_a183_esmStateRequest 1;
BA_ "Confidence" SG_ 1480 EPBL_a183_esmOperationTrigger 1;
BA_ "SystemSignalLongSymbol" SG_ 1480 EPBL_a183_redundantBrakingEnable "EPBL_a183_redundantBrakingEnabled";
BA_ "Confidence" SG_ 1480 EPBL_a184_esmOpTrigger 1;
BA_ "Confidence" SG_ 1480 EPBL_a184_previousState 1;
BA_ "Confidence" SG_ 1480 EPBL_a184_nextState 1;
BA_ "Confidence" SG_ 1480 EPBL_a187_esmOpTrigger 1;
BA_ "Confidence" SG_ 1480 EPBL_a187_previousState 1;
BA_ "Confidence" SG_ 1480 EPBL_a187_nextState 1;
BA_ "Confidence" SG_ 1480 EPBL_a188_esmOpTrigger 1;
BA_ "Confidence" SG_ 1480 EPBL_a188_previousState 1;
BA_ "Confidence" SG_ 1480 EPBL_a188_nextState 1;
BA_ "Confidence" SG_ 1480 EPBL_a189_esmOpTrigger 1;
BA_ "Confidence" SG_ 1480 EPBL_a189_previousState 1;
BA_ "Confidence" SG_ 1480 EPBL_a189_nextState 1;
BA_ "Confidence" SG_ 1480 EPBL_a190_esmState 1;
BA_ "Confidence" SG_ 1480 EPBL_a190_esmStateRequest 1;
BA_ "Confidence" SG_ 1480 EPBL_a190_faultStatus 1;
BA_ "Confidence" SG_ 1480 EPBL_a190_monitorUnitStatus 1;
BA_ "Confidence" SG_ 1480 EPBL_a190_monitorFaultStatus 1;
BA_ "Confidence" SG_ 1480 EPBL_a190_csmFaultReason 1;
BA_ "Confidence" SG_ 1480 EPBL_a190_esmOpTrigger 1;
BA_ "Confidence" SG_ 1480 EPBL_a190_nonterminalReason 1;
BA_ "Confidence" SG_ 1480 EPBL_a191_esmState 1;
BA_ "Confidence" SG_ 1480 EPBL_a191_esmStateRequest 1;
BA_ "Confidence" SG_ 1480 EPBL_a191_faultStatus 1;
BA_ "Confidence" SG_ 1480 EPBL_a191_monitorUnitStatus 1;
BA_ "Confidence" SG_ 1480 EPBL_a191_monitorFaultStatus 1;
BA_ "Confidence" SG_ 1480 EPBL_a191_csmFaultReason 1;
BA_ "Confidence" SG_ 1480 EPBL_a191_esmOpTrigger 1;
BA_ "Confidence" SG_ 1480 EPBL_a191_nonterminalReason 1;
BA_ "Confidence" SG_ 1480 EPBL_a202_localEpbConfig 1;
BA_ "Confidence" SG_ 1480 EPBL_a202_remoteEpbConfig 1;
BA_ "Confidence" SG_ 1480 EPBL_a203_gtwConfig 1;
BA_ "Confidence" SG_ 1480 EPBL_a203_epbConfig 1;
BA_ "SystemSignalLongSymbol" SG_ 1480 EPBL_a210_driverLeftForAllSensor "EPBL_a210_driverLeftForAllSensors";
BA_ "SystemSignalLongSymbol" SG_ 1480 EPBL_a210_driverLeftForInactivit "EPBL_a210_driverLeftForInactivity";
BA_ "Confidence" SG_ 1480 EPBL_a210_driverIsLeavingSpeedCl 1;
BA_ "SystemSignalLongSymbol" SG_ 1480 EPBL_a210_driverIsLeavingSpeedCl "EPBL_a210_driverIsLeavingSpeedClass";
BA_ "SystemSignalLongSymbol" SG_ 1480 EPBL_a210_localDriverIsLeavingAn "EPBL_a210_localDriverIsLeavingAnySpeed";
BA_ "SystemSignalLongSymbol" SG_ 1480 EPBL_a210_remoteDriverIsLeavingA "EPBL_a210_remoteDriverIsLeavingAnySpeed";
BA_ "Confidence" SG_ 1480 EPBL_a210_primaryDriverDoorClose 1;
BA_ "GenSigSNA" SG_ 1480 EPBL_a210_primaryDriverDoorClose "2";
BA_ "SystemSignalLongSymbol" SG_ 1480 EPBL_a210_primaryDriverDoorClose "EPBL_a210_primaryDriverDoorClosed";
BA_ "Confidence" SG_ 1480 EPBL_a210_secondaryDriverDoorClo 1;
BA_ "GenSigSNA" SG_ 1480 EPBL_a210_secondaryDriverDoorClo "2";
BA_ "SystemSignalLongSymbol" SG_ 1480 EPBL_a210_secondaryDriverDoorClo "EPBL_a210_secondaryDriverDoorClosed";
BA_ "Confidence" SG_ 1480 EPBL_a210_driverBuckled 1;
BA_ "GenSigSNA" SG_ 1480 EPBL_a210_driverBuckled "2";
BA_ "Confidence" SG_ 1480 EPBL_a210_driverSeated 1;
BA_ "GenSigSNA" SG_ 1480 EPBL_a210_driverSeated "2";
BA_ "Confidence" SG_ 1480 EPBL_a225_esmOpTrigger 1;
BA_ "Confidence" SG_ 1480 EPBL_a225_previousState 1;
BA_ "Confidence" SG_ 1480 EPBL_a225_nextState 1;
BA_ "Confidence" SG_ 1480 EPBL_a241_epbSysStatus 1;
BA_ "Confidence" SG_ 1480 EPBL_a241_vehiclePowerState 1;
BA_ "Confidence" SG_ 1480 EPBL_a242_hvState 1;
BA_ "Confidence" SG_ 1480 EPBL_a242_vehiclePowerState 1;
BA_ "Confidence" SG_ 1480 EPBL_a246_previousState 1;
BA_ "Confidence" SG_ 1480 EPBL_a246_nextState 1;
BA_ "Confidence" SG_ 1480 EPBL_a246_esmStateRequest 1;
BA_ "Confidence" SG_ 1480 EPBL_a246_faultStatus 1;
BA_ "Confidence" SG_ 1480 EPBL_a246_esmOpTrigger 1;
BA_ "Confidence" SG_ 1480 EPBL_a247_esmState 1;
BA_ "Confidence" SG_ 1480 EPBL_a247_esmStateRequest 1;
BA_ "Confidence" SG_ 1480 EPBL_a247_faultStatus 1;
BA_ "Confidence" SG_ 1480 EPBL_a247_monitorUnitStatus 1;
BA_ "Confidence" SG_ 1480 EPBL_a247_monitorFaultStatus 1;
BA_ "Confidence" SG_ 1480 EPBL_a247_csmFaultReason 1;
BA_ "Confidence" SG_ 1480 EPBL_a247_esmOpTrigger 1;
BA_ "Confidence" SG_ 1480 EPBL_a247_nonterminalReason 1;
BA_ "Confidence" SG_ 1480 EPBL_a248_esmState 1;
BA_ "Confidence" SG_ 1480 EPBL_a248_esmStateRequest 1;
BA_ "Confidence" SG_ 1480 EPBL_a248_faultStatus 1;
BA_ "Confidence" SG_ 1480 EPBL_a248_monitorUnitStatus 1;
BA_ "Confidence" SG_ 1480 EPBL_a248_monitorFaultStatus 1;
BA_ "Confidence" SG_ 1480 EPBL_a248_csmFaultReason 1;
BA_ "Confidence" SG_ 1480 EPBL_a248_esmOpTrigger 1;
BA_ "Confidence" SG_ 1480 EPBL_a248_nonterminalReason 1;
BA_ "Confidence" SG_ 1480 EPBL_a249_previousState 1;
BA_ "Confidence" SG_ 1480 EPBL_a249_nextState 1;
BA_ "Confidence" SG_ 1480 EPBL_a249_esmStateRequest 1;
BA_ "Confidence" SG_ 1480 EPBL_a249_faultStatus 1;
BA_ "Confidence" SG_ 1480 EPBL_a249_esmOpTrigger 1;
BA_ "Confidence" SG_ 1480 EPBL_a250_esmSpeedClass 1;
BA_ "Confidence" SG_ 1480 EPBL_a250_esmOperationTrigger 1;
BA_ "Confidence" SG_ 1480 EPBL_a251_currentVariance 1;
BA_ "Confidence" SG_ 1480 EPBL_a251_pistonPosition 1;
BA_ "Confidence" SG_ 1480 EPBL_a251_temperature 1;
BA_ "Confidence" SG_ 1480 EPBL_a272_expectedState 1;
BA_ "Confidence" SG_ 1480 EPBL_a272_actualState 1;
BA_ "Confidence" SG_ 1480 EPBL_a301_setSpeed 1;
BA_ "Confidence" SG_ 1480 EPBL_a301_oocDistanceFiltered 1;
BA_ "Confidence" SG_ 1480 EPBL_a302_pistonPosition 1;
BA_ "Confidence" SG_ 1480 EPBL_a302_deltaCurrent 1;
BA_ "Confidence" SG_ 1480 EPBL_a303_currentVariance 1;
BA_ "Confidence" SG_ 1480 EPBL_a303_pistonPosition 1;
BA_ "Confidence" SG_ 1480 EPBL_a303_temperature 1;
BA_ "Confidence" SG_ 1480 EPBL_a350_ensPeriod 1;
BA_ "Confidence" SG_ 1480 EPBL_a350_ensDuty 1;
BA_ "Confidence" SG_ 1480 EPBL_a355_brakeHwConfig 1;
BA_ "Confidence" SG_ 1480 EPBL_a355_epbHwConfig 1;
BA_ "Confidence" SG_ 1480 EPBL_a357_epbSystemStatus 1;
BA_ "Confidence" SG_ 1480 EPBL_a357_grade 1;
BA_ "Confidence" SG_ 1480 EPBL_a357_ambientTemp 1;
BA_ "Confidence" SG_ 1480 EPBL_a357_brakeTemp 1;
BA_ "Confidence" SG_ 1480 EPBL_a358_epbSystemStatus 1;
BA_ "Confidence" SG_ 1480 EPBL_a358_grade 1;
BA_ "Confidence" SG_ 1480 EPBL_a358_ambientTemp 1;
BA_ "Confidence" SG_ 1480 EPBL_a358_brakeTemp 1;
BA_ "Confidence" SG_ 1480 EPBL_a365_epbSystemStatus 1;
BA_ "Confidence" SG_ 1480 EPBL_a365_grade 1;
BA_ "Confidence" SG_ 1480 EPBL_a365_ambientTemp 1;
BA_ "Confidence" SG_ 1480 EPBL_a366_epbSystemStatus 1;
BA_ "Confidence" SG_ 1480 EPBL_a366_grade 1;
BA_ "Confidence" SG_ 1480 EPBL_a366_ambientTemp 1;
VAL_ 1480 EPBL_alertID 366 "a366_TooSteepToParkWithTrailerUnSecEnv" 365 "a365_TooSteepToParkWithTrailerWarning" 364 "a364_espMasterCylCompOverThreshold" 363 "a363_ibstNotPressedEspPressedMismatch" 362 "a362_ibstPressedEspNotPressedMismatch" 361 "a361_espBrakeSwitchInvalid" 360 "a360_ibstBrakeSwitchInvalid" 358 "a358_brakesTooHotForSlopeWithOnlyOneEpb" 357 "a357_brakesTooHotForSlope" 356 "a356_parkingForStationaryDetect" 355 "a355_brakeHwAndEpbHwMismatch" 354 "a354_parkedForLowBrakeFluidMode" 353 "a353_missingSpeedUnableToPark" 352 "a352_audioCurrentSpikeData" 350 "a350_ensOutOfRange" 305 "a305_premiumAmpEFuseTrip" 304 "a304_rearSeatControllerEFuseTrip" 303 "a303_clampingOccuredEarly" 302 "a302_csmLongRelease" 301 "a301_oocSpeedViolation" 300 "a300_leftRightConfusion" 272 "a272_vhclPwrStateMsmtch" 264 "a264_winchModeDeactivated" 263 "a263_epbRecoveryPark" 262 "a262_cannotPrepareWinchMode" 261 "a261_winchModeWithoutSteering" 256 "a256_epbSystemApply" 254 "a254_showStalkParkButtonFaultOnUi" 253 "a253_esmReleaseBlocked" 252 "a252_winchModePending" 251 "a251_currentVarianceHigh" 250 "a250_WinchModeCanceled" 249 "a249_idleFaultRelease" 248 "a248_csmDynamicApplyFailed" 247 "a247_csmDynamicApplyRetry" 246 "a246_idleFaultApply" 245 "a245_serviceModeActive" 244 "a244_WinchModeActive" 243 "a243_bdwUnavailable" 242 "a242_hvOutputLocked" 241 "a241_diOutputLocked" 225 "a225_epbActiveDecel" 217 "a217_SPI_MIA_debugData2" 216 "a216_SPI_MIA_debugData1" 210 "a210_parkForDriverIsLeavingDebug" 203 "a203_hwBrakeTypeMismatch" 202 "a202_remoteEpbConfigIncompatible" 200 "a200_PmUnparkNotAllowed" 198 "a198_holdClampComplete" 197 "a197_freeRollModeAtSpeed" 196 "a196_freeRollModeActive" 195 "a195_parkForDriverIsLeaving" 191 "a191_csmReleaseDegraded" 190 "a190_csmApplyDegraded" 189 "a189_epbDynamicParkCanceled" 188 "a188_epbDynamic" 187 "a187_cdpDynamic" 186 "a186_externalParkAbort" 185 "a185_summonAborted" 184 "a184_dynamicParkAbort" 183 "a183_cdpNotAvailable" 182 "a182_OneEPBAppliedUnsecEnv" 181 "a181_TooSteepGradeToPark" 180 "a180_dynamicActive" 179 "a179_epbProblem" 178 "a178_caliperStateUnknown" 177 "a177_csmApplyRetry" 176 "a176_csmApplyFailed" 175 "a175_csmReleaseRetry" 174 "a174_csmReleaseFailed" 173 "a173_hiCurrentMissing" 172 "a172_SPI_MIA" 171 "a171_12vUv" 170 "a170_12vOv" 141 "a141_invalidState" 140 "a140_NvmSlowWrite" 139 "a139_NvmRedundancyLoss" 138 "a138_NvmDualFailure" 137 "a137_PvUv" 136 "a136_PvOv" 135 "a135_NvUv" 134 "a134_NvOv" 132 "a132_VCBATT1_MIA" 131 "a131_RCU_MIA" 130 "a130_BB_MIA" 129 "a129_ICR_MIA" 128 "a128_MotorPVoltHigh" 127 "a127_MotorNVoltHigh" 126 "a126_MotorNVoltLow" 125 "a125_IdleVMismatch" 124 "a124_calOutOfBounds" 123 "a123_Uc" 122 "a122_Oc" 121 "a121_nDriveFault" 120 "a120_DI_DRIVE_MIA" 119 "a119_SCCM_MIA" 118 "a118_VCFRONT_MIA" 117 "a117_VCLEFT_MIA" 116 "a116_VCRIGHT_MIA" 115 "a115_VCSEC_MIA" 114 "a114_ESP_MIA" 113 "a113_UI_MIA" 112 "a112_EPBL_MIA" 111 "a111_EPBR_MIA" 110 "a110_GTW_MIA" 109 "a109_RCM_MIA" 108 "a108_DIF_MIA" 107 "a107_BMS_MIA" 106 "a106_PCS_MIA" 105 "a105_TAS_MIA" 104 "a104_DAS_MIA" 103 "a103_CP_MIA" 102 "a102_PTC_MIA" 101 "a101_PM_MIA" 100 "a100_CANbus_MIA" 99 "a099_PARK_MIA" 98 "a098_DIR_MIA" 97 "a097_CMP_MIA" 96 "a096_OCS1P_MIA" 95 "a095_CHG_MIA" 94 "a094_EPAS3P_MIA" 93 "a093_VCSEATP_MIA" 92 "a092_VCSEATD_MIA" 91 "a091_CMPD_MIA" 90 "a090_APS_MIA" 89 "a089_IBST_MIA" 88 "a088_DIRER_MIA" 87 "a087_DIREL_MIA" 86 "a086_VCBATT_MIA" 85 "a085_CCCM_MIA" 84 "a084_TPMS_MIA" 83 "a083_VCLEFT_IPC_MIA" 82 "a082_VCRIGHT_IPC_MIA" 81 "a081_APP_MIA" 64 "a064_busSleepReqTimeout" 63 "a063_SwitchFault" 62 "a062_XCPWasConnected" 61 "a061_XCPConnected" 60 "a060_engineeringBuild" 59 "a059_inputResistanceHigh" 58 "a058_inputRHighSyncDebug" 57 "a057_HVP_MIA" 46 "a046_Task1000msError" 45 "a045_Task100msError" 44 "a044_Task10msError" 43 "a043_Task1msError" 42 "a042_HighStackUsage" 41 "a041_HighCPULoad" 31 "a031_UDSActive" 30 "a030_ECULogUploadRequest" 29 "a029_CoreDump" 22 "a022_TaskInitError" 21 "a021_TaskSchedulerError" 16 "a016_NVMMRecordError" 15 "a015_NVMMError" 13 "a013_AlertManagerFault" 12 "a012_CPUReset" 6 "a006_CANTX_cyclicError" 5 "a005_CANTXError" 3 "a003_SWAssertion" 2 "a002_PowerLossReset" 1 "a001_WatchdogReset" 0 "ALERT_DO_NOT_USE_ZERO" ;
VAL_ 1480 EPBL_alertState 1 "SET" 0 "CLEARED" ;
VAL_ 1480 EPBL_a138_localState 6 "WINCHMODE" 5 "SERVICE" 4 "OPEN" 3 "PARK" 2 "REAPPLY" 1 "UNKNOWN" 0 "UNSAVED" ;
VAL_ 1480 EPBL_a138_monitorState 6 "WINCHMODE" 5 "SERVICE" 4 "OPEN" 3 "PARK" 2 "REAPPLY" 1 "UNKNOWN" 0 "UNSAVED" ;
VAL_ 1480 EPBL_a139_localState 6 "WINCHMODE" 5 "SERVICE" 4 "OPEN" 3 "PARK" 2 "REAPPLY" 1 "UNKNOWN" 0 "UNSAVED" ;
VAL_ 1480 EPBL_a139_monitorState 6 "WINCHMODE" 5 "SERVICE" 4 "OPEN" 3 "PARK" 2 "REAPPLY" 1 "UNKNOWN" 0 "UNSAVED" ;
VAL_ 1480 EPBL_a141_fromState 21 "UNKNOWN" 20 "SYSTEM_DYNAMIC_EXTERNAL" 19 "FREE_ROLL_MODE" 18 "DYNAMIC_EXTERNAL_EXIT" 17 "SERVICE_PENDING" 16 "LATCHED_DYNAMIC_EXTERNAL" 15 "DYNAMIC_PENDING" 14 "DYNAMIC_EXTERNAL" 13 "SUMMON_PARK" 12 "WINCHMODE_PENDING" 11 "PARK_PENDING" 10 "DYNAMIC_PARK" 9 "DIAGNOSTIC_OPEN" 8 "DIAGNOSTIC_PARK" 7 "SERVICE" 6 "WINCHMODE" 5 "SUMMON" 4 "DYNAMIC" 3 "OPEN" 2 "REAPPLY" 1 "PARK" 0 "INIT" ;
VAL_ 1480 EPBL_a141_toState 21 "UNKNOWN" 20 "SYSTEM_DYNAMIC_EXTERNAL" 19 "FREE_ROLL_MODE" 18 "DYNAMIC_EXTERNAL_EXIT" 17 "SERVICE_PENDING" 16 "LATCHED_DYNAMIC_EXTERNAL" 15 "DYNAMIC_PENDING" 14 "DYNAMIC_EXTERNAL" 13 "SUMMON_PARK" 12 "WINCHMODE_PENDING" 11 "PARK_PENDING" 10 "DYNAMIC_PARK" 9 "DIAGNOSTIC_OPEN" 8 "DIAGNOSTIC_PARK" 7 "SERVICE" 6 "WINCHMODE" 5 "SUMMON" 4 "DYNAMIC" 3 "OPEN" 2 "REAPPLY" 1 "PARK" 0 "INIT" ;
VAL_ 1480 EPBL_a174_esmState 21 "UNKNOWN" 20 "SYSTEM_DYNAMIC_EXTERNAL" 19 "FREE_ROLL_MODE" 18 "DYNAMIC_EXTERNAL_EXIT" 17 "SERVICE_PENDING" 16 "LATCHED_DYNAMIC_EXTERNAL" 15 "DYNAMIC_PENDING" 14 "DYNAMIC_EXTERNAL" 13 "SUMMON_PARK" 12 "WINCHMODE_PENDING" 11 "PARK_PENDING" 10 "DYNAMIC_PARK" 9 "DIAGNOSTIC_OPEN" 8 "DIAGNOSTIC_PARK" 7 "SERVICE" 6 "WINCHMODE" 5 "SUMMON" 4 "DYNAMIC" 3 "OPEN" 2 "REAPPLY" 1 "PARK" 0 "INIT" ;
VAL_ 1480 EPBL_a174_esmStateRequest 21 "UNKNOWN" 20 "SYSTEM_DYNAMIC_EXTERNAL" 19 "FREE_ROLL_MODE" 18 "DYNAMIC_EXTERNAL_EXIT" 17 "SERVICE_PENDING" 16 "LATCHED_DYNAMIC_EXTERNAL" 15 "DYNAMIC_PENDING" 14 "DYNAMIC_EXTERNAL" 13 "SUMMON_PARK" 12 "WINCHMODE_PENDING" 11 "PARK_PENDING" 10 "DYNAMIC_PARK" 9 "DIAGNOSTIC_OPEN" 8 "DIAGNOSTIC_PARK" 7 "SERVICE" 6 "WINCHMODE" 5 "SUMMON" 4 "DYNAMIC" 3 "OPEN" 2 "REAPPLY" 1 "PARK" 0 "INIT" ;
VAL_ 1480 EPBL_a174_faultStatus 3 "FAULT_IDLE" 2 "FAULT" 1 "RETRY" 0 "NOMINAL" ;
VAL_ 1480 EPBL_a174_monitorUnitStatus 22 "COUNT" 21 "FREE_ROLL_MODE" 20 "DYNAMIC_PARKING" 19 "EXTERNAL_PARKING" 18 "RELEASING_FOR_EXTERNAL_PARK" 17 "EXTERNAL_DYNAMIC" 16 "SUMMON_PARKING" 15 "SUMMON_RELEASING" 14 "SUMMON" 13 "WINCHMODE_PENDING" 12 "PARK_PENDING" 11 "SERVICE_RELEASING" 10 "RELEASING" 9 "DYNAMIC_APPLYING" 8 "PARKING" 7 "WINCHMODE_RELEASING" 6 "WINCHMODE" 5 "SERVICE" 4 "START" 3 "PARK" 2 "DYNAMIC" 1 "OPEN" 0 "UNKNOWN" ;
VAL_ 1480 EPBL_a174_monitorFaultStatus 3 "FAULT_IDLE" 2 "FAULT" 1 "RETRY" 0 "NOMINAL" ;
VAL_ 1480 EPBL_a174_csmFaultReason 23 "REMOTE_MIA" 22 "NVM_MISMATCH" 21 "EPBM_MIA" 20 "MOTOR_NOT_READY" 19 "MOTOR_ACTIVE_FAULT" 18 "MOTOR_IDLE_FAULT" 17 "TIMEOUT_EPBM_START" 16 "TIMEOUT_NO_RAMP" 15 "TIMEOUT_EPBM_CUTOFF" 14 "TIMEOUT_RELEASE_COMPLETE" 13 "TIMEOUT_RELEASE_NO_LOAD" 12 "TIMEOUT_RELEASE_WAIT_FOR_ENDSTOP" 11 "TIMEOUT_RELEASE_INRUSH" 10 "TIMEOUT_EPBM_WAIT_FOR_CLAMP" 9 "TIMEOUT_EPB_WAIT_FOR_CLAMP" 8 "TIMEOUT_APPLY_INRUSH" 7 "TIMEOUT_APPLY_COMPLETE" 6 "RELEASE_BLOCKED" 5 "APPLY_BLOCKED" 4 "TIMEOUT_CALIBRATE" 3 "STATE_MISMATCH" 2 "EPBM_FAULTED" 1 "EPBM_DISABLED" 0 "NONE" ;
VAL_ 1480 EPBL_a174_esmOpTrigger 47 "RECOVERY_PARK" 46 "SPEED_SOURCES_LOST" 45 "ACTIVE_DECEL_OKTOPARK" 44 "ACTIVE_DECEL_FAST" 43 "STEERING_ACTIVE_DECEL" 42 "LV_ACTIVE_DECEL" 41 "CDP_PANIC_MODE_READY" 40 "CDP_PANIC_MODE_TIMEOUT" 39 "DI_PARK" 38 "FREE_ROLL_PARK_FOR_HANDLE_PULLED" 37 "LOW_BRAKE_FLUID_MODE_DYNAMIC" 36 "LOW_BRAKE_FLUID_MODE_DYNAMIC_PARK" 35 "LOW_BRAKE_FLUID_MODE_PARK" 34 "STATIONARY_DETECT" 33 "TOUCHSCREEN_INVALID" 32 "UI_DOOR_OPEN_REQUEST" 31 "AUTOPARK_END" 30 "DRIVER_IS_LEAVING" 29 "SYSTEM_APPLY" 28 "ACCELERATION" 27 "EPBM_DISQUALIFIED" 26 "DISQUALIFIED" 25 "SUMMON_FAULT" 24 "FAULT" 23 "SUMMON_COMPLETE" 22 "REAPPLY" 21 "SAVESTATE_ON_BOOT" 20 "TIMEOUT" 19 "SPEED_FAST" 18 "SPEED_OKAYTOPARK" 17 "SPEED_STOPPED" 16 "USER_CANCEL" 15 "USER_CONFIRMED" 14 "DIAG_EXIT" 13 "DIAG_OPEN" 12 "DIAG_CLOSE" 11 "SERVICE" 10 "WINCHMODE_UNAVAILABLE" 9 "WINCHMODE_ENTER" 8 "WINCHMODE_EXIT" 7 "TOUCHSCREEN" 6 "DI_UNPARK" 5 "ACTIVE_PARK_REQUEST" 4 "PBUTTON_RELEASED" 3 "PBUTTON_PRESSED_UNKNOWN" 2 "PBUTTON_PRESSED_FAST" 1 "PBUTTON_PRESSED_OKTOPARK" 0 "PBUTTON_PRESSED_STOPPED" ;
VAL_ 1480 EPBL_a174_nonterminalReason 23 "REMOTE_MIA" 22 "NVM_MISMATCH" 21 "EPBM_MIA" 20 "MOTOR_NOT_READY" 19 "MOTOR_ACTIVE_FAULT" 18 "MOTOR_IDLE_FAULT" 17 "TIMEOUT_EPBM_START" 16 "TIMEOUT_NO_RAMP" 15 "TIMEOUT_EPBM_CUTOFF" 14 "TIMEOUT_RELEASE_COMPLETE" 13 "TIMEOUT_RELEASE_NO_LOAD" 12 "TIMEOUT_RELEASE_WAIT_FOR_ENDSTOP" 11 "TIMEOUT_RELEASE_INRUSH" 10 "TIMEOUT_EPBM_WAIT_FOR_CLAMP" 9 "TIMEOUT_EPB_WAIT_FOR_CLAMP" 8 "TIMEOUT_APPLY_INRUSH" 7 "TIMEOUT_APPLY_COMPLETE" 6 "RELEASE_BLOCKED" 5 "APPLY_BLOCKED" 4 "TIMEOUT_CALIBRATE" 3 "STATE_MISMATCH" 2 "EPBM_FAULTED" 1 "EPBM_DISABLED" 0 "NONE" ;
VAL_ 1480 EPBL_a175_esmState 21 "UNKNOWN" 20 "SYSTEM_DYNAMIC_EXTERNAL" 19 "FREE_ROLL_MODE" 18 "DYNAMIC_EXTERNAL_EXIT" 17 "SERVICE_PENDING" 16 "LATCHED_DYNAMIC_EXTERNAL" 15 "DYNAMIC_PENDING" 14 "DYNAMIC_EXTERNAL" 13 "SUMMON_PARK" 12 "WINCHMODE_PENDING" 11 "PARK_PENDING" 10 "DYNAMIC_PARK" 9 "DIAGNOSTIC_OPEN" 8 "DIAGNOSTIC_PARK" 7 "SERVICE" 6 "WINCHMODE" 5 "SUMMON" 4 "DYNAMIC" 3 "OPEN" 2 "REAPPLY" 1 "PARK" 0 "INIT" ;
VAL_ 1480 EPBL_a175_esmStateRequest 21 "UNKNOWN" 20 "SYSTEM_DYNAMIC_EXTERNAL" 19 "FREE_ROLL_MODE" 18 "DYNAMIC_EXTERNAL_EXIT" 17 "SERVICE_PENDING" 16 "LATCHED_DYNAMIC_EXTERNAL" 15 "DYNAMIC_PENDING" 14 "DYNAMIC_EXTERNAL" 13 "SUMMON_PARK" 12 "WINCHMODE_PENDING" 11 "PARK_PENDING" 10 "DYNAMIC_PARK" 9 "DIAGNOSTIC_OPEN" 8 "DIAGNOSTIC_PARK" 7 "SERVICE" 6 "WINCHMODE" 5 "SUMMON" 4 "DYNAMIC" 3 "OPEN" 2 "REAPPLY" 1 "PARK" 0 "INIT" ;
VAL_ 1480 EPBL_a175_faultStatus 3 "FAULT_IDLE" 2 "FAULT" 1 "RETRY" 0 "NOMINAL" ;
VAL_ 1480 EPBL_a175_monitorUnitStatus 22 "COUNT" 21 "FREE_ROLL_MODE" 20 "DYNAMIC_PARKING" 19 "EXTERNAL_PARKING" 18 "RELEASING_FOR_EXTERNAL_PARK" 17 "EXTERNAL_DYNAMIC" 16 "SUMMON_PARKING" 15 "SUMMON_RELEASING" 14 "SUMMON" 13 "WINCHMODE_PENDING" 12 "PARK_PENDING" 11 "SERVICE_RELEASING" 10 "RELEASING" 9 "DYNAMIC_APPLYING" 8 "PARKING" 7 "WINCHMODE_RELEASING" 6 "WINCHMODE" 5 "SERVICE" 4 "START" 3 "PARK" 2 "DYNAMIC" 1 "OPEN" 0 "UNKNOWN" ;
VAL_ 1480 EPBL_a175_monitorFaultStatus 3 "FAULT_IDLE" 2 "FAULT" 1 "RETRY" 0 "NOMINAL" ;
VAL_ 1480 EPBL_a175_csmFaultReason 23 "REMOTE_MIA" 22 "NVM_MISMATCH" 21 "EPBM_MIA" 20 "MOTOR_NOT_READY" 19 "MOTOR_ACTIVE_FAULT" 18 "MOTOR_IDLE_FAULT" 17 "TIMEOUT_EPBM_START" 16 "TIMEOUT_NO_RAMP" 15 "TIMEOUT_EPBM_CUTOFF" 14 "TIMEOUT_RELEASE_COMPLETE" 13 "TIMEOUT_RELEASE_NO_LOAD" 12 "TIMEOUT_RELEASE_WAIT_FOR_ENDSTOP" 11 "TIMEOUT_RELEASE_INRUSH" 10 "TIMEOUT_EPBM_WAIT_FOR_CLAMP" 9 "TIMEOUT_EPB_WAIT_FOR_CLAMP" 8 "TIMEOUT_APPLY_INRUSH" 7 "TIMEOUT_APPLY_COMPLETE" 6 "RELEASE_BLOCKED" 5 "APPLY_BLOCKED" 4 "TIMEOUT_CALIBRATE" 3 "STATE_MISMATCH" 2 "EPBM_FAULTED" 1 "EPBM_DISABLED" 0 "NONE" ;
VAL_ 1480 EPBL_a175_esmOpTrigger 47 "RECOVERY_PARK" 46 "SPEED_SOURCES_LOST" 45 "ACTIVE_DECEL_OKTOPARK" 44 "ACTIVE_DECEL_FAST" 43 "STEERING_ACTIVE_DECEL" 42 "LV_ACTIVE_DECEL" 41 "CDP_PANIC_MODE_READY" 40 "CDP_PANIC_MODE_TIMEOUT" 39 "DI_PARK" 38 "FREE_ROLL_PARK_FOR_HANDLE_PULLED" 37 "LOW_BRAKE_FLUID_MODE_DYNAMIC" 36 "LOW_BRAKE_FLUID_MODE_DYNAMIC_PARK" 35 "LOW_BRAKE_FLUID_MODE_PARK" 34 "STATIONARY_DETECT" 33 "TOUCHSCREEN_INVALID" 32 "UI_DOOR_OPEN_REQUEST" 31 "AUTOPARK_END" 30 "DRIVER_IS_LEAVING" 29 "SYSTEM_APPLY" 28 "ACCELERATION" 27 "EPBM_DISQUALIFIED" 26 "DISQUALIFIED" 25 "SUMMON_FAULT" 24 "FAULT" 23 "SUMMON_COMPLETE" 22 "REAPPLY" 21 "SAVESTATE_ON_BOOT" 20 "TIMEOUT" 19 "SPEED_FAST" 18 "SPEED_OKAYTOPARK" 17 "SPEED_STOPPED" 16 "USER_CANCEL" 15 "USER_CONFIRMED" 14 "DIAG_EXIT" 13 "DIAG_OPEN" 12 "DIAG_CLOSE" 11 "SERVICE" 10 "WINCHMODE_UNAVAILABLE" 9 "WINCHMODE_ENTER" 8 "WINCHMODE_EXIT" 7 "TOUCHSCREEN" 6 "DI_UNPARK" 5 "ACTIVE_PARK_REQUEST" 4 "PBUTTON_RELEASED" 3 "PBUTTON_PRESSED_UNKNOWN" 2 "PBUTTON_PRESSED_FAST" 1 "PBUTTON_PRESSED_OKTOPARK" 0 "PBUTTON_PRESSED_STOPPED" ;
VAL_ 1480 EPBL_a175_nonterminalReason 23 "REMOTE_MIA" 22 "NVM_MISMATCH" 21 "EPBM_MIA" 20 "MOTOR_NOT_READY" 19 "MOTOR_ACTIVE_FAULT" 18 "MOTOR_IDLE_FAULT" 17 "TIMEOUT_EPBM_START" 16 "TIMEOUT_NO_RAMP" 15 "TIMEOUT_EPBM_CUTOFF" 14 "TIMEOUT_RELEASE_COMPLETE" 13 "TIMEOUT_RELEASE_NO_LOAD" 12 "TIMEOUT_RELEASE_WAIT_FOR_ENDSTOP" 11 "TIMEOUT_RELEASE_INRUSH" 10 "TIMEOUT_EPBM_WAIT_FOR_CLAMP" 9 "TIMEOUT_EPB_WAIT_FOR_CLAMP" 8 "TIMEOUT_APPLY_INRUSH" 7 "TIMEOUT_APPLY_COMPLETE" 6 "RELEASE_BLOCKED" 5 "APPLY_BLOCKED" 4 "TIMEOUT_CALIBRATE" 3 "STATE_MISMATCH" 2 "EPBM_FAULTED" 1 "EPBM_DISABLED" 0 "NONE" ;
VAL_ 1480 EPBL_a176_esmState 21 "UNKNOWN" 20 "SYSTEM_DYNAMIC_EXTERNAL" 19 "FREE_ROLL_MODE" 18 "DYNAMIC_EXTERNAL_EXIT" 17 "SERVICE_PENDING" 16 "LATCHED_DYNAMIC_EXTERNAL" 15 "DYNAMIC_PENDING" 14 "DYNAMIC_EXTERNAL" 13 "SUMMON_PARK" 12 "WINCHMODE_PENDING" 11 "PARK_PENDING" 10 "DYNAMIC_PARK" 9 "DIAGNOSTIC_OPEN" 8 "DIAGNOSTIC_PARK" 7 "SERVICE" 6 "WINCHMODE" 5 "SUMMON" 4 "DYNAMIC" 3 "OPEN" 2 "REAPPLY" 1 "PARK" 0 "INIT" ;
VAL_ 1480 EPBL_a176_esmStateRequest 21 "UNKNOWN" 20 "SYSTEM_DYNAMIC_EXTERNAL" 19 "FREE_ROLL_MODE" 18 "DYNAMIC_EXTERNAL_EXIT" 17 "SERVICE_PENDING" 16 "LATCHED_DYNAMIC_EXTERNAL" 15 "DYNAMIC_PENDING" 14 "DYNAMIC_EXTERNAL" 13 "SUMMON_PARK" 12 "WINCHMODE_PENDING" 11 "PARK_PENDING" 10 "DYNAMIC_PARK" 9 "DIAGNOSTIC_OPEN" 8 "DIAGNOSTIC_PARK" 7 "SERVICE" 6 "WINCHMODE" 5 "SUMMON" 4 "DYNAMIC" 3 "OPEN" 2 "REAPPLY" 1 "PARK" 0 "INIT" ;
VAL_ 1480 EPBL_a176_faultStatus 3 "FAULT_IDLE" 2 "FAULT" 1 "RETRY" 0 "NOMINAL" ;
VAL_ 1480 EPBL_a176_monitorUnitStatus 22 "COUNT" 21 "FREE_ROLL_MODE" 20 "DYNAMIC_PARKING" 19 "EXTERNAL_PARKING" 18 "RELEASING_FOR_EXTERNAL_PARK" 17 "EXTERNAL_DYNAMIC" 16 "SUMMON_PARKING" 15 "SUMMON_RELEASING" 14 "SUMMON" 13 "WINCHMODE_PENDING" 12 "PARK_PENDING" 11 "SERVICE_RELEASING" 10 "RELEASING" 9 "DYNAMIC_APPLYING" 8 "PARKING" 7 "WINCHMODE_RELEASING" 6 "WINCHMODE" 5 "SERVICE" 4 "START" 3 "PARK" 2 "DYNAMIC" 1 "OPEN" 0 "UNKNOWN" ;
VAL_ 1480 EPBL_a176_monitorFaultStatus 3 "FAULT_IDLE" 2 "FAULT" 1 "RETRY" 0 "NOMINAL" ;
VAL_ 1480 EPBL_a176_csmFaultReason 23 "REMOTE_MIA" 22 "NVM_MISMATCH" 21 "EPBM_MIA" 20 "MOTOR_NOT_READY" 19 "MOTOR_ACTIVE_FAULT" 18 "MOTOR_IDLE_FAULT" 17 "TIMEOUT_EPBM_START" 16 "TIMEOUT_NO_RAMP" 15 "TIMEOUT_EPBM_CUTOFF" 14 "TIMEOUT_RELEASE_COMPLETE" 13 "TIMEOUT_RELEASE_NO_LOAD" 12 "TIMEOUT_RELEASE_WAIT_FOR_ENDSTOP" 11 "TIMEOUT_RELEASE_INRUSH" 10 "TIMEOUT_EPBM_WAIT_FOR_CLAMP" 9 "TIMEOUT_EPB_WAIT_FOR_CLAMP" 8 "TIMEOUT_APPLY_INRUSH" 7 "TIMEOUT_APPLY_COMPLETE" 6 "RELEASE_BLOCKED" 5 "APPLY_BLOCKED" 4 "TIMEOUT_CALIBRATE" 3 "STATE_MISMATCH" 2 "EPBM_FAULTED" 1 "EPBM_DISABLED" 0 "NONE" ;
VAL_ 1480 EPBL_a176_esmOpTrigger 47 "RECOVERY_PARK" 46 "SPEED_SOURCES_LOST" 45 "ACTIVE_DECEL_OKTOPARK" 44 "ACTIVE_DECEL_FAST" 43 "STEERING_ACTIVE_DECEL" 42 "LV_ACTIVE_DECEL" 41 "CDP_PANIC_MODE_READY" 40 "CDP_PANIC_MODE_TIMEOUT" 39 "DI_PARK" 38 "FREE_ROLL_PARK_FOR_HANDLE_PULLED" 37 "LOW_BRAKE_FLUID_MODE_DYNAMIC" 36 "LOW_BRAKE_FLUID_MODE_DYNAMIC_PARK" 35 "LOW_BRAKE_FLUID_MODE_PARK" 34 "STATIONARY_DETECT" 33 "TOUCHSCREEN_INVALID" 32 "UI_DOOR_OPEN_REQUEST" 31 "AUTOPARK_END" 30 "DRIVER_IS_LEAVING" 29 "SYSTEM_APPLY" 28 "ACCELERATION" 27 "EPBM_DISQUALIFIED" 26 "DISQUALIFIED" 25 "SUMMON_FAULT" 24 "FAULT" 23 "SUMMON_COMPLETE" 22 "REAPPLY" 21 "SAVESTATE_ON_BOOT" 20 "TIMEOUT" 19 "SPEED_FAST" 18 "SPEED_OKAYTOPARK" 17 "SPEED_STOPPED" 16 "USER_CANCEL" 15 "USER_CONFIRMED" 14 "DIAG_EXIT" 13 "DIAG_OPEN" 12 "DIAG_CLOSE" 11 "SERVICE" 10 "WINCHMODE_UNAVAILABLE" 9 "WINCHMODE_ENTER" 8 "WINCHMODE_EXIT" 7 "TOUCHSCREEN" 6 "DI_UNPARK" 5 "ACTIVE_PARK_REQUEST" 4 "PBUTTON_RELEASED" 3 "PBUTTON_PRESSED_UNKNOWN" 2 "PBUTTON_PRESSED_FAST" 1 "PBUTTON_PRESSED_OKTOPARK" 0 "PBUTTON_PRESSED_STOPPED" ;
VAL_ 1480 EPBL_a176_nonterminalReason 23 "REMOTE_MIA" 22 "NVM_MISMATCH" 21 "EPBM_MIA" 20 "MOTOR_NOT_READY" 19 "MOTOR_ACTIVE_FAULT" 18 "MOTOR_IDLE_FAULT" 17 "TIMEOUT_EPBM_START" 16 "TIMEOUT_NO_RAMP" 15 "TIMEOUT_EPBM_CUTOFF" 14 "TIMEOUT_RELEASE_COMPLETE" 13 "TIMEOUT_RELEASE_NO_LOAD" 12 "TIMEOUT_RELEASE_WAIT_FOR_ENDSTOP" 11 "TIMEOUT_RELEASE_INRUSH" 10 "TIMEOUT_EPBM_WAIT_FOR_CLAMP" 9 "TIMEOUT_EPB_WAIT_FOR_CLAMP" 8 "TIMEOUT_APPLY_INRUSH" 7 "TIMEOUT_APPLY_COMPLETE" 6 "RELEASE_BLOCKED" 5 "APPLY_BLOCKED" 4 "TIMEOUT_CALIBRATE" 3 "STATE_MISMATCH" 2 "EPBM_FAULTED" 1 "EPBM_DISABLED" 0 "NONE" ;
VAL_ 1480 EPBL_a177_esmState 21 "UNKNOWN" 20 "SYSTEM_DYNAMIC_EXTERNAL" 19 "FREE_ROLL_MODE" 18 "DYNAMIC_EXTERNAL_EXIT" 17 "SERVICE_PENDING" 16 "LATCHED_DYNAMIC_EXTERNAL" 15 "DYNAMIC_PENDING" 14 "DYNAMIC_EXTERNAL" 13 "SUMMON_PARK" 12 "WINCHMODE_PENDING" 11 "PARK_PENDING" 10 "DYNAMIC_PARK" 9 "DIAGNOSTIC_OPEN" 8 "DIAGNOSTIC_PARK" 7 "SERVICE" 6 "WINCHMODE" 5 "SUMMON" 4 "DYNAMIC" 3 "OPEN" 2 "REAPPLY" 1 "PARK" 0 "INIT" ;
VAL_ 1480 EPBL_a177_esmStateRequest 21 "UNKNOWN" 20 "SYSTEM_DYNAMIC_EXTERNAL" 19 "FREE_ROLL_MODE" 18 "DYNAMIC_EXTERNAL_EXIT" 17 "SERVICE_PENDING" 16 "LATCHED_DYNAMIC_EXTERNAL" 15 "DYNAMIC_PENDING" 14 "DYNAMIC_EXTERNAL" 13 "SUMMON_PARK" 12 "WINCHMODE_PENDING" 11 "PARK_PENDING" 10 "DYNAMIC_PARK" 9 "DIAGNOSTIC_OPEN" 8 "DIAGNOSTIC_PARK" 7 "SERVICE" 6 "WINCHMODE" 5 "SUMMON" 4 "DYNAMIC" 3 "OPEN" 2 "REAPPLY" 1 "PARK" 0 "INIT" ;
VAL_ 1480 EPBL_a177_faultStatus 3 "FAULT_IDLE" 2 "FAULT" 1 "RETRY" 0 "NOMINAL" ;
VAL_ 1480 EPBL_a177_monitorUnitStatus 22 "COUNT" 21 "FREE_ROLL_MODE" 20 "DYNAMIC_PARKING" 19 "EXTERNAL_PARKING" 18 "RELEASING_FOR_EXTERNAL_PARK" 17 "EXTERNAL_DYNAMIC" 16 "SUMMON_PARKING" 15 "SUMMON_RELEASING" 14 "SUMMON" 13 "WINCHMODE_PENDING" 12 "PARK_PENDING" 11 "SERVICE_RELEASING" 10 "RELEASING" 9 "DYNAMIC_APPLYING" 8 "PARKING" 7 "WINCHMODE_RELEASING" 6 "WINCHMODE" 5 "SERVICE" 4 "START" 3 "PARK" 2 "DYNAMIC" 1 "OPEN" 0 "UNKNOWN" ;
VAL_ 1480 EPBL_a177_monitorFaultStatus 3 "FAULT_IDLE" 2 "FAULT" 1 "RETRY" 0 "NOMINAL" ;
VAL_ 1480 EPBL_a177_csmFaultReason 23 "REMOTE_MIA" 22 "NVM_MISMATCH" 21 "EPBM_MIA" 20 "MOTOR_NOT_READY" 19 "MOTOR_ACTIVE_FAULT" 18 "MOTOR_IDLE_FAULT" 17 "TIMEOUT_EPBM_START" 16 "TIMEOUT_NO_RAMP" 15 "TIMEOUT_EPBM_CUTOFF" 14 "TIMEOUT_RELEASE_COMPLETE" 13 "TIMEOUT_RELEASE_NO_LOAD" 12 "TIMEOUT_RELEASE_WAIT_FOR_ENDSTOP" 11 "TIMEOUT_RELEASE_INRUSH" 10 "TIMEOUT_EPBM_WAIT_FOR_CLAMP" 9 "TIMEOUT_EPB_WAIT_FOR_CLAMP" 8 "TIMEOUT_APPLY_INRUSH" 7 "TIMEOUT_APPLY_COMPLETE" 6 "RELEASE_BLOCKED" 5 "APPLY_BLOCKED" 4 "TIMEOUT_CALIBRATE" 3 "STATE_MISMATCH" 2 "EPBM_FAULTED" 1 "EPBM_DISABLED" 0 "NONE" ;
VAL_ 1480 EPBL_a177_esmOpTrigger 47 "RECOVERY_PARK" 46 "SPEED_SOURCES_LOST" 45 "ACTIVE_DECEL_OKTOPARK" 44 "ACTIVE_DECEL_FAST" 43 "STEERING_ACTIVE_DECEL" 42 "LV_ACTIVE_DECEL" 41 "CDP_PANIC_MODE_READY" 40 "CDP_PANIC_MODE_TIMEOUT" 39 "DI_PARK" 38 "FREE_ROLL_PARK_FOR_HANDLE_PULLED" 37 "LOW_BRAKE_FLUID_MODE_DYNAMIC" 36 "LOW_BRAKE_FLUID_MODE_DYNAMIC_PARK" 35 "LOW_BRAKE_FLUID_MODE_PARK" 34 "STATIONARY_DETECT" 33 "TOUCHSCREEN_INVALID" 32 "UI_DOOR_OPEN_REQUEST" 31 "AUTOPARK_END" 30 "DRIVER_IS_LEAVING" 29 "SYSTEM_APPLY" 28 "ACCELERATION" 27 "EPBM_DISQUALIFIED" 26 "DISQUALIFIED" 25 "SUMMON_FAULT" 24 "FAULT" 23 "SUMMON_COMPLETE" 22 "REAPPLY" 21 "SAVESTATE_ON_BOOT" 20 "TIMEOUT" 19 "SPEED_FAST" 18 "SPEED_OKAYTOPARK" 17 "SPEED_STOPPED" 16 "USER_CANCEL" 15 "USER_CONFIRMED" 14 "DIAG_EXIT" 13 "DIAG_OPEN" 12 "DIAG_CLOSE" 11 "SERVICE" 10 "WINCHMODE_UNAVAILABLE" 9 "WINCHMODE_ENTER" 8 "WINCHMODE_EXIT" 7 "TOUCHSCREEN" 6 "DI_UNPARK" 5 "ACTIVE_PARK_REQUEST" 4 "PBUTTON_RELEASED" 3 "PBUTTON_PRESSED_UNKNOWN" 2 "PBUTTON_PRESSED_FAST" 1 "PBUTTON_PRESSED_OKTOPARK" 0 "PBUTTON_PRESSED_STOPPED" ;
VAL_ 1480 EPBL_a177_nonterminalReason 23 "REMOTE_MIA" 22 "NVM_MISMATCH" 21 "EPBM_MIA" 20 "MOTOR_NOT_READY" 19 "MOTOR_ACTIVE_FAULT" 18 "MOTOR_IDLE_FAULT" 17 "TIMEOUT_EPBM_START" 16 "TIMEOUT_NO_RAMP" 15 "TIMEOUT_EPBM_CUTOFF" 14 "TIMEOUT_RELEASE_COMPLETE" 13 "TIMEOUT_RELEASE_NO_LOAD" 12 "TIMEOUT_RELEASE_WAIT_FOR_ENDSTOP" 11 "TIMEOUT_RELEASE_INRUSH" 10 "TIMEOUT_EPBM_WAIT_FOR_CLAMP" 9 "TIMEOUT_EPB_WAIT_FOR_CLAMP" 8 "TIMEOUT_APPLY_INRUSH" 7 "TIMEOUT_APPLY_COMPLETE" 6 "RELEASE_BLOCKED" 5 "APPLY_BLOCKED" 4 "TIMEOUT_CALIBRATE" 3 "STATE_MISMATCH" 2 "EPBM_FAULTED" 1 "EPBM_DISABLED" 0 "NONE" ;
VAL_ 1480 EPBL_a178_localCaliperState 6 "WINCHMODE" 5 "SERVICE" 4 "OPEN" 3 "PARK" 2 "REAPPLY" 1 "UNKNOWN" 0 "UNSAVED" ;
VAL_ 1480 EPBL_a178_monitorCaliperState 6 "WINCHMODE" 5 "SERVICE" 4 "OPEN" 3 "PARK" 2 "REAPPLY" 1 "UNKNOWN" 0 "UNSAVED" ;
VAL_ 1480 EPBL_a179_esmState 21 "UNKNOWN" 20 "SYSTEM_DYNAMIC_EXTERNAL" 19 "FREE_ROLL_MODE" 18 "DYNAMIC_EXTERNAL_EXIT" 17 "SERVICE_PENDING" 16 "LATCHED_DYNAMIC_EXTERNAL" 15 "DYNAMIC_PENDING" 14 "DYNAMIC_EXTERNAL" 13 "SUMMON_PARK" 12 "WINCHMODE_PENDING" 11 "PARK_PENDING" 10 "DYNAMIC_PARK" 9 "DIAGNOSTIC_OPEN" 8 "DIAGNOSTIC_PARK" 7 "SERVICE" 6 "WINCHMODE" 5 "SUMMON" 4 "DYNAMIC" 3 "OPEN" 2 "REAPPLY" 1 "PARK" 0 "INIT" ;
VAL_ 1480 EPBL_a179_esmStateRequest 21 "UNKNOWN" 20 "SYSTEM_DYNAMIC_EXTERNAL" 19 "FREE_ROLL_MODE" 18 "DYNAMIC_EXTERNAL_EXIT" 17 "SERVICE_PENDING" 16 "LATCHED_DYNAMIC_EXTERNAL" 15 "DYNAMIC_PENDING" 14 "DYNAMIC_EXTERNAL" 13 "SUMMON_PARK" 12 "WINCHMODE_PENDING" 11 "PARK_PENDING" 10 "DYNAMIC_PARK" 9 "DIAGNOSTIC_OPEN" 8 "DIAGNOSTIC_PARK" 7 "SERVICE" 6 "WINCHMODE" 5 "SUMMON" 4 "DYNAMIC" 3 "OPEN" 2 "REAPPLY" 1 "PARK" 0 "INIT" ;
VAL_ 1480 EPBL_a179_faultStatus 3 "FAULT_IDLE" 2 "FAULT" 1 "RETRY" 0 "NOMINAL" ;
VAL_ 1480 EPBL_a179_monitorUnitStatus 22 "COUNT" 21 "FREE_ROLL_MODE" 20 "DYNAMIC_PARKING" 19 "EXTERNAL_PARKING" 18 "RELEASING_FOR_EXTERNAL_PARK" 17 "EXTERNAL_DYNAMIC" 16 "SUMMON_PARKING" 15 "SUMMON_RELEASING" 14 "SUMMON" 13 "WINCHMODE_PENDING" 12 "PARK_PENDING" 11 "SERVICE_RELEASING" 10 "RELEASING" 9 "DYNAMIC_APPLYING" 8 "PARKING" 7 "WINCHMODE_RELEASING" 6 "WINCHMODE" 5 "SERVICE" 4 "START" 3 "PARK" 2 "DYNAMIC" 1 "OPEN" 0 "UNKNOWN" ;
VAL_ 1480 EPBL_a179_monitorFaultStatus 3 "FAULT_IDLE" 2 "FAULT" 1 "RETRY" 0 "NOMINAL" ;
VAL_ 1480 EPBL_a179_csmFaultReason 23 "REMOTE_MIA" 22 "NVM_MISMATCH" 21 "EPBM_MIA" 20 "MOTOR_NOT_READY" 19 "MOTOR_ACTIVE_FAULT" 18 "MOTOR_IDLE_FAULT" 17 "TIMEOUT_EPBM_START" 16 "TIMEOUT_NO_RAMP" 15 "TIMEOUT_EPBM_CUTOFF" 14 "TIMEOUT_RELEASE_COMPLETE" 13 "TIMEOUT_RELEASE_NO_LOAD" 12 "TIMEOUT_RELEASE_WAIT_FOR_ENDSTOP" 11 "TIMEOUT_RELEASE_INRUSH" 10 "TIMEOUT_EPBM_WAIT_FOR_CLAMP" 9 "TIMEOUT_EPB_WAIT_FOR_CLAMP" 8 "TIMEOUT_APPLY_INRUSH" 7 "TIMEOUT_APPLY_COMPLETE" 6 "RELEASE_BLOCKED" 5 "APPLY_BLOCKED" 4 "TIMEOUT_CALIBRATE" 3 "STATE_MISMATCH" 2 "EPBM_FAULTED" 1 "EPBM_DISABLED" 0 "NONE" ;
VAL_ 1480 EPBL_a179_esmOpTrigger 47 "RECOVERY_PARK" 46 "SPEED_SOURCES_LOST" 45 "ACTIVE_DECEL_OKTOPARK" 44 "ACTIVE_DECEL_FAST" 43 "STEERING_ACTIVE_DECEL" 42 "LV_ACTIVE_DECEL" 41 "CDP_PANIC_MODE_READY" 40 "CDP_PANIC_MODE_TIMEOUT" 39 "DI_PARK" 38 "FREE_ROLL_PARK_FOR_HANDLE_PULLED" 37 "LOW_BRAKE_FLUID_MODE_DYNAMIC" 36 "LOW_BRAKE_FLUID_MODE_DYNAMIC_PARK" 35 "LOW_BRAKE_FLUID_MODE_PARK" 34 "STATIONARY_DETECT" 33 "TOUCHSCREEN_INVALID" 32 "UI_DOOR_OPEN_REQUEST" 31 "AUTOPARK_END" 30 "DRIVER_IS_LEAVING" 29 "SYSTEM_APPLY" 28 "ACCELERATION" 27 "EPBM_DISQUALIFIED" 26 "DISQUALIFIED" 25 "SUMMON_FAULT" 24 "FAULT" 23 "SUMMON_COMPLETE" 22 "REAPPLY" 21 "SAVESTATE_ON_BOOT" 20 "TIMEOUT" 19 "SPEED_FAST" 18 "SPEED_OKAYTOPARK" 17 "SPEED_STOPPED" 16 "USER_CANCEL" 15 "USER_CONFIRMED" 14 "DIAG_EXIT" 13 "DIAG_OPEN" 12 "DIAG_CLOSE" 11 "SERVICE" 10 "WINCHMODE_UNAVAILABLE" 9 "WINCHMODE_ENTER" 8 "WINCHMODE_EXIT" 7 "TOUCHSCREEN" 6 "DI_UNPARK" 5 "ACTIVE_PARK_REQUEST" 4 "PBUTTON_RELEASED" 3 "PBUTTON_PRESSED_UNKNOWN" 2 "PBUTTON_PRESSED_FAST" 1 "PBUTTON_PRESSED_OKTOPARK" 0 "PBUTTON_PRESSED_STOPPED" ;
VAL_ 1480 EPBL_a179_nonterminalReason 23 "REMOTE_MIA" 22 "NVM_MISMATCH" 21 "EPBM_MIA" 20 "MOTOR_NOT_READY" 19 "MOTOR_ACTIVE_FAULT" 18 "MOTOR_IDLE_FAULT" 17 "TIMEOUT_EPBM_START" 16 "TIMEOUT_NO_RAMP" 15 "TIMEOUT_EPBM_CUTOFF" 14 "TIMEOUT_RELEASE_COMPLETE" 13 "TIMEOUT_RELEASE_NO_LOAD" 12 "TIMEOUT_RELEASE_WAIT_FOR_ENDSTOP" 11 "TIMEOUT_RELEASE_INRUSH" 10 "TIMEOUT_EPBM_WAIT_FOR_CLAMP" 9 "TIMEOUT_EPB_WAIT_FOR_CLAMP" 8 "TIMEOUT_APPLY_INRUSH" 7 "TIMEOUT_APPLY_COMPLETE" 6 "RELEASE_BLOCKED" 5 "APPLY_BLOCKED" 4 "TIMEOUT_CALIBRATE" 3 "STATE_MISMATCH" 2 "EPBM_FAULTED" 1 "EPBM_DISABLED" 0 "NONE" ;
VAL_ 1480 EPBL_a180_esmOpTrigger 47 "RECOVERY_PARK" 46 "SPEED_SOURCES_LOST" 45 "ACTIVE_DECEL_OKTOPARK" 44 "ACTIVE_DECEL_FAST" 43 "STEERING_ACTIVE_DECEL" 42 "LV_ACTIVE_DECEL" 41 "CDP_PANIC_MODE_READY" 40 "CDP_PANIC_MODE_TIMEOUT" 39 "DI_PARK" 38 "FREE_ROLL_PARK_FOR_HANDLE_PULLED" 37 "LOW_BRAKE_FLUID_MODE_DYNAMIC" 36 "LOW_BRAKE_FLUID_MODE_DYNAMIC_PARK" 35 "LOW_BRAKE_FLUID_MODE_PARK" 34 "STATIONARY_DETECT" 33 "TOUCHSCREEN_INVALID" 32 "UI_DOOR_OPEN_REQUEST" 31 "AUTOPARK_END" 30 "DRIVER_IS_LEAVING" 29 "SYSTEM_APPLY" 28 "ACCELERATION" 27 "EPBM_DISQUALIFIED" 26 "DISQUALIFIED" 25 "SUMMON_FAULT" 24 "FAULT" 23 "SUMMON_COMPLETE" 22 "REAPPLY" 21 "SAVESTATE_ON_BOOT" 20 "TIMEOUT" 19 "SPEED_FAST" 18 "SPEED_OKAYTOPARK" 17 "SPEED_STOPPED" 16 "USER_CANCEL" 15 "USER_CONFIRMED" 14 "DIAG_EXIT" 13 "DIAG_OPEN" 12 "DIAG_CLOSE" 11 "SERVICE" 10 "WINCHMODE_UNAVAILABLE" 9 "WINCHMODE_ENTER" 8 "WINCHMODE_EXIT" 7 "TOUCHSCREEN" 6 "DI_UNPARK" 5 "ACTIVE_PARK_REQUEST" 4 "PBUTTON_RELEASED" 3 "PBUTTON_PRESSED_UNKNOWN" 2 "PBUTTON_PRESSED_FAST" 1 "PBUTTON_PRESSED_OKTOPARK" 0 "PBUTTON_PRESSED_STOPPED" ;
VAL_ 1480 EPBL_a180_previousState 21 "UNKNOWN" 20 "SYSTEM_DYNAMIC_EXTERNAL" 19 "FREE_ROLL_MODE" 18 "DYNAMIC_EXTERNAL_EXIT" 17 "SERVICE_PENDING" 16 "LATCHED_DYNAMIC_EXTERNAL" 15 "DYNAMIC_PENDING" 14 "DYNAMIC_EXTERNAL" 13 "SUMMON_PARK" 12 "WINCHMODE_PENDING" 11 "PARK_PENDING" 10 "DYNAMIC_PARK" 9 "DIAGNOSTIC_OPEN" 8 "DIAGNOSTIC_PARK" 7 "SERVICE" 6 "WINCHMODE" 5 "SUMMON" 4 "DYNAMIC" 3 "OPEN" 2 "REAPPLY" 1 "PARK" 0 "INIT" ;
VAL_ 1480 EPBL_a180_nextState 21 "UNKNOWN" 20 "SYSTEM_DYNAMIC_EXTERNAL" 19 "FREE_ROLL_MODE" 18 "DYNAMIC_EXTERNAL_EXIT" 17 "SERVICE_PENDING" 16 "LATCHED_DYNAMIC_EXTERNAL" 15 "DYNAMIC_PENDING" 14 "DYNAMIC_EXTERNAL" 13 "SUMMON_PARK" 12 "WINCHMODE_PENDING" 11 "PARK_PENDING" 10 "DYNAMIC_PARK" 9 "DIAGNOSTIC_OPEN" 8 "DIAGNOSTIC_PARK" 7 "SERVICE" 6 "WINCHMODE" 5 "SUMMON" 4 "DYNAMIC" 3 "OPEN" 2 "REAPPLY" 1 "PARK" 0 "INIT" ;
VAL_ 1480 EPBL_a182_epbSystemStatus 8 "MISMATCH" 7 "FAULT_SECURE" 6 "FAULT" 5 "RELEASING" 4 "PARKING" 3 "DYNAMIC" 2 "PARKED" 1 "RELEASED" 0 "UNKNOWN" ;
VAL_ 1480 EPBL_a183_localCdpState 2 "FAULT" 1 "VALID" 0 "UNKNOWN" ;
VAL_ 1480 EPBL_a183_remoteCdpState 2 "FAULT" 1 "VALID" 0 "UNKNOWN" ;
VAL_ 1480 EPBL_a183_espCdpStatus 2 "INVALID" 1 "VALID" 0 "IDLE" ;
VAL_ 1480 EPBL_a183_esmState 21 "UNKNOWN" 20 "SYSTEM_DYNAMIC_EXTERNAL" 19 "FREE_ROLL_MODE" 18 "DYNAMIC_EXTERNAL_EXIT" 17 "SERVICE_PENDING" 16 "LATCHED_DYNAMIC_EXTERNAL" 15 "DYNAMIC_PENDING" 14 "DYNAMIC_EXTERNAL" 13 "SUMMON_PARK" 12 "WINCHMODE_PENDING" 11 "PARK_PENDING" 10 "DYNAMIC_PARK" 9 "DIAGNOSTIC_OPEN" 8 "DIAGNOSTIC_PARK" 7 "SERVICE" 6 "WINCHMODE" 5 "SUMMON" 4 "DYNAMIC" 3 "OPEN" 2 "REAPPLY" 1 "PARK" 0 "INIT" ;
VAL_ 1480 EPBL_a183_esmStateRequest 21 "UNKNOWN" 20 "SYSTEM_DYNAMIC_EXTERNAL" 19 "FREE_ROLL_MODE" 18 "DYNAMIC_EXTERNAL_EXIT" 17 "SERVICE_PENDING" 16 "LATCHED_DYNAMIC_EXTERNAL" 15 "DYNAMIC_PENDING" 14 "DYNAMIC_EXTERNAL" 13 "SUMMON_PARK" 12 "WINCHMODE_PENDING" 11 "PARK_PENDING" 10 "DYNAMIC_PARK" 9 "DIAGNOSTIC_OPEN" 8 "DIAGNOSTIC_PARK" 7 "SERVICE" 6 "WINCHMODE" 5 "SUMMON" 4 "DYNAMIC" 3 "OPEN" 2 "REAPPLY" 1 "PARK" 0 "INIT" ;
VAL_ 1480 EPBL_a183_esmOperationTrigger 47 "RECOVERY_PARK" 46 "SPEED_SOURCES_LOST" 45 "ACTIVE_DECEL_OKTOPARK" 44 "ACTIVE_DECEL_FAST" 43 "STEERING_ACTIVE_DECEL" 42 "LV_ACTIVE_DECEL" 41 "CDP_PANIC_MODE_READY" 40 "CDP_PANIC_MODE_TIMEOUT" 39 "DI_PARK" 38 "FREE_ROLL_PARK_FOR_HANDLE_PULLED" 37 "LOW_BRAKE_FLUID_MODE_DYNAMIC" 36 "LOW_BRAKE_FLUID_MODE_DYNAMIC_PARK" 35 "LOW_BRAKE_FLUID_MODE_PARK" 34 "STATIONARY_DETECT" 33 "TOUCHSCREEN_INVALID" 32 "UI_DOOR_OPEN_REQUEST" 31 "AUTOPARK_END" 30 "DRIVER_IS_LEAVING" 29 "SYSTEM_APPLY" 28 "ACCELERATION" 27 "EPBM_DISQUALIFIED" 26 "DISQUALIFIED" 25 "SUMMON_FAULT" 24 "FAULT" 23 "SUMMON_COMPLETE" 22 "REAPPLY" 21 "SAVESTATE_ON_BOOT" 20 "TIMEOUT" 19 "SPEED_FAST" 18 "SPEED_OKAYTOPARK" 17 "SPEED_STOPPED" 16 "USER_CANCEL" 15 "USER_CONFIRMED" 14 "DIAG_EXIT" 13 "DIAG_OPEN" 12 "DIAG_CLOSE" 11 "SERVICE" 10 "WINCHMODE_UNAVAILABLE" 9 "WINCHMODE_ENTER" 8 "WINCHMODE_EXIT" 7 "TOUCHSCREEN" 6 "DI_UNPARK" 5 "ACTIVE_PARK_REQUEST" 4 "PBUTTON_RELEASED" 3 "PBUTTON_PRESSED_UNKNOWN" 2 "PBUTTON_PRESSED_FAST" 1 "PBUTTON_PRESSED_OKTOPARK" 0 "PBUTTON_PRESSED_STOPPED" ;
VAL_ 1480 EPBL_a184_esmOpTrigger 47 "RECOVERY_PARK" 46 "SPEED_SOURCES_LOST" 45 "ACTIVE_DECEL_OKTOPARK" 44 "ACTIVE_DECEL_FAST" 43 "STEERING_ACTIVE_DECEL" 42 "LV_ACTIVE_DECEL" 41 "CDP_PANIC_MODE_READY" 40 "CDP_PANIC_MODE_TIMEOUT" 39 "DI_PARK" 38 "FREE_ROLL_PARK_FOR_HANDLE_PULLED" 37 "LOW_BRAKE_FLUID_MODE_DYNAMIC" 36 "LOW_BRAKE_FLUID_MODE_DYNAMIC_PARK" 35 "LOW_BRAKE_FLUID_MODE_PARK" 34 "STATIONARY_DETECT" 33 "TOUCHSCREEN_INVALID" 32 "UI_DOOR_OPEN_REQUEST" 31 "AUTOPARK_END" 30 "DRIVER_IS_LEAVING" 29 "SYSTEM_APPLY" 28 "ACCELERATION" 27 "EPBM_DISQUALIFIED" 26 "DISQUALIFIED" 25 "SUMMON_FAULT" 24 "FAULT" 23 "SUMMON_COMPLETE" 22 "REAPPLY" 21 "SAVESTATE_ON_BOOT" 20 "TIMEOUT" 19 "SPEED_FAST" 18 "SPEED_OKAYTOPARK" 17 "SPEED_STOPPED" 16 "USER_CANCEL" 15 "USER_CONFIRMED" 14 "DIAG_EXIT" 13 "DIAG_OPEN" 12 "DIAG_CLOSE" 11 "SERVICE" 10 "WINCHMODE_UNAVAILABLE" 9 "WINCHMODE_ENTER" 8 "WINCHMODE_EXIT" 7 "TOUCHSCREEN" 6 "DI_UNPARK" 5 "ACTIVE_PARK_REQUEST" 4 "PBUTTON_RELEASED" 3 "PBUTTON_PRESSED_UNKNOWN" 2 "PBUTTON_PRESSED_FAST" 1 "PBUTTON_PRESSED_OKTOPARK" 0 "PBUTTON_PRESSED_STOPPED" ;
VAL_ 1480 EPBL_a184_previousState 21 "UNKNOWN" 20 "SYSTEM_DYNAMIC_EXTERNAL" 19 "FREE_ROLL_MODE" 18 "DYNAMIC_EXTERNAL_EXIT" 17 "SERVICE_PENDING" 16 "LATCHED_DYNAMIC_EXTERNAL" 15 "DYNAMIC_PENDING" 14 "DYNAMIC_EXTERNAL" 13 "SUMMON_PARK" 12 "WINCHMODE_PENDING" 11 "PARK_PENDING" 10 "DYNAMIC_PARK" 9 "DIAGNOSTIC_OPEN" 8 "DIAGNOSTIC_PARK" 7 "SERVICE" 6 "WINCHMODE" 5 "SUMMON" 4 "DYNAMIC" 3 "OPEN" 2 "REAPPLY" 1 "PARK" 0 "INIT" ;
VAL_ 1480 EPBL_a184_nextState 21 "UNKNOWN" 20 "SYSTEM_DYNAMIC_EXTERNAL" 19 "FREE_ROLL_MODE" 18 "DYNAMIC_EXTERNAL_EXIT" 17 "SERVICE_PENDING" 16 "LATCHED_DYNAMIC_EXTERNAL" 15 "DYNAMIC_PENDING" 14 "DYNAMIC_EXTERNAL" 13 "SUMMON_PARK" 12 "WINCHMODE_PENDING" 11 "PARK_PENDING" 10 "DYNAMIC_PARK" 9 "DIAGNOSTIC_OPEN" 8 "DIAGNOSTIC_PARK" 7 "SERVICE" 6 "WINCHMODE" 5 "SUMMON" 4 "DYNAMIC" 3 "OPEN" 2 "REAPPLY" 1 "PARK" 0 "INIT" ;
VAL_ 1480 EPBL_a187_esmOpTrigger 47 "RECOVERY_PARK" 46 "SPEED_SOURCES_LOST" 45 "ACTIVE_DECEL_OKTOPARK" 44 "ACTIVE_DECEL_FAST" 43 "STEERING_ACTIVE_DECEL" 42 "LV_ACTIVE_DECEL" 41 "CDP_PANIC_MODE_READY" 40 "CDP_PANIC_MODE_TIMEOUT" 39 "DI_PARK" 38 "FREE_ROLL_PARK_FOR_HANDLE_PULLED" 37 "LOW_BRAKE_FLUID_MODE_DYNAMIC" 36 "LOW_BRAKE_FLUID_MODE_DYNAMIC_PARK" 35 "LOW_BRAKE_FLUID_MODE_PARK" 34 "STATIONARY_DETECT" 33 "TOUCHSCREEN_INVALID" 32 "UI_DOOR_OPEN_REQUEST" 31 "AUTOPARK_END" 30 "DRIVER_IS_LEAVING" 29 "SYSTEM_APPLY" 28 "ACCELERATION" 27 "EPBM_DISQUALIFIED" 26 "DISQUALIFIED" 25 "SUMMON_FAULT" 24 "FAULT" 23 "SUMMON_COMPLETE" 22 "REAPPLY" 21 "SAVESTATE_ON_BOOT" 20 "TIMEOUT" 19 "SPEED_FAST" 18 "SPEED_OKAYTOPARK" 17 "SPEED_STOPPED" 16 "USER_CANCEL" 15 "USER_CONFIRMED" 14 "DIAG_EXIT" 13 "DIAG_OPEN" 12 "DIAG_CLOSE" 11 "SERVICE" 10 "WINCHMODE_UNAVAILABLE" 9 "WINCHMODE_ENTER" 8 "WINCHMODE_EXIT" 7 "TOUCHSCREEN" 6 "DI_UNPARK" 5 "ACTIVE_PARK_REQUEST" 4 "PBUTTON_RELEASED" 3 "PBUTTON_PRESSED_UNKNOWN" 2 "PBUTTON_PRESSED_FAST" 1 "PBUTTON_PRESSED_OKTOPARK" 0 "PBUTTON_PRESSED_STOPPED" ;
VAL_ 1480 EPBL_a187_previousState 21 "UNKNOWN" 20 "SYSTEM_DYNAMIC_EXTERNAL" 19 "FREE_ROLL_MODE" 18 "DYNAMIC_EXTERNAL_EXIT" 17 "SERVICE_PENDING" 16 "LATCHED_DYNAMIC_EXTERNAL" 15 "DYNAMIC_PENDING" 14 "DYNAMIC_EXTERNAL" 13 "SUMMON_PARK" 12 "WINCHMODE_PENDING" 11 "PARK_PENDING" 10 "DYNAMIC_PARK" 9 "DIAGNOSTIC_OPEN" 8 "DIAGNOSTIC_PARK" 7 "SERVICE" 6 "WINCHMODE" 5 "SUMMON" 4 "DYNAMIC" 3 "OPEN" 2 "REAPPLY" 1 "PARK" 0 "INIT" ;
VAL_ 1480 EPBL_a187_nextState 21 "UNKNOWN" 20 "SYSTEM_DYNAMIC_EXTERNAL" 19 "FREE_ROLL_MODE" 18 "DYNAMIC_EXTERNAL_EXIT" 17 "SERVICE_PENDING" 16 "LATCHED_DYNAMIC_EXTERNAL" 15 "DYNAMIC_PENDING" 14 "DYNAMIC_EXTERNAL" 13 "SUMMON_PARK" 12 "WINCHMODE_PENDING" 11 "PARK_PENDING" 10 "DYNAMIC_PARK" 9 "DIAGNOSTIC_OPEN" 8 "DIAGNOSTIC_PARK" 7 "SERVICE" 6 "WINCHMODE" 5 "SUMMON" 4 "DYNAMIC" 3 "OPEN" 2 "REAPPLY" 1 "PARK" 0 "INIT" ;
VAL_ 1480 EPBL_a188_esmOpTrigger 47 "RECOVERY_PARK" 46 "SPEED_SOURCES_LOST" 45 "ACTIVE_DECEL_OKTOPARK" 44 "ACTIVE_DECEL_FAST" 43 "STEERING_ACTIVE_DECEL" 42 "LV_ACTIVE_DECEL" 41 "CDP_PANIC_MODE_READY" 40 "CDP_PANIC_MODE_TIMEOUT" 39 "DI_PARK" 38 "FREE_ROLL_PARK_FOR_HANDLE_PULLED" 37 "LOW_BRAKE_FLUID_MODE_DYNAMIC" 36 "LOW_BRAKE_FLUID_MODE_DYNAMIC_PARK" 35 "LOW_BRAKE_FLUID_MODE_PARK" 34 "STATIONARY_DETECT" 33 "TOUCHSCREEN_INVALID" 32 "UI_DOOR_OPEN_REQUEST" 31 "AUTOPARK_END" 30 "DRIVER_IS_LEAVING" 29 "SYSTEM_APPLY" 28 "ACCELERATION" 27 "EPBM_DISQUALIFIED" 26 "DISQUALIFIED" 25 "SUMMON_FAULT" 24 "FAULT" 23 "SUMMON_COMPLETE" 22 "REAPPLY" 21 "SAVESTATE_ON_BOOT" 20 "TIMEOUT" 19 "SPEED_FAST" 18 "SPEED_OKAYTOPARK" 17 "SPEED_STOPPED" 16 "USER_CANCEL" 15 "USER_CONFIRMED" 14 "DIAG_EXIT" 13 "DIAG_OPEN" 12 "DIAG_CLOSE" 11 "SERVICE" 10 "WINCHMODE_UNAVAILABLE" 9 "WINCHMODE_ENTER" 8 "WINCHMODE_EXIT" 7 "TOUCHSCREEN" 6 "DI_UNPARK" 5 "ACTIVE_PARK_REQUEST" 4 "PBUTTON_RELEASED" 3 "PBUTTON_PRESSED_UNKNOWN" 2 "PBUTTON_PRESSED_FAST" 1 "PBUTTON_PRESSED_OKTOPARK" 0 "PBUTTON_PRESSED_STOPPED" ;
VAL_ 1480 EPBL_a188_previousState 21 "UNKNOWN" 20 "SYSTEM_DYNAMIC_EXTERNAL" 19 "FREE_ROLL_MODE" 18 "DYNAMIC_EXTERNAL_EXIT" 17 "SERVICE_PENDING" 16 "LATCHED_DYNAMIC_EXTERNAL" 15 "DYNAMIC_PENDING" 14 "DYNAMIC_EXTERNAL" 13 "SUMMON_PARK" 12 "WINCHMODE_PENDING" 11 "PARK_PENDING" 10 "DYNAMIC_PARK" 9 "DIAGNOSTIC_OPEN" 8 "DIAGNOSTIC_PARK" 7 "SERVICE" 6 "WINCHMODE" 5 "SUMMON" 4 "DYNAMIC" 3 "OPEN" 2 "REAPPLY" 1 "PARK" 0 "INIT" ;
VAL_ 1480 EPBL_a188_nextState 21 "UNKNOWN" 20 "SYSTEM_DYNAMIC_EXTERNAL" 19 "FREE_ROLL_MODE" 18 "DYNAMIC_EXTERNAL_EXIT" 17 "SERVICE_PENDING" 16 "LATCHED_DYNAMIC_EXTERNAL" 15 "DYNAMIC_PENDING" 14 "DYNAMIC_EXTERNAL" 13 "SUMMON_PARK" 12 "WINCHMODE_PENDING" 11 "PARK_PENDING" 10 "DYNAMIC_PARK" 9 "DIAGNOSTIC_OPEN" 8 "DIAGNOSTIC_PARK" 7 "SERVICE" 6 "WINCHMODE" 5 "SUMMON" 4 "DYNAMIC" 3 "OPEN" 2 "REAPPLY" 1 "PARK" 0 "INIT" ;
VAL_ 1480 EPBL_a189_esmOpTrigger 47 "RECOVERY_PARK" 46 "SPEED_SOURCES_LOST" 45 "ACTIVE_DECEL_OKTOPARK" 44 "ACTIVE_DECEL_FAST" 43 "STEERING_ACTIVE_DECEL" 42 "LV_ACTIVE_DECEL" 41 "CDP_PANIC_MODE_READY" 40 "CDP_PANIC_MODE_TIMEOUT" 39 "DI_PARK" 38 "FREE_ROLL_PARK_FOR_HANDLE_PULLED" 37 "LOW_BRAKE_FLUID_MODE_DYNAMIC" 36 "LOW_BRAKE_FLUID_MODE_DYNAMIC_PARK" 35 "LOW_BRAKE_FLUID_MODE_PARK" 34 "STATIONARY_DETECT" 33 "TOUCHSCREEN_INVALID" 32 "UI_DOOR_OPEN_REQUEST" 31 "AUTOPARK_END" 30 "DRIVER_IS_LEAVING" 29 "SYSTEM_APPLY" 28 "ACCELERATION" 27 "EPBM_DISQUALIFIED" 26 "DISQUALIFIED" 25 "SUMMON_FAULT" 24 "FAULT" 23 "SUMMON_COMPLETE" 22 "REAPPLY" 21 "SAVESTATE_ON_BOOT" 20 "TIMEOUT" 19 "SPEED_FAST" 18 "SPEED_OKAYTOPARK" 17 "SPEED_STOPPED" 16 "USER_CANCEL" 15 "USER_CONFIRMED" 14 "DIAG_EXIT" 13 "DIAG_OPEN" 12 "DIAG_CLOSE" 11 "SERVICE" 10 "WINCHMODE_UNAVAILABLE" 9 "WINCHMODE_ENTER" 8 "WINCHMODE_EXIT" 7 "TOUCHSCREEN" 6 "DI_UNPARK" 5 "ACTIVE_PARK_REQUEST" 4 "PBUTTON_RELEASED" 3 "PBUTTON_PRESSED_UNKNOWN" 2 "PBUTTON_PRESSED_FAST" 1 "PBUTTON_PRESSED_OKTOPARK" 0 "PBUTTON_PRESSED_STOPPED" ;
VAL_ 1480 EPBL_a189_previousState 21 "UNKNOWN" 20 "SYSTEM_DYNAMIC_EXTERNAL" 19 "FREE_ROLL_MODE" 18 "DYNAMIC_EXTERNAL_EXIT" 17 "SERVICE_PENDING" 16 "LATCHED_DYNAMIC_EXTERNAL" 15 "DYNAMIC_PENDING" 14 "DYNAMIC_EXTERNAL" 13 "SUMMON_PARK" 12 "WINCHMODE_PENDING" 11 "PARK_PENDING" 10 "DYNAMIC_PARK" 9 "DIAGNOSTIC_OPEN" 8 "DIAGNOSTIC_PARK" 7 "SERVICE" 6 "WINCHMODE" 5 "SUMMON" 4 "DYNAMIC" 3 "OPEN" 2 "REAPPLY" 1 "PARK" 0 "INIT" ;
VAL_ 1480 EPBL_a189_nextState 21 "UNKNOWN" 20 "SYSTEM_DYNAMIC_EXTERNAL" 19 "FREE_ROLL_MODE" 18 "DYNAMIC_EXTERNAL_EXIT" 17 "SERVICE_PENDING" 16 "LATCHED_DYNAMIC_EXTERNAL" 15 "DYNAMIC_PENDING" 14 "DYNAMIC_EXTERNAL" 13 "SUMMON_PARK" 12 "WINCHMODE_PENDING" 11 "PARK_PENDING" 10 "DYNAMIC_PARK" 9 "DIAGNOSTIC_OPEN" 8 "DIAGNOSTIC_PARK" 7 "SERVICE" 6 "WINCHMODE" 5 "SUMMON" 4 "DYNAMIC" 3 "OPEN" 2 "REAPPLY" 1 "PARK" 0 "INIT" ;
VAL_ 1480 EPBL_a190_esmState 21 "UNKNOWN" 20 "SYSTEM_DYNAMIC_EXTERNAL" 19 "FREE_ROLL_MODE" 18 "DYNAMIC_EXTERNAL_EXIT" 17 "SERVICE_PENDING" 16 "LATCHED_DYNAMIC_EXTERNAL" 15 "DYNAMIC_PENDING" 14 "DYNAMIC_EXTERNAL" 13 "SUMMON_PARK" 12 "WINCHMODE_PENDING" 11 "PARK_PENDING" 10 "DYNAMIC_PARK" 9 "DIAGNOSTIC_OPEN" 8 "DIAGNOSTIC_PARK" 7 "SERVICE" 6 "WINCHMODE" 5 "SUMMON" 4 "DYNAMIC" 3 "OPEN" 2 "REAPPLY" 1 "PARK" 0 "INIT" ;
VAL_ 1480 EPBL_a190_esmStateRequest 21 "UNKNOWN" 20 "SYSTEM_DYNAMIC_EXTERNAL" 19 "FREE_ROLL_MODE" 18 "DYNAMIC_EXTERNAL_EXIT" 17 "SERVICE_PENDING" 16 "LATCHED_DYNAMIC_EXTERNAL" 15 "DYNAMIC_PENDING" 14 "DYNAMIC_EXTERNAL" 13 "SUMMON_PARK" 12 "WINCHMODE_PENDING" 11 "PARK_PENDING" 10 "DYNAMIC_PARK" 9 "DIAGNOSTIC_OPEN" 8 "DIAGNOSTIC_PARK" 7 "SERVICE" 6 "WINCHMODE" 5 "SUMMON" 4 "DYNAMIC" 3 "OPEN" 2 "REAPPLY" 1 "PARK" 0 "INIT" ;
VAL_ 1480 EPBL_a190_faultStatus 3 "FAULT_IDLE" 2 "FAULT" 1 "RETRY" 0 "NOMINAL" ;
VAL_ 1480 EPBL_a190_monitorUnitStatus 22 "COUNT" 21 "FREE_ROLL_MODE" 20 "DYNAMIC_PARKING" 19 "EXTERNAL_PARKING" 18 "RELEASING_FOR_EXTERNAL_PARK" 17 "EXTERNAL_DYNAMIC" 16 "SUMMON_PARKING" 15 "SUMMON_RELEASING" 14 "SUMMON" 13 "WINCHMODE_PENDING" 12 "PARK_PENDING" 11 "SERVICE_RELEASING" 10 "RELEASING" 9 "DYNAMIC_APPLYING" 8 "PARKING" 7 "WINCHMODE_RELEASING" 6 "WINCHMODE" 5 "SERVICE" 4 "START" 3 "PARK" 2 "DYNAMIC" 1 "OPEN" 0 "UNKNOWN" ;
VAL_ 1480 EPBL_a190_monitorFaultStatus 3 "FAULT_IDLE" 2 "FAULT" 1 "RETRY" 0 "NOMINAL" ;
VAL_ 1480 EPBL_a190_csmFaultReason 23 "REMOTE_MIA" 22 "NVM_MISMATCH" 21 "EPBM_MIA" 20 "MOTOR_NOT_READY" 19 "MOTOR_ACTIVE_FAULT" 18 "MOTOR_IDLE_FAULT" 17 "TIMEOUT_EPBM_START" 16 "TIMEOUT_NO_RAMP" 15 "TIMEOUT_EPBM_CUTOFF" 14 "TIMEOUT_RELEASE_COMPLETE" 13 "TIMEOUT_RELEASE_NO_LOAD" 12 "TIMEOUT_RELEASE_WAIT_FOR_ENDSTOP" 11 "TIMEOUT_RELEASE_INRUSH" 10 "TIMEOUT_EPBM_WAIT_FOR_CLAMP" 9 "TIMEOUT_EPB_WAIT_FOR_CLAMP" 8 "TIMEOUT_APPLY_INRUSH" 7 "TIMEOUT_APPLY_COMPLETE" 6 "RELEASE_BLOCKED" 5 "APPLY_BLOCKED" 4 "TIMEOUT_CALIBRATE" 3 "STATE_MISMATCH" 2 "EPBM_FAULTED" 1 "EPBM_DISABLED" 0 "NONE" ;
VAL_ 1480 EPBL_a190_esmOpTrigger 47 "RECOVERY_PARK" 46 "SPEED_SOURCES_LOST" 45 "ACTIVE_DECEL_OKTOPARK" 44 "ACTIVE_DECEL_FAST" 43 "STEERING_ACTIVE_DECEL" 42 "LV_ACTIVE_DECEL" 41 "CDP_PANIC_MODE_READY" 40 "CDP_PANIC_MODE_TIMEOUT" 39 "DI_PARK" 38 "FREE_ROLL_PARK_FOR_HANDLE_PULLED" 37 "LOW_BRAKE_FLUID_MODE_DYNAMIC" 36 "LOW_BRAKE_FLUID_MODE_DYNAMIC_PARK" 35 "LOW_BRAKE_FLUID_MODE_PARK" 34 "STATIONARY_DETECT" 33 "TOUCHSCREEN_INVALID" 32 "UI_DOOR_OPEN_REQUEST" 31 "AUTOPARK_END" 30 "DRIVER_IS_LEAVING" 29 "SYSTEM_APPLY" 28 "ACCELERATION" 27 "EPBM_DISQUALIFIED" 26 "DISQUALIFIED" 25 "SUMMON_FAULT" 24 "FAULT" 23 "SUMMON_COMPLETE" 22 "REAPPLY" 21 "SAVESTATE_ON_BOOT" 20 "TIMEOUT" 19 "SPEED_FAST" 18 "SPEED_OKAYTOPARK" 17 "SPEED_STOPPED" 16 "USER_CANCEL" 15 "USER_CONFIRMED" 14 "DIAG_EXIT" 13 "DIAG_OPEN" 12 "DIAG_CLOSE" 11 "SERVICE" 10 "WINCHMODE_UNAVAILABLE" 9 "WINCHMODE_ENTER" 8 "WINCHMODE_EXIT" 7 "TOUCHSCREEN" 6 "DI_UNPARK" 5 "ACTIVE_PARK_REQUEST" 4 "PBUTTON_RELEASED" 3 "PBUTTON_PRESSED_UNKNOWN" 2 "PBUTTON_PRESSED_FAST" 1 "PBUTTON_PRESSED_OKTOPARK" 0 "PBUTTON_PRESSED_STOPPED" ;
VAL_ 1480 EPBL_a190_nonterminalReason 23 "REMOTE_MIA" 22 "NVM_MISMATCH" 21 "EPBM_MIA" 20 "MOTOR_NOT_READY" 19 "MOTOR_ACTIVE_FAULT" 18 "MOTOR_IDLE_FAULT" 17 "TIMEOUT_EPBM_START" 16 "TIMEOUT_NO_RAMP" 15 "TIMEOUT_EPBM_CUTOFF" 14 "TIMEOUT_RELEASE_COMPLETE" 13 "TIMEOUT_RELEASE_NO_LOAD" 12 "TIMEOUT_RELEASE_WAIT_FOR_ENDSTOP" 11 "TIMEOUT_RELEASE_INRUSH" 10 "TIMEOUT_EPBM_WAIT_FOR_CLAMP" 9 "TIMEOUT_EPB_WAIT_FOR_CLAMP" 8 "TIMEOUT_APPLY_INRUSH" 7 "TIMEOUT_APPLY_COMPLETE" 6 "RELEASE_BLOCKED" 5 "APPLY_BLOCKED" 4 "TIMEOUT_CALIBRATE" 3 "STATE_MISMATCH" 2 "EPBM_FAULTED" 1 "EPBM_DISABLED" 0 "NONE" ;
VAL_ 1480 EPBL_a191_esmState 21 "UNKNOWN" 20 "SYSTEM_DYNAMIC_EXTERNAL" 19 "FREE_ROLL_MODE" 18 "DYNAMIC_EXTERNAL_EXIT" 17 "SERVICE_PENDING" 16 "LATCHED_DYNAMIC_EXTERNAL" 15 "DYNAMIC_PENDING" 14 "DYNAMIC_EXTERNAL" 13 "SUMMON_PARK" 12 "WINCHMODE_PENDING" 11 "PARK_PENDING" 10 "DYNAMIC_PARK" 9 "DIAGNOSTIC_OPEN" 8 "DIAGNOSTIC_PARK" 7 "SERVICE" 6 "WINCHMODE" 5 "SUMMON" 4 "DYNAMIC" 3 "OPEN" 2 "REAPPLY" 1 "PARK" 0 "INIT" ;
VAL_ 1480 EPBL_a191_esmStateRequest 21 "UNKNOWN" 20 "SYSTEM_DYNAMIC_EXTERNAL" 19 "FREE_ROLL_MODE" 18 "DYNAMIC_EXTERNAL_EXIT" 17 "SERVICE_PENDING" 16 "LATCHED_DYNAMIC_EXTERNAL" 15 "DYNAMIC_PENDING" 14 "DYNAMIC_EXTERNAL" 13 "SUMMON_PARK" 12 "WINCHMODE_PENDING" 11 "PARK_PENDING" 10 "DYNAMIC_PARK" 9 "DIAGNOSTIC_OPEN" 8 "DIAGNOSTIC_PARK" 7 "SERVICE" 6 "WINCHMODE" 5 "SUMMON" 4 "DYNAMIC" 3 "OPEN" 2 "REAPPLY" 1 "PARK" 0 "INIT" ;
VAL_ 1480 EPBL_a191_faultStatus 3 "FAULT_IDLE" 2 "FAULT" 1 "RETRY" 0 "NOMINAL" ;
VAL_ 1480 EPBL_a191_monitorUnitStatus 22 "COUNT" 21 "FREE_ROLL_MODE" 20 "DYNAMIC_PARKING" 19 "EXTERNAL_PARKING" 18 "RELEASING_FOR_EXTERNAL_PARK" 17 "EXTERNAL_DYNAMIC" 16 "SUMMON_PARKING" 15 "SUMMON_RELEASING" 14 "SUMMON" 13 "WINCHMODE_PENDING" 12 "PARK_PENDING" 11 "SERVICE_RELEASING" 10 "RELEASING" 9 "DYNAMIC_APPLYING" 8 "PARKING" 7 "WINCHMODE_RELEASING" 6 "WINCHMODE" 5 "SERVICE" 4 "START" 3 "PARK" 2 "DYNAMIC" 1 "OPEN" 0 "UNKNOWN" ;
VAL_ 1480 EPBL_a191_monitorFaultStatus 3 "FAULT_IDLE" 2 "FAULT" 1 "RETRY" 0 "NOMINAL" ;
VAL_ 1480 EPBL_a191_csmFaultReason 23 "REMOTE_MIA" 22 "NVM_MISMATCH" 21 "EPBM_MIA" 20 "MOTOR_NOT_READY" 19 "MOTOR_ACTIVE_FAULT" 18 "MOTOR_IDLE_FAULT" 17 "TIMEOUT_EPBM_START" 16 "TIMEOUT_NO_RAMP" 15 "TIMEOUT_EPBM_CUTOFF" 14 "TIMEOUT_RELEASE_COMPLETE" 13 "TIMEOUT_RELEASE_NO_LOAD" 12 "TIMEOUT_RELEASE_WAIT_FOR_ENDSTOP" 11 "TIMEOUT_RELEASE_INRUSH" 10 "TIMEOUT_EPBM_WAIT_FOR_CLAMP" 9 "TIMEOUT_EPB_WAIT_FOR_CLAMP" 8 "TIMEOUT_APPLY_INRUSH" 7 "TIMEOUT_APPLY_COMPLETE" 6 "RELEASE_BLOCKED" 5 "APPLY_BLOCKED" 4 "TIMEOUT_CALIBRATE" 3 "STATE_MISMATCH" 2 "EPBM_FAULTED" 1 "EPBM_DISABLED" 0 "NONE" ;
VAL_ 1480 EPBL_a191_esmOpTrigger 47 "RECOVERY_PARK" 46 "SPEED_SOURCES_LOST" 45 "ACTIVE_DECEL_OKTOPARK" 44 "ACTIVE_DECEL_FAST" 43 "STEERING_ACTIVE_DECEL" 42 "LV_ACTIVE_DECEL" 41 "CDP_PANIC_MODE_READY" 40 "CDP_PANIC_MODE_TIMEOUT" 39 "DI_PARK" 38 "FREE_ROLL_PARK_FOR_HANDLE_PULLED" 37 "LOW_BRAKE_FLUID_MODE_DYNAMIC" 36 "LOW_BRAKE_FLUID_MODE_DYNAMIC_PARK" 35 "LOW_BRAKE_FLUID_MODE_PARK" 34 "STATIONARY_DETECT" 33 "TOUCHSCREEN_INVALID" 32 "UI_DOOR_OPEN_REQUEST" 31 "AUTOPARK_END" 30 "DRIVER_IS_LEAVING" 29 "SYSTEM_APPLY" 28 "ACCELERATION" 27 "EPBM_DISQUALIFIED" 26 "DISQUALIFIED" 25 "SUMMON_FAULT" 24 "FAULT" 23 "SUMMON_COMPLETE" 22 "REAPPLY" 21 "SAVESTATE_ON_BOOT" 20 "TIMEOUT" 19 "SPEED_FAST" 18 "SPEED_OKAYTOPARK" 17 "SPEED_STOPPED" 16 "USER_CANCEL" 15 "USER_CONFIRMED" 14 "DIAG_EXIT" 13 "DIAG_OPEN" 12 "DIAG_CLOSE" 11 "SERVICE" 10 "WINCHMODE_UNAVAILABLE" 9 "WINCHMODE_ENTER" 8 "WINCHMODE_EXIT" 7 "TOUCHSCREEN" 6 "DI_UNPARK" 5 "ACTIVE_PARK_REQUEST" 4 "PBUTTON_RELEASED" 3 "PBUTTON_PRESSED_UNKNOWN" 2 "PBUTTON_PRESSED_FAST" 1 "PBUTTON_PRESSED_OKTOPARK" 0 "PBUTTON_PRESSED_STOPPED" ;
VAL_ 1480 EPBL_a191_nonterminalReason 23 "REMOTE_MIA" 22 "NVM_MISMATCH" 21 "EPBM_MIA" 20 "MOTOR_NOT_READY" 19 "MOTOR_ACTIVE_FAULT" 18 "MOTOR_IDLE_FAULT" 17 "TIMEOUT_EPBM_START" 16 "TIMEOUT_NO_RAMP" 15 "TIMEOUT_EPBM_CUTOFF" 14 "TIMEOUT_RELEASE_COMPLETE" 13 "TIMEOUT_RELEASE_NO_LOAD" 12 "TIMEOUT_RELEASE_WAIT_FOR_ENDSTOP" 11 "TIMEOUT_RELEASE_INRUSH" 10 "TIMEOUT_EPBM_WAIT_FOR_CLAMP" 9 "TIMEOUT_EPB_WAIT_FOR_CLAMP" 8 "TIMEOUT_APPLY_INRUSH" 7 "TIMEOUT_APPLY_COMPLETE" 6 "RELEASE_BLOCKED" 5 "APPLY_BLOCKED" 4 "TIMEOUT_CALIBRATE" 3 "STATE_MISMATCH" 2 "EPBM_FAULTED" 1 "EPBM_DISABLED" 0 "NONE" ;
VAL_ 1480 EPBL_a202_localEpbConfig 11 "CT_MANDO" 10 "MODEL3_ZF" 9 "MODELS_CERAMIC" 8 "MODELY_PERFORMANCE_V2" 7 "MODEL3_PERFORMANCE_V2" 6 "MODELX_BASE" 5 "MODELY_PERFORMANCE" 4 "MODELY_BASE" 3 "MODELS_BASE" 2 "MODEL3_PERFORMANCE" 1 "MODEL3_BASE" 0 "UNKNOWN" ;
VAL_ 1480 EPBL_a202_remoteEpbConfig 11 "CT_MANDO" 10 "MODEL3_ZF" 9 "MODELS_CERAMIC" 8 "MODELY_PERFORMANCE_V2" 7 "MODEL3_PERFORMANCE_V2" 6 "MODELX_BASE" 5 "MODELY_PERFORMANCE" 4 "MODELY_BASE" 3 "MODELS_BASE" 2 "MODEL3_PERFORMANCE" 1 "MODEL3_BASE" 0 "UNKNOWN" ;
VAL_ 1480 EPBL_a203_gtwConfig 11 "CT_MANDO" 10 "MODEL3_ZF" 9 "MODELS_CERAMIC" 8 "MODELY_PERFORMANCE_V2" 7 "MODEL3_PERFORMANCE_V2" 6 "MODELX_BASE" 5 "MODELY_PERFORMANCE" 4 "MODELY_BASE" 3 "MODELS_BASE" 2 "MODEL3_PERFORMANCE" 1 "MODEL3_BASE" 0 "UNKNOWN" ;
VAL_ 1480 EPBL_a203_epbConfig 11 "CT_MANDO" 10 "MODEL3_ZF" 9 "MODELS_CERAMIC" 8 "MODELY_PERFORMANCE_V2" 7 "MODEL3_PERFORMANCE_V2" 6 "MODELX_BASE" 5 "MODELY_PERFORMANCE" 4 "MODELY_BASE" 3 "MODELS_BASE" 2 "MODEL3_PERFORMANCE" 1 "MODEL3_BASE" 0 "UNKNOWN" ;
VAL_ 1480 EPBL_a210_driverIsLeavingSpeedCl 4 "UNKNOWN" 3 "TOO_FAST_FOR_DECEL" 2 "TOO_FAST_TO_PARK" 1 "SLOW_ENOUGH_TO_PARK" 0 "STOPPED" ;
VAL_ 1480 EPBL_a210_primaryDriverDoorClose 2 "SNA" 1 "FALSE" 0 "TRUE" ;
VAL_ 1480 EPBL_a210_secondaryDriverDoorClo 2 "SNA" 1 "FALSE" 0 "TRUE" ;
VAL_ 1480 EPBL_a210_driverBuckled 2 "SNA" 1 "FALSE" 0 "TRUE" ;
VAL_ 1480 EPBL_a210_driverSeated 2 "SNA" 1 "FALSE" 0 "TRUE" ;
VAL_ 1480 EPBL_a225_esmOpTrigger 47 "RECOVERY_PARK" 46 "SPEED_SOURCES_LOST" 45 "ACTIVE_DECEL_OKTOPARK" 44 "ACTIVE_DECEL_FAST" 43 "STEERING_ACTIVE_DECEL" 42 "LV_ACTIVE_DECEL" 41 "CDP_PANIC_MODE_READY" 40 "CDP_PANIC_MODE_TIMEOUT" 39 "DI_PARK" 38 "FREE_ROLL_PARK_FOR_HANDLE_PULLED" 37 "LOW_BRAKE_FLUID_MODE_DYNAMIC" 36 "LOW_BRAKE_FLUID_MODE_DYNAMIC_PARK" 35 "LOW_BRAKE_FLUID_MODE_PARK" 34 "STATIONARY_DETECT" 33 "TOUCHSCREEN_INVALID" 32 "UI_DOOR_OPEN_REQUEST" 31 "AUTOPARK_END" 30 "DRIVER_IS_LEAVING" 29 "SYSTEM_APPLY" 28 "ACCELERATION" 27 "EPBM_DISQUALIFIED" 26 "DISQUALIFIED" 25 "SUMMON_FAULT" 24 "FAULT" 23 "SUMMON_COMPLETE" 22 "REAPPLY" 21 "SAVESTATE_ON_BOOT" 20 "TIMEOUT" 19 "SPEED_FAST" 18 "SPEED_OKAYTOPARK" 17 "SPEED_STOPPED" 16 "USER_CANCEL" 15 "USER_CONFIRMED" 14 "DIAG_EXIT" 13 "DIAG_OPEN" 12 "DIAG_CLOSE" 11 "SERVICE" 10 "WINCHMODE_UNAVAILABLE" 9 "WINCHMODE_ENTER" 8 "WINCHMODE_EXIT" 7 "TOUCHSCREEN" 6 "DI_UNPARK" 5 "ACTIVE_PARK_REQUEST" 4 "PBUTTON_RELEASED" 3 "PBUTTON_PRESSED_UNKNOWN" 2 "PBUTTON_PRESSED_FAST" 1 "PBUTTON_PRESSED_OKTOPARK" 0 "PBUTTON_PRESSED_STOPPED" ;
VAL_ 1480 EPBL_a225_previousState 21 "UNKNOWN" 20 "SYSTEM_DYNAMIC_EXTERNAL" 19 "FREE_ROLL_MODE" 18 "DYNAMIC_EXTERNAL_EXIT" 17 "SERVICE_PENDING" 16 "LATCHED_DYNAMIC_EXTERNAL" 15 "DYNAMIC_PENDING" 14 "DYNAMIC_EXTERNAL" 13 "SUMMON_PARK" 12 "WINCHMODE_PENDING" 11 "PARK_PENDING" 10 "DYNAMIC_PARK" 9 "DIAGNOSTIC_OPEN" 8 "DIAGNOSTIC_PARK" 7 "SERVICE" 6 "WINCHMODE" 5 "SUMMON" 4 "DYNAMIC" 3 "OPEN" 2 "REAPPLY" 1 "PARK" 0 "INIT" ;
VAL_ 1480 EPBL_a225_nextState 21 "UNKNOWN" 20 "SYSTEM_DYNAMIC_EXTERNAL" 19 "FREE_ROLL_MODE" 18 "DYNAMIC_EXTERNAL_EXIT" 17 "SERVICE_PENDING" 16 "LATCHED_DYNAMIC_EXTERNAL" 15 "DYNAMIC_PENDING" 14 "DYNAMIC_EXTERNAL" 13 "SUMMON_PARK" 12 "WINCHMODE_PENDING" 11 "PARK_PENDING" 10 "DYNAMIC_PARK" 9 "DIAGNOSTIC_OPEN" 8 "DIAGNOSTIC_PARK" 7 "SERVICE" 6 "WINCHMODE" 5 "SUMMON" 4 "DYNAMIC" 3 "OPEN" 2 "REAPPLY" 1 "PARK" 0 "INIT" ;
VAL_ 1480 EPBL_a241_epbSysStatus 8 "MISMATCH" 7 "FAULT_SECURE" 6 "FAULT" 5 "RELEASING" 4 "PARKING" 3 "DYNAMIC" 2 "PARKED" 1 "RELEASED" 0 "UNKNOWN" ;
VAL_ 1480 EPBL_a241_vehiclePowerState 3 "DRIVE" 2 "ACCESSORY" 1 "CONDITIONING" 0 "OFF" ;
VAL_ 1480 EPBL_a242_hvState 6 "UP" 5 "UP_FOR_DC_CHARGE" 4 "UP_FOR_CHARGE" 3 "UP_FOR_DRIVE" 2 "GOING_DOWN" 1 "COMING_UP" 0 "DOWN" ;
VAL_ 1480 EPBL_a242_vehiclePowerState 3 "DRIVE" 2 "ACCESSORY" 1 "CONDITIONING" 0 "OFF" ;
VAL_ 1480 EPBL_a246_previousState 21 "UNKNOWN" 20 "SYSTEM_DYNAMIC_EXTERNAL" 19 "FREE_ROLL_MODE" 18 "DYNAMIC_EXTERNAL_EXIT" 17 "SERVICE_PENDING" 16 "LATCHED_DYNAMIC_EXTERNAL" 15 "DYNAMIC_PENDING" 14 "DYNAMIC_EXTERNAL" 13 "SUMMON_PARK" 12 "WINCHMODE_PENDING" 11 "PARK_PENDING" 10 "DYNAMIC_PARK" 9 "DIAGNOSTIC_OPEN" 8 "DIAGNOSTIC_PARK" 7 "SERVICE" 6 "WINCHMODE" 5 "SUMMON" 4 "DYNAMIC" 3 "OPEN" 2 "REAPPLY" 1 "PARK" 0 "INIT" ;
VAL_ 1480 EPBL_a246_nextState 21 "UNKNOWN" 20 "SYSTEM_DYNAMIC_EXTERNAL" 19 "FREE_ROLL_MODE" 18 "DYNAMIC_EXTERNAL_EXIT" 17 "SERVICE_PENDING" 16 "LATCHED_DYNAMIC_EXTERNAL" 15 "DYNAMIC_PENDING" 14 "DYNAMIC_EXTERNAL" 13 "SUMMON_PARK" 12 "WINCHMODE_PENDING" 11 "PARK_PENDING" 10 "DYNAMIC_PARK" 9 "DIAGNOSTIC_OPEN" 8 "DIAGNOSTIC_PARK" 7 "SERVICE" 6 "WINCHMODE" 5 "SUMMON" 4 "DYNAMIC" 3 "OPEN" 2 "REAPPLY" 1 "PARK" 0 "INIT" ;
VAL_ 1480 EPBL_a246_esmStateRequest 21 "UNKNOWN" 20 "SYSTEM_DYNAMIC_EXTERNAL" 19 "FREE_ROLL_MODE" 18 "DYNAMIC_EXTERNAL_EXIT" 17 "SERVICE_PENDING" 16 "LATCHED_DYNAMIC_EXTERNAL" 15 "DYNAMIC_PENDING" 14 "DYNAMIC_EXTERNAL" 13 "SUMMON_PARK" 12 "WINCHMODE_PENDING" 11 "PARK_PENDING" 10 "DYNAMIC_PARK" 9 "DIAGNOSTIC_OPEN" 8 "DIAGNOSTIC_PARK" 7 "SERVICE" 6 "WINCHMODE" 5 "SUMMON" 4 "DYNAMIC" 3 "OPEN" 2 "REAPPLY" 1 "PARK" 0 "INIT" ;
VAL_ 1480 EPBL_a246_faultStatus 3 "FAULT_IDLE" 2 "FAULT" 1 "RETRY" 0 "NOMINAL" ;
VAL_ 1480 EPBL_a246_esmOpTrigger 47 "RECOVERY_PARK" 46 "SPEED_SOURCES_LOST" 45 "ACTIVE_DECEL_OKTOPARK" 44 "ACTIVE_DECEL_FAST" 43 "STEERING_ACTIVE_DECEL" 42 "LV_ACTIVE_DECEL" 41 "CDP_PANIC_MODE_READY" 40 "CDP_PANIC_MODE_TIMEOUT" 39 "DI_PARK" 38 "FREE_ROLL_PARK_FOR_HANDLE_PULLED" 37 "LOW_BRAKE_FLUID_MODE_DYNAMIC" 36 "LOW_BRAKE_FLUID_MODE_DYNAMIC_PARK" 35 "LOW_BRAKE_FLUID_MODE_PARK" 34 "STATIONARY_DETECT" 33 "TOUCHSCREEN_INVALID" 32 "UI_DOOR_OPEN_REQUEST" 31 "AUTOPARK_END" 30 "DRIVER_IS_LEAVING" 29 "SYSTEM_APPLY" 28 "ACCELERATION" 27 "EPBM_DISQUALIFIED" 26 "DISQUALIFIED" 25 "SUMMON_FAULT" 24 "FAULT" 23 "SUMMON_COMPLETE" 22 "REAPPLY" 21 "SAVESTATE_ON_BOOT" 20 "TIMEOUT" 19 "SPEED_FAST" 18 "SPEED_OKAYTOPARK" 17 "SPEED_STOPPED" 16 "USER_CANCEL" 15 "USER_CONFIRMED" 14 "DIAG_EXIT" 13 "DIAG_OPEN" 12 "DIAG_CLOSE" 11 "SERVICE" 10 "WINCHMODE_UNAVAILABLE" 9 "WINCHMODE_ENTER" 8 "WINCHMODE_EXIT" 7 "TOUCHSCREEN" 6 "DI_UNPARK" 5 "ACTIVE_PARK_REQUEST" 4 "PBUTTON_RELEASED" 3 "PBUTTON_PRESSED_UNKNOWN" 2 "PBUTTON_PRESSED_FAST" 1 "PBUTTON_PRESSED_OKTOPARK" 0 "PBUTTON_PRESSED_STOPPED" ;
VAL_ 1480 EPBL_a247_esmState 21 "UNKNOWN" 20 "SYSTEM_DYNAMIC_EXTERNAL" 19 "FREE_ROLL_MODE" 18 "DYNAMIC_EXTERNAL_EXIT" 17 "SERVICE_PENDING" 16 "LATCHED_DYNAMIC_EXTERNAL" 15 "DYNAMIC_PENDING" 14 "DYNAMIC_EXTERNAL" 13 "SUMMON_PARK" 12 "WINCHMODE_PENDING" 11 "PARK_PENDING" 10 "DYNAMIC_PARK" 9 "DIAGNOSTIC_OPEN" 8 "DIAGNOSTIC_PARK" 7 "SERVICE" 6 "WINCHMODE" 5 "SUMMON" 4 "DYNAMIC" 3 "OPEN" 2 "REAPPLY" 1 "PARK" 0 "INIT" ;
VAL_ 1480 EPBL_a247_esmStateRequest 21 "UNKNOWN" 20 "SYSTEM_DYNAMIC_EXTERNAL" 19 "FREE_ROLL_MODE" 18 "DYNAMIC_EXTERNAL_EXIT" 17 "SERVICE_PENDING" 16 "LATCHED_DYNAMIC_EXTERNAL" 15 "DYNAMIC_PENDING" 14 "DYNAMIC_EXTERNAL" 13 "SUMMON_PARK" 12 "WINCHMODE_PENDING" 11 "PARK_PENDING" 10 "DYNAMIC_PARK" 9 "DIAGNOSTIC_OPEN" 8 "DIAGNOSTIC_PARK" 7 "SERVICE" 6 "WINCHMODE" 5 "SUMMON" 4 "DYNAMIC" 3 "OPEN" 2 "REAPPLY" 1 "PARK" 0 "INIT" ;
VAL_ 1480 EPBL_a247_faultStatus 3 "FAULT_IDLE" 2 "FAULT" 1 "RETRY" 0 "NOMINAL" ;
VAL_ 1480 EPBL_a247_monitorUnitStatus 22 "COUNT" 21 "FREE_ROLL_MODE" 20 "DYNAMIC_PARKING" 19 "EXTERNAL_PARKING" 18 "RELEASING_FOR_EXTERNAL_PARK" 17 "EXTERNAL_DYNAMIC" 16 "SUMMON_PARKING" 15 "SUMMON_RELEASING" 14 "SUMMON" 13 "WINCHMODE_PENDING" 12 "PARK_PENDING" 11 "SERVICE_RELEASING" 10 "RELEASING" 9 "DYNAMIC_APPLYING" 8 "PARKING" 7 "WINCHMODE_RELEASING" 6 "WINCHMODE" 5 "SERVICE" 4 "START" 3 "PARK" 2 "DYNAMIC" 1 "OPEN" 0 "UNKNOWN" ;
VAL_ 1480 EPBL_a247_monitorFaultStatus 3 "FAULT_IDLE" 2 "FAULT" 1 "RETRY" 0 "NOMINAL" ;
VAL_ 1480 EPBL_a247_csmFaultReason 23 "REMOTE_MIA" 22 "NVM_MISMATCH" 21 "EPBM_MIA" 20 "MOTOR_NOT_READY" 19 "MOTOR_ACTIVE_FAULT" 18 "MOTOR_IDLE_FAULT" 17 "TIMEOUT_EPBM_START" 16 "TIMEOUT_NO_RAMP" 15 "TIMEOUT_EPBM_CUTOFF" 14 "TIMEOUT_RELEASE_COMPLETE" 13 "TIMEOUT_RELEASE_NO_LOAD" 12 "TIMEOUT_RELEASE_WAIT_FOR_ENDSTOP" 11 "TIMEOUT_RELEASE_INRUSH" 10 "TIMEOUT_EPBM_WAIT_FOR_CLAMP" 9 "TIMEOUT_EPB_WAIT_FOR_CLAMP" 8 "TIMEOUT_APPLY_INRUSH" 7 "TIMEOUT_APPLY_COMPLETE" 6 "RELEASE_BLOCKED" 5 "APPLY_BLOCKED" 4 "TIMEOUT_CALIBRATE" 3 "STATE_MISMATCH" 2 "EPBM_FAULTED" 1 "EPBM_DISABLED" 0 "NONE" ;
VAL_ 1480 EPBL_a247_esmOpTrigger 47 "RECOVERY_PARK" 46 "SPEED_SOURCES_LOST" 45 "ACTIVE_DECEL_OKTOPARK" 44 "ACTIVE_DECEL_FAST" 43 "STEERING_ACTIVE_DECEL" 42 "LV_ACTIVE_DECEL" 41 "CDP_PANIC_MODE_READY" 40 "CDP_PANIC_MODE_TIMEOUT" 39 "DI_PARK" 38 "FREE_ROLL_PARK_FOR_HANDLE_PULLED" 37 "LOW_BRAKE_FLUID_MODE_DYNAMIC" 36 "LOW_BRAKE_FLUID_MODE_DYNAMIC_PARK" 35 "LOW_BRAKE_FLUID_MODE_PARK" 34 "STATIONARY_DETECT" 33 "TOUCHSCREEN_INVALID" 32 "UI_DOOR_OPEN_REQUEST" 31 "AUTOPARK_END" 30 "DRIVER_IS_LEAVING" 29 "SYSTEM_APPLY" 28 "ACCELERATION" 27 "EPBM_DISQUALIFIED" 26 "DISQUALIFIED" 25 "SUMMON_FAULT" 24 "FAULT" 23 "SUMMON_COMPLETE" 22 "REAPPLY" 21 "SAVESTATE_ON_BOOT" 20 "TIMEOUT" 19 "SPEED_FAST" 18 "SPEED_OKAYTOPARK" 17 "SPEED_STOPPED" 16 "USER_CANCEL" 15 "USER_CONFIRMED" 14 "DIAG_EXIT" 13 "DIAG_OPEN" 12 "DIAG_CLOSE" 11 "SERVICE" 10 "WINCHMODE_UNAVAILABLE" 9 "WINCHMODE_ENTER" 8 "WINCHMODE_EXIT" 7 "TOUCHSCREEN" 6 "DI_UNPARK" 5 "ACTIVE_PARK_REQUEST" 4 "PBUTTON_RELEASED" 3 "PBUTTON_PRESSED_UNKNOWN" 2 "PBUTTON_PRESSED_FAST" 1 "PBUTTON_PRESSED_OKTOPARK" 0 "PBUTTON_PRESSED_STOPPED" ;
VAL_ 1480 EPBL_a247_nonterminalReason 23 "REMOTE_MIA" 22 "NVM_MISMATCH" 21 "EPBM_MIA" 20 "MOTOR_NOT_READY" 19 "MOTOR_ACTIVE_FAULT" 18 "MOTOR_IDLE_FAULT" 17 "TIMEOUT_EPBM_START" 16 "TIMEOUT_NO_RAMP" 15 "TIMEOUT_EPBM_CUTOFF" 14 "TIMEOUT_RELEASE_COMPLETE" 13 "TIMEOUT_RELEASE_NO_LOAD" 12 "TIMEOUT_RELEASE_WAIT_FOR_ENDSTOP" 11 "TIMEOUT_RELEASE_INRUSH" 10 "TIMEOUT_EPBM_WAIT_FOR_CLAMP" 9 "TIMEOUT_EPB_WAIT_FOR_CLAMP" 8 "TIMEOUT_APPLY_INRUSH" 7 "TIMEOUT_APPLY_COMPLETE" 6 "RELEASE_BLOCKED" 5 "APPLY_BLOCKED" 4 "TIMEOUT_CALIBRATE" 3 "STATE_MISMATCH" 2 "EPBM_FAULTED" 1 "EPBM_DISABLED" 0 "NONE" ;
VAL_ 1480 EPBL_a248_esmState 21 "UNKNOWN" 20 "SYSTEM_DYNAMIC_EXTERNAL" 19 "FREE_ROLL_MODE" 18 "DYNAMIC_EXTERNAL_EXIT" 17 "SERVICE_PENDING" 16 "LATCHED_DYNAMIC_EXTERNAL" 15 "DYNAMIC_PENDING" 14 "DYNAMIC_EXTERNAL" 13 "SUMMON_PARK" 12 "WINCHMODE_PENDING" 11 "PARK_PENDING" 10 "DYNAMIC_PARK" 9 "DIAGNOSTIC_OPEN" 8 "DIAGNOSTIC_PARK" 7 "SERVICE" 6 "WINCHMODE" 5 "SUMMON" 4 "DYNAMIC" 3 "OPEN" 2 "REAPPLY" 1 "PARK" 0 "INIT" ;
VAL_ 1480 EPBL_a248_esmStateRequest 21 "UNKNOWN" 20 "SYSTEM_DYNAMIC_EXTERNAL" 19 "FREE_ROLL_MODE" 18 "DYNAMIC_EXTERNAL_EXIT" 17 "SERVICE_PENDING" 16 "LATCHED_DYNAMIC_EXTERNAL" 15 "DYNAMIC_PENDING" 14 "DYNAMIC_EXTERNAL" 13 "SUMMON_PARK" 12 "WINCHMODE_PENDING" 11 "PARK_PENDING" 10 "DYNAMIC_PARK" 9 "DIAGNOSTIC_OPEN" 8 "DIAGNOSTIC_PARK" 7 "SERVICE" 6 "WINCHMODE" 5 "SUMMON" 4 "DYNAMIC" 3 "OPEN" 2 "REAPPLY" 1 "PARK" 0 "INIT" ;
VAL_ 1480 EPBL_a248_faultStatus 3 "FAULT_IDLE" 2 "FAULT" 1 "RETRY" 0 "NOMINAL" ;
VAL_ 1480 EPBL_a248_monitorUnitStatus 22 "COUNT" 21 "FREE_ROLL_MODE" 20 "DYNAMIC_PARKING" 19 "EXTERNAL_PARKING" 18 "RELEASING_FOR_EXTERNAL_PARK" 17 "EXTERNAL_DYNAMIC" 16 "SUMMON_PARKING" 15 "SUMMON_RELEASING" 14 "SUMMON" 13 "WINCHMODE_PENDING" 12 "PARK_PENDING" 11 "SERVICE_RELEASING" 10 "RELEASING" 9 "DYNAMIC_APPLYING" 8 "PARKING" 7 "WINCHMODE_RELEASING" 6 "WINCHMODE" 5 "SERVICE" 4 "START" 3 "PARK" 2 "DYNAMIC" 1 "OPEN" 0 "UNKNOWN" ;
VAL_ 1480 EPBL_a248_monitorFaultStatus 3 "FAULT_IDLE" 2 "FAULT" 1 "RETRY" 0 "NOMINAL" ;
VAL_ 1480 EPBL_a248_csmFaultReason 23 "REMOTE_MIA" 22 "NVM_MISMATCH" 21 "EPBM_MIA" 20 "MOTOR_NOT_READY" 19 "MOTOR_ACTIVE_FAULT" 18 "MOTOR_IDLE_FAULT" 17 "TIMEOUT_EPBM_START" 16 "TIMEOUT_NO_RAMP" 15 "TIMEOUT_EPBM_CUTOFF" 14 "TIMEOUT_RELEASE_COMPLETE" 13 "TIMEOUT_RELEASE_NO_LOAD" 12 "TIMEOUT_RELEASE_WAIT_FOR_ENDSTOP" 11 "TIMEOUT_RELEASE_INRUSH" 10 "TIMEOUT_EPBM_WAIT_FOR_CLAMP" 9 "TIMEOUT_EPB_WAIT_FOR_CLAMP" 8 "TIMEOUT_APPLY_INRUSH" 7 "TIMEOUT_APPLY_COMPLETE" 6 "RELEASE_BLOCKED" 5 "APPLY_BLOCKED" 4 "TIMEOUT_CALIBRATE" 3 "STATE_MISMATCH" 2 "EPBM_FAULTED" 1 "EPBM_DISABLED" 0 "NONE" ;
VAL_ 1480 EPBL_a248_esmOpTrigger 47 "RECOVERY_PARK" 46 "SPEED_SOURCES_LOST" 45 "ACTIVE_DECEL_OKTOPARK" 44 "ACTIVE_DECEL_FAST" 43 "STEERING_ACTIVE_DECEL" 42 "LV_ACTIVE_DECEL" 41 "CDP_PANIC_MODE_READY" 40 "CDP_PANIC_MODE_TIMEOUT" 39 "DI_PARK" 38 "FREE_ROLL_PARK_FOR_HANDLE_PULLED" 37 "LOW_BRAKE_FLUID_MODE_DYNAMIC" 36 "LOW_BRAKE_FLUID_MODE_DYNAMIC_PARK" 35 "LOW_BRAKE_FLUID_MODE_PARK" 34 "STATIONARY_DETECT" 33 "TOUCHSCREEN_INVALID" 32 "UI_DOOR_OPEN_REQUEST" 31 "AUTOPARK_END" 30 "DRIVER_IS_LEAVING" 29 "SYSTEM_APPLY" 28 "ACCELERATION" 27 "EPBM_DISQUALIFIED" 26 "DISQUALIFIED" 25 "SUMMON_FAULT" 24 "FAULT" 23 "SUMMON_COMPLETE" 22 "REAPPLY" 21 "SAVESTATE_ON_BOOT" 20 "TIMEOUT" 19 "SPEED_FAST" 18 "SPEED_OKAYTOPARK" 17 "SPEED_STOPPED" 16 "USER_CANCEL" 15 "USER_CONFIRMED" 14 "DIAG_EXIT" 13 "DIAG_OPEN" 12 "DIAG_CLOSE" 11 "SERVICE" 10 "WINCHMODE_UNAVAILABLE" 9 "WINCHMODE_ENTER" 8 "WINCHMODE_EXIT" 7 "TOUCHSCREEN" 6 "DI_UNPARK" 5 "ACTIVE_PARK_REQUEST" 4 "PBUTTON_RELEASED" 3 "PBUTTON_PRESSED_UNKNOWN" 2 "PBUTTON_PRESSED_FAST" 1 "PBUTTON_PRESSED_OKTOPARK" 0 "PBUTTON_PRESSED_STOPPED" ;
VAL_ 1480 EPBL_a248_nonterminalReason 23 "REMOTE_MIA" 22 "NVM_MISMATCH" 21 "EPBM_MIA" 20 "MOTOR_NOT_READY" 19 "MOTOR_ACTIVE_FAULT" 18 "MOTOR_IDLE_FAULT" 17 "TIMEOUT_EPBM_START" 16 "TIMEOUT_NO_RAMP" 15 "TIMEOUT_EPBM_CUTOFF" 14 "TIMEOUT_RELEASE_COMPLETE" 13 "TIMEOUT_RELEASE_NO_LOAD" 12 "TIMEOUT_RELEASE_WAIT_FOR_ENDSTOP" 11 "TIMEOUT_RELEASE_INRUSH" 10 "TIMEOUT_EPBM_WAIT_FOR_CLAMP" 9 "TIMEOUT_EPB_WAIT_FOR_CLAMP" 8 "TIMEOUT_APPLY_INRUSH" 7 "TIMEOUT_APPLY_COMPLETE" 6 "RELEASE_BLOCKED" 5 "APPLY_BLOCKED" 4 "TIMEOUT_CALIBRATE" 3 "STATE_MISMATCH" 2 "EPBM_FAULTED" 1 "EPBM_DISABLED" 0 "NONE" ;
VAL_ 1480 EPBL_a249_previousState 21 "UNKNOWN" 20 "SYSTEM_DYNAMIC_EXTERNAL" 19 "FREE_ROLL_MODE" 18 "DYNAMIC_EXTERNAL_EXIT" 17 "SERVICE_PENDING" 16 "LATCHED_DYNAMIC_EXTERNAL" 15 "DYNAMIC_PENDING" 14 "DYNAMIC_EXTERNAL" 13 "SUMMON_PARK" 12 "WINCHMODE_PENDING" 11 "PARK_PENDING" 10 "DYNAMIC_PARK" 9 "DIAGNOSTIC_OPEN" 8 "DIAGNOSTIC_PARK" 7 "SERVICE" 6 "WINCHMODE" 5 "SUMMON" 4 "DYNAMIC" 3 "OPEN" 2 "REAPPLY" 1 "PARK" 0 "INIT" ;
VAL_ 1480 EPBL_a249_nextState 21 "UNKNOWN" 20 "SYSTEM_DYNAMIC_EXTERNAL" 19 "FREE_ROLL_MODE" 18 "DYNAMIC_EXTERNAL_EXIT" 17 "SERVICE_PENDING" 16 "LATCHED_DYNAMIC_EXTERNAL" 15 "DYNAMIC_PENDING" 14 "DYNAMIC_EXTERNAL" 13 "SUMMON_PARK" 12 "WINCHMODE_PENDING" 11 "PARK_PENDING" 10 "DYNAMIC_PARK" 9 "DIAGNOSTIC_OPEN" 8 "DIAGNOSTIC_PARK" 7 "SERVICE" 6 "WINCHMODE" 5 "SUMMON" 4 "DYNAMIC" 3 "OPEN" 2 "REAPPLY" 1 "PARK" 0 "INIT" ;
VAL_ 1480 EPBL_a249_esmStateRequest 21 "UNKNOWN" 20 "SYSTEM_DYNAMIC_EXTERNAL" 19 "FREE_ROLL_MODE" 18 "DYNAMIC_EXTERNAL_EXIT" 17 "SERVICE_PENDING" 16 "LATCHED_DYNAMIC_EXTERNAL" 15 "DYNAMIC_PENDING" 14 "DYNAMIC_EXTERNAL" 13 "SUMMON_PARK" 12 "WINCHMODE_PENDING" 11 "PARK_PENDING" 10 "DYNAMIC_PARK" 9 "DIAGNOSTIC_OPEN" 8 "DIAGNOSTIC_PARK" 7 "SERVICE" 6 "WINCHMODE" 5 "SUMMON" 4 "DYNAMIC" 3 "OPEN" 2 "REAPPLY" 1 "PARK" 0 "INIT" ;
VAL_ 1480 EPBL_a249_faultStatus 3 "FAULT_IDLE" 2 "FAULT" 1 "RETRY" 0 "NOMINAL" ;
VAL_ 1480 EPBL_a249_esmOpTrigger 47 "RECOVERY_PARK" 46 "SPEED_SOURCES_LOST" 45 "ACTIVE_DECEL_OKTOPARK" 44 "ACTIVE_DECEL_FAST" 43 "STEERING_ACTIVE_DECEL" 42 "LV_ACTIVE_DECEL" 41 "CDP_PANIC_MODE_READY" 40 "CDP_PANIC_MODE_TIMEOUT" 39 "DI_PARK" 38 "FREE_ROLL_PARK_FOR_HANDLE_PULLED" 37 "LOW_BRAKE_FLUID_MODE_DYNAMIC" 36 "LOW_BRAKE_FLUID_MODE_DYNAMIC_PARK" 35 "LOW_BRAKE_FLUID_MODE_PARK" 34 "STATIONARY_DETECT" 33 "TOUCHSCREEN_INVALID" 32 "UI_DOOR_OPEN_REQUEST" 31 "AUTOPARK_END" 30 "DRIVER_IS_LEAVING" 29 "SYSTEM_APPLY" 28 "ACCELERATION" 27 "EPBM_DISQUALIFIED" 26 "DISQUALIFIED" 25 "SUMMON_FAULT" 24 "FAULT" 23 "SUMMON_COMPLETE" 22 "REAPPLY" 21 "SAVESTATE_ON_BOOT" 20 "TIMEOUT" 19 "SPEED_FAST" 18 "SPEED_OKAYTOPARK" 17 "SPEED_STOPPED" 16 "USER_CANCEL" 15 "USER_CONFIRMED" 14 "DIAG_EXIT" 13 "DIAG_OPEN" 12 "DIAG_CLOSE" 11 "SERVICE" 10 "WINCHMODE_UNAVAILABLE" 9 "WINCHMODE_ENTER" 8 "WINCHMODE_EXIT" 7 "TOUCHSCREEN" 6 "DI_UNPARK" 5 "ACTIVE_PARK_REQUEST" 4 "PBUTTON_RELEASED" 3 "PBUTTON_PRESSED_UNKNOWN" 2 "PBUTTON_PRESSED_FAST" 1 "PBUTTON_PRESSED_OKTOPARK" 0 "PBUTTON_PRESSED_STOPPED" ;
VAL_ 1480 EPBL_a250_esmSpeedClass 4 "UNKNOWN" 3 "FAST" 2 "USER_APPLY_OK" 1 "SYSTEM_APPLY_OK" 0 "STOPPED" ;
VAL_ 1480 EPBL_a250_esmOperationTrigger 47 "RECOVERY_PARK" 46 "SPEED_SOURCES_LOST" 45 "ACTIVE_DECEL_OKTOPARK" 44 "ACTIVE_DECEL_FAST" 43 "STEERING_ACTIVE_DECEL" 42 "LV_ACTIVE_DECEL" 41 "CDP_PANIC_MODE_READY" 40 "CDP_PANIC_MODE_TIMEOUT" 39 "DI_PARK" 38 "FREE_ROLL_PARK_FOR_HANDLE_PULLED" 37 "LOW_BRAKE_FLUID_MODE_DYNAMIC" 36 "LOW_BRAKE_FLUID_MODE_DYNAMIC_PARK" 35 "LOW_BRAKE_FLUID_MODE_PARK" 34 "STATIONARY_DETECT" 33 "TOUCHSCREEN_INVALID" 32 "UI_DOOR_OPEN_REQUEST" 31 "AUTOPARK_END" 30 "DRIVER_IS_LEAVING" 29 "SYSTEM_APPLY" 28 "ACCELERATION" 27 "EPBM_DISQUALIFIED" 26 "DISQUALIFIED" 25 "SUMMON_FAULT" 24 "FAULT" 23 "SUMMON_COMPLETE" 22 "REAPPLY" 21 "SAVESTATE_ON_BOOT" 20 "TIMEOUT" 19 "SPEED_FAST" 18 "SPEED_OKAYTOPARK" 17 "SPEED_STOPPED" 16 "USER_CANCEL" 15 "USER_CONFIRMED" 14 "DIAG_EXIT" 13 "DIAG_OPEN" 12 "DIAG_CLOSE" 11 "SERVICE" 10 "WINCHMODE_UNAVAILABLE" 9 "WINCHMODE_ENTER" 8 "WINCHMODE_EXIT" 7 "TOUCHSCREEN" 6 "DI_UNPARK" 5 "ACTIVE_PARK_REQUEST" 4 "PBUTTON_RELEASED" 3 "PBUTTON_PRESSED_UNKNOWN" 2 "PBUTTON_PRESSED_FAST" 1 "PBUTTON_PRESSED_OKTOPARK" 0 "PBUTTON_PRESSED_STOPPED" ;
VAL_ 1480 EPBL_a272_expectedState 3 "DRIVE" 2 "ACCESSORY" 1 "CONDITIONING" 0 "OFF" ;
VAL_ 1480 EPBL_a272_actualState 3 "DRIVE" 2 "ACCESSORY" 1 "CONDITIONING" 0 "OFF" ;
VAL_ 1480 EPBL_a355_brakeHwConfig 11 "CT_MANDO" 10 "MODEL3_ZF" 9 "MODELS_CERAMIC" 8 "MODELY_PERFORMANCE_V2" 7 "MODEL3_PERFORMANCE_V2" 6 "MODELX_BASE" 5 "MODELY_PERFORMANCE" 4 "MODELY_BASE" 3 "MODELS_BASE" 2 "MODEL3_PERFORMANCE" 1 "MODEL3_BASE" 0 "UNKNOWN" ;
VAL_ 1480 EPBL_a355_epbHwConfig 11 "CT_MANDO" 10 "MODEL3_ZF" 9 "MODELS_CERAMIC" 8 "MODELY_PERFORMANCE_V2" 7 "MODEL3_PERFORMANCE_V2" 6 "MODELX_BASE" 5 "MODELY_PERFORMANCE" 4 "MODELY_BASE" 3 "MODELS_BASE" 2 "MODEL3_PERFORMANCE" 1 "MODEL3_BASE" 0 "UNKNOWN" ;
VAL_ 1480 EPBL_a357_epbSystemStatus 8 "MISMATCH" 7 "FAULT_SECURE" 6 "FAULT" 5 "RELEASING" 4 "PARKING" 3 "DYNAMIC" 2 "PARKED" 1 "RELEASED" 0 "UNKNOWN" ;
VAL_ 1480 EPBL_a358_epbSystemStatus 8 "MISMATCH" 7 "FAULT_SECURE" 6 "FAULT" 5 "RELEASING" 4 "PARKING" 3 "DYNAMIC" 2 "PARKED" 1 "RELEASED" 0 "UNKNOWN" ;
VAL_ 1480 EPBL_a365_epbSystemStatus 8 "MISMATCH" 7 "FAULT_SECURE" 6 "FAULT" 5 "RELEASING" 4 "PARKING" 3 "DYNAMIC" 2 "PARKED" 1 "RELEASED" 0 "UNKNOWN" ;
VAL_ 1480 EPBL_a366_epbSystemStatus 8 "MISMATCH" 7 "FAULT_SECURE" 6 "FAULT" 5 "RELEASING" 4 "PARKING" 3 "DYNAMIC" 2 "PARKED" 1 "RELEASED" 0 "UNKNOWN" ;
