VERSION "dbc-export 1 2025.20.8"

NS_ :

BS_:

BU_: ADSP APB APP APS APSB BB BMS CC CMP CMPD CP DAS DI DIF DIR DPB EPAS3P EPAS3S EPASTP EPASTS EPBL EPBR ESP EVSE FC GTW HCML HCMR HVP IBST ICR IDB LS OCS1P ODIN PARK PCS PLG PM PMF PMR PNCD PTC RADC RCM RCM2 RCM3 RCU SCCM SCM SCS SDCR TAS TCU TPMS TRCM UDS UI UIS UMC USM VC VCFRONT VCLEFT VCRIGHT VCSEC VEH

BO_ 1332 VCFRONT_alertLog: 8 VCFRONT
 SG_ VCFRONT_alertID M : 0|10@1+ (1,0) [0|1023] "" Vector__XXX
 SG_ VCFRONT_a475_drl1Status m475 : 37|3@1+ (1,0) [0|7] "" Vector__XXX
 SG_ VCFRONT_a475_drl2Status m475 : 40|3@1+ (1,0) [0|7] "" Vector__XXX
 SG_ VCFRONT_a475_drl3Status m475 : 43|3@1+ (1,0) [0|7] "" Vector__XXX
 SG_ VCFRONT_a475_turnStatus m475 : 48|3@1+ (1,0) [0|7] "" Vector__XXX
 SG_ VCFRONT_a475_fanStatus m475 : 51|1@1+ (1,0) [0|1] "" Vector__XXX
 SG_ VCFRONT_a475_TPS92520_COMPOV m475 : 52|1@1+ (1,0) [0|1] "" Vector__XXX
 SG_ VCFRONT_a475_TPS92520_HSILIM m475 : 53|1@1+ (1,0) [0|1] "" Vector__XXX
 SG_ VCFRONT_a475_TPS92520_BSTUV m475 : 54|1@1+ (1,0) [0|1] "" Vector__XXX
 SG_ VCFRONT_a475_BoostRailStatus m475 : 55|1@1+ (1,0) [0|1] "" Vector__XXX
 SG_ VCFRONT_a475_EEPROM_DataStatus m475 : 56|1@1+ (1,0) [0|1] "" Vector__XXX
 SG_ VCFRONT_a475_LMMVariant m475 : 57|2@1+ (1,0) [1|3] "" Vector__XXX
 SG_ VCFRONT_a475_headlampECURevision m475 : 59|4@1+ (1,0) [0|15] "" Vector__XXX
 SG_ VCFRONT_a476_FRM1_timedOut m476 : 16|1@1+ (1,0) [0|1] "" Vector__XXX
 SG_ VCFRONT_a476_FRM2_timedOut m476 : 17|1@1+ (1,0) [0|1] "" Vector__XXX
 SG_ VCFRONT_a476_FRM3_timedOut m476 : 18|1@1+ (1,0) [0|1] "" Vector__XXX
 SG_ VCFRONT_a476_FRM4_timedOut m476 : 19|1@1+ (1,0) [0|1] "" Vector__XXX
 SG_ VCFRONT_a476_FRM5_timedOut m476 : 20|1@1+ (1,0) [0|1] "" Vector__XXX
 SG_ VCFRONT_a476_FRM6_timedOut m476 : 21|1@1+ (1,0) [0|1] "" Vector__XXX
 SG_ VCFRONT_a476_FRM7_timedOut m476 : 22|1@1+ (1,0) [0|1] "" Vector__XXX
 SG_ VCFRONT_a476_FRM8_timedOut m476 : 23|1@1+ (1,0) [0|1] "" Vector__XXX
 SG_ VCFRONT_a476_FRM9_timedOut m476 : 24|1@1+ (1,0) [0|1] "" Vector__XXX
 SG_ VCFRONT_a476_FRM10_timedOut m476 : 25|1@1+ (1,0) [0|1] "" Vector__XXX
 SG_ VCFRONT_a476_FRM11_timedOut m476 : 26|1@1+ (1,0) [0|1] "" Vector__XXX
 SG_ VCFRONT_a476_FRM12_timedOut m476 : 27|1@1+ (1,0) [0|1] "" Vector__XXX
 SG_ VCFRONT_a476_factoryMode m476 : 28|1@1+ (1,0) [0|1] "" Vector__XXX
 SG_ VCFRONT_a476_serviceMode m476 : 29|1@1+ (1,0) [0|1] "" Vector__XXX
 SG_ VCFRONT_a476_transportMode m476 : 30|1@1+ (1,0) [0|1] "" Vector__XXX
 SG_ VCFRONT_a476_frunkOpen m476 : 31|1@1+ (1,0) [0|1] "" Vector__XXX
 SG_ VCFRONT_a476_vehiclePowerState m476 : 32|2@1+ (1,0) [0|3] "" Vector__XXX
 SG_ VCFRONT_a476_batterySMState m476 : 34|4@1+ (1,0) [0|15] "" Vector__XXX
 SG_ VCFRONT_a476_ECPAState m476 : 38|2@1+ (1,0) [0|2] "" Vector__XXX
 SG_ VCFRONT_a477_cell1Voltage m477 : 16|9@1+ (0.01,0) [0|5.11] "V" Vector__XXX
 SG_ VCFRONT_a477_cell2Voltage m477 : 25|9@1+ (0.01,0) [0|5.11] "V" Vector__XXX
 SG_ VCFRONT_a477_cell3Voltage m477 : 34|9@1+ (0.01,0) [0|5.11] "V" Vector__XXX
 SG_ VCFRONT_a477_cell4Voltage m477 : 43|9@1+ (0.01,0) [0|5.11] "V" Vector__XXX
 SG_ VCFRONT_a477_sumCellVoltage m477 : 52|8@1+ (0.1,0) [0|25.5] "V" Vector__XXX
 SG_ VCFRONT_a477_deepDischargeFlag m477 : 60|1@1+ (1,0) [0|1] "" Vector__XXX
 SG_ VCFRONT_a477_serviceMode m477 : 61|1@1+ (1,0) [0|1] "" Vector__XXX
 SG_ VCFRONT_a477_frunkOpen m477 : 62|1@1+ (1,0) [0|1] "" Vector__XXX
 SG_ VCFRONT_a478_battFaultPackOverVo m478 : 16|1@1+ (1,0) [0|1] "" Vector__XXX
 SG_ VCFRONT_a478_battFaultHardwareOv m478 : 17|1@1+ (1,0) [0|1] "" Vector__XXX
 SG_ VCFRONT_a478_battFaultChargeOver m478 : 18|1@1+ (1,0) [0|1] "" Vector__XXX
 SG_ VCFRONT_a478_battFaultCellUnderV m478 : 19|1@1+ (1,0) [0|1] "" Vector__XXX
 SG_ VCFRONT_a478_battFaultCellOverVo m478 : 20|1@1+ (1,0) [0|1] "" Vector__XXX
 SG_ VCFRONT_a478_vehiclePowerState m478 : 21|2@1+ (1,0) [0|3] "" Vector__XXX
 SG_ VCFRONT_a478_batterySMState m478 : 24|4@1+ (1,0) [0|15] "" Vector__XXX
 SG_ VCFRONT_a478_bmsState m478 : 28|4@1+ (1,0) [0|15] "" Vector__XXX
 SG_ VCFRONT_a478_dcdcLVSupportStatus m478 : 32|2@1+ (1,0) [0|3] "" Vector__XXX
 SG_ VCFRONT_a478_factoryMode m478 : 34|1@1+ (1,0) [0|1] "" Vector__XXX
 SG_ VCFRONT_a478_serviceMode m478 : 35|1@1+ (1,0) [0|1] "" Vector__XXX
 SG_ VCFRONT_a478_transportMode m478 : 36|1@1+ (1,0) [0|1] "" Vector__XXX
 SG_ VCFRONT_a478_notEnoughPowerForSu m478 : 37|1@1+ (1,0) [0|1] "" Vector__XXX
 SG_ VCFRONT_a478_crashDetected m478 : 38|1@1+ (1,0) [0|1] "" Vector__XXX
 SG_ VCFRONT_a478_BMS_MIA m478 : 39|1@1+ (1,0) [0|1] "" Vector__XXX
 SG_ VCFRONT_a478_PCS_MIA m478 : 40|1@1+ (1,0) [0|1] "" Vector__XXX
 SG_ VCFRONT_a478_HVBlockingMismatch m478 : 41|1@1+ (1,0) [0|1] "" Vector__XXX
 SG_ VCFRONT_a478_HV_UP m478 : 42|1@1+ (1,0) [0|1] "" Vector__XXX
 SG_ VCFRONT_a478_pcsEFuseStable m478 : 43|1@1+ (1,0) [0|1] "" Vector__XXX
 SG_ VCFRONT_a478_vcrightEFuseStable m478 : 44|1@1+ (1,0) [0|1] "" Vector__XXX
 SG_ VCFRONT_a478_contactorEFuseStabl m478 : 45|1@1+ (1,0) [0|1] "" Vector__XXX
 SG_ VCFRONT_a478_hvcEFuseStable m478 : 46|1@1+ (1,0) [0|1] "" Vector__XXX
 SG_ VCFRONT_a478_frunkOpen m478 : 47|1@1+ (1,0) [0|1] "" Vector__XXX
 SG_ VCFRONT_a479_FRM3_timedOut m479 : 16|1@1+ (1,0) [0|1] "" Vector__XXX
 SG_ VCFRONT_a479_ECPAState m479 : 17|2@1+ (1,0) [0|2] "" Vector__XXX
 SG_ VCFRONT_a479_factoryMode m479 : 19|1@1+ (1,0) [0|1] "" Vector__XXX
 SG_ VCFRONT_a479_serviceMode m479 : 20|1@1+ (1,0) [0|1] "" Vector__XXX
 SG_ VCFRONT_a479_transportMode m479 : 21|1@1+ (1,0) [0|1] "" Vector__XXX
 SG_ VCFRONT_a479_frunkLatchStatus m479 : 24|4@1+ (1,0) [1|15] "" Vector__XXX
 SG_ VCFRONT_a479_vehiclePowerState m479 : 28|2@1+ (1,0) [0|3] "" Vector__XXX
 SG_ VCFRONT_a479_batterySMState m479 : 32|4@1+ (1,0) [0|15] "" Vector__XXX
 SG_ VCFRONT_a480_channel m480 : 16|3@1+ (1,0) [0|7] "" Vector__XXX
 SG_ VCFRONT_a480_reset m480 : 19|1@1+ (1,0) [0|1] "" Vector__XXX
 SG_ VCFRONT_a480_spiError m480 : 20|1@1+ (1,0) [0|1] "" Vector__XXX
 SG_ VCFRONT_a480_autoOn m480 : 21|1@1+ (1,0) [0|1] "" Vector__XXX
 SG_ VCFRONT_a480_diagnosticBit m480 : 22|1@1+ (1,0) [0|1] "" Vector__XXX
 SG_ VCFRONT_a480_deviceError m480 : 23|1@1+ (1,0) [0|1] "" Vector__XXX
 SG_ VCFRONT_a480_overcurrent m480 : 24|1@1+ (1,0) [0|1] "" Vector__XXX
 SG_ VCFRONT_a480_unexpectedLock m480 : 25|1@1+ (1,0) [0|1] "" Vector__XXX
 SG_ VCFRONT_a480_disableOutputFault m480 : 26|1@1+ (1,0) [0|1] "" Vector__XXX
 SG_ VCFRONT_a480_vsUndervoltage m480 : 27|1@1+ (1,0) [0|1] "" Vector__XXX
 SG_ VCFRONT_a480_hardShort m480 : 28|1@1+ (1,0) [0|1] "" Vector__XXX
 SG_ VCFRONT_a480_vdsMax m480 : 29|1@1+ (1,0) [0|1] "" Vector__XXX
 SG_ VCFRONT_a480_bypassSaturation m480 : 30|1@1+ (1,0) [0|1] "" Vector__XXX
 SG_ VCFRONT_a480_fuseLatch m480 : 31|1@1+ (1,0) [0|1] "" Vector__XXX
 SG_ VCFRONT_a480_deviceOvertemperatu m480 : 32|1@1+ (1,0) [0|1] "" Vector__XXX
 SG_ VCFRONT_a480_ntcOvertemperature m480 : 33|1@1+ (1,0) [0|1] "" Vector__XXX
 SG_ VCFRONT_a480_vgsLow m480 : 34|1@1+ (1,0) [0|1] "" Vector__XXX
 SG_ VCFRONT_a480_chargePumpLow m480 : 35|1@1+ (1,0) [0|1] "" Vector__XXX
 SG_ VCFRONT_a480_watchdog m480 : 36|1@1+ (1,0) [0|1] "" Vector__XXX
 SG_ VCFRONT_a480_spiNotDone m480 : 37|1@1+ (1,0) [0|1] "" Vector__XXX
 SG_ VCFRONT_a480_configIncorrect m480 : 38|1@1+ (1,0) [0|1] "" Vector__XXX
 SG_ VCFRONT_a480_bufferFull m480 : 39|1@1+ (1,0) [0|1] "" Vector__XXX
 SG_ VCFRONT_a480_hitAlertRateLimit m480 : 40|1@1+ (1,0) [0|1] "" Vector__XXX
 SG_ VCFRONT_a480_hwlo m480 : 41|1@1+ (1,0) [0|1] "" Vector__XXX
 SG_ VCFRONT_a480_enable m480 : 42|1@1+ (1,0) [0|1] "" Vector__XXX
 SG_ VCFRONT_a486_mcuGraphicsEFuseCur m486 : 16|10@1+ (0.1,0) [0|102.3] "A" Vector__XXX
 SG_ VCFRONT_a490_coolantPumpType m490 : 16|3@1+ (1,0) [0|7] "" Vector__XXX
 SG_ VCFRONT_a493_minBrickSocId m493 : 16|7@1+ (1,1) [1|128] "" Vector__XXX
 SG_ VCFRONT_a493_minBrickSocByOcvMax m493 : 24|8@1+ (0.5,0) [0|127.5] "PCT" Vector__XXX
 SG_ VCFRONT_a493_maxBrickSocId m493 : 32|7@1+ (1,1) [1|128] "" Vector__XXX
 SG_ VCFRONT_a493_maxBrickSocByOcvMin m493 : 40|8@1+ (0.5,0) [0|127.5] "PCT" Vector__XXX
 SG_ VCFRONT_a493_maxBrickSoc m493 : 48|7@1+ (1,0) [0|127] "PCT" Vector__XXX
 SG_ VCFRONT_a493_avgBrickSoc m493 : 56|7@1+ (1,0) [0|127] "PCT" Vector__XXX
 SG_ VCFRONT_a495_SoCUnrecoverable m495 : 16|1@1+ (1,0) [0|1] "" Vector__XXX
 SG_ VCFRONT_a495_SocTooLow m495 : 17|1@1+ (1,0) [0|1] "" Vector__XXX
 SG_ VCFRONT_a495_retryExpended m495 : 18|1@1+ (1,0) [0|1] "" Vector__XXX
 SG_ VCFRONT_a495_LVBMSMIA m495 : 19|1@1+ (1,0) [0|1] "" Vector__XXX
 SG_ VCFRONT_a495_reverseBatteryEFuse m495 : 20|1@1+ (1,0) [0|1] "" Vector__XXX
 SG_ VCFRONT_a495_DCDCOff m495 : 21|1@1+ (1,0) [0|1] "" Vector__XXX
 SG_ VCFRONT_a495_HVOff m495 : 22|1@1+ (1,0) [0|1] "" Vector__XXX
 SG_ VCFRONT_a495_externalInteraction m495 : 23|1@1+ (1,0) [0|1] "" Vector__XXX
 SG_ VCFRONT_a495_serviceMode m495 : 24|1@1+ (1,0) [0|1] "" Vector__XXX
 SG_ VCFRONT_a495_frunkOpen m495 : 25|1@1+ (1,0) [0|1] "" Vector__XXX
 SG_ VCFRONT_a495_externalPowerSupply m495 : 26|1@1+ (1,0) [0|1] "" Vector__XXX
 SG_ VCFRONT_a496_reverseBatteryEFuse m496 : 16|1@1+ (1,0) [0|1] "" Vector__XXX
 SG_ VCFRONT_a496_vehicleLoadShedActi m496 : 17|1@1+ (1,0) [0|1] "" Vector__XXX
 SG_ VCFRONT_a496_MOSState m496 : 18|2@1+ (1,0) [0|2] "" Vector__XXX
 SG_ VCFRONT_a496_serviceMode m496 : 20|1@1+ (1,0) [0|1] "" Vector__XXX
 SG_ VCFRONT_a496_frunkOpen m496 : 21|1@1+ (1,0) [0|1] "" Vector__XXX
 SG_ VCFRONT_a496_PCS_MIA m496 : 22|1@1+ (1,0) [0|1] "" Vector__XXX
 SG_ VCFRONT_a496_NotEnoughPowerForSu m496 : 23|1@1+ (1,0) [0|1] "" Vector__XXX
 SG_ VCFRONT_a496_bmsState m496 : 24|4@1+ (1,0) [0|15] "" Vector__XXX
 SG_ VCFRONT_a497_serviceMode m497 : 16|1@1+ (1,0) [0|1] "" Vector__XXX
 SG_ VCFRONT_a497_FactoryMode m497 : 17|1@1+ (1,0) [0|1] "" Vector__XXX
 SG_ VCFRONT_a497_SOC m497 : 24|7@1+ (1,0) [0|127] "%" Vector__XXX
 SG_ VCFRONT_a497_PackCurrent m497 : 32|12@1+ (0.2,-600) [-600|219] "A" Vector__XXX
 SG_ VCFRONT_a497_SumCellVoltage m497 : 48|8@1+ (0.1,0) [0|25.5] "V" Vector__XXX
 SG_ VCFRONT_a497_frunkOpen m497 : 56|1@1+ (1,0) [0|1] "" Vector__XXX
 SG_ VCFRONT_a500_channel m500 : 16|8@1+ (1,0) [0|255] "" Vector__XXX
 SG_ VCFRONT_a500_mismatchedState m500 : 24|3@1+ (1,0) [0|7] "" Vector__XXX
 SG_ VCFRONT_a503_brickVoltageMin m503 : 16|10@1+ (0.005,0) [0|5.115] "V" Vector__XXX
 SG_ VCFRONT_a503_brickVoltageMax m503 : 26|10@1+ (0.005,0) [0|5.115] "V" Vector__XXX
 SG_ VCFRONT_a503_packCurrent m503 : 36|10@1- (5,0) [-2560|2555] "A" Vector__XXX
 SG_ VCFRONT_a503_socMax m503 : 46|8@1+ (0.5,0) [0|127.5] "%" Vector__XXX
 SG_ VCFRONT_a503_brickId m503 : 54|8@1+ (1,1) [1|256] "" Vector__XXX
 SG_ VCFRONT_a509_vcrightEFuseCurrent m509 : 16|16@1- (0.1,0) [-3276.8|3276.7] "A" Vector__XXX
 SG_ VCFRONT_a509_vcrightEFuseTemp m509 : 32|8@1+ (0.75,0) [0|191.25] "degC" Vector__XXX
 SG_ VCFRONT_a509_ambientTemp m509 : 40|8@1+ (0.5,-40) [-40|87.5] "degC" Vector__XXX
 SG_ VCFRONT_a509_serviceMode m509 : 48|1@1+ (1,0) [0|1] "" Vector__XXX
 SG_ VCFRONT_a509_frunkOpen m509 : 49|1@1+ (1,0) [0|1] "" Vector__XXX
 SG_ VCFRONT_a510_sumCellVoltage m510 : 16|8@1+ (0.1,0) [0|25.5] "V" Vector__XXX
 SG_ VCFRONT_a510_packVoltage m510 : 24|8@1+ (0.1,0) [0|25.5] "V" Vector__XXX
 SG_ VCFRONT_a510_targetPCSVoltage m510 : 32|8@1+ (0.1,0) [0|25.5] "V" Vector__XXX
 SG_ VCFRONT_a510_serviceMode m510 : 40|1@1+ (1,0) [0|1] "" Vector__XXX
 SG_ VCFRONT_a510_frunkOpen m510 : 41|1@1+ (1,0) [0|1] "" Vector__XXX
 SG_ VCFRONT_a511_PCSEFuseCurrent m511 : 16|16@1- (0.1,0) [-3276.8|3276.7] "A" Vector__XXX
 SG_ VCFRONT_a511_DCDCMaxOutputCurren m511 : 32|16@1- (0.1,0) [-3276.8|3276.7] "A" Vector__XXX
 SG_ VCFRONT_a511_hvState m511 : 48|3@1+ (1,0) [0|7] "" Vector__XXX
 SG_ VCFRONT_a511_DCDCOutputIsLimited m511 : 51|1@1+ (1,0) [0|1] "" Vector__XXX
 SG_ VCFRONT_a511_PCSSignalsAreValid m511 : 52|1@1+ (1,0) [0|1] "" Vector__XXX
 SG_ VCFRONT_a511_factoryGated m511 : 53|1@1+ (1,0) [0|1] "" Vector__XXX
 SG_ VCFRONT_a511_vehicleIsUpdating m511 : 54|1@1+ (1,0) [0|1] "" Vector__XXX
 SG_ VCFRONT_a511_serviceMode m511 : 55|1@1+ (1,0) [0|1] "" Vector__XXX
 SG_ VCFRONT_a511_frunkOpen m511 : 56|1@1+ (1,0) [0|1] "" Vector__XXX
 SG_ VCFRONT_a512_packVoltageInt_0001 m512 : 16|8@1+ (0.1,0) [0|25.5] "V" Vector__XXX
 SG_ VCFRONT_a512_packVoltageInterval m512 : 24|8@1+ (0.1,0) [0|25.5] "V" Vector__XXX
 SG_ VCFRONT_a512_packTemperature m512 : 32|8@1+ (1,-40) [-40|215] "C" Vector__XXX
 SG_ VCFRONT_a512_sumCellVoltage m512 : 40|8@1+ (0.1,0) [0|25.5] "V" Vector__XXX
 SG_ VCFRONT_a512_overcurrentDirectio m512 : 48|2@1+ (1,0) [0|3] "" Vector__XXX
 SG_ VCFRONT_a512_serviceMode m512 : 50|1@1+ (1,0) [0|1] "" Vector__XXX
 SG_ VCFRONT_a512_frunkOpen m512 : 51|1@1+ (1,0) [0|1] "" Vector__XXX
 SG_ VCFRONT_a512_vehiclePowerState m512 : 52|2@1+ (1,0) [0|3] "" Vector__XXX
 SG_ VCFRONT_a513_packCurrent m513 : 16|12@1+ (0.2,-600) [-600|219] "A" Vector__XXX
 SG_ VCFRONT_a513_packTemperature m513 : 32|8@1+ (1,-40) [-40|215] "C" Vector__XXX
 SG_ VCFRONT_a513_packVoltage m513 : 40|8@1+ (0.1,0) [0|25.5] "V" Vector__XXX
 SG_ VCFRONT_a513_packSOC m513 : 48|10@1+ (0.1,0) [0|102.3] "%" Vector__XXX
 SG_ VCFRONT_a513_serviceMode m513 : 58|1@1+ (1,0) [0|1] "" Vector__XXX
 SG_ VCFRONT_a513_frunkOpen m513 : 59|1@1+ (1,0) [0|1] "" Vector__XXX
 SG_ VCFRONT_a513_vehiclePowerState m513 : 60|2@1+ (1,0) [0|3] "" Vector__XXX
 SG_ VCFRONT_a514_cell1Voltage m514 : 16|7@1+ (0.08,0) [0|10.16] "V" Vector__XXX
 SG_ VCFRONT_a514_cell2Voltage m514 : 23|7@1+ (0.08,0) [0|10.16] "V" Vector__XXX
 SG_ VCFRONT_a514_cell3Voltage m514 : 30|7@1+ (0.08,0) [0|10.16] "V" Vector__XXX
 SG_ VCFRONT_a514_cell4Voltage m514 : 37|7@1+ (0.08,0) [0|10.16] "V" Vector__XXX
 SG_ VCFRONT_a514_packVoltage m514 : 44|8@1+ (0.1,0) [0|25.5] "V" Vector__XXX
 SG_ VCFRONT_a514_packSOC m514 : 52|8@1+ (0.4,0) [0|102] "%" Vector__XXX
 SG_ VCFRONT_a514_serviceMode m514 : 60|1@1+ (1,0) [0|1] "" Vector__XXX
 SG_ VCFRONT_a514_frunkOpen m514 : 61|1@1+ (1,0) [0|1] "" Vector__XXX
 SG_ VCFRONT_a514_vehiclePowerState m514 : 62|2@1+ (1,0) [0|3] "" Vector__XXX
 SG_ VCFRONT_a515_cell1Voltage m515 : 16|7@1+ (0.08,0) [0|10.16] "V" Vector__XXX
 SG_ VCFRONT_a515_cell2Voltage m515 : 23|7@1+ (0.08,0) [0|10.16] "V" Vector__XXX
 SG_ VCFRONT_a515_cell3Voltage m515 : 30|7@1+ (0.08,0) [0|10.16] "V" Vector__XXX
 SG_ VCFRONT_a515_cell4Voltage m515 : 37|7@1+ (0.08,0) [0|10.16] "V" Vector__XXX
 SG_ VCFRONT_a515_packVoltage m515 : 44|8@1+ (0.1,0) [0|25.5] "V" Vector__XXX
 SG_ VCFRONT_a515_packSOC m515 : 52|8@1+ (0.4,0) [0|102] "%" Vector__XXX
 SG_ VCFRONT_a515_serviceMode m515 : 60|1@1+ (1,0) [0|1] "" Vector__XXX
 SG_ VCFRONT_a515_frunkOpen m515 : 61|1@1+ (1,0) [0|1] "" Vector__XXX
 SG_ VCFRONT_a515_vehiclePowerState m515 : 62|2@1+ (1,0) [0|3] "" Vector__XXX
 SG_ VCFRONT_a516_IBSVoltage m516 : 16|8@1+ (0.1,0) [0|25.5] "V" Vector__XXX
 SG_ VCFRONT_a516_HVSoc m516 : 24|10@1+ (0.1,0) [0|102.3] "%" Vector__XXX
 SG_ VCFRONT_a516_contactorsPermanent m516 : 34|1@1+ (1,0) [0|1] "" Vector__XXX
 SG_ VCFRONT_a516_LVBatteryDisconnect m516 : 35|1@1+ (1,0) [0|1] "" Vector__XXX
 SG_ VCFRONT_a516_reverseBatteryFault m516 : 36|1@1+ (1,0) [0|1] "" Vector__XXX
 SG_ VCFRONT_a516_LVBatteryCannotSupp m516 : 37|1@1+ (1,0) [0|1] "" Vector__XXX
 SG_ VCFRONT_a517_IBSVoltage m517 : 16|8@1+ (0.1,0) [0|25.5] "V" Vector__XXX
 SG_ VCFRONT_a517_HVSoc m517 : 24|10@1+ (0.1,0) [0|102.3] "%" Vector__XXX
 SG_ VCFRONT_a518_packVoltage m518 : 16|8@1+ (0.1,0) [0|25.5] "V" Vector__XXX
 SG_ VCFRONT_a518_IBSVoltage m518 : 24|9@1+ (0.05,0) [0|25.55] "V" Vector__XXX
 SG_ VCFRONT_a518_targetPCSVoltage m518 : 33|8@1+ (0.1,0) [0|25.5] "V" Vector__XXX
 SG_ VCFRONT_a518_outputVoltageAtPCS m518 : 41|8@1+ (0.1,0) [0|25.5] "V" Vector__XXX
 SG_ VCFRONT_a518_packSOC m518 : 49|10@1+ (0.1,0) [0|102.3] "%" Vector__XXX
 SG_ VCFRONT_a518_serviceMode m518 : 59|1@1+ (1,0) [0|1] "" Vector__XXX
 SG_ VCFRONT_a518_frunkOpen m518 : 60|1@1+ (1,0) [0|1] "" Vector__XXX
 SG_ VCFRONT_a518_vehiclePowerState m518 : 61|2@1+ (1,0) [0|3] "" Vector__XXX
 SG_ VCFRONT_a519_MatrixBank1Status m519 : 16|2@1+ (1,0) [0|3] "" Vector__XXX
 SG_ VCFRONT_a519_MatrixBank2Status m519 : 18|2@1+ (1,0) [0|3] "" Vector__XXX
 SG_ VCFRONT_a519_MatrixBank3Status m519 : 20|2@1+ (1,0) [0|3] "" Vector__XXX
 SG_ VCFRONT_a519_MatrixBank4Status m519 : 22|2@1+ (1,0) [0|3] "" Vector__XXX
 SG_ VCFRONT_a519_TurnSignalStatus m519 : 24|3@1+ (1,0) [0|7] "" Vector__XXX
 SG_ VCFRONT_a519_SideMarkerStatus m519 : 27|2@1+ (1,0) [0|3] "" Vector__XXX
 SG_ VCFRONT_a519_DRLStatus m519 : 29|3@1+ (1,0) [0|7] "" Vector__XXX
 SG_ VCFRONT_a519_AmbientStatus m519 : 32|3@1+ (1,0) [0|7] "" Vector__XXX
 SG_ VCFRONT_a519_LBFlatSAEStatus m519 : 35|3@1+ (1,0) [0|7] "" Vector__XXX
 SG_ VCFRONT_a519_LBFlatECEStatus m519 : 40|3@1+ (1,0) [0|7] "" Vector__XXX
 SG_ VCFRONT_a519_TPS92520_COMPOV m519 : 43|1@1+ (1,0) [0|1] "" Vector__XXX
 SG_ VCFRONT_a519_TPS92520_HSILIM m519 : 44|1@1+ (1,0) [0|1] "" Vector__XXX
 SG_ VCFRONT_a519_TPS92520_BSTUV m519 : 45|1@1+ (1,0) [0|1] "" Vector__XXX
 SG_ VCFRONT_a519_CoolingFanStatus m519 : 46|1@1+ (1,0) [0|1] "" Vector__XXX
 SG_ VCFRONT_a519_BoostRailStatus m519 : 47|1@1+ (1,0) [0|1] "" Vector__XXX
 SG_ VCFRONT_a519_EEPROMCurrentBinSta m519 : 48|1@1+ (1,0) [0|1] "" Vector__XXX
 SG_ VCFRONT_a519_EEPROMCalCurrentSta m519 : 49|1@1+ (1,0) [0|1] "" Vector__XXX
 SG_ VCFRONT_a519_HeadlampECURevision m519 : 50|4@1+ (1,0) [0|15] "" Vector__XXX
 SG_ VCFRONT_a519_NonzeroEEPROMRetrie m519 : 54|1@1+ (1,0) [0|1] "" Vector__XXX
 SG_ VCFRONT_a519_MaxEEPROMRetries m519 : 55|1@1+ (1,0) [0|1] "" Vector__XXX
 SG_ VCFRONT_a520_MatrixBank1Status m520 : 16|2@1+ (1,0) [0|3] "" Vector__XXX
 SG_ VCFRONT_a520_MatrixBank2Status m520 : 18|2@1+ (1,0) [0|3] "" Vector__XXX
 SG_ VCFRONT_a520_MatrixBank3Status m520 : 20|2@1+ (1,0) [0|3] "" Vector__XXX
 SG_ VCFRONT_a520_MatrixBank4Status m520 : 22|2@1+ (1,0) [0|3] "" Vector__XXX
 SG_ VCFRONT_a520_TurnSignalStatus m520 : 24|3@1+ (1,0) [0|7] "" Vector__XXX
 SG_ VCFRONT_a520_SideMarkerStatus m520 : 27|2@1+ (1,0) [0|3] "" Vector__XXX
 SG_ VCFRONT_a520_DRLStatus m520 : 29|3@1+ (1,0) [0|7] "" Vector__XXX
 SG_ VCFRONT_a520_AmbientStatus m520 : 32|3@1+ (1,0) [0|7] "" Vector__XXX
 SG_ VCFRONT_a520_LBFlatSAEStatus m520 : 35|3@1+ (1,0) [0|7] "" Vector__XXX
 SG_ VCFRONT_a520_LBFlatECEStatus m520 : 40|3@1+ (1,0) [0|7] "" Vector__XXX
 SG_ VCFRONT_a520_TPS92520_COMPOV m520 : 43|1@1+ (1,0) [0|1] "" Vector__XXX
 SG_ VCFRONT_a520_TPS92520_HSILIM m520 : 44|1@1+ (1,0) [0|1] "" Vector__XXX
 SG_ VCFRONT_a520_TPS92520_BSTUV m520 : 45|1@1+ (1,0) [0|1] "" Vector__XXX
 SG_ VCFRONT_a520_CoolingFanStatus m520 : 46|1@1+ (1,0) [0|1] "" Vector__XXX
 SG_ VCFRONT_a520_BoostRailStatus m520 : 47|1@1+ (1,0) [0|1] "" Vector__XXX
 SG_ VCFRONT_a520_EEPROMCurrentBinSta m520 : 48|1@1+ (1,0) [0|1] "" Vector__XXX
 SG_ VCFRONT_a520_EEPROMCalCurrentSta m520 : 49|1@1+ (1,0) [0|1] "" Vector__XXX
 SG_ VCFRONT_a520_HeadlampECURevision m520 : 50|4@1+ (1,0) [0|15] "" Vector__XXX
 SG_ VCFRONT_a520_NonzeroEEPROMRetrie m520 : 54|1@1+ (1,0) [0|1] "" Vector__XXX
 SG_ VCFRONT_a520_MaxEEPROMRetries m520 : 55|1@1+ (1,0) [0|1] "" Vector__XXX
 SG_ VCFRONT_a521_vcleftEFuseCurrent m521 : 16|16@1- (0.1,0) [-3276.8|3276.7] "A" Vector__XXX
 SG_ VCFRONT_a521_vcleftEFuseTemp m521 : 32|8@1+ (0.75,0) [0|191.25] "degC" Vector__XXX
 SG_ VCFRONT_a521_ambientTemp m521 : 40|8@1+ (0.5,-40) [-40|87.5] "degC" Vector__XXX
 SG_ VCFRONT_a521_serviceMode m521 : 48|1@1+ (1,0) [0|1] "" Vector__XXX
 SG_ VCFRONT_a521_frunkOpen m521 : 49|1@1+ (1,0) [0|1] "" Vector__XXX
 SG_ VCFRONT_a522_IBSVoltage m522 : 16|8@1+ (0.1,0) [0|25.5] "V" Vector__XXX
 SG_ VCFRONT_a522_HVSoc m522 : 24|10@1+ (0.1,0) [0|102.3] "%" Vector__XXX
 SG_ VCFRONT_a522_contactorsPermanent m522 : 34|1@1+ (1,0) [0|1] "" Vector__XXX
 SG_ VCFRONT_a522_LVBatteryDisconnect m522 : 35|1@1+ (1,0) [0|1] "" Vector__XXX
 SG_ VCFRONT_a522_reverseBatteryFault m522 : 36|1@1+ (1,0) [0|1] "" Vector__XXX
 SG_ VCFRONT_a522_LVBatteryCannotSupp m522 : 37|1@1+ (1,0) [0|1] "" Vector__XXX
 SG_ VCFRONT_a523_channel m523 : 16|8@1+ (1,0) [0|255] "" Vector__XXX
 SG_ VCFRONT_a523_control2Byte1 m523 : 24|8@1+ (1,0) [0|255] "" Vector__XXX
 SG_ VCFRONT_a523_control2Byte2 m523 : 32|8@1+ (1,0) [0|255] "" Vector__XXX
 SG_ VCFRONT_a523_control2Byte3 m523 : 40|8@1+ (1,0) [0|255] "" Vector__XXX
 SG_ VCFRONT_a523_control3Byte2 m523 : 48|8@1+ (1,0) [0|255] "" Vector__XXX
 SG_ VCFRONT_a523_control3Byte3 m523 : 56|8@1+ (1,0) [0|255] "" Vector__XXX
 SG_ VCFRONT_a525_GTW_twelveVBatteryT m525 : 16|3@1+ (1,0) [0|7] "" Vector__XXX
 SG_ VCFRONT_a525_newLVBatteryType m525 : 19|3@1+ (1,0) [0|7] "" Vector__XXX
 SG_ VCFRONT_a525_initialLVBatteryTyp m525 : 24|3@1+ (1,0) [0|7] "" Vector__XXX
 SG_ VCFRONT_a525_serviceMode m525 : 27|1@1+ (1,0) [0|1] "" Vector__XXX
 SG_ VCFRONT_a525_factoryGated m525 : 28|1@1+ (1,0) [0|1] "" Vector__XXX
 SG_ VCFRONT_a525_frunkOpen m525 : 29|1@1+ (1,0) [0|1] "" Vector__XXX
 SG_ VCFRONT_a527_cell1Voltage m527 : 16|10@1+ (0.01,0) [0|10.23] "V" Vector__XXX
 SG_ VCFRONT_a527_cell2Voltage m527 : 26|10@1+ (0.01,0) [0|10.23] "V" Vector__XXX
 SG_ VCFRONT_a527_cell3Voltage m527 : 36|10@1+ (0.01,0) [0|10.23] "V" Vector__XXX
 SG_ VCFRONT_a527_cell4Voltage m527 : 46|10@1+ (0.01,0) [0|10.23] "V" Vector__XXX
 SG_ VCFRONT_a527_serviceMode m527 : 56|1@1+ (1,0) [0|1] "" Vector__XXX
 SG_ VCFRONT_a527_frunkOpen m527 : 57|1@1+ (1,0) [0|1] "" Vector__XXX
 SG_ VCFRONT_a528_ECPAStateSNA m528 : 16|1@1+ (1,0) [0|1] "" Vector__XXX
 SG_ VCFRONT_a528_ECPAFrameTimeout m528 : 17|1@1+ (1,0) [0|1] "" Vector__XXX
 SG_ VCFRONT_a528_currentSenseFaulted m528 : 18|1@1+ (1,0) [0|1] "" Vector__XXX
 SG_ VCFRONT_a528_serviceMode m528 : 19|1@1+ (1,0) [0|1] "" Vector__XXX
 SG_ VCFRONT_a528_frunkOpen m528 : 20|1@1+ (1,0) [0|1] "" Vector__XXX
 SG_ VCFRONT_a531_powerIndexFiltered m531 : 16|7@1+ (1,0) [0|127] "-" Vector__XXX
 SG_ VCFRONT_a532_eFuseFault m532 : 16|1@1+ (1,0) [0|1] "" Vector__XXX
 SG_ VCFRONT_a533_temperature m533 : 16|16@1+ (0.01,0) [0|655.35] "C" Vector__XXX
 SG_ VCFRONT_a541_PackTemperature m541 : 16|9@1+ (0.5,-50) [-50|205.5] "degC" Vector__XXX
 SG_ VCFRONT_a541_ChargeCurrentLimit m541 : 25|10@1+ (0.05,0) [0|51.15] "A" Vector__XXX
 SG_ VCFRONT_a541_PeakCurrent m541 : 35|10@1+ (0.05,0) [0|51.15] "A" Vector__XXX
 SG_ VCFRONT_a541_AverageCurrent m541 : 45|10@1+ (0.05,0) [0|51.15] "A" Vector__XXX
 SG_ VCFRONT_a541_SOC m541 : 56|7@1+ (1,0) [0|127] "%" Vector__XXX
 SG_ VCFRONT_a544_serviceMode m544 : 16|1@1+ (1,0) [0|1] "" Vector__XXX
 SG_ VCFRONT_a544_frunkOpen m544 : 17|1@1+ (1,0) [0|1] "" Vector__XXX
 SG_ VCFRONT_a544_LVBMSSOC m544 : 18|5@1+ (3,0) [0|93] "%" Vector__XXX
 SG_ VCFRONT_a545_GTW_twelveVBatteryT m545 : 16|3@1+ (1,0) [0|7] "" Vector__XXX
 SG_ VCFRONT_a545_newLVBatteryType m545 : 19|3@1+ (1,0) [0|7] "" Vector__XXX
 SG_ VCFRONT_a545_serviceMode m545 : 22|1@1+ (1,0) [0|1] "" Vector__XXX
 SG_ VCFRONT_a545_factoryGated m545 : 23|1@1+ (1,0) [0|1] "" Vector__XXX
 SG_ VCFRONT_a545_frunkOpen m545 : 24|1@1+ (1,0) [0|1] "" Vector__XXX
 SG_ VCFRONT_a547_serviceMode m547 : 16|1@1+ (1,0) [0|1] "" Vector__XXX
 SG_ VCFRONT_a547_frunkOpen m547 : 17|1@1+ (1,0) [0|1] "" Vector__XXX
 SG_ VCFRONT_a548_vehiclePowerState m548 : 16|2@1+ (1,0) [0|3] "" Vector__XXX
 SG_ VCFRONT_a548_notEnoughPowerForSu m548 : 18|1@1+ (1,0) [0|1] "" Vector__XXX
 SG_ VCFRONT_a548_HVBlockingMismatch m548 : 19|1@1+ (1,0) [0|1] "" Vector__XXX
 SG_ VCFRONT_a548_LVBatteryCannotSupp m548 : 20|1@1+ (1,0) [0|1] "" Vector__XXX
 SG_ VCFRONT_a548_DI_gear m548 : 21|3@1+ (1,0) [0|6] "" Vector__XXX
 SG_ VCFRONT_a548_backstopBucketCount m548 : 24|5@1+ (0.035,0) [0|1.085] "Ah" Vector__XXX
 SG_ VCFRONT_a548_hvState m548 : 29|3@1+ (1,0) [0|7] "" Vector__XXX
 SG_ VCFRONT_a548_BMS_MIA m548 : 32|1@1+ (1,0) [0|1] "" Vector__XXX
 SG_ VCFRONT_a548_PCS_MIA m548 : 33|1@1+ (1,0) [0|1] "" Vector__XXX
 SG_ VCFRONT_a548_ampHourBucketCount m548 : 34|6@1+ (0.01,0) [0|0.63] "Ah" Vector__XXX
 SG_ VCFRONT_a548_LVBMSSOC m548 : 40|5@1+ (3,0) [0|93] "%" Vector__XXX
 SG_ VCFRONT_a548_serviceMode m548 : 45|1@1+ (1,0) [0|1] "" Vector__XXX
 SG_ VCFRONT_a548_frunkOpen m548 : 46|1@1+ (1,0) [0|1] "" Vector__XXX
 SG_ VCFRONT_a548_PCSTargetVoltage m548 : 48|8@1+ (0.1,0) [0|25.5] "V" Vector__XXX
 SG_ VCFRONT_a548_ampHourBucketFilled m548 : 56|1@1+ (1,0) [0|1] "" Vector__XXX
 SG_ VCFRONT_a548_HVNotConfirmedUpTri m548 : 57|1@1+ (1,0) [0|1] "" Vector__XXX
 SG_ VCFRONT_a548_PCSNotMeetingTarget m548 : 58|1@1+ (1,0) [0|1] "" Vector__XXX
 SG_ VCFRONT_a548_PCSMIATrigger m548 : 59|1@1+ (1,0) [0|1] "" Vector__XXX
 SG_ VCFRONT_a548_PCSSaturatedTrigger m548 : 60|1@1+ (1,0) [0|1] "" Vector__XXX
 SG_ VCFRONT_a548_backstopHit m548 : 61|1@1+ (1,0) [0|1] "" Vector__XXX
 SG_ VCFRONT_a549_MatrixBank1Status m549 : 16|2@1+ (1,0) [0|3] "" Vector__XXX
 SG_ VCFRONT_a549_SideMarkerStatus m549 : 18|3@1+ (1,0) [0|7] "" Vector__XXX
 SG_ VCFRONT_a549_TurnSignalStatus m549 : 21|3@1+ (1,0) [0|7] "" Vector__XXX
 SG_ VCFRONT_a549_DRL1Status m549 : 24|3@1+ (1,0) [0|7] "" Vector__XXX
 SG_ VCFRONT_a549_DRL2Status m549 : 27|3@1+ (1,0) [0|7] "" Vector__XXX
 SG_ VCFRONT_a549_DRL3Status m549 : 32|3@1+ (1,0) [0|7] "" Vector__XXX
 SG_ VCFRONT_a549_LowBeamStatus m549 : 35|3@1+ (1,0) [0|7] "" Vector__XXX
 SG_ VCFRONT_a549_TPS92520_COMPOV m549 : 38|1@1+ (1,0) [0|1] "" Vector__XXX
 SG_ VCFRONT_a549_TPS92520_HSILIM m549 : 39|1@1+ (1,0) [0|1] "" Vector__XXX
 SG_ VCFRONT_a549_TPS92520_BSTUV m549 : 40|1@1+ (1,0) [0|1] "" Vector__XXX
 SG_ VCFRONT_a549_BoostRailStatus m549 : 41|1@1+ (1,0) [0|1] "" Vector__XXX
 SG_ VCFRONT_a549_EEPROMDataStatus m549 : 42|1@1+ (1,0) [0|1] "" Vector__XXX
 SG_ VCFRONT_a549_HeadlampECURevision m549 : 43|4@1+ (1,0) [0|15] "" Vector__XXX
 SG_ VCFRONT_a551_headlampCurrent m551 : 16|8@1+ (0.1,0) [0|25.5] "A" Vector__XXX
 SG_ VCFRONT_a552_vcrightSelfTestResu m552 : 16|4@1+ (1,0) [0|15] "" Vector__XXX
 SG_ VCFRONT_a552_epas3pSelfTestResul m552 : 20|4@1+ (1,0) [0|15] "" Vector__XXX
 SG_ VCFRONT_a552_epas3sSelfTestResul m552 : 24|4@1+ (1,0) [0|15] "" Vector__XXX
 SG_ VCFRONT_a553_headlampCurrent m553 : 16|8@1+ (0.1,0) [0|25.5] "A" Vector__XXX
 SG_ VCFRONT_a555_cell1Voltage m555 : 16|10@1+ (0.01,0) [0|10.23] "V" Vector__XXX
 SG_ VCFRONT_a555_cell2Voltage m555 : 26|10@1+ (0.01,0) [0|10.23] "V" Vector__XXX
 SG_ VCFRONT_a555_cell3Voltage m555 : 36|10@1+ (0.01,0) [0|10.23] "V" Vector__XXX
 SG_ VCFRONT_a555_cell4Voltage m555 : 46|10@1+ (0.01,0) [0|10.23] "V" Vector__XXX
 SG_ VCFRONT_a557_MatrixBank1Status m557 : 16|2@1+ (1,0) [0|3] "" Vector__XXX
 SG_ VCFRONT_a557_SideMarkerStatus m557 : 18|3@1+ (1,0) [0|7] "" Vector__XXX
 SG_ VCFRONT_a557_TurnSignalStatus m557 : 21|3@1+ (1,0) [0|7] "" Vector__XXX
 SG_ VCFRONT_a557_DRL1Status m557 : 24|3@1+ (1,0) [0|7] "" Vector__XXX
 SG_ VCFRONT_a557_DRL2Status m557 : 27|3@1+ (1,0) [0|7] "" Vector__XXX
 SG_ VCFRONT_a557_DRL3Status m557 : 32|3@1+ (1,0) [0|7] "" Vector__XXX
 SG_ VCFRONT_a557_CenterStatus m557 : 35|3@1+ (1,0) [0|7] "" Vector__XXX
 SG_ VCFRONT_a557_LowBeamStatus m557 : 40|3@1+ (1,0) [0|7] "" Vector__XXX
 SG_ VCFRONT_a557_TPS92520_COMPOV m557 : 43|1@1+ (1,0) [0|1] "" Vector__XXX
 SG_ VCFRONT_a557_TPS92520_HSILIM m557 : 44|1@1+ (1,0) [0|1] "" Vector__XXX
 SG_ VCFRONT_a557_TPS92520_BSTUV m557 : 45|1@1+ (1,0) [0|1] "" Vector__XXX
 SG_ VCFRONT_a557_BoostRailStatus m557 : 46|1@1+ (1,0) [0|1] "" Vector__XXX
 SG_ VCFRONT_a557_EEPROMDataStatus m557 : 47|1@1+ (1,0) [0|1] "" Vector__XXX
 SG_ VCFRONT_a557_HeadlampECURevision m557 : 48|4@1+ (1,0) [0|15] "" Vector__XXX
 SG_ VCFRONT_a559_SOC m559 : 16|7@1+ (1,0) [0|127] "%" Vector__XXX
 SG_ VCFRONT_a559_PackCurrent m559 : 24|12@1+ (0.2,-600) [-600|219] "A" Vector__XXX
 SG_ VCFRONT_a559_vehiclePowerState m559 : 36|2@1+ (1,0) [0|3] "" Vector__XXX
 SG_ VCFRONT_a559_batterySMState m559 : 40|4@1+ (1,0) [0|15] "" Vector__XXX
 SG_ VCFRONT_a559_bmsState m559 : 44|4@1+ (1,0) [0|15] "" Vector__XXX
 SG_ VCFRONT_a559_dcdcLVSupportStatus m559 : 48|2@1+ (1,0) [0|3] "" Vector__XXX
 SG_ VCFRONT_a559_factoryMode m559 : 50|1@1+ (1,0) [0|1] "" Vector__XXX
 SG_ VCFRONT_a559_serviceMode m559 : 51|1@1+ (1,0) [0|1] "" Vector__XXX
 SG_ VCFRONT_a559_transportMode m559 : 52|1@1+ (1,0) [0|1] "" Vector__XXX
 SG_ VCFRONT_a559_notEnoughPowerForSu m559 : 53|1@1+ (1,0) [0|1] "" Vector__XXX
 SG_ VCFRONT_a559_crashDetected m559 : 54|1@1+ (1,0) [0|1] "" Vector__XXX
 SG_ VCFRONT_a559_BMS_MIA m559 : 55|1@1+ (1,0) [0|1] "" Vector__XXX
 SG_ VCFRONT_a559_PCS_MIA m559 : 56|1@1+ (1,0) [0|1] "" Vector__XXX
 SG_ VCFRONT_a559_HVBlockingMismatch m559 : 57|1@1+ (1,0) [0|1] "" Vector__XXX
 SG_ VCFRONT_a559_HV_UP m559 : 58|1@1+ (1,0) [0|1] "" Vector__XXX
 SG_ VCFRONT_a559_pcsEFuseStable m559 : 59|1@1+ (1,0) [0|1] "" Vector__XXX
 SG_ VCFRONT_a559_vcrightEFuseStable m559 : 60|1@1+ (1,0) [0|1] "" Vector__XXX
 SG_ VCFRONT_a559_contactorEFuseStabl m559 : 61|1@1+ (1,0) [0|1] "" Vector__XXX
 SG_ VCFRONT_a559_hvcEFuseStable m559 : 62|1@1+ (1,0) [0|1] "" Vector__XXX
 SG_ VCFRONT_a559_frunkOpen m559 : 63|1@1+ (1,0) [0|1] "" Vector__XXX
 SG_ VCFRONT_a560_highSHCOP1 m560 : 16|1@1+ (1,0) [0|1] "" Vector__XXX
 SG_ VCFRONT_a560_highSHBattCondition m560 : 17|1@1+ (1,0) [0|1] "" Vector__XXX
 SG_ VCFRONT_a560_highSHCabinReheatCD m560 : 18|1@1+ (1,0) [0|1] "" Vector__XXX
 SG_ VCFRONT_a560_highSHCabinReheatHD m560 : 19|1@1+ (1,0) [0|1] "" Vector__XXX
 SG_ VCFRONT_a560_highSHCabinCooling m560 : 20|1@1+ (1,0) [0|1] "" Vector__XXX
 SG_ VCFRONT_a560_highSHCabinHeating m560 : 21|1@1+ (1,0) [0|1] "" Vector__XXX
 SG_ VCFRONT_a560_highSHCatchAll m560 : 22|1@1+ (1,0) [0|1] "" Vector__XXX
 SG_ VCFRONT_a561_efuseTemperature m561 : 16|5@1+ (4,0) [0|124] "C" Vector__XXX
 SG_ VCFRONT_a561_packTemperature m561 : 21|5@1+ (4,0) [0|124] "C" Vector__XXX
 SG_ VCFRONT_a561_ambientTemperature m561 : 26|6@1+ (4,0) [0|252] "C" Vector__XXX
 SG_ VCFRONT_a561_cell1Voltage m561 : 32|7@1+ (0.04,0) [0|5.08] "V" Vector__XXX
 SG_ VCFRONT_a561_cell2Voltage m561 : 39|7@1+ (0.04,0) [0|5.08] "V" Vector__XXX
 SG_ VCFRONT_a561_cell3Voltage m561 : 46|7@1+ (0.04,0) [0|5.08] "V" Vector__XXX
 SG_ VCFRONT_a561_cell4Voltage m561 : 53|7@1+ (0.04,0) [0|5.08] "V" Vector__XXX
 SG_ VCFRONT_a561_factoryMode m561 : 60|1@1+ (1,0) [0|1] "" Vector__XXX
 SG_ VCFRONT_a561_serviceMode m561 : 61|1@1+ (1,0) [0|1] "" Vector__XXX
 SG_ VCFRONT_a561_frunkOpen m561 : 62|1@1+ (1,0) [0|1] "" Vector__XXX
 SG_ VCFRONT_a562_efuseTemperature m562 : 16|5@1+ (4,0) [0|124] "C" Vector__XXX
 SG_ VCFRONT_a562_packTemperature m562 : 21|5@1+ (4,0) [0|124] "C" Vector__XXX
 SG_ VCFRONT_a562_ambientTemperature m562 : 26|6@1+ (4,0) [0|252] "C" Vector__XXX
 SG_ VCFRONT_a562_cell1Voltage m562 : 32|7@1+ (0.04,0) [0|5.08] "V" Vector__XXX
 SG_ VCFRONT_a562_cell2Voltage m562 : 39|7@1+ (0.04,0) [0|5.08] "V" Vector__XXX
 SG_ VCFRONT_a562_cell3Voltage m562 : 46|7@1+ (0.04,0) [0|5.08] "V" Vector__XXX
 SG_ VCFRONT_a562_cell4Voltage m562 : 53|7@1+ (0.04,0) [0|5.08] "V" Vector__XXX
 SG_ VCFRONT_a562_factoryMode m562 : 60|1@1+ (1,0) [0|1] "" Vector__XXX
 SG_ VCFRONT_a562_serviceMode m562 : 61|1@1+ (1,0) [0|1] "" Vector__XXX
 SG_ VCFRONT_a562_frunkOpen m562 : 62|1@1+ (1,0) [0|1] "" Vector__XXX
 SG_ VCFRONT_a579_leftHeadlightCurren m579 : 16|16@1+ (0.1,0) [0|6553.5] "A" Vector__XXX
 SG_ VCFRONT_a579_leftHeadlightVoltag m579 : 32|16@1+ (0.1,0) [0|6553.5] "V" Vector__XXX
 SG_ VCFRONT_a579_leftHeadlightRemain m579 : 48|4@1+ (1,0) [0|15] "" Vector__XXX
 SG_ VCFRONT_a580_rightHeadlightCurre m580 : 16|16@1+ (0.1,0) [0|6553.5] "A" Vector__XXX
 SG_ VCFRONT_a580_rightHeadlightVolta m580 : 32|16@1+ (0.1,0) [0|6553.5] "V" Vector__XXX
 SG_ VCFRONT_a580_rightHeadlightRemai m580 : 48|4@1+ (1,0) [0|15] "" Vector__XXX
 SG_ VCFRONT_a582_batterySMState m582 : 16|4@1+ (1,0) [0|15] "" Vector__XXX
 SG_ VCFRONT_a582_PCSCurrent m582 : 24|8@1+ (0.5,-127) [-127|0.5] "A" Vector__XXX
 SG_ VCFRONT_a582_LVBusVoltage m582 : 32|8@1+ (0.1,0) [0|25.5] "V" Vector__XXX
 SG_ VCFRONT_a582_LVBusVoltageSource m582 : 40|2@1+ (1,0) [0|3] "" Vector__XXX
 SG_ VCFRONT_a582_batteryType m582 : 42|3@1+ (1,0) [0|7] "" Vector__XXX
 SG_ VCFRONT_a582_inFactoryMode m582 : 45|1@1+ (1,0) [0|1] "" Vector__XXX
 SG_ VCFRONT_a582_frunkOpen m582 : 46|1@1+ (1,0) [0|1] "" Vector__XXX
 SG_ VCFRONT_a585_leftHeadlampInterna m585 : 16|20@1+ (1,0) [0|1048575] "" Vector__XXX
 SG_ VCFRONT_a585_rightHeadlampIntern m585 : 36|20@1+ (1,0) [0|1048575] "" Vector__XXX
 SG_ VCFRONT_a585_inFactoryMode m585 : 56|1@1+ (1,0) [0|1] "" Vector__XXX
 SG_ VCFRONT_a585_inServiceMode m585 : 57|1@1+ (1,0) [0|1] "" Vector__XXX
 SG_ VCFRONT_a585_inTransportMode m585 : 58|1@1+ (1,0) [0|1] "" Vector__XXX
 SG_ VCFRONT_a585_uiMia m585 : 59|1@1+ (1,0) [0|1] "" Vector__XXX
 SG_ VCFRONT_a585_frunkOpen m585 : 60|1@1+ (1,0) [0|1] "" Vector__XXX
 SG_ VCFRONT_a585_leftRailVoltageLow m585 : 61|1@1+ (1,0) [0|1] "" Vector__XXX
 SG_ VCFRONT_a585_rightRailVoltageLow m585 : 62|1@1+ (1,0) [0|1] "" Vector__XXX
 SG_ VCFRONT_a592_vcleftCutoffEFuseCu m592 : 16|1@1+ (1,0) [0|1] "" Vector__XXX
 SG_ VCFRONT_a592_vcleftCutoffCurveOf m592 : 17|3@1+ (1,0) [0|7] "" Vector__XXX
 SG_ VCFRONT_a592_vcleftCutoffATerm m592 : 24|16@1+ (50,0) [0|3276700] "-" Vector__XXX
 SG_ VCFRONT_a592_vcleftCutoffBTerm m592 : 40|8@1- (1,-78) [-206|49] "-" Vector__XXX
 SG_ VCFRONT_a592_vcleftCutoffCTerm m592 : 48|16@1- (50,0) [-1638400|1638350] "-" Vector__XXX
 SG_ VCFRONT_a593_vcleftCutoffEFuseFa m593 : 16|1@1+ (1,0) [0|1] "" Vector__XXX
 SG_ VCFRONT_a593_vcleftCutoffCurrent m593 : 17|12@1+ (0.1,0) [0|409.5] "A" Vector__XXX
 SG_ VCFRONT_a593_vcleftCutoffTimingT m593 : 32|16@1+ (1,0) [0|65535] "" Vector__XXX
 SG_ VCFRONT_a593_vcleftCutoffMaxCoun m593 : 48|5@1+ (1,0) [0|31] "" Vector__XXX
 SG_ VCFRONT_a596_vcrightCutoffEFuseC m596 : 16|1@1+ (1,0) [0|1] "" Vector__XXX
 SG_ VCFRONT_a596_vcrightCutoffCurveO m596 : 17|3@1+ (1,0) [0|7] "" Vector__XXX
 SG_ VCFRONT_a596_vcrightCutoffATerm m596 : 24|16@1+ (50,0) [0|3276700] "-" Vector__XXX
 SG_ VCFRONT_a596_vcrightCutoffBTerm m596 : 40|8@1- (1,-78) [-206|49] "-" Vector__XXX
 SG_ VCFRONT_a596_vcrightCutoffCTerm m596 : 48|16@1- (50,0) [-1638400|1638350] "-" Vector__XXX
 SG_ VCFRONT_a597_vcrightCutoffEFuseF m597 : 16|1@1+ (1,0) [0|1] "" Vector__XXX
 SG_ VCFRONT_a597_vcrightCutoffCurren m597 : 17|12@1+ (0.1,0) [0|409.5] "A" Vector__XXX
 SG_ VCFRONT_a597_vcrightCutoffTiming m597 : 32|16@1+ (1,0) [0|65535] "" Vector__XXX
 SG_ VCFRONT_a597_vcrightCutoffMaxCou m597 : 48|5@1+ (1,0) [0|31] "" Vector__XXX
 SG_ VCFRONT_a598_vcleftSelfTestResul m598 : 16|4@1+ (1,0) [0|15] "" Vector__XXX
 SG_ VCFRONT_a599_GTW_twelveVBatteryT m599 : 16|3@1+ (1,0) [0|7] "" Vector__XXX
 SG_ VCFRONT_a599_newLVBatteryType m599 : 19|3@1+ (1,0) [0|7] "" Vector__XXX
 SG_ VCFRONT_a599_initialLVBatteryTyp m599 : 24|3@1+ (1,0) [0|7] "" Vector__XXX
 SG_ VCFRONT_a599_serviceMode m599 : 27|1@1+ (1,0) [0|1] "" Vector__XXX
 SG_ VCFRONT_a599_factoryGated m599 : 28|1@1+ (1,0) [0|1] "" Vector__XXX
 SG_ VCFRONT_a599_frunkOpen m599 : 29|1@1+ (1,0) [0|1] "" Vector__XXX
 SG_ VCFRONT_a605_vbatProtVoltage m605 : 16|10@1+ (0.1,0) [0|102.3] "V" Vector__XXX
 SG_ VCFRONT_a605_sleepBypassVoltage m605 : 26|10@1+ (0.1,0) [0|102.3] "V" Vector__XXX
 SG_ VCFRONT_a605_sleepBypassCurrent m605 : 36|10@1+ (0.1,0) [0|102.3] "A" Vector__XXX
 SG_ VCFRONT_a610_switch1State m610 : 16|2@1+ (1,0) [1|3] "" Vector__XXX
 SG_ VCFRONT_a610_switch2State m610 : 18|2@1+ (1,0) [1|3] "" Vector__XXX
 SG_ VCFRONT_a610_dataBufferBits m610 : 20|10@1+ (1,0) [0|1023] "" Vector__XXX
 SG_ VCFRONT_a610_temperature m610 : 32|8@1+ (0.5,-40) [-39.5|87.5] "degC" Vector__XXX
 SG_ VCFRONT_a611_tempCoolantPTInlet m611 : 16|6@1+ (1,20) [20|83] "degC" Vector__XXX
 SG_ VCFRONT_a611_tempCoolantPTInletE m611 : 22|6@1+ (1,20) [20|83] "degC" Vector__XXX
 SG_ VCFRONT_a611_tempAmbientRaw m611 : 28|6@1+ (1,20) [20|83] "degC" Vector__XXX
 SG_ VCFRONT_a611_radFanAvgSpeed m611 : 34|6@1+ (100,0) [0|6300] "RPM" Vector__XXX
 SG_ VCFRONT_a611_ptLoopCoolantFlow m611 : 40|6@1+ (0.5,0) [0|31.5] "LPM" Vector__XXX
 SG_ VCFRONT_a611_compressorPower m611 : 46|6@1+ (200,0) [0|12600] "W" Vector__XXX
 SG_ VCFRONT_a611_heatGenTotal m611 : 52|6@1+ (500,0) [0|31500] "W" Vector__XXX
 SG_ VCFRONT_a611_radCoolantToAirUAEs m611 : 58|6@1+ (20,0) [0|1260] "W/degC" Vector__XXX
 SG_ VCFRONT_a612_DI_gear m612 : 16|3@1+ (1,0) [0|6] "" Vector__XXX
 SG_ VCFRONT_a612_manualDrivingProhib m612 : 19|1@1+ (1,0) [0|1] "" Vector__XXX
 SG_ VCFRONT_a612_vehicleSpeed m612 : 20|12@1+ (0.08,-40) [-40|287.6] "kph" Vector__XXX
 SG_ VCFRONT_a612_lvHealthStatus m612 : 32|2@1+ (1,0) [0|3] "" Vector__XXX
 SG_ VCFRONT_a620_powertrainIsDryRunD m620 : 16|1@1+ (1,0) [0|1] "" Vector__XXX
 SG_ VCFRONT_a620_powertrainPumpRpm m620 : 17|8@1+ (30,0) [0|7620] "rpm" Vector__XXX
 SG_ VCFRONT_a620_powertrainPumpIPhas m620 : 25|8@1+ (0.1,0) [0|25.4] "A" Vector__XXX
 SG_ VCFRONT_a620_powertrainPump_0001 m620 : 33|7@1+ (0.1,0) [0|12.6] "A" Vector__XXX
 SG_ VCFRONT_a620_chillerIsDryRunDete m620 : 40|1@1+ (1,0) [0|1] "" Vector__XXX
 SG_ VCFRONT_a620_chillerPumpRpm m620 : 41|8@1+ (30,0) [0|7620] "rpm" Vector__XXX
 SG_ VCFRONT_a620_chillerPumpIPhaseFi m620 : 49|8@1+ (0.1,0) [0|25.4] "A" Vector__XXX
 SG_ VCFRONT_a620_chillerPumpIPhaseMi m620 : 57|7@1+ (0.1,0) [0|12.6] "A" Vector__XXX
 SG_ VCFRONT_a622_pumpChLowCoolantFlo m622 : 16|1@1+ (1,0) [0|1] "" Vector__XXX
 SG_ VCFRONT_a622_pumpPtLowCoolantFlo m622 : 17|1@1+ (1,0) [0|1] "" Vector__XXX
 SG_ VCFRONT_a622_coolantMode m622 : 18|2@1+ (1,0) [0|3] "" Vector__XXX
 SG_ VCFRONT_a622_isRadiatorBypassed m622 : 20|1@1+ (1,0) [0|1] "" Vector__XXX
 SG_ VCFRONT_a623_DI_gear m623 : 16|3@1+ (1,0) [0|6] "" Vector__XXX
 SG_ VCFRONT_a623_manualDrivingProhib m623 : 19|1@1+ (1,0) [0|1] "" Vector__XXX
 SG_ VCFRONT_a623_vehicleSpeed m623 : 20|12@1+ (0.08,-40) [-40|287.6] "kph" Vector__XXX
 SG_ VCFRONT_a623_lvHealthStatus m623 : 32|2@1+ (1,0) [0|3] "" Vector__XXX
 SG_ VCFRONT_a623_unhealthyReason m623 : 34|5@1+ (1,0) [0|31] "" Vector__XXX
 SG_ VCFRONT_a623_failureLvBatteryEne m623 : 39|1@1+ (1,0) [0|1] "" Vector__XXX
 SG_ VCFRONT_a623_failureLvBatte_0003 m623 : 40|1@1+ (1,0) [0|1] "" Vector__XXX
 SG_ VCFRONT_a623_failureReverseBatte m623 : 41|1@1+ (1,0) [0|1] "" Vector__XXX
 SG_ VCFRONT_a623_failureLvbmbEfuseOp m623 : 42|1@1+ (1,0) [0|1] "" Vector__XXX
 SG_ VCFRONT_a623_failureLvBatteryCom m623 : 43|1@1+ (1,0) [0|1] "" Vector__XXX
 SG_ VCFRONT_a623_failureLvBatterySen m623 : 44|1@1+ (1,0) [0|1] "" Vector__XXX
 SG_ VCFRONT_a623_failureLvBatte_0001 m623 : 45|1@1+ (1,0) [0|1] "" Vector__XXX
 SG_ VCFRONT_a623_failureLvBatte_0002 m623 : 46|1@1+ (1,0) [0|1] "" Vector__XXX
 SG_ VCFRONT_a623_failurePcsEfuseOff m623 : 47|1@1+ (1,0) [0|1] "" Vector__XXX
 SG_ VCFRONT_a623_failurePcsNotActive m623 : 48|1@1+ (1,0) [0|1] "" Vector__XXX
 SG_ VCFRONT_a623_failurePcsMia m623 : 49|1@1+ (1,0) [0|1] "" Vector__XXX
 SG_ VCFRONT_a623_failurePcsOpenCircu m623 : 50|1@1+ (1,0) [0|1] "" Vector__XXX
 SG_ VCFRONT_a623_failureLvBatteryPow m623 : 51|1@1+ (1,0) [0|1] "" Vector__XXX
 SG_ VCFRONT_a623_failureLvBatteryCap m623 : 52|1@1+ (1,0) [0|1] "" Vector__XXX
 SG_ VCFRONT_a623_failureLvBatteryCon m623 : 53|1@1+ (1,0) [0|1] "" Vector__XXX
 SG_ VCFRONT_a623_failureLvBatteryHig m623 : 54|1@1+ (1,0) [0|1] "" Vector__XXX
 SG_ VCFRONT_a623_factoryMode m623 : 55|1@1+ (1,0) [0|1] "" Vector__XXX
 SG_ VCFRONT_a623_serviceMode m623 : 56|1@1+ (1,0) [0|1] "" Vector__XXX
 SG_ VCFRONT_a624_HighBeam_OV m624 : 16|1@1+ (1,0) [0|1] "" Vector__XXX
 SG_ VCFRONT_a624_HighBeam_UV m624 : 17|1@1+ (1,0) [0|1] "" Vector__XXX
 SG_ VCFRONT_a624_HighBeam_short m624 : 18|1@1+ (1,0) [0|1] "" Vector__XXX
 SG_ VCFRONT_a624_HighBeam_compov m624 : 19|1@1+ (1,0) [0|1] "" Vector__XXX
 SG_ VCFRONT_a624_HighBeam_bootuv m624 : 20|1@1+ (1,0) [0|1] "" Vector__XXX
 SG_ VCFRONT_a624_HighBeam_binStatus m624 : 21|1@1+ (1,0) [0|1] "" Vector__XXX
 SG_ VCFRONT_a624_LowBeam_OV m624 : 22|1@1+ (1,0) [0|1] "" Vector__XXX
 SG_ VCFRONT_a624_LowBeam_UV m624 : 23|1@1+ (1,0) [0|1] "" Vector__XXX
 SG_ VCFRONT_a624_LowBeam_short m624 : 24|1@1+ (1,0) [0|1] "" Vector__XXX
 SG_ VCFRONT_a624_LowBeam_compov m624 : 25|1@1+ (1,0) [0|1] "" Vector__XXX
 SG_ VCFRONT_a624_LowBeam_bootuv m624 : 26|1@1+ (1,0) [0|1] "" Vector__XXX
 SG_ VCFRONT_a624_LowBeam_binStatus m624 : 27|1@1+ (1,0) [0|1] "" Vector__XXX
 SG_ VCFRONT_a624_DRL_OV m624 : 28|1@1+ (1,0) [0|1] "" Vector__XXX
 SG_ VCFRONT_a624_DRL_UV m624 : 29|1@1+ (1,0) [0|1] "" Vector__XXX
 SG_ VCFRONT_a624_DRL_short m624 : 30|1@1+ (1,0) [0|1] "" Vector__XXX
 SG_ VCFRONT_a624_DRL_compov m624 : 31|1@1+ (1,0) [0|1] "" Vector__XXX
 SG_ VCFRONT_a624_DRL_bootuv m624 : 32|1@1+ (1,0) [0|1] "" Vector__XXX
 SG_ VCFRONT_a624_DRL_binStatus m624 : 33|1@1+ (1,0) [0|1] "" Vector__XXX
 SG_ VCFRONT_a624_TurnSignal_OV m624 : 34|1@1+ (1,0) [0|1] "" Vector__XXX
 SG_ VCFRONT_a624_TurnSignal_UV m624 : 35|1@1+ (1,0) [0|1] "" Vector__XXX
 SG_ VCFRONT_a624_TurnSignal_short m624 : 36|1@1+ (1,0) [0|1] "" Vector__XXX
 SG_ VCFRONT_a624_TurnSignal_compov m624 : 37|1@1+ (1,0) [0|1] "" Vector__XXX
 SG_ VCFRONT_a624_TurnSignal_bootuv m624 : 38|1@1+ (1,0) [0|1] "" Vector__XXX
 SG_ VCFRONT_a624_TurnSignal_binStatu m624 : 39|1@1+ (1,0) [0|1] "" Vector__XXX
 SG_ VCFRONT_a624_SideMarker_OV m624 : 40|1@1+ (1,0) [0|1] "" Vector__XXX
 SG_ VCFRONT_a624_SideMarker_UV m624 : 41|1@1+ (1,0) [0|1] "" Vector__XXX
 SG_ VCFRONT_a624_SideMarker_short m624 : 42|1@1+ (1,0) [0|1] "" Vector__XXX
 SG_ VCFRONT_a624_SideMarker_compov m624 : 43|1@1+ (1,0) [0|1] "" Vector__XXX
 SG_ VCFRONT_a624_SideMarker_bootuv m624 : 44|1@1+ (1,0) [0|1] "" Vector__XXX
 SG_ VCFRONT_a624_SideMarker_binStatu m624 : 45|1@1+ (1,0) [0|1] "" Vector__XXX
 SG_ VCFRONT_a624_boost_OV m624 : 46|1@1+ (1,0) [0|1] "" Vector__XXX
 SG_ VCFRONT_a624_boost_BOOTUV m624 : 47|1@1+ (1,0) [0|1] "" Vector__XXX
 SG_ VCFRONT_a624_boost_ILIM m624 : 48|1@1+ (1,0) [0|1] "" Vector__XXX
 SG_ VCFRONT_a624_boost_ISPUV m624 : 49|1@1+ (1,0) [0|1] "" Vector__XXX
 SG_ VCFRONT_a624_EEPROM_status m624 : 50|1@1+ (1,0) [0|1] "" Vector__XXX
 SG_ VCFRONT_a624_EEPROM_region m624 : 51|3@1+ (1,0) [1|7] "" Vector__XXX
 SG_ VCFRONT_a625_HighBeam_OV m625 : 16|1@1+ (1,0) [0|1] "" Vector__XXX
 SG_ VCFRONT_a625_HighBeam_UV m625 : 17|1@1+ (1,0) [0|1] "" Vector__XXX
 SG_ VCFRONT_a625_HighBeam_short m625 : 18|1@1+ (1,0) [0|1] "" Vector__XXX
 SG_ VCFRONT_a625_HighBeam_compov m625 : 19|1@1+ (1,0) [0|1] "" Vector__XXX
 SG_ VCFRONT_a625_HighBeam_bootuv m625 : 20|1@1+ (1,0) [0|1] "" Vector__XXX
 SG_ VCFRONT_a625_HighBeam_binStatus m625 : 21|1@1+ (1,0) [0|1] "" Vector__XXX
 SG_ VCFRONT_a625_LowBeam_OV m625 : 22|1@1+ (1,0) [0|1] "" Vector__XXX
 SG_ VCFRONT_a625_LowBeam_UV m625 : 23|1@1+ (1,0) [0|1] "" Vector__XXX
 SG_ VCFRONT_a625_LowBeam_short m625 : 24|1@1+ (1,0) [0|1] "" Vector__XXX
 SG_ VCFRONT_a625_LowBeam_compov m625 : 25|1@1+ (1,0) [0|1] "" Vector__XXX
 SG_ VCFRONT_a625_LowBeam_bootuv m625 : 26|1@1+ (1,0) [0|1] "" Vector__XXX
 SG_ VCFRONT_a625_LowBeam_binStatus m625 : 27|1@1+ (1,0) [0|1] "" Vector__XXX
 SG_ VCFRONT_a625_DRL_OV m625 : 28|1@1+ (1,0) [0|1] "" Vector__XXX
 SG_ VCFRONT_a625_DRL_UV m625 : 29|1@1+ (1,0) [0|1] "" Vector__XXX
 SG_ VCFRONT_a625_DRL_short m625 : 30|1@1+ (1,0) [0|1] "" Vector__XXX
 SG_ VCFRONT_a625_DRL_compov m625 : 31|1@1+ (1,0) [0|1] "" Vector__XXX
 SG_ VCFRONT_a625_DRL_bootuv m625 : 32|1@1+ (1,0) [0|1] "" Vector__XXX
 SG_ VCFRONT_a625_DRL_binStatus m625 : 33|1@1+ (1,0) [0|1] "" Vector__XXX
 SG_ VCFRONT_a625_TurnSignal_OV m625 : 34|1@1+ (1,0) [0|1] "" Vector__XXX
 SG_ VCFRONT_a625_TurnSignal_UV m625 : 35|1@1+ (1,0) [0|1] "" Vector__XXX
 SG_ VCFRONT_a625_TurnSignal_short m625 : 36|1@1+ (1,0) [0|1] "" Vector__XXX
 SG_ VCFRONT_a625_TurnSignal_compov m625 : 37|1@1+ (1,0) [0|1] "" Vector__XXX
 SG_ VCFRONT_a625_TurnSignal_bootuv m625 : 38|1@1+ (1,0) [0|1] "" Vector__XXX
 SG_ VCFRONT_a625_TurnSignal_binStatu m625 : 39|1@1+ (1,0) [0|1] "" Vector__XXX
 SG_ VCFRONT_a625_SideMarker_OV m625 : 40|1@1+ (1,0) [0|1] "" Vector__XXX
 SG_ VCFRONT_a625_SideMarker_UV m625 : 41|1@1+ (1,0) [0|1] "" Vector__XXX
 SG_ VCFRONT_a625_SideMarker_short m625 : 42|1@1+ (1,0) [0|1] "" Vector__XXX
 SG_ VCFRONT_a625_SideMarker_compov m625 : 43|1@1+ (1,0) [0|1] "" Vector__XXX
 SG_ VCFRONT_a625_SideMarker_bootuv m625 : 44|1@1+ (1,0) [0|1] "" Vector__XXX
 SG_ VCFRONT_a625_SideMarker_binStatu m625 : 45|1@1+ (1,0) [0|1] "" Vector__XXX
 SG_ VCFRONT_a625_boost_OV m625 : 46|1@1+ (1,0) [0|1] "" Vector__XXX
 SG_ VCFRONT_a625_boost_BOOTUV m625 : 47|1@1+ (1,0) [0|1] "" Vector__XXX
 SG_ VCFRONT_a625_boost_ILIM m625 : 48|1@1+ (1,0) [0|1] "" Vector__XXX
 SG_ VCFRONT_a625_boost_ISPUV m625 : 49|1@1+ (1,0) [0|1] "" Vector__XXX
 SG_ VCFRONT_a625_EEPROM_status m625 : 50|1@1+ (1,0) [0|1] "" Vector__XXX
 SG_ VCFRONT_a625_EEPROM_region m625 : 51|3@1+ (1,0) [1|7] "" Vector__XXX
 SG_ VCFRONT_a626_dcrMilliOhms m626 : 16|8@1+ (0.2,0) [0|51] "mOhms" Vector__XXX
 SG_ VCFRONT_a626_elevatedDcrThreshol m626 : 24|4@1+ (0.5,12) [12|19.5] "mOhms" Vector__XXX
 SG_ VCFRONT_a626_avgIntervalCurrent m626 : 28|5@1+ (1,-31) [-31|0] "A" Vector__XXX
 SG_ VCFRONT_a626_intervalCurrentVari m626 : 33|6@1+ (0.1,0) [0|6.3] "A" Vector__XXX
 SG_ VCFRONT_a626_avgPulseCurrent m626 : 39|7@1+ (1,-127) [-127|0] "A" Vector__XXX
 SG_ VCFRONT_a626_pulseCurrentVarianc m626 : 46|6@1+ (0.25,0) [0|15.75] "A" Vector__XXX
 SG_ VCFRONT_a626_IBSTemperature m626 : 52|8@1+ (0.5,-30) [-30|97.5] "degC" Vector__XXX
 SG_ VCFRONT_a626_testCounter m626 : 60|2@1+ (1,0) [0|3] "-" Vector__XXX
 SG_ VCFRONT_a626_testingExpended m626 : 62|1@1+ (1,0) [0|1] "" Vector__XXX
 SG_ VCFRONT_a626_opportunisticTest m626 : 63|1@1+ (1,0) [0|1] "" Vector__XXX
 SG_ VCFRONT_a627_cell1Voltage m627 : 16|9@1+ (0.01,0) [0|5.11] "V" Vector__XXX
 SG_ VCFRONT_a627_cell2Voltage m627 : 25|9@1+ (0.01,0) [0|5.11] "V" Vector__XXX
 SG_ VCFRONT_a627_cell3Voltage m627 : 34|9@1+ (0.01,0) [0|5.11] "V" Vector__XXX
 SG_ VCFRONT_a627_cell4Voltage m627 : 43|9@1+ (0.01,0) [0|5.11] "V" Vector__XXX
 SG_ VCFRONT_a627_sumCellVoltage m627 : 52|8@1+ (0.1,0) [0|25.5] "V" Vector__XXX
 SG_ VCFRONT_a627_deepDischargeFlag m627 : 60|1@1+ (1,0) [0|1] "" Vector__XXX
 SG_ VCFRONT_a627_serviceMode m627 : 61|1@1+ (1,0) [0|1] "" Vector__XXX
 SG_ VCFRONT_a627_frunkOpen m627 : 62|1@1+ (1,0) [0|1] "" Vector__XXX

CM_ SG_ 1332 VCFRONT_a475_drl1Status "Front body controller: a475 drl1 status";
CM_ SG_ 1332 VCFRONT_a475_drl2Status "Front body controller: a475 drl2 status";
CM_ SG_ 1332 VCFRONT_a475_drl3Status "Front body controller: a475 drl3 status";
CM_ SG_ 1332 VCFRONT_a475_turnStatus "Front body controller: a475 turn status";
CM_ SG_ 1332 VCFRONT_a475_fanStatus "Front body controller: a475 fan status";
CM_ SG_ 1332 VCFRONT_a475_TPS92520_COMPOV "Front body controller: a475 TPS92520 COMPOV";
CM_ SG_ 1332 VCFRONT_a475_TPS92520_HSILIM "Front body controller: a475 TPS92520 HSILIM";
CM_ SG_ 1332 VCFRONT_a475_TPS92520_BSTUV "Front body controller: a475 TPS92520 BSTUV";
CM_ SG_ 1332 VCFRONT_a475_BoostRailStatus "Front body controller: a475 boost rail status";
CM_ SG_ 1332 VCFRONT_a475_EEPROM_DataStatus "Front body controller: a475 EEPROM data status";
CM_ SG_ 1332 VCFRONT_a475_LMMVariant "Front body controller: a475 LMM variant; raw 0 = signal not available (SNA)";
CM_ SG_ 1332 VCFRONT_a475_headlampECURevision "Front body controller: a475 headlamp ECU revision";
CM_ SG_ 1332 VCFRONT_a476_FRM1_timedOut "Front body controller: a476 FRM1 timed out";
CM_ SG_ 1332 VCFRONT_a476_FRM2_timedOut "Front body controller: a476 FRM2 timed out";
CM_ SG_ 1332 VCFRONT_a476_FRM3_timedOut "Front body controller: a476 FRM3 timed out";
CM_ SG_ 1332 VCFRONT_a476_FRM4_timedOut "Front body controller: a476 FRM4 timed out";
CM_ SG_ 1332 VCFRONT_a476_FRM5_timedOut "Front body controller: a476 FRM5 timed out";
CM_ SG_ 1332 VCFRONT_a476_FRM6_timedOut "Front body controller: a476 FRM6 timed out";
CM_ SG_ 1332 VCFRONT_a476_FRM7_timedOut "Front body controller: a476 FRM7 timed out";
CM_ SG_ 1332 VCFRONT_a476_FRM8_timedOut "Front body controller: a476 FRM8 timed out";
CM_ SG_ 1332 VCFRONT_a476_FRM9_timedOut "Front body controller: a476 FRM9 timed out";
CM_ SG_ 1332 VCFRONT_a476_FRM10_timedOut "Front body controller: a476 FRM10 timed out";
CM_ SG_ 1332 VCFRONT_a476_FRM11_timedOut "Front body controller: a476 FRM11 timed out";
CM_ SG_ 1332 VCFRONT_a476_FRM12_timedOut "Front body controller: a476 FRM12 timed out";
CM_ SG_ 1332 VCFRONT_a476_factoryMode "Front body controller: a476 factory mode";
CM_ SG_ 1332 VCFRONT_a476_serviceMode "Signal reported by Front body controller";
CM_ SG_ 1332 VCFRONT_a476_transportMode "Front body controller: a476 transport mode";
CM_ SG_ 1332 VCFRONT_a476_frunkOpen "Front body controller: a476 frunk open";
CM_ SG_ 1332 VCFRONT_a476_vehiclePowerState "Front body controller: a476 vehicle power state";
CM_ SG_ 1332 VCFRONT_a476_batterySMState "Front body controller: a476 battery SM state";
CM_ SG_ 1332 VCFRONT_a476_ECPAState "Front body controller: a476 ECPA state; raw 3 = signal not available (SNA)";
CM_ SG_ 1332 VCFRONT_a477_cell1Voltage "Front body controller: a477 cell1 voltage";
CM_ SG_ 1332 VCFRONT_a477_cell2Voltage "Front body controller: a477 cell2 voltage";
CM_ SG_ 1332 VCFRONT_a477_cell3Voltage "Front body controller: a477 cell3 voltage";
CM_ SG_ 1332 VCFRONT_a477_cell4Voltage "Front body controller: a477 cell4 voltage";
CM_ SG_ 1332 VCFRONT_a477_sumCellVoltage "Front body controller: a477 sum cell voltage";
CM_ SG_ 1332 VCFRONT_a477_deepDischargeFlag "Front body controller: a477 deep discharge flag";
CM_ SG_ 1332 VCFRONT_a477_serviceMode "Signal reported by Front body controller";
CM_ SG_ 1332 VCFRONT_a477_frunkOpen "Front body controller: a477 frunk open";
CM_ SG_ 1332 VCFRONT_a478_battFaultPackOverVo "Front body controller: a478 batt fault pack over voltage";
CM_ SG_ 1332 VCFRONT_a478_battFaultHardwareOv "Front body controller: a478 batt fault hardware over current";
CM_ SG_ 1332 VCFRONT_a478_battFaultChargeOver "Front body controller: a478 batt fault charge over current";
CM_ SG_ 1332 VCFRONT_a478_battFaultCellUnderV "Front body controller: a478 batt fault cell under voltage";
CM_ SG_ 1332 VCFRONT_a478_battFaultCellOverVo "Front body controller: a478 batt fault cell over voltage";
CM_ SG_ 1332 VCFRONT_a478_vehiclePowerState "Front body controller: a478 vehicle power state";
CM_ SG_ 1332 VCFRONT_a478_batterySMState "Front body controller: a478 battery SM state";
CM_ SG_ 1332 VCFRONT_a478_bmsState "Front body controller: a478 bms state; raw 9 = signal not available (SNA)";
CM_ SG_ 1332 VCFRONT_a478_dcdcLVSupportStatus "Front body controller: a478 dcdc LV support status";
CM_ SG_ 1332 VCFRONT_a478_factoryMode "Front body controller: a478 factory mode";
CM_ SG_ 1332 VCFRONT_a478_serviceMode "Signal reported by Front body controller";
CM_ SG_ 1332 VCFRONT_a478_transportMode "Front body controller: a478 transport mode";
CM_ SG_ 1332 VCFRONT_a478_notEnoughPowerForSu "Front body controller: a478 not enough power for support";
CM_ SG_ 1332 VCFRONT_a478_crashDetected "Front body controller: a478 crash detected";
CM_ SG_ 1332 VCFRONT_a478_BMS_MIA "Front body controller: a478 BMS MIA";
CM_ SG_ 1332 VCFRONT_a478_PCS_MIA "Front body controller: a478 PCS MIA";
CM_ SG_ 1332 VCFRONT_a478_HVBlockingMismatch "Front body controller: a478 HV blocking mismatch";
CM_ SG_ 1332 VCFRONT_a478_HV_UP "Front body controller: a478 HV UP";
CM_ SG_ 1332 VCFRONT_a478_pcsEFuseStable "Front body controller: a478 pcs e fuse stable";
CM_ SG_ 1332 VCFRONT_a478_vcrightEFuseStable "Front body controller: a478 vcright e fuse stable";
CM_ SG_ 1332 VCFRONT_a478_contactorEFuseStabl "Front body controller: a478 contactor e fuse stable";
CM_ SG_ 1332 VCFRONT_a478_hvcEFuseStable "Front body controller: a478 hvc e fuse stable";
CM_ SG_ 1332 VCFRONT_a478_frunkOpen "Front body controller: a478 frunk open";
CM_ SG_ 1332 VCFRONT_a479_FRM3_timedOut "Front body controller: a479 FRM3 timed out";
CM_ SG_ 1332 VCFRONT_a479_ECPAState "Front body controller: a479 ECPA state; raw 3 = signal not available (SNA)";
CM_ SG_ 1332 VCFRONT_a479_factoryMode "Front body controller: a479 factory mode";
CM_ SG_ 1332 VCFRONT_a479_serviceMode "Signal reported by Front body controller";
CM_ SG_ 1332 VCFRONT_a479_transportMode "Front body controller: a479 transport mode";
CM_ SG_ 1332 VCFRONT_a479_frunkLatchStatus "Front body controller: a479 frunk latch status; raw 0 = signal not available (SNA)";
CM_ SG_ 1332 VCFRONT_a479_vehiclePowerState "Front body controller: a479 vehicle power state";
CM_ SG_ 1332 VCFRONT_a479_batterySMState "Front body controller: a479 battery SM state";
CM_ SG_ 1332 VCFRONT_a480_channel "Front body controller: a480 channel";
CM_ SG_ 1332 VCFRONT_a480_reset "Front body controller: a480 reset";
CM_ SG_ 1332 VCFRONT_a480_spiError "Front body controller: a480 spi error";
CM_ SG_ 1332 VCFRONT_a480_autoOn "Front body controller: a480 auto on";
CM_ SG_ 1332 VCFRONT_a480_diagnosticBit "Front body controller: a480 diagnostic bit";
CM_ SG_ 1332 VCFRONT_a480_deviceError "Front body controller: a480 device error";
CM_ SG_ 1332 VCFRONT_a480_overcurrent "Front body controller: a480 overcurrent";
CM_ SG_ 1332 VCFRONT_a480_unexpectedLock "Front body controller: a480 unexpected lock";
CM_ SG_ 1332 VCFRONT_a480_disableOutputFault "Front body controller: a480 disable output fault";
CM_ SG_ 1332 VCFRONT_a480_vsUndervoltage "Front body controller: a480 vs undervoltage";
CM_ SG_ 1332 VCFRONT_a480_hardShort "Front body controller: a480 hard short";
CM_ SG_ 1332 VCFRONT_a480_vdsMax "Front body controller: a480 vds max";
CM_ SG_ 1332 VCFRONT_a480_bypassSaturation "Front body controller: a480 bypass saturation";
CM_ SG_ 1332 VCFRONT_a480_fuseLatch "Front body controller: a480 fuse latch";
CM_ SG_ 1332 VCFRONT_a480_deviceOvertemperatu "Front body controller: a480 device overtemperature";
CM_ SG_ 1332 VCFRONT_a480_ntcOvertemperature "Front body controller: a480 ntc overtemperature";
CM_ SG_ 1332 VCFRONT_a480_vgsLow "Front body controller: a480 vgs low";
CM_ SG_ 1332 VCFRONT_a480_chargePumpLow "Front body controller: a480 charge pump low";
CM_ SG_ 1332 VCFRONT_a480_watchdog "Front body controller: a480 watchdog";
CM_ SG_ 1332 VCFRONT_a480_spiNotDone "Front body controller: a480 spi not done";
CM_ SG_ 1332 VCFRONT_a480_configIncorrect "Front body controller: a480 config incorrect";
CM_ SG_ 1332 VCFRONT_a480_bufferFull "Front body controller: a480 buffer full";
CM_ SG_ 1332 VCFRONT_a480_hitAlertRateLimit "Front body controller: a480 hit alert rate limit";
CM_ SG_ 1332 VCFRONT_a480_hwlo "Front body controller: a480 hwlo";
CM_ SG_ 1332 VCFRONT_a480_enable "Front body controller: a480 enable";
CM_ SG_ 1332 VCFRONT_a486_mcuGraphicsEFuseCur "Front body controller: a486 mcu graphics e fuse current";
CM_ SG_ 1332 VCFRONT_a490_coolantPumpType "Front body controller: a490 coolant pump type";
CM_ SG_ 1332 VCFRONT_a493_minBrickSocId "Front body controller: a493 min brick soc id";
CM_ SG_ 1332 VCFRONT_a493_minBrickSocByOcvMax "Front body controller: a493 min brick soc by ocv max";
CM_ SG_ 1332 VCFRONT_a493_maxBrickSocId "Front body controller: a493 max brick soc id";
CM_ SG_ 1332 VCFRONT_a493_maxBrickSocByOcvMin "Front body controller: a493 max brick soc by ocv min";
CM_ SG_ 1332 VCFRONT_a493_maxBrickSoc "Front body controller: a493 max brick soc";
CM_ SG_ 1332 VCFRONT_a493_avgBrickSoc "Front body controller: a493 avg brick soc";
CM_ SG_ 1332 VCFRONT_a495_SoCUnrecoverable "Front body controller: a495 so c unrecoverable";
CM_ SG_ 1332 VCFRONT_a495_SocTooLow "Front body controller: a495 soc too low";
CM_ SG_ 1332 VCFRONT_a495_retryExpended "Front body controller: a495 retry expended";
CM_ SG_ 1332 VCFRONT_a495_LVBMSMIA "Front body controller: a495 LVBMSMIA";
CM_ SG_ 1332 VCFRONT_a495_reverseBatteryEFuse "Front body controller: a495 reverse battery e fuse fault";
CM_ SG_ 1332 VCFRONT_a495_DCDCOff "Front body controller: a495 DCDC off";
CM_ SG_ 1332 VCFRONT_a495_HVOff "Front body controller: a495 HV off";
CM_ SG_ 1332 VCFRONT_a495_externalInteraction "Front body controller: a495 external interaction";
CM_ SG_ 1332 VCFRONT_a495_serviceMode "Signal reported by Front body controller";
CM_ SG_ 1332 VCFRONT_a495_frunkOpen "Front body controller: a495 frunk open";
CM_ SG_ 1332 VCFRONT_a495_externalPowerSupply "Front body controller: a495 external power supply";
CM_ SG_ 1332 VCFRONT_a496_reverseBatteryEFuse "Front body controller: a496 reverse battery e fuse fault";
CM_ SG_ 1332 VCFRONT_a496_vehicleLoadShedActi "Front body controller: a496 vehicle load shed active";
CM_ SG_ 1332 VCFRONT_a496_MOSState "Front body controller: a496 MOS state; raw 3 = signal not available (SNA)";
CM_ SG_ 1332 VCFRONT_a496_serviceMode "Signal reported by Front body controller";
CM_ SG_ 1332 VCFRONT_a496_frunkOpen "Front body controller: a496 frunk open";
CM_ SG_ 1332 VCFRONT_a496_PCS_MIA "Front body controller: a496 PCS MIA";
CM_ SG_ 1332 VCFRONT_a496_NotEnoughPowerForSu "Front body controller: a496 not enough power for support";
CM_ SG_ 1332 VCFRONT_a496_bmsState "Front body controller: a496 bms state; raw 9 = signal not available (SNA)";
CM_ SG_ 1332 VCFRONT_a497_serviceMode "Signal reported by Front body controller";
CM_ SG_ 1332 VCFRONT_a497_FactoryMode "Front body controller: a497 factory mode";
CM_ SG_ 1332 VCFRONT_a497_SOC "Front body controller: a497 SOC";
CM_ SG_ 1332 VCFRONT_a497_PackCurrent "Front body controller: a497 pack current";
CM_ SG_ 1332 VCFRONT_a497_SumCellVoltage "Front body controller: a497 sum cell voltage";
CM_ SG_ 1332 VCFRONT_a497_frunkOpen "Front body controller: a497 frunk open";
CM_ SG_ 1332 VCFRONT_a500_channel "Front body controller: a500 channel";
CM_ SG_ 1332 VCFRONT_a500_mismatchedState "Front body controller: a500 mismatched state";
CM_ SG_ 1332 VCFRONT_a503_brickVoltageMin "Front body controller: a503 brick voltage min";
CM_ SG_ 1332 VCFRONT_a503_brickVoltageMax "Front body controller: a503 brick voltage max";
CM_ SG_ 1332 VCFRONT_a503_packCurrent "Front body controller: a503 pack current";
CM_ SG_ 1332 VCFRONT_a503_socMax "Front body controller: a503 soc max";
CM_ SG_ 1332 VCFRONT_a503_brickId "Front body controller: a503 brick id";
CM_ SG_ 1332 VCFRONT_a509_vcrightEFuseCurrent "Front body controller: a509 vcright e fuse current";
CM_ SG_ 1332 VCFRONT_a509_vcrightEFuseTemp "Front body controller: a509 vcright e fuse temp";
CM_ SG_ 1332 VCFRONT_a509_ambientTemp "Front body controller: a509 ambient temp";
CM_ SG_ 1332 VCFRONT_a509_serviceMode "Signal reported by Front body controller";
CM_ SG_ 1332 VCFRONT_a509_frunkOpen "Front body controller: a509 frunk open";
CM_ SG_ 1332 VCFRONT_a510_sumCellVoltage "Front body controller: a510 sum cell voltage";
CM_ SG_ 1332 VCFRONT_a510_packVoltage "Front body controller: a510 pack voltage";
CM_ SG_ 1332 VCFRONT_a510_targetPCSVoltage "Front body controller: a510 target PCS voltage";
CM_ SG_ 1332 VCFRONT_a510_serviceMode "Signal reported by Front body controller";
CM_ SG_ 1332 VCFRONT_a510_frunkOpen "Front body controller: a510 frunk open";
CM_ SG_ 1332 VCFRONT_a511_PCSEFuseCurrent "Front body controller: a511 PCSE fuse current";
CM_ SG_ 1332 VCFRONT_a511_DCDCMaxOutputCurren "Front body controller: a511 DCDC max output current allowed";
CM_ SG_ 1332 VCFRONT_a511_hvState "Front body controller: a511 hv state";
CM_ SG_ 1332 VCFRONT_a511_DCDCOutputIsLimited "Front body controller: a511 DCDC output is limited";
CM_ SG_ 1332 VCFRONT_a511_PCSSignalsAreValid "Front body controller: a511 PCS signals are valid";
CM_ SG_ 1332 VCFRONT_a511_factoryGated "Front body controller: a511 factory gated";
CM_ SG_ 1332 VCFRONT_a511_vehicleIsUpdating "Front body controller: a511 vehicle is updating";
CM_ SG_ 1332 VCFRONT_a511_serviceMode "Signal reported by Front body controller";
CM_ SG_ 1332 VCFRONT_a511_frunkOpen "Front body controller: a511 frunk open";
CM_ SG_ 1332 VCFRONT_a512_packVoltageInt_0001 "Front body controller: a512 pack voltage interval min";
CM_ SG_ 1332 VCFRONT_a512_packVoltageInterval "Front body controller: a512 pack voltage interval max";
CM_ SG_ 1332 VCFRONT_a512_packTemperature "Front body controller: a512 pack temperature";
CM_ SG_ 1332 VCFRONT_a512_sumCellVoltage "Front body controller: a512 sum cell voltage";
CM_ SG_ 1332 VCFRONT_a512_overcurrentDirectio "Front body controller: a512 overcurrent direction";
CM_ SG_ 1332 VCFRONT_a512_serviceMode "Signal reported by Front body controller";
CM_ SG_ 1332 VCFRONT_a512_frunkOpen "Front body controller: a512 frunk open";
CM_ SG_ 1332 VCFRONT_a512_vehiclePowerState "Front body controller: a512 vehicle power state";
CM_ SG_ 1332 VCFRONT_a513_packCurrent "Front body controller: a513 pack current";
CM_ SG_ 1332 VCFRONT_a513_packTemperature "Front body controller: a513 pack temperature";
CM_ SG_ 1332 VCFRONT_a513_packVoltage "Front body controller: a513 pack voltage";
CM_ SG_ 1332 VCFRONT_a513_packSOC "Front body controller: a513 pack SOC";
CM_ SG_ 1332 VCFRONT_a513_serviceMode "Signal reported by Front body controller";
CM_ SG_ 1332 VCFRONT_a513_frunkOpen "Front body controller: a513 frunk open";
CM_ SG_ 1332 VCFRONT_a513_vehiclePowerState "Front body controller: a513 vehicle power state";
CM_ SG_ 1332 VCFRONT_a514_cell1Voltage "Front body controller: a514 cell1 voltage";
CM_ SG_ 1332 VCFRONT_a514_cell2Voltage "Front body controller: a514 cell2 voltage";
CM_ SG_ 1332 VCFRONT_a514_cell3Voltage "Front body controller: a514 cell3 voltage";
CM_ SG_ 1332 VCFRONT_a514_cell4Voltage "Front body controller: a514 cell4 voltage";
CM_ SG_ 1332 VCFRONT_a514_packVoltage "Front body controller: a514 pack voltage";
CM_ SG_ 1332 VCFRONT_a514_packSOC "Front body controller: a514 pack SOC";
CM_ SG_ 1332 VCFRONT_a514_serviceMode "Signal reported by Front body controller";
CM_ SG_ 1332 VCFRONT_a514_frunkOpen "Front body controller: a514 frunk open";
CM_ SG_ 1332 VCFRONT_a514_vehiclePowerState "Front body controller: a514 vehicle power state";
CM_ SG_ 1332 VCFRONT_a515_cell1Voltage "Front body controller: a515 cell1 voltage";
CM_ SG_ 1332 VCFRONT_a515_cell2Voltage "Front body controller: a515 cell2 voltage";
CM_ SG_ 1332 VCFRONT_a515_cell3Voltage "Front body controller: a515 cell3 voltage";
CM_ SG_ 1332 VCFRONT_a515_cell4Voltage "Front body controller: a515 cell4 voltage";
CM_ SG_ 1332 VCFRONT_a515_packVoltage "Front body controller: a515 pack voltage";
CM_ SG_ 1332 VCFRONT_a515_packSOC "Front body controller: a515 pack SOC";
CM_ SG_ 1332 VCFRONT_a515_serviceMode "Signal reported by Front body controller";
CM_ SG_ 1332 VCFRONT_a515_frunkOpen "Front body controller: a515 frunk open";
CM_ SG_ 1332 VCFRONT_a515_vehiclePowerState "Front body controller: a515 vehicle power state";
CM_ SG_ 1332 VCFRONT_a516_IBSVoltage "Front body controller: a516 IBS voltage";
CM_ SG_ 1332 VCFRONT_a516_HVSoc "Front body controller: a516 HV soc";
CM_ SG_ 1332 VCFRONT_a516_contactorsPermanent "Front body controller: a516 contactors permanently closed";
CM_ SG_ 1332 VCFRONT_a516_LVBatteryDisconnect "Front body controller: a516 LV battery disconnected";
CM_ SG_ 1332 VCFRONT_a516_reverseBatteryFault "Front body controller: a516 reverse battery fault";
CM_ SG_ 1332 VCFRONT_a516_LVBatteryCannotSupp "Front body controller: a516 LV battery cannot support vehicle";
CM_ SG_ 1332 VCFRONT_a517_IBSVoltage "Front body controller: a517 IBS voltage";
CM_ SG_ 1332 VCFRONT_a517_HVSoc "Front body controller: a517 HV soc";
CM_ SG_ 1332 VCFRONT_a518_packVoltage "Front body controller: a518 pack voltage";
CM_ SG_ 1332 VCFRONT_a518_IBSVoltage "Front body controller: a518 IBS voltage";
CM_ SG_ 1332 VCFRONT_a518_targetPCSVoltage "Front body controller: a518 target PCS voltage";
CM_ SG_ 1332 VCFRONT_a518_outputVoltageAtPCS "Front body controller: a518 output voltage at PCS";
CM_ SG_ 1332 VCFRONT_a518_packSOC "Front body controller: a518 pack SOC";
CM_ SG_ 1332 VCFRONT_a518_serviceMode "Signal reported by Front body controller";
CM_ SG_ 1332 VCFRONT_a518_frunkOpen "Front body controller: a518 frunk open";
CM_ SG_ 1332 VCFRONT_a518_vehiclePowerState "Front body controller: a518 vehicle power state";
CM_ SG_ 1332 VCFRONT_a519_MatrixBank1Status "Front body controller: a519 matrix bank1 status";
CM_ SG_ 1332 VCFRONT_a519_MatrixBank2Status "Front body controller: a519 matrix bank2 status";
CM_ SG_ 1332 VCFRONT_a519_MatrixBank3Status "Front body controller: a519 matrix bank3 status";
CM_ SG_ 1332 VCFRONT_a519_MatrixBank4Status "Front body controller: a519 matrix bank4 status";
CM_ SG_ 1332 VCFRONT_a519_TurnSignalStatus "Front body controller: a519 turn signal status";
CM_ SG_ 1332 VCFRONT_a519_SideMarkerStatus "Front body controller: a519 side marker status";
CM_ SG_ 1332 VCFRONT_a519_DRLStatus "Front body controller: a519 DRL status";
CM_ SG_ 1332 VCFRONT_a519_AmbientStatus "Front body controller: a519 ambient status";
CM_ SG_ 1332 VCFRONT_a519_LBFlatSAEStatus "Front body controller: a519 LB flat SAE status";
CM_ SG_ 1332 VCFRONT_a519_LBFlatECEStatus "Front body controller: a519 LB flat ECE status";
CM_ SG_ 1332 VCFRONT_a519_TPS92520_COMPOV "Front body controller: a519 TPS92520 COMPOV";
CM_ SG_ 1332 VCFRONT_a519_TPS92520_HSILIM "Front body controller: a519 TPS92520 HSILIM";
CM_ SG_ 1332 VCFRONT_a519_TPS92520_BSTUV "Front body controller: a519 TPS92520 BSTUV";
CM_ SG_ 1332 VCFRONT_a519_CoolingFanStatus "Front body controller: a519 cooling fan status";
CM_ SG_ 1332 VCFRONT_a519_BoostRailStatus "Front body controller: a519 boost rail status";
CM_ SG_ 1332 VCFRONT_a519_EEPROMCurrentBinSta "Front body controller: a519 EEPROM current bin status";
CM_ SG_ 1332 VCFRONT_a519_EEPROMCalCurrentSta "Front body controller: a519 EEPROM cal current status";
CM_ SG_ 1332 VCFRONT_a519_HeadlampECURevision "Front body controller: a519 headlamp ECU revision";
CM_ SG_ 1332 VCFRONT_a519_NonzeroEEPROMRetrie "Front body controller: a519 nonzero EEPROM retries";
CM_ SG_ 1332 VCFRONT_a519_MaxEEPROMRetries "Front body controller: a519 max EEPROM retries";
CM_ SG_ 1332 VCFRONT_a520_MatrixBank1Status "Front body controller: a520 matrix bank1 status";
CM_ SG_ 1332 VCFRONT_a520_MatrixBank2Status "Front body controller: a520 matrix bank2 status";
CM_ SG_ 1332 VCFRONT_a520_MatrixBank3Status "Front body controller: a520 matrix bank3 status";
CM_ SG_ 1332 VCFRONT_a520_MatrixBank4Status "Front body controller: a520 matrix bank4 status";
CM_ SG_ 1332 VCFRONT_a520_TurnSignalStatus "Front body controller: a520 turn signal status";
CM_ SG_ 1332 VCFRONT_a520_SideMarkerStatus "Front body controller: a520 side marker status";
CM_ SG_ 1332 VCFRONT_a520_DRLStatus "Front body controller: a520 DRL status";
CM_ SG_ 1332 VCFRONT_a520_AmbientStatus "Front body controller: a520 ambient status";
CM_ SG_ 1332 VCFRONT_a520_LBFlatSAEStatus "Front body controller: a520 LB flat SAE status";
CM_ SG_ 1332 VCFRONT_a520_LBFlatECEStatus "Front body controller: a520 LB flat ECE status";
CM_ SG_ 1332 VCFRONT_a520_TPS92520_COMPOV "Front body controller: a520 TPS92520 COMPOV";
CM_ SG_ 1332 VCFRONT_a520_TPS92520_HSILIM "Front body controller: a520 TPS92520 HSILIM";
CM_ SG_ 1332 VCFRONT_a520_TPS92520_BSTUV "Front body controller: a520 TPS92520 BSTUV";
CM_ SG_ 1332 VCFRONT_a520_CoolingFanStatus "Front body controller: a520 cooling fan status";
CM_ SG_ 1332 VCFRONT_a520_BoostRailStatus "Front body controller: a520 boost rail status";
CM_ SG_ 1332 VCFRONT_a520_EEPROMCurrentBinSta "Front body controller: a520 EEPROM current bin status";
CM_ SG_ 1332 VCFRONT_a520_EEPROMCalCurrentSta "Front body controller: a520 EEPROM cal current status";
CM_ SG_ 1332 VCFRONT_a520_HeadlampECURevision "Front body controller: a520 headlamp ECU revision";
CM_ SG_ 1332 VCFRONT_a520_NonzeroEEPROMRetrie "Front body controller: a520 nonzero EEPROM retries";
CM_ SG_ 1332 VCFRONT_a520_MaxEEPROMRetries "Front body controller: a520 max EEPROM retries";
CM_ SG_ 1332 VCFRONT_a521_vcleftEFuseCurrent "Front body controller: a521 vcleft e fuse current";
CM_ SG_ 1332 VCFRONT_a521_vcleftEFuseTemp "Front body controller: a521 vcleft e fuse temp";
CM_ SG_ 1332 VCFRONT_a521_ambientTemp "Front body controller: a521 ambient temp";
CM_ SG_ 1332 VCFRONT_a521_serviceMode "Signal reported by Front body controller";
CM_ SG_ 1332 VCFRONT_a521_frunkOpen "Front body controller: a521 frunk open";
CM_ SG_ 1332 VCFRONT_a522_IBSVoltage "Front body controller: a522 IBS voltage";
CM_ SG_ 1332 VCFRONT_a522_HVSoc "Front body controller: a522 HV soc";
CM_ SG_ 1332 VCFRONT_a522_contactorsPermanent "Front body controller: a522 contactors permanently closed";
CM_ SG_ 1332 VCFRONT_a522_LVBatteryDisconnect "Front body controller: a522 LV battery disconnected";
CM_ SG_ 1332 VCFRONT_a522_reverseBatteryFault "Front body controller: a522 reverse battery fault";
CM_ SG_ 1332 VCFRONT_a522_LVBatteryCannotSupp "Front body controller: a522 LV battery cannot support vehicle";
CM_ SG_ 1332 VCFRONT_a523_channel "Front body controller: a523 channel";
CM_ SG_ 1332 VCFRONT_a523_control2Byte1 "Front body controller: a523 control2 byte1";
CM_ SG_ 1332 VCFRONT_a523_control2Byte2 "Front body controller: a523 control2 byte2";
CM_ SG_ 1332 VCFRONT_a523_control2Byte3 "Front body controller: a523 control2 byte3";
CM_ SG_ 1332 VCFRONT_a523_control3Byte2 "Front body controller: a523 control3 byte2";
CM_ SG_ 1332 VCFRONT_a523_control3Byte3 "Front body controller: a523 control3 byte3";
CM_ SG_ 1332 VCFRONT_a525_GTW_twelveVBatteryT "Front body controller: a525 GTW twelve v battery type";
CM_ SG_ 1332 VCFRONT_a525_newLVBatteryType "Front body controller: a525 new LV battery type";
CM_ SG_ 1332 VCFRONT_a525_initialLVBatteryTyp "Front body controller: a525 initial LV battery type";
CM_ SG_ 1332 VCFRONT_a525_serviceMode "Signal reported by Front body controller";
CM_ SG_ 1332 VCFRONT_a525_factoryGated "Front body controller: a525 factory gated";
CM_ SG_ 1332 VCFRONT_a525_frunkOpen "Front body controller: a525 frunk open";
CM_ SG_ 1332 VCFRONT_a527_cell1Voltage "Front body controller: a527 cell1 voltage";
CM_ SG_ 1332 VCFRONT_a527_cell2Voltage "Front body controller: a527 cell2 voltage";
CM_ SG_ 1332 VCFRONT_a527_cell3Voltage "Front body controller: a527 cell3 voltage";
CM_ SG_ 1332 VCFRONT_a527_cell4Voltage "Front body controller: a527 cell4 voltage";
CM_ SG_ 1332 VCFRONT_a527_serviceMode "Signal reported by Front body controller";
CM_ SG_ 1332 VCFRONT_a527_frunkOpen "Front body controller: a527 frunk open";
CM_ SG_ 1332 VCFRONT_a528_ECPAStateSNA "Front body controller: a528 ECPA state SNA";
CM_ SG_ 1332 VCFRONT_a528_ECPAFrameTimeout "Front body controller: a528 ECPA frame timeout";
CM_ SG_ 1332 VCFRONT_a528_currentSenseFaulted "Front body controller: a528 current sense faulted";
CM_ SG_ 1332 VCFRONT_a528_serviceMode "Signal reported by Front body controller";
CM_ SG_ 1332 VCFRONT_a528_frunkOpen "Front body controller: a528 frunk open";
CM_ SG_ 1332 VCFRONT_a531_powerIndexFiltered "Front body controller: a531 power index filtered";
CM_ SG_ 1332 VCFRONT_a532_eFuseFault "Front body controller: a532 e fuse fault";
CM_ SG_ 1332 VCFRONT_a533_temperature "Front body controller: a533 temperature";
CM_ SG_ 1332 VCFRONT_a541_PackTemperature "Front body controller: a541 pack temperature";
CM_ SG_ 1332 VCFRONT_a541_ChargeCurrentLimit "Front body controller: a541 charge current limit";
CM_ SG_ 1332 VCFRONT_a541_PeakCurrent "Front body controller: a541 peak current";
CM_ SG_ 1332 VCFRONT_a541_AverageCurrent "Front body controller: a541 average current";
CM_ SG_ 1332 VCFRONT_a541_SOC "Front body controller: a541 SOC";
CM_ SG_ 1332 VCFRONT_a544_serviceMode "Signal reported by Front body controller";
CM_ SG_ 1332 VCFRONT_a544_frunkOpen "Front body controller: a544 frunk open";
CM_ SG_ 1332 VCFRONT_a544_LVBMSSOC "Front body controller: a544 LVBMSSOC";
CM_ SG_ 1332 VCFRONT_a545_GTW_twelveVBatteryT "Front body controller: a545 GTW twelve v battery type";
CM_ SG_ 1332 VCFRONT_a545_newLVBatteryType "Front body controller: a545 new LV battery type";
CM_ SG_ 1332 VCFRONT_a545_serviceMode "Signal reported by Front body controller";
CM_ SG_ 1332 VCFRONT_a545_factoryGated "Front body controller: a545 factory gated";
CM_ SG_ 1332 VCFRONT_a545_frunkOpen "Front body controller: a545 frunk open";
CM_ SG_ 1332 VCFRONT_a547_serviceMode "Signal reported by Front body controller";
CM_ SG_ 1332 VCFRONT_a547_frunkOpen "Front body controller: a547 frunk open";
CM_ SG_ 1332 VCFRONT_a548_vehiclePowerState "Front body controller: a548 vehicle power state";
CM_ SG_ 1332 VCFRONT_a548_notEnoughPowerForSu "Front body controller: a548 not enough power for support";
CM_ SG_ 1332 VCFRONT_a548_HVBlockingMismatch "Front body controller: a548 HV blocking mismatch";
CM_ SG_ 1332 VCFRONT_a548_LVBatteryCannotSupp "Front body controller: a548 LV battery cannot support vehicle";
CM_ SG_ 1332 VCFRONT_a548_DI_gear "Front body controller: a548 DI gear; raw 7 = signal not available (SNA)";
CM_ SG_ 1332 VCFRONT_a548_backstopBucketCount "Front body controller: a548 backstop bucket count";
CM_ SG_ 1332 VCFRONT_a548_hvState "Front body controller: a548 hv state";
CM_ SG_ 1332 VCFRONT_a548_BMS_MIA "Front body controller: a548 BMS MIA";
CM_ SG_ 1332 VCFRONT_a548_PCS_MIA "Front body controller: a548 PCS MIA";
CM_ SG_ 1332 VCFRONT_a548_ampHourBucketCount "Front body controller: a548 amp hour bucket count";
CM_ SG_ 1332 VCFRONT_a548_LVBMSSOC "Front body controller: a548 LVBMSSOC";
CM_ SG_ 1332 VCFRONT_a548_serviceMode "Signal reported by Front body controller";
CM_ SG_ 1332 VCFRONT_a548_frunkOpen "Front body controller: a548 frunk open";
CM_ SG_ 1332 VCFRONT_a548_PCSTargetVoltage "Front body controller: a548 PCS target voltage";
CM_ SG_ 1332 VCFRONT_a548_ampHourBucketFilled "Front body controller: a548 amp hour bucket filled";
CM_ SG_ 1332 VCFRONT_a548_HVNotConfirmedUpTri "Front body controller: a548 HV not confirmed up trigger";
CM_ SG_ 1332 VCFRONT_a548_PCSNotMeetingTarget "Front body controller: a548 PCS not meeting target trigger";
CM_ SG_ 1332 VCFRONT_a548_PCSMIATrigger "Front body controller: a548 PCSMIA trigger";
CM_ SG_ 1332 VCFRONT_a548_PCSSaturatedTrigger "Front body controller: a548 PCS saturated trigger";
CM_ SG_ 1332 VCFRONT_a548_backstopHit "Front body controller: a548 backstop hit";
CM_ SG_ 1332 VCFRONT_a549_MatrixBank1Status "Front body controller: a549 matrix bank1 status";
CM_ SG_ 1332 VCFRONT_a549_SideMarkerStatus "Front body controller: a549 side marker status";
CM_ SG_ 1332 VCFRONT_a549_TurnSignalStatus "Front body controller: a549 turn signal status";
CM_ SG_ 1332 VCFRONT_a549_DRL1Status "Front body controller: a549 DRL1 status";
CM_ SG_ 1332 VCFRONT_a549_DRL2Status "Front body controller: a549 DRL2 status";
CM_ SG_ 1332 VCFRONT_a549_DRL3Status "Front body controller: a549 DRL3 status";
CM_ SG_ 1332 VCFRONT_a549_LowBeamStatus "Front body controller: a549 low beam status";
CM_ SG_ 1332 VCFRONT_a549_TPS92520_COMPOV "Front body controller: a549 TPS92520 COMPOV";
CM_ SG_ 1332 VCFRONT_a549_TPS92520_HSILIM "Front body controller: a549 TPS92520 HSILIM";
CM_ SG_ 1332 VCFRONT_a549_TPS92520_BSTUV "Front body controller: a549 TPS92520 BSTUV";
CM_ SG_ 1332 VCFRONT_a549_BoostRailStatus "Front body controller: a549 boost rail status";
CM_ SG_ 1332 VCFRONT_a549_EEPROMDataStatus "Front body controller: a549 EEPROM data status";
CM_ SG_ 1332 VCFRONT_a549_HeadlampECURevision "Front body controller: a549 headlamp ECU revision";
CM_ SG_ 1332 VCFRONT_a551_headlampCurrent "Front body controller: a551 headlamp current";
CM_ SG_ 1332 VCFRONT_a552_vcrightSelfTestResu "Front body controller: a552 vcright self test result; raw 12 = signal not available (SNA)";
CM_ SG_ 1332 VCFRONT_a552_epas3pSelfTestResul "Front body controller: a552 epas3p self test result; raw 12 = signal not available (SNA)";
CM_ SG_ 1332 VCFRONT_a552_epas3sSelfTestResul "Front body controller: a552 epas3s self test result; raw 12 = signal not available (SNA)";
CM_ SG_ 1332 VCFRONT_a553_headlampCurrent "Front body controller: a553 headlamp current";
CM_ SG_ 1332 VCFRONT_a555_cell1Voltage "Front body controller: a555 cell1 voltage";
CM_ SG_ 1332 VCFRONT_a555_cell2Voltage "Front body controller: a555 cell2 voltage";
CM_ SG_ 1332 VCFRONT_a555_cell3Voltage "Front body controller: a555 cell3 voltage";
CM_ SG_ 1332 VCFRONT_a555_cell4Voltage "Front body controller: a555 cell4 voltage";
CM_ SG_ 1332 VCFRONT_a557_MatrixBank1Status "Front body controller: a557 matrix bank1 status";
CM_ SG_ 1332 VCFRONT_a557_SideMarkerStatus "Front body controller: a557 side marker status";
CM_ SG_ 1332 VCFRONT_a557_TurnSignalStatus "Front body controller: a557 turn signal status";
CM_ SG_ 1332 VCFRONT_a557_DRL1Status "Front body controller: a557 DRL1 status";
CM_ SG_ 1332 VCFRONT_a557_DRL2Status "Front body controller: a557 DRL2 status";
CM_ SG_ 1332 VCFRONT_a557_DRL3Status "Front body controller: a557 DRL3 status";
CM_ SG_ 1332 VCFRONT_a557_CenterStatus "Front body controller: a557 center status";
CM_ SG_ 1332 VCFRONT_a557_LowBeamStatus "Front body controller: a557 low beam status";
CM_ SG_ 1332 VCFRONT_a557_TPS92520_COMPOV "Front body controller: a557 TPS92520 COMPOV";
CM_ SG_ 1332 VCFRONT_a557_TPS92520_HSILIM "Front body controller: a557 TPS92520 HSILIM";
CM_ SG_ 1332 VCFRONT_a557_TPS92520_BSTUV "Front body controller: a557 TPS92520 BSTUV";
CM_ SG_ 1332 VCFRONT_a557_BoostRailStatus "Front body controller: a557 boost rail status";
CM_ SG_ 1332 VCFRONT_a557_EEPROMDataStatus "Front body controller: a557 EEPROM data status";
CM_ SG_ 1332 VCFRONT_a557_HeadlampECURevision "Front body controller: a557 headlamp ECU revision";
CM_ SG_ 1332 VCFRONT_a559_SOC "Front body controller: a559 SOC";
CM_ SG_ 1332 VCFRONT_a559_PackCurrent "Front body controller: a559 pack current";
CM_ SG_ 1332 VCFRONT_a559_vehiclePowerState "Front body controller: a559 vehicle power state";
CM_ SG_ 1332 VCFRONT_a559_batterySMState "Front body controller: a559 battery SM state";
CM_ SG_ 1332 VCFRONT_a559_bmsState "Front body controller: a559 bms state; raw 9 = signal not available (SNA)";
CM_ SG_ 1332 VCFRONT_a559_dcdcLVSupportStatus "Front body controller: a559 dcdc LV support status";
CM_ SG_ 1332 VCFRONT_a559_factoryMode "Front body controller: a559 factory mode";
CM_ SG_ 1332 VCFRONT_a559_serviceMode "Signal reported by Front body controller";
CM_ SG_ 1332 VCFRONT_a559_transportMode "Front body controller: a559 transport mode";
CM_ SG_ 1332 VCFRONT_a559_notEnoughPowerForSu "Front body controller: a559 not enough power for support";
CM_ SG_ 1332 VCFRONT_a559_crashDetected "Front body controller: a559 crash detected";
CM_ SG_ 1332 VCFRONT_a559_BMS_MIA "Front body controller: a559 BMS MIA";
CM_ SG_ 1332 VCFRONT_a559_PCS_MIA "Front body controller: a559 PCS MIA";
CM_ SG_ 1332 VCFRONT_a559_HVBlockingMismatch "Front body controller: a559 HV blocking mismatch";
CM_ SG_ 1332 VCFRONT_a559_HV_UP "Front body controller: a559 HV UP";
CM_ SG_ 1332 VCFRONT_a559_pcsEFuseStable "Front body controller: a559 pcs e fuse stable";
CM_ SG_ 1332 VCFRONT_a559_vcrightEFuseStable "Front body controller: a559 vcright e fuse stable";
CM_ SG_ 1332 VCFRONT_a559_contactorEFuseStabl "Front body controller: a559 contactor e fuse stable";
CM_ SG_ 1332 VCFRONT_a559_hvcEFuseStable "Front body controller: a559 hvc e fuse stable";
CM_ SG_ 1332 VCFRONT_a559_frunkOpen "Front body controller: a559 frunk open";
CM_ SG_ 1332 VCFRONT_a560_highSHCOP1 "Front body controller: a560 high SHCOP1";
CM_ SG_ 1332 VCFRONT_a560_highSHBattCondition "Front body controller: a560 high SH batt conditioning";
CM_ SG_ 1332 VCFRONT_a560_highSHCabinReheatCD "Front body controller: a560 high SH cabin reheat CD";
CM_ SG_ 1332 VCFRONT_a560_highSHCabinReheatHD "Front body controller: a560 high SH cabin reheat HD";
CM_ SG_ 1332 VCFRONT_a560_highSHCabinCooling "Front body controller: a560 high SH cabin cooling";
CM_ SG_ 1332 VCFRONT_a560_highSHCabinHeating "Front body controller: a560 high SH cabin heating";
CM_ SG_ 1332 VCFRONT_a560_highSHCatchAll "Front body controller: a560 high SH catch all";
CM_ SG_ 1332 VCFRONT_a561_efuseTemperature "Front body controller: a561 efuse temperature";
CM_ SG_ 1332 VCFRONT_a561_packTemperature "Front body controller: a561 pack temperature";
CM_ SG_ 1332 VCFRONT_a561_ambientTemperature "Front body controller: a561 ambient temperature";
CM_ SG_ 1332 VCFRONT_a561_cell1Voltage "Front body controller: a561 cell1 voltage";
CM_ SG_ 1332 VCFRONT_a561_cell2Voltage "Front body controller: a561 cell2 voltage";
CM_ SG_ 1332 VCFRONT_a561_cell3Voltage "Front body controller: a561 cell3 voltage";
CM_ SG_ 1332 VCFRONT_a561_cell4Voltage "Front body controller: a561 cell4 voltage";
CM_ SG_ 1332 VCFRONT_a561_factoryMode "Front body controller: a561 factory mode";
CM_ SG_ 1332 VCFRONT_a561_serviceMode "Signal reported by Front body controller";
CM_ SG_ 1332 VCFRONT_a561_frunkOpen "Front body controller: a561 frunk open";
CM_ SG_ 1332 VCFRONT_a562_efuseTemperature "Front body controller: a562 efuse temperature";
CM_ SG_ 1332 VCFRONT_a562_packTemperature "Front body controller: a562 pack temperature";
CM_ SG_ 1332 VCFRONT_a562_ambientTemperature "Front body controller: a562 ambient temperature";
CM_ SG_ 1332 VCFRONT_a562_cell1Voltage "Front body controller: a562 cell1 voltage";
CM_ SG_ 1332 VCFRONT_a562_cell2Voltage "Front body controller: a562 cell2 voltage";
CM_ SG_ 1332 VCFRONT_a562_cell3Voltage "Front body controller: a562 cell3 voltage";
CM_ SG_ 1332 VCFRONT_a562_cell4Voltage "Front body controller: a562 cell4 voltage";
CM_ SG_ 1332 VCFRONT_a562_factoryMode "Front body controller: a562 factory mode";
CM_ SG_ 1332 VCFRONT_a562_serviceMode "Signal reported by Front body controller";
CM_ SG_ 1332 VCFRONT_a562_frunkOpen "Front body controller: a562 frunk open";
CM_ SG_ 1332 VCFRONT_a579_leftHeadlightCurren "Front body controller: a579 left headlight current";
CM_ SG_ 1332 VCFRONT_a579_leftHeadlightVoltag "Front body controller: a579 left headlight voltage";
CM_ SG_ 1332 VCFRONT_a579_leftHeadlightRemain "Front body controller: a579 left headlight remaining retries";
CM_ SG_ 1332 VCFRONT_a580_rightHeadlightCurre "Front body controller: a580 right headlight current";
CM_ SG_ 1332 VCFRONT_a580_rightHeadlightVolta "Front body controller: a580 right headlight voltage";
CM_ SG_ 1332 VCFRONT_a580_rightHeadlightRemai "Front body controller: a580 right headlight remaining retries";
CM_ SG_ 1332 VCFRONT_a582_batterySMState "Front body controller: a582 battery SM state";
CM_ SG_ 1332 VCFRONT_a582_PCSCurrent "Front body controller: a582 PCS current";
CM_ SG_ 1332 VCFRONT_a582_LVBusVoltage "Front body controller: a582 LV bus voltage";
CM_ SG_ 1332 VCFRONT_a582_LVBusVoltageSource "Front body controller: a582 LV bus voltage source";
CM_ SG_ 1332 VCFRONT_a582_batteryType "Front body controller: a582 battery type";
CM_ SG_ 1332 VCFRONT_a582_inFactoryMode "Front body controller: a582 in factory mode";
CM_ SG_ 1332 VCFRONT_a582_frunkOpen "Front body controller: a582 frunk open";
CM_ SG_ 1332 VCFRONT_a585_leftHeadlampInterna "Front body controller: a585 left headlamp internal error mask";
CM_ SG_ 1332 VCFRONT_a585_rightHeadlampIntern "Front body controller: a585 right headlamp internal error mask";
CM_ SG_ 1332 VCFRONT_a585_inFactoryMode "Front body controller: a585 in factory mode";
CM_ SG_ 1332 VCFRONT_a585_inServiceMode "Signal reported by Front body controller";
CM_ SG_ 1332 VCFRONT_a585_inTransportMode "Front body controller: a585 in transport mode";
CM_ SG_ 1332 VCFRONT_a585_uiMia "Front body controller: a585 ui mia";
CM_ SG_ 1332 VCFRONT_a585_frunkOpen "Front body controller: a585 frunk open";
CM_ SG_ 1332 VCFRONT_a585_leftRailVoltageLow "Front body controller: a585 left rail voltage low";
CM_ SG_ 1332 VCFRONT_a585_rightRailVoltageLow "Front body controller: a585 right rail voltage low";
CM_ SG_ 1332 VCFRONT_a592_vcleftCutoffEFuseCu "Front body controller: a592 vcleft cutoff e fuse curve type";
CM_ SG_ 1332 VCFRONT_a592_vcleftCutoffCurveOf "Front body controller: a592 vcleft cutoff curve offset channel";
CM_ SG_ 1332 VCFRONT_a592_vcleftCutoffATerm "Front body controller: a592 vcleft cutoff a term; raw 65535 = signal not available (SNA)";
CM_ SG_ 1332 VCFRONT_a592_vcleftCutoffBTerm "Front body controller: a592 vcleft cutoff b term; raw 128 = signal not available (SNA)";
CM_ SG_ 1332 VCFRONT_a592_vcleftCutoffCTerm "Front body controller: a592 vcleft cutoff c term; raw 32768 = signal not available (SNA)";
CM_ SG_ 1332 VCFRONT_a593_vcleftCutoffEFuseFa "Front body controller: a593 vcleft cutoff e fuse fast blow type";
CM_ SG_ 1332 VCFRONT_a593_vcleftCutoffCurrent "Front body controller: a593 vcleft cutoff current threshold";
CM_ SG_ 1332 VCFRONT_a593_vcleftCutoffTimingT "Front body controller: a593 vcleft cutoff timing threshold ms";
CM_ SG_ 1332 VCFRONT_a593_vcleftCutoffMaxCoun "Front body controller: a593 vcleft cutoff max count";
CM_ SG_ 1332 VCFRONT_a596_vcrightCutoffEFuseC "Front body controller: a596 vcright cutoff e fuse curve type";
CM_ SG_ 1332 VCFRONT_a596_vcrightCutoffCurveO "Front body controller: a596 vcright cutoff curve offset channel";
CM_ SG_ 1332 VCFRONT_a596_vcrightCutoffATerm "Front body controller: a596 vcright cutoff a term; raw 65535 = signal not available (SNA)";
CM_ SG_ 1332 VCFRONT_a596_vcrightCutoffBTerm "Front body controller: a596 vcright cutoff b term; raw 128 = signal not available (SNA)";
CM_ SG_ 1332 VCFRONT_a596_vcrightCutoffCTerm "Front body controller: a596 vcright cutoff c term; raw 32768 = signal not available (SNA)";
CM_ SG_ 1332 VCFRONT_a597_vcrightCutoffEFuseF "Front body controller: a597 vcright cutoff e fuse fast blow type";
CM_ SG_ 1332 VCFRONT_a597_vcrightCutoffCurren "Front body controller: a597 vcright cutoff current threshold";
CM_ SG_ 1332 VCFRONT_a597_vcrightCutoffTiming "Front body controller: a597 vcright cutoff timing threshold ms";
CM_ SG_ 1332 VCFRONT_a597_vcrightCutoffMaxCou "Front body controller: a597 vcright cutoff max count";
CM_ SG_ 1332 VCFRONT_a598_vcleftSelfTestResul "Front body controller: a598 vcleft self test result; raw 12 = signal not available (SNA)";
CM_ SG_ 1332 VCFRONT_a599_GTW_twelveVBatteryT "Front body controller: a599 GTW twelve v battery type";
CM_ SG_ 1332 VCFRONT_a599_newLVBatteryType "Front body controller: a599 new LV battery type";
CM_ SG_ 1332 VCFRONT_a599_initialLVBatteryTyp "Front body controller: a599 initial LV battery type";
CM_ SG_ 1332 VCFRONT_a599_serviceMode "Signal reported by Front body controller";
CM_ SG_ 1332 VCFRONT_a599_factoryGated "Front body controller: a599 factory gated";
CM_ SG_ 1332 VCFRONT_a599_frunkOpen "Front body controller: a599 frunk open";
CM_ SG_ 1332 VCFRONT_a605_vbatProtVoltage "Front body controller: a605 vbat prot voltage";
CM_ SG_ 1332 VCFRONT_a605_sleepBypassVoltage "Front body controller: a605 sleep bypass voltage";
CM_ SG_ 1332 VCFRONT_a605_sleepBypassCurrent "Front body controller: a605 sleep bypass current";
CM_ SG_ 1332 VCFRONT_a610_switch1State "Front body controller: a610 switch1 state; raw 0 = signal not available (SNA)";
CM_ SG_ 1332 VCFRONT_a610_switch2State "Front body controller: a610 switch2 state; raw 0 = signal not available (SNA)";
CM_ SG_ 1332 VCFRONT_a610_dataBufferBits "Front body controller: a610 data buffer bits";
CM_ SG_ 1332 VCFRONT_a610_temperature "Front body controller: a610 temperature; raw 0 = signal not available (SNA)";
CM_ SG_ 1332 VCFRONT_a611_tempCoolantPTInlet "Front body controller: a611 temp coolant PT inlet";
CM_ SG_ 1332 VCFRONT_a611_tempCoolantPTInletE "Front body controller: a611 temp coolant PT inlet est";
CM_ SG_ 1332 VCFRONT_a611_tempAmbientRaw "Front body controller: a611 temp ambient raw";
CM_ SG_ 1332 VCFRONT_a611_radFanAvgSpeed "Front body controller: a611 rad fan avg speed";
CM_ SG_ 1332 VCFRONT_a611_ptLoopCoolantFlow "Front body controller: a611 pt loop coolant flow";
CM_ SG_ 1332 VCFRONT_a611_compressorPower "Front body controller: a611 compressor power";
CM_ SG_ 1332 VCFRONT_a611_heatGenTotal "Front body controller: a611 heat gen total";
CM_ SG_ 1332 VCFRONT_a611_radCoolantToAirUAEs "Front body controller: a611 rad coolant to air UA est";
CM_ SG_ 1332 VCFRONT_a612_DI_gear "Front body controller: a612 DI gear; raw 7 = signal not available (SNA)";
CM_ SG_ 1332 VCFRONT_a612_manualDrivingProhib "Front body controller: a612 manual driving prohibited";
CM_ SG_ 1332 VCFRONT_a612_vehicleSpeed "Front body controller: a612 vehicle speed";
CM_ SG_ 1332 VCFRONT_a612_lvHealthStatus "Front body controller: a612 lv health status";
CM_ SG_ 1332 VCFRONT_a620_powertrainIsDryRunD "Front body controller: a620 powertrain is dry run detected";
CM_ SG_ 1332 VCFRONT_a620_powertrainPumpRpm "Front body controller: a620 powertrain pump rpm; raw 255 = signal not available (SNA)";
CM_ SG_ 1332 VCFRONT_a620_powertrainPumpIPhas "Front body controller: a620 powertrain pump i phase filtered; raw 255 = signal not available (SNA)";
CM_ SG_ 1332 VCFRONT_a620_powertrainPump_0001 "Front body controller: a620 powertrain pump i phase min filt; raw 127 = signal not available (SNA)";
CM_ SG_ 1332 VCFRONT_a620_chillerIsDryRunDete "Front body controller: a620 chiller is dry run detected";
CM_ SG_ 1332 VCFRONT_a620_chillerPumpRpm "Front body controller: a620 chiller pump rpm; raw 255 = signal not available (SNA)";
CM_ SG_ 1332 VCFRONT_a620_chillerPumpIPhaseFi "Front body controller: a620 chiller pump i phase filtered; raw 255 = signal not available (SNA)";
CM_ SG_ 1332 VCFRONT_a620_chillerPumpIPhaseMi "Front body controller: a620 chiller pump i phase min filt; raw 127 = signal not available (SNA)";
CM_ SG_ 1332 VCFRONT_a622_pumpChLowCoolantFlo "Front body controller: a622 pump ch low coolant flow";
CM_ SG_ 1332 VCFRONT_a622_pumpPtLowCoolantFlo "Front body controller: a622 pump pt low coolant flow";
CM_ SG_ 1332 VCFRONT_a622_coolantMode "Front body controller: a622 coolant mode";
CM_ SG_ 1332 VCFRONT_a622_isRadiatorBypassed "Front body controller: a622 is radiator bypassed";
CM_ SG_ 1332 VCFRONT_a623_DI_gear "Front body controller: a623 DI gear; raw 7 = signal not available (SNA)";
CM_ SG_ 1332 VCFRONT_a623_manualDrivingProhib "Front body controller: a623 manual driving prohibited";
CM_ SG_ 1332 VCFRONT_a623_vehicleSpeed "Front body controller: a623 vehicle speed";
CM_ SG_ 1332 VCFRONT_a623_lvHealthStatus "Front body controller: a623 lv health status";
CM_ SG_ 1332 VCFRONT_a623_unhealthyReason "Front body controller: a623 unhealthy reason";
CM_ SG_ 1332 VCFRONT_a623_failureLvBatteryEne "Front body controller: a623 failure lv battery energy active decel";
CM_ SG_ 1332 VCFRONT_a623_failureLvBatte_0003 "Front body controller: a623 failure lv battery energy critical";
CM_ SG_ 1332 VCFRONT_a623_failureReverseBatte "Front body controller: a623 failure reverse battery efuse off";
CM_ SG_ 1332 VCFRONT_a623_failureLvbmbEfuseOp "Front body controller: a623 failure lvbmb efuse open";
CM_ SG_ 1332 VCFRONT_a623_failureLvBatteryCom "Front body controller: a623 failure lv battery comms";
CM_ SG_ 1332 VCFRONT_a623_failureLvBatterySen "Front body controller: a623 failure lv battery sensor ibs mia";
CM_ SG_ 1332 VCFRONT_a623_failureLvBatte_0001 "Front body controller: a623 failure lv battery connection";
CM_ SG_ 1332 VCFRONT_a623_failureLvBatte_0002 "Front body controller: a623 failure lv battery connection unknown";
CM_ SG_ 1332 VCFRONT_a623_failurePcsEfuseOff "Front body controller: a623 failure pcs efuse off";
CM_ SG_ 1332 VCFRONT_a623_failurePcsNotActive "Front body controller: a623 failure pcs not active";
CM_ SG_ 1332 VCFRONT_a623_failurePcsMia "Front body controller: a623 failure pcs mia";
CM_ SG_ 1332 VCFRONT_a623_failurePcsOpenCircu "Front body controller: a623 failure pcs open circuit";
CM_ SG_ 1332 VCFRONT_a623_failureLvBatteryPow "Front body controller: a623 failure lv battery power active decel";
CM_ SG_ 1332 VCFRONT_a623_failureLvBatteryCap "Front body controller: a623 failure lv battery capability low accuracy";
CM_ SG_ 1332 VCFRONT_a623_failureLvBatteryCon "Front body controller: a623 failure lv battery configuration";
CM_ SG_ 1332 VCFRONT_a623_failureLvBatteryHig "Front body controller: a623 failure lv battery high impedance";
CM_ SG_ 1332 VCFRONT_a623_factoryMode "Front body controller: a623 factory mode";
CM_ SG_ 1332 VCFRONT_a623_serviceMode "Signal reported by Front body controller";
CM_ SG_ 1332 VCFRONT_a624_HighBeam_OV "Front body controller: a624 high beam OV";
CM_ SG_ 1332 VCFRONT_a624_HighBeam_UV "Front body controller: a624 high beam UV";
CM_ SG_ 1332 VCFRONT_a624_HighBeam_short "Front body controller: a624 high beam short";
CM_ SG_ 1332 VCFRONT_a624_HighBeam_compov "Front body controller: a624 high beam compov";
CM_ SG_ 1332 VCFRONT_a624_HighBeam_bootuv "Front body controller: a624 high beam bootuv";
CM_ SG_ 1332 VCFRONT_a624_HighBeam_binStatus "Front body controller: a624 high beam bin status";
CM_ SG_ 1332 VCFRONT_a624_LowBeam_OV "Front body controller: a624 low beam OV";
CM_ SG_ 1332 VCFRONT_a624_LowBeam_UV "Front body controller: a624 low beam UV";
CM_ SG_ 1332 VCFRONT_a624_LowBeam_short "Front body controller: a624 low beam short";
CM_ SG_ 1332 VCFRONT_a624_LowBeam_compov "Front body controller: a624 low beam compov";
CM_ SG_ 1332 VCFRONT_a624_LowBeam_bootuv "Front body controller: a624 low beam bootuv";
CM_ SG_ 1332 VCFRONT_a624_LowBeam_binStatus "Front body controller: a624 low beam bin status";
CM_ SG_ 1332 VCFRONT_a624_DRL_OV "Front body controller: a624 DRL OV";
CM_ SG_ 1332 VCFRONT_a624_DRL_UV "Front body controller: a624 DRL UV";
CM_ SG_ 1332 VCFRONT_a624_DRL_short "Front body controller: a624 DRL short";
CM_ SG_ 1332 VCFRONT_a624_DRL_compov "Front body controller: a624 DRL compov";
CM_ SG_ 1332 VCFRONT_a624_DRL_bootuv "Front body controller: a624 DRL bootuv";
CM_ SG_ 1332 VCFRONT_a624_DRL_binStatus "Front body controller: a624 DRL bin status";
CM_ SG_ 1332 VCFRONT_a624_TurnSignal_OV "Front body controller: a624 turn signal OV";
CM_ SG_ 1332 VCFRONT_a624_TurnSignal_UV "Front body controller: a624 turn signal UV";
CM_ SG_ 1332 VCFRONT_a624_TurnSignal_short "Front body controller: a624 turn signal short";
CM_ SG_ 1332 VCFRONT_a624_TurnSignal_compov "Front body controller: a624 turn signal compov";
CM_ SG_ 1332 VCFRONT_a624_TurnSignal_bootuv "Front body controller: a624 turn signal bootuv";
CM_ SG_ 1332 VCFRONT_a624_TurnSignal_binStatu "Front body controller: a624 turn signal bin status";
CM_ SG_ 1332 VCFRONT_a624_SideMarker_OV "Front body controller: a624 side marker OV";
CM_ SG_ 1332 VCFRONT_a624_SideMarker_UV "Front body controller: a624 side marker UV";
CM_ SG_ 1332 VCFRONT_a624_SideMarker_short "Front body controller: a624 side marker short";
CM_ SG_ 1332 VCFRONT_a624_SideMarker_compov "Front body controller: a624 side marker compov";
CM_ SG_ 1332 VCFRONT_a624_SideMarker_bootuv "Front body controller: a624 side marker bootuv";
CM_ SG_ 1332 VCFRONT_a624_SideMarker_binStatu "Front body controller: a624 side marker bin status";
CM_ SG_ 1332 VCFRONT_a624_boost_OV "Front body controller: a624 boost OV";
CM_ SG_ 1332 VCFRONT_a624_boost_BOOTUV "Front body controller: a624 boost BOOTUV";
CM_ SG_ 1332 VCFRONT_a624_boost_ILIM "Front body controller: a624 boost ILIM";
CM_ SG_ 1332 VCFRONT_a624_boost_ISPUV "Front body controller: a624 boost ISPUV";
CM_ SG_ 1332 VCFRONT_a624_EEPROM_status "Front body controller: a624 EEPROM status";
CM_ SG_ 1332 VCFRONT_a624_EEPROM_region "Front body controller: a624 EEPROM region; raw 0 = signal not available (SNA)";
CM_ SG_ 1332 VCFRONT_a625_HighBeam_OV "Front body controller: a625 high beam OV";
CM_ SG_ 1332 VCFRONT_a625_HighBeam_UV "Front body controller: a625 high beam UV";
CM_ SG_ 1332 VCFRONT_a625_HighBeam_short "Front body controller: a625 high beam short";
CM_ SG_ 1332 VCFRONT_a625_HighBeam_compov "Front body controller: a625 high beam compov";
CM_ SG_ 1332 VCFRONT_a625_HighBeam_bootuv "Front body controller: a625 high beam bootuv";
CM_ SG_ 1332 VCFRONT_a625_HighBeam_binStatus "Front body controller: a625 high beam bin status";
CM_ SG_ 1332 VCFRONT_a625_LowBeam_OV "Front body controller: a625 low beam OV";
CM_ SG_ 1332 VCFRONT_a625_LowBeam_UV "Front body controller: a625 low beam UV";
CM_ SG_ 1332 VCFRONT_a625_LowBeam_short "Front body controller: a625 low beam short";
CM_ SG_ 1332 VCFRONT_a625_LowBeam_compov "Front body controller: a625 low beam compov";
CM_ SG_ 1332 VCFRONT_a625_LowBeam_bootuv "Front body controller: a625 low beam bootuv";
CM_ SG_ 1332 VCFRONT_a625_LowBeam_binStatus "Front body controller: a625 low beam bin status";
CM_ SG_ 1332 VCFRONT_a625_DRL_OV "Front body controller: a625 DRL OV";
CM_ SG_ 1332 VCFRONT_a625_DRL_UV "Front body controller: a625 DRL UV";
CM_ SG_ 1332 VCFRONT_a625_DRL_short "Front body controller: a625 DRL short";
CM_ SG_ 1332 VCFRONT_a625_DRL_compov "Front body controller: a625 DRL compov";
CM_ SG_ 1332 VCFRONT_a625_DRL_bootuv "Front body controller: a625 DRL bootuv";
CM_ SG_ 1332 VCFRONT_a625_DRL_binStatus "Front body controller: a625 DRL bin status";
CM_ SG_ 1332 VCFRONT_a625_TurnSignal_OV "Front body controller: a625 turn signal OV";
CM_ SG_ 1332 VCFRONT_a625_TurnSignal_UV "Front body controller: a625 turn signal UV";
CM_ SG_ 1332 VCFRONT_a625_TurnSignal_short "Front body controller: a625 turn signal short";
CM_ SG_ 1332 VCFRONT_a625_TurnSignal_compov "Front body controller: a625 turn signal compov";
CM_ SG_ 1332 VCFRONT_a625_TurnSignal_bootuv "Front body controller: a625 turn signal bootuv";
CM_ SG_ 1332 VCFRONT_a625_TurnSignal_binStatu "Front body controller: a625 turn signal bin status";
CM_ SG_ 1332 VCFRONT_a625_SideMarker_OV "Front body controller: a625 side marker OV";
CM_ SG_ 1332 VCFRONT_a625_SideMarker_UV "Front body controller: a625 side marker UV";
CM_ SG_ 1332 VCFRONT_a625_SideMarker_short "Front body controller: a625 side marker short";
CM_ SG_ 1332 VCFRONT_a625_SideMarker_compov "Front body controller: a625 side marker compov";
CM_ SG_ 1332 VCFRONT_a625_SideMarker_bootuv "Front body controller: a625 side marker bootuv";
CM_ SG_ 1332 VCFRONT_a625_SideMarker_binStatu "Front body controller: a625 side marker bin status";
CM_ SG_ 1332 VCFRONT_a625_boost_OV "Front body controller: a625 boost OV";
CM_ SG_ 1332 VCFRONT_a625_boost_BOOTUV "Front body controller: a625 boost BOOTUV";
CM_ SG_ 1332 VCFRONT_a625_boost_ILIM "Front body controller: a625 boost ILIM";
CM_ SG_ 1332 VCFRONT_a625_boost_ISPUV "Front body controller: a625 boost ISPUV";
CM_ SG_ 1332 VCFRONT_a625_EEPROM_status "Front body controller: a625 EEPROM status";
CM_ SG_ 1332 VCFRONT_a625_EEPROM_region "Front body controller: a625 EEPROM region; raw 0 = signal not available (SNA)";
CM_ SG_ 1332 VCFRONT_a626_dcrMilliOhms "Front body controller: a626 dcr milli ohms";
CM_ SG_ 1332 VCFRONT_a626_elevatedDcrThreshol "Front body controller: a626 elevated dcr threshold";
CM_ SG_ 1332 VCFRONT_a626_avgIntervalCurrent "Front body controller: a626 avg interval current";
CM_ SG_ 1332 VCFRONT_a626_intervalCurrentVari "Front body controller: a626 interval current variance";
CM_ SG_ 1332 VCFRONT_a626_avgPulseCurrent "Front body controller: a626 avg pulse current";
CM_ SG_ 1332 VCFRONT_a626_pulseCurrentVarianc "Front body controller: a626 pulse current variance";
CM_ SG_ 1332 VCFRONT_a626_IBSTemperature "Front body controller: a626 IBS temperature";
CM_ SG_ 1332 VCFRONT_a626_testCounter "Front body controller: a626 test counter";
CM_ SG_ 1332 VCFRONT_a626_testingExpended "Front body controller: a626 testing expended";
CM_ SG_ 1332 VCFRONT_a626_opportunisticTest "Front body controller: a626 opportunistic test";
CM_ SG_ 1332 VCFRONT_a627_cell1Voltage "Front body controller: a627 cell1 voltage";
CM_ SG_ 1332 VCFRONT_a627_cell2Voltage "Front body controller: a627 cell2 voltage";
CM_ SG_ 1332 VCFRONT_a627_cell3Voltage "Front body controller: a627 cell3 voltage";
CM_ SG_ 1332 VCFRONT_a627_cell4Voltage "Front body controller: a627 cell4 voltage";
CM_ SG_ 1332 VCFRONT_a627_sumCellVoltage "Front body controller: a627 sum cell voltage";
CM_ SG_ 1332 VCFRONT_a627_deepDischargeFlag "Front body controller: a627 deep discharge flag";
CM_ SG_ 1332 VCFRONT_a627_serviceMode "Signal reported by Front body controller";
CM_ SG_ 1332 VCFRONT_a627_frunkOpen "Front body controller: a627 frunk open";
BA_DEF_ BO_ "GenMsgCycleTime" INT 0 3600000;
BA_DEF_ BO_ "GenMsgSendType" ENUM "Cyclic","NotUsed","NotUsed","NotUsed","NotUsed","NotUsed","NotUsed","IfActive","NoMsgSendType","NotUsed";
BA_DEF_ BO_ "VFrameFormat" ENUM "StandardCAN","ExtendedCAN","reserved","J1939PG","reserved","reserved","reserved","reserved","reserved","reserved","reserved","reserved","reserved","reserved","StandardCAN_FD","ExtendedCAN_FD";
BA_DEF_ BO_ "CANFD_BRS" ENUM "0","1";
BA_DEF_ SG_ "GenSigSNA" STRING;
BA_DEF_ SG_ "SystemSignalLongSymbol" STRING;
BA_DEF_ SG_ "Confidence" ENUM "validated","plausible","layout-only","contradicted";
BA_DEF_DEF_ "GenMsgCycleTime" 0;
BA_DEF_DEF_ "GenMsgSendType" "NoMsgSendType";
BA_DEF_DEF_ "VFrameFormat" "StandardCAN";
BA_DEF_DEF_ "CANFD_BRS" "1";
BA_DEF_DEF_ "GenSigSNA" "";
BA_DEF_DEF_ "SystemSignalLongSymbol" "";
BA_DEF_DEF_ "Confidence" "layout-only";
BA_ "Confidence" SG_ 1332 VCFRONT_a475_drl1Status 1;
BA_ "Confidence" SG_ 1332 VCFRONT_a475_drl2Status 1;
BA_ "Confidence" SG_ 1332 VCFRONT_a475_drl3Status 1;
BA_ "Confidence" SG_ 1332 VCFRONT_a475_turnStatus 1;
BA_ "Confidence" SG_ 1332 VCFRONT_a475_fanStatus 1;
BA_ "Confidence" SG_ 1332 VCFRONT_a475_TPS92520_COMPOV 1;
BA_ "Confidence" SG_ 1332 VCFRONT_a475_TPS92520_HSILIM 1;
BA_ "Confidence" SG_ 1332 VCFRONT_a475_TPS92520_BSTUV 1;
BA_ "Confidence" SG_ 1332 VCFRONT_a475_BoostRailStatus 1;
BA_ "Confidence" SG_ 1332 VCFRONT_a475_EEPROM_DataStatus 1;
BA_ "Confidence" SG_ 1332 VCFRONT_a475_LMMVariant 1;
BA_ "GenSigSNA" SG_ 1332 VCFRONT_a475_LMMVariant "0";
BA_ "Confidence" SG_ 1332 VCFRONT_a475_headlampECURevision 1;
BA_ "Confidence" SG_ 1332 VCFRONT_a476_vehiclePowerState 1;
BA_ "Confidence" SG_ 1332 VCFRONT_a476_batterySMState 1;
BA_ "Confidence" SG_ 1332 VCFRONT_a476_ECPAState 1;
BA_ "GenSigSNA" SG_ 1332 VCFRONT_a476_ECPAState "3";
BA_ "Confidence" SG_ 1332 VCFRONT_a477_cell1Voltage 1;
BA_ "Confidence" SG_ 1332 VCFRONT_a477_cell2Voltage 1;
BA_ "Confidence" SG_ 1332 VCFRONT_a477_cell3Voltage 1;
BA_ "Confidence" SG_ 1332 VCFRONT_a477_cell4Voltage 1;
BA_ "Confidence" SG_ 1332 VCFRONT_a477_sumCellVoltage 1;
BA_ "SystemSignalLongSymbol" SG_ 1332 VCFRONT_a478_battFaultPackOverVo "VCFRONT_a478_battFaultPackOverVoltage";
BA_ "SystemSignalLongSymbol" SG_ 1332 VCFRONT_a478_battFaultHardwareOv "VCFRONT_a478_battFaultHardwareOverCurrent";
BA_ "SystemSignalLongSymbol" SG_ 1332 VCFRONT_a478_battFaultChargeOver "VCFRONT_a478_battFaultChargeOverCurrent";
BA_ "SystemSignalLongSymbol" SG_ 1332 VCFRONT_a478_battFaultCellUnderV "VCFRONT_a478_battFaultCellUnderVoltage";
BA_ "SystemSignalLongSymbol" SG_ 1332 VCFRONT_a478_battFaultCellOverVo "VCFRONT_a478_battFaultCellOverVoltage";
BA_ "Confidence" SG_ 1332 VCFRONT_a478_vehiclePowerState 1;
BA_ "Confidence" SG_ 1332 VCFRONT_a478_batterySMState 1;
BA_ "Confidence" SG_ 1332 VCFRONT_a478_bmsState 1;
BA_ "GenSigSNA" SG_ 1332 VCFRONT_a478_bmsState "9";
BA_ "Confidence" SG_ 1332 VCFRONT_a478_dcdcLVSupportStatus 1;
BA_ "SystemSignalLongSymbol" SG_ 1332 VCFRONT_a478_notEnoughPowerForSu "VCFRONT_a478_notEnoughPowerForSupport";
BA_ "SystemSignalLongSymbol" SG_ 1332 VCFRONT_a478_contactorEFuseStabl "VCFRONT_a478_contactorEFuseStable";
BA_ "Confidence" SG_ 1332 VCFRONT_a479_ECPAState 1;
BA_ "GenSigSNA" SG_ 1332 VCFRONT_a479_ECPAState "3";
BA_ "Confidence" SG_ 1332 VCFRONT_a479_frunkLatchStatus 1;
BA_ "GenSigSNA" SG_ 1332 VCFRONT_a479_frunkLatchStatus "0";
BA_ "Confidence" SG_ 1332 VCFRONT_a479_vehiclePowerState 1;
BA_ "Confidence" SG_ 1332 VCFRONT_a479_batterySMState 1;
BA_ "Confidence" SG_ 1332 VCFRONT_a480_channel 1;
BA_ "SystemSignalLongSymbol" SG_ 1332 VCFRONT_a480_deviceOvertemperatu "VCFRONT_a480_deviceOvertemperature";
BA_ "Confidence" SG_ 1332 VCFRONT_a486_mcuGraphicsEFuseCur 1;
BA_ "SystemSignalLongSymbol" SG_ 1332 VCFRONT_a486_mcuGraphicsEFuseCur "VCFRONT_a486_mcuGraphicsEFuseCurrent";
BA_ "Confidence" SG_ 1332 VCFRONT_a490_coolantPumpType 1;
BA_ "Confidence" SG_ 1332 VCFRONT_a493_minBrickSocByOcvMax 1;
BA_ "Confidence" SG_ 1332 VCFRONT_a493_maxBrickSocByOcvMin 1;
BA_ "Confidence" SG_ 1332 VCFRONT_a493_maxBrickSoc 1;
BA_ "Confidence" SG_ 1332 VCFRONT_a493_avgBrickSoc 1;
BA_ "SystemSignalLongSymbol" SG_ 1332 VCFRONT_a495_reverseBatteryEFuse "VCFRONT_a495_reverseBatteryEFuseFault";
BA_ "SystemSignalLongSymbol" SG_ 1332 VCFRONT_a496_reverseBatteryEFuse "VCFRONT_a496_reverseBatteryEFuseFault";
BA_ "SystemSignalLongSymbol" SG_ 1332 VCFRONT_a496_vehicleLoadShedActi "VCFRONT_a496_vehicleLoadShedActive";
BA_ "Confidence" SG_ 1332 VCFRONT_a496_MOSState 1;
BA_ "GenSigSNA" SG_ 1332 VCFRONT_a496_MOSState "3";
BA_ "SystemSignalLongSymbol" SG_ 1332 VCFRONT_a496_NotEnoughPowerForSu "VCFRONT_a496_NotEnoughPowerForSupport";
BA_ "Confidence" SG_ 1332 VCFRONT_a496_bmsState 1;
BA_ "GenSigSNA" SG_ 1332 VCFRONT_a496_bmsState "9";
BA_ "Confidence" SG_ 1332 VCFRONT_a497_SOC 1;
BA_ "Confidence" SG_ 1332 VCFRONT_a497_PackCurrent 1;
BA_ "Confidence" SG_ 1332 VCFRONT_a497_SumCellVoltage 1;
BA_ "Confidence" SG_ 1332 VCFRONT_a500_mismatchedState 1;
BA_ "Confidence" SG_ 1332 VCFRONT_a503_brickVoltageMin 1;
BA_ "Confidence" SG_ 1332 VCFRONT_a503_brickVoltageMax 1;
BA_ "Confidence" SG_ 1332 VCFRONT_a503_packCurrent 1;
BA_ "Confidence" SG_ 1332 VCFRONT_a503_socMax 1;
BA_ "Confidence" SG_ 1332 VCFRONT_a509_vcrightEFuseCurrent 1;
BA_ "Confidence" SG_ 1332 VCFRONT_a509_vcrightEFuseTemp 1;
BA_ "Confidence" SG_ 1332 VCFRONT_a509_ambientTemp 1;
BA_ "Confidence" SG_ 1332 VCFRONT_a510_sumCellVoltage 1;
BA_ "Confidence" SG_ 1332 VCFRONT_a510_packVoltage 1;
BA_ "Confidence" SG_ 1332 VCFRONT_a510_targetPCSVoltage 1;
BA_ "Confidence" SG_ 1332 VCFRONT_a511_PCSEFuseCurrent 1;
BA_ "Confidence" SG_ 1332 VCFRONT_a511_DCDCMaxOutputCurren 1;
BA_ "SystemSignalLongSymbol" SG_ 1332 VCFRONT_a511_DCDCMaxOutputCurren "VCFRONT_a511_DCDCMaxOutputCurrentAllowed";
BA_ "Confidence" SG_ 1332 VCFRONT_a511_hvState 1;
BA_ "Confidence" SG_ 1332 VCFRONT_a512_packVoltageInt_0001 1;
BA_ "SystemSignalLongSymbol" SG_ 1332 VCFRONT_a512_packVoltageInt_0001 "VCFRONT_a512_packVoltageIntervalMin";
BA_ "Confidence" SG_ 1332 VCFRONT_a512_packVoltageInterval 1;
BA_ "SystemSignalLongSymbol" SG_ 1332 VCFRONT_a512_packVoltageInterval "VCFRONT_a512_packVoltageIntervalMax";
BA_ "Confidence" SG_ 1332 VCFRONT_a512_packTemperature 1;
BA_ "Confidence" SG_ 1332 VCFRONT_a512_sumCellVoltage 1;
BA_ "Confidence" SG_ 1332 VCFRONT_a512_overcurrentDirectio 1;
BA_ "SystemSignalLongSymbol" SG_ 1332 VCFRONT_a512_overcurrentDirectio "VCFRONT_a512_overcurrentDirection";
BA_ "Confidence" SG_ 1332 VCFRONT_a512_vehiclePowerState 1;
BA_ "Confidence" SG_ 1332 VCFRONT_a513_packCurrent 1;
BA_ "Confidence" SG_ 1332 VCFRONT_a513_packTemperature 1;
BA_ "Confidence" SG_ 1332 VCFRONT_a513_packVoltage 1;
BA_ "Confidence" SG_ 1332 VCFRONT_a513_packSOC 1;
BA_ "Confidence" SG_ 1332 VCFRONT_a513_vehiclePowerState 1;
BA_ "Confidence" SG_ 1332 VCFRONT_a514_cell1Voltage 1;
BA_ "Confidence" SG_ 1332 VCFRONT_a514_cell2Voltage 1;
BA_ "Confidence" SG_ 1332 VCFRONT_a514_cell3Voltage 1;
BA_ "Confidence" SG_ 1332 VCFRONT_a514_cell4Voltage 1;
BA_ "Confidence" SG_ 1332 VCFRONT_a514_packVoltage 1;
BA_ "Confidence" SG_ 1332 VCFRONT_a514_packSOC 1;
BA_ "Confidence" SG_ 1332 VCFRONT_a514_vehiclePowerState 1;
BA_ "Confidence" SG_ 1332 VCFRONT_a515_cell1Voltage 1;
BA_ "Confidence" SG_ 1332 VCFRONT_a515_cell2Voltage 1;
BA_ "Confidence" SG_ 1332 VCFRONT_a515_cell3Voltage 1;
BA_ "Confidence" SG_ 1332 VCFRONT_a515_cell4Voltage 1;
BA_ "Confidence" SG_ 1332 VCFRONT_a515_packVoltage 1;
BA_ "Confidence" SG_ 1332 VCFRONT_a515_packSOC 1;
BA_ "Confidence" SG_ 1332 VCFRONT_a515_vehiclePowerState 1;
BA_ "Confidence" SG_ 1332 VCFRONT_a516_IBSVoltage 1;
BA_ "Confidence" SG_ 1332 VCFRONT_a516_HVSoc 1;
BA_ "SystemSignalLongSymbol" SG_ 1332 VCFRONT_a516_contactorsPermanent "VCFRONT_a516_contactorsPermanentlyClosed";
BA_ "SystemSignalLongSymbol" SG_ 1332 VCFRONT_a516_LVBatteryDisconnect "VCFRONT_a516_LVBatteryDisconnected";
BA_ "SystemSignalLongSymbol" SG_ 1332 VCFRONT_a516_LVBatteryCannotSupp "VCFRONT_a516_LVBatteryCannotSupportVehicle";
BA_ "Confidence" SG_ 1332 VCFRONT_a517_IBSVoltage 1;
BA_ "Confidence" SG_ 1332 VCFRONT_a517_HVSoc 1;
BA_ "Confidence" SG_ 1332 VCFRONT_a518_packVoltage 1;
BA_ "Confidence" SG_ 1332 VCFRONT_a518_IBSVoltage 1;
BA_ "Confidence" SG_ 1332 VCFRONT_a518_targetPCSVoltage 1;
BA_ "Confidence" SG_ 1332 VCFRONT_a518_outputVoltageAtPCS 1;
BA_ "Confidence" SG_ 1332 VCFRONT_a518_packSOC 1;
BA_ "Confidence" SG_ 1332 VCFRONT_a518_vehiclePowerState 1;
BA_ "Confidence" SG_ 1332 VCFRONT_a519_MatrixBank1Status 1;
BA_ "Confidence" SG_ 1332 VCFRONT_a519_MatrixBank2Status 1;
BA_ "Confidence" SG_ 1332 VCFRONT_a519_MatrixBank3Status 1;
BA_ "Confidence" SG_ 1332 VCFRONT_a519_MatrixBank4Status 1;
BA_ "Confidence" SG_ 1332 VCFRONT_a519_TurnSignalStatus 1;
BA_ "Confidence" SG_ 1332 VCFRONT_a519_SideMarkerStatus 1;
BA_ "Confidence" SG_ 1332 VCFRONT_a519_DRLStatus 1;
BA_ "Confidence" SG_ 1332 VCFRONT_a519_AmbientStatus 1;
BA_ "Confidence" SG_ 1332 VCFRONT_a519_LBFlatSAEStatus 1;
BA_ "Confidence" SG_ 1332 VCFRONT_a519_LBFlatECEStatus 1;
BA_ "Confidence" SG_ 1332 VCFRONT_a519_TPS92520_COMPOV 1;
BA_ "Confidence" SG_ 1332 VCFRONT_a519_TPS92520_HSILIM 1;
BA_ "Confidence" SG_ 1332 VCFRONT_a519_TPS92520_BSTUV 1;
BA_ "Confidence" SG_ 1332 VCFRONT_a519_CoolingFanStatus 1;
BA_ "Confidence" SG_ 1332 VCFRONT_a519_BoostRailStatus 1;
BA_ "Confidence" SG_ 1332 VCFRONT_a519_EEPROMCurrentBinSta 1;
BA_ "SystemSignalLongSymbol" SG_ 1332 VCFRONT_a519_EEPROMCurrentBinSta "VCFRONT_a519_EEPROMCurrentBinStatus";
BA_ "Confidence" SG_ 1332 VCFRONT_a519_EEPROMCalCurrentSta 1;
BA_ "SystemSignalLongSymbol" SG_ 1332 VCFRONT_a519_EEPROMCalCurrentSta "VCFRONT_a519_EEPROMCalCurrentStatus";
BA_ "Confidence" SG_ 1332 VCFRONT_a519_HeadlampECURevision 1;
BA_ "Confidence" SG_ 1332 VCFRONT_a519_NonzeroEEPROMRetrie 1;
BA_ "SystemSignalLongSymbol" SG_ 1332 VCFRONT_a519_NonzeroEEPROMRetrie "VCFRONT_a519_NonzeroEEPROMRetries";
BA_ "Confidence" SG_ 1332 VCFRONT_a519_MaxEEPROMRetries 1;
BA_ "Confidence" SG_ 1332 VCFRONT_a520_MatrixBank1Status 1;
BA_ "Confidence" SG_ 1332 VCFRONT_a520_MatrixBank2Status 1;
BA_ "Confidence" SG_ 1332 VCFRONT_a520_MatrixBank3Status 1;
BA_ "Confidence" SG_ 1332 VCFRONT_a520_MatrixBank4Status 1;
BA_ "Confidence" SG_ 1332 VCFRONT_a520_TurnSignalStatus 1;
BA_ "Confidence" SG_ 1332 VCFRONT_a520_SideMarkerStatus 1;
BA_ "Confidence" SG_ 1332 VCFRONT_a520_DRLStatus 1;
BA_ "Confidence" SG_ 1332 VCFRONT_a520_AmbientStatus 1;
BA_ "Confidence" SG_ 1332 VCFRONT_a520_LBFlatSAEStatus 1;
BA_ "Confidence" SG_ 1332 VCFRONT_a520_LBFlatECEStatus 1;
BA_ "Confidence" SG_ 1332 VCFRONT_a520_TPS92520_COMPOV 1;
BA_ "Confidence" SG_ 1332 VCFRONT_a520_TPS92520_HSILIM 1;
BA_ "Confidence" SG_ 1332 VCFRONT_a520_TPS92520_BSTUV 1;
BA_ "Confidence" SG_ 1332 VCFRONT_a520_CoolingFanStatus 1;
BA_ "Confidence" SG_ 1332 VCFRONT_a520_BoostRailStatus 1;
BA_ "Confidence" SG_ 1332 VCFRONT_a520_EEPROMCurrentBinSta 1;
BA_ "SystemSignalLongSymbol" SG_ 1332 VCFRONT_a520_EEPROMCurrentBinSta "VCFRONT_a520_EEPROMCurrentBinStatus";
BA_ "Confidence" SG_ 1332 VCFRONT_a520_EEPROMCalCurrentSta 1;
BA_ "SystemSignalLongSymbol" SG_ 1332 VCFRONT_a520_EEPROMCalCurrentSta "VCFRONT_a520_EEPROMCalCurrentStatus";
BA_ "Confidence" SG_ 1332 VCFRONT_a520_HeadlampECURevision 1;
BA_ "Confidence" SG_ 1332 VCFRONT_a520_NonzeroEEPROMRetrie 1;
BA_ "SystemSignalLongSymbol" SG_ 1332 VCFRONT_a520_NonzeroEEPROMRetrie "VCFRONT_a520_NonzeroEEPROMRetries";
BA_ "Confidence" SG_ 1332 VCFRONT_a520_MaxEEPROMRetries 1;
BA_ "Confidence" SG_ 1332 VCFRONT_a521_vcleftEFuseCurrent 1;
BA_ "Confidence" SG_ 1332 VCFRONT_a521_vcleftEFuseTemp 1;
BA_ "Confidence" SG_ 1332 VCFRONT_a521_ambientTemp 1;
BA_ "Confidence" SG_ 1332 VCFRONT_a522_IBSVoltage 1;
BA_ "Confidence" SG_ 1332 VCFRONT_a522_HVSoc 1;
BA_ "SystemSignalLongSymbol" SG_ 1332 VCFRONT_a522_contactorsPermanent "VCFRONT_a522_contactorsPermanentlyClosed";
BA_ "SystemSignalLongSymbol" SG_ 1332 VCFRONT_a522_LVBatteryDisconnect "VCFRONT_a522_LVBatteryDisconnected";
BA_ "SystemSignalLongSymbol" SG_ 1332 VCFRONT_a522_LVBatteryCannotSupp "VCFRONT_a522_LVBatteryCannotSupportVehicle";
BA_ "Confidence" SG_ 1332 VCFRONT_a525_GTW_twelveVBatteryT 1;
BA_ "SystemSignalLongSymbol" SG_ 1332 VCFRONT_a525_GTW_twelveVBatteryT "VCFRONT_a525_GTW_twelveVBatteryType";
BA_ "Confidence" SG_ 1332 VCFRONT_a525_newLVBatteryType 1;
BA_ "Confidence" SG_ 1332 VCFRONT_a525_initialLVBatteryTyp 1;
BA_ "SystemSignalLongSymbol" SG_ 1332 VCFRONT_a525_initialLVBatteryTyp "VCFRONT_a525_initialLVBatteryType";
BA_ "Confidence" SG_ 1332 VCFRONT_a527_cell1Voltage 1;
BA_ "Confidence" SG_ 1332 VCFRONT_a527_cell2Voltage 1;
BA_ "Confidence" SG_ 1332 VCFRONT_a527_cell3Voltage 1;
BA_ "Confidence" SG_ 1332 VCFRONT_a527_cell4Voltage 1;
BA_ "Confidence" SG_ 1332 VCFRONT_a531_powerIndexFiltered 1;
BA_ "Confidence" SG_ 1332 VCFRONT_a533_temperature 1;
BA_ "Confidence" SG_ 1332 VCFRONT_a541_PackTemperature 1;
BA_ "Confidence" SG_ 1332 VCFRONT_a541_ChargeCurrentLimit 1;
BA_ "Confidence" SG_ 1332 VCFRONT_a541_PeakCurrent 1;
BA_ "Confidence" SG_ 1332 VCFRONT_a541_AverageCurrent 1;
BA_ "Confidence" SG_ 1332 VCFRONT_a541_SOC 1;
BA_ "Confidence" SG_ 1332 VCFRONT_a544_LVBMSSOC 1;
BA_ "Confidence" SG_ 1332 VCFRONT_a545_GTW_twelveVBatteryT 1;
BA_ "SystemSignalLongSymbol" SG_ 1332 VCFRONT_a545_GTW_twelveVBatteryT "VCFRONT_a545_GTW_twelveVBatteryType";
BA_ "Confidence" SG_ 1332 VCFRONT_a545_newLVBatteryType 1;
BA_ "Confidence" SG_ 1332 VCFRONT_a548_vehiclePowerState 1;
BA_ "SystemSignalLongSymbol" SG_ 1332 VCFRONT_a548_notEnoughPowerForSu "VCFRONT_a548_notEnoughPowerForSupport";
BA_ "SystemSignalLongSymbol" SG_ 1332 VCFRONT_a548_LVBatteryCannotSupp "VCFRONT_a548_LVBatteryCannotSupportVehicle";
BA_ "Confidence" SG_ 1332 VCFRONT_a548_DI_gear 1;
BA_ "GenSigSNA" SG_ 1332 VCFRONT_a548_DI_gear "7";
BA_ "Confidence" SG_ 1332 VCFRONT_a548_backstopBucketCount 1;
BA_ "Confidence" SG_ 1332 VCFRONT_a548_hvState 1;
BA_ "Confidence" SG_ 1332 VCFRONT_a548_ampHourBucketCount 1;
BA_ "Confidence" SG_ 1332 VCFRONT_a548_LVBMSSOC 1;
BA_ "Confidence" SG_ 1332 VCFRONT_a548_PCSTargetVoltage 1;
BA_ "SystemSignalLongSymbol" SG_ 1332 VCFRONT_a548_HVNotConfirmedUpTri "VCFRONT_a548_HVNotConfirmedUpTrigger";
BA_ "SystemSignalLongSymbol" SG_ 1332 VCFRONT_a548_PCSNotMeetingTarget "VCFRONT_a548_PCSNotMeetingTargetTrigger";
BA_ "Confidence" SG_ 1332 VCFRONT_a549_MatrixBank1Status 1;
BA_ "Confidence" SG_ 1332 VCFRONT_a549_SideMarkerStatus 1;
BA_ "Confidence" SG_ 1332 VCFRONT_a549_TurnSignalStatus 1;
BA_ "Confidence" SG_ 1332 VCFRONT_a549_DRL1Status 1;
BA_ "Confidence" SG_ 1332 VCFRONT_a549_DRL2Status 1;
BA_ "Confidence" SG_ 1332 VCFRONT_a549_DRL3Status 1;
BA_ "Confidence" SG_ 1332 VCFRONT_a549_LowBeamStatus 1;
BA_ "Confidence" SG_ 1332 VCFRONT_a549_TPS92520_COMPOV 1;
BA_ "Confidence" SG_ 1332 VCFRONT_a549_TPS92520_HSILIM 1;
BA_ "Confidence" SG_ 1332 VCFRONT_a549_TPS92520_BSTUV 1;
BA_ "Confidence" SG_ 1332 VCFRONT_a549_BoostRailStatus 1;
BA_ "Confidence" SG_ 1332 VCFRONT_a549_EEPROMDataStatus 1;
BA_ "Confidence" SG_ 1332 VCFRONT_a549_HeadlampECURevision 1;
BA_ "Confidence" SG_ 1332 VCFRONT_a551_headlampCurrent 1;
BA_ "Confidence" SG_ 1332 VCFRONT_a552_vcrightSelfTestResu 1;
BA_ "GenSigSNA" SG_ 1332 VCFRONT_a552_vcrightSelfTestResu "12";
BA_ "SystemSignalLongSymbol" SG_ 1332 VCFRONT_a552_vcrightSelfTestResu "VCFRONT_a552_vcrightSelfTestResult";
BA_ "Confidence" SG_ 1332 VCFRONT_a552_epas3pSelfTestResul 1;
BA_ "GenSigSNA" SG_ 1332 VCFRONT_a552_epas3pSelfTestResul "12";
BA_ "SystemSignalLongSymbol" SG_ 1332 VCFRONT_a552_epas3pSelfTestResul "VCFRONT_a552_epas3pSelfTestResult";
BA_ "Confidence" SG_ 1332 VCFRONT_a552_epas3sSelfTestResul 1;
BA_ "GenSigSNA" SG_ 1332 VCFRONT_a552_epas3sSelfTestResul "12";
BA_ "SystemSignalLongSymbol" SG_ 1332 VCFRONT_a552_epas3sSelfTestResul "VCFRONT_a552_epas3sSelfTestResult";
BA_ "Confidence" SG_ 1332 VCFRONT_a553_headlampCurrent 1;
BA_ "Confidence" SG_ 1332 VCFRONT_a555_cell1Voltage 1;
BA_ "Confidence" SG_ 1332 VCFRONT_a555_cell2Voltage 1;
BA_ "Confidence" SG_ 1332 VCFRONT_a555_cell3Voltage 1;
BA_ "Confidence" SG_ 1332 VCFRONT_a555_cell4Voltage 1;
BA_ "Confidence" SG_ 1332 VCFRONT_a557_MatrixBank1Status 1;
BA_ "Confidence" SG_ 1332 VCFRONT_a557_SideMarkerStatus 1;
BA_ "Confidence" SG_ 1332 VCFRONT_a557_TurnSignalStatus 1;
BA_ "Confidence" SG_ 1332 VCFRONT_a557_DRL1Status 1;
BA_ "Confidence" SG_ 1332 VCFRONT_a557_DRL2Status 1;
BA_ "Confidence" SG_ 1332 VCFRONT_a557_DRL3Status 1;
BA_ "Confidence" SG_ 1332 VCFRONT_a557_CenterStatus 1;
BA_ "Confidence" SG_ 1332 VCFRONT_a557_LowBeamStatus 1;
BA_ "Confidence" SG_ 1332 VCFRONT_a557_TPS92520_COMPOV 1;
BA_ "Confidence" SG_ 1332 VCFRONT_a557_TPS92520_HSILIM 1;
BA_ "Confidence" SG_ 1332 VCFRONT_a557_TPS92520_BSTUV 1;
BA_ "Confidence" SG_ 1332 VCFRONT_a557_BoostRailStatus 1;
BA_ "Confidence" SG_ 1332 VCFRONT_a557_EEPROMDataStatus 1;
BA_ "Confidence" SG_ 1332 VCFRONT_a557_HeadlampECURevision 1;
BA_ "Confidence" SG_ 1332 VCFRONT_a559_SOC 1;
BA_ "Confidence" SG_ 1332 VCFRONT_a559_PackCurrent 1;
BA_ "Confidence" SG_ 1332 VCFRONT_a559_vehiclePowerState 1;
BA_ "Confidence" SG_ 1332 VCFRONT_a559_batterySMState 1;
BA_ "Confidence" SG_ 1332 VCFRONT_a559_bmsState 1;
BA_ "GenSigSNA" SG_ 1332 VCFRONT_a559_bmsState "9";
BA_ "Confidence" SG_ 1332 VCFRONT_a559_dcdcLVSupportStatus 1;
BA_ "SystemSignalLongSymbol" SG_ 1332 VCFRONT_a559_notEnoughPowerForSu "VCFRONT_a559_notEnoughPowerForSupport";
BA_ "SystemSignalLongSymbol" SG_ 1332 VCFRONT_a559_contactorEFuseStabl "VCFRONT_a559_contactorEFuseStable";
BA_ "SystemSignalLongSymbol" SG_ 1332 VCFRONT_a560_highSHBattCondition "VCFRONT_a560_highSHBattConditioning";
BA_ "Confidence" SG_ 1332 VCFRONT_a561_efuseTemperature 1;
BA_ "Confidence" SG_ 1332 VCFRONT_a561_packTemperature 1;
BA_ "Confidence" SG_ 1332 VCFRONT_a561_ambientTemperature 1;
BA_ "Confidence" SG_ 1332 VCFRONT_a561_cell1Voltage 1;
BA_ "Confidence" SG_ 1332 VCFRONT_a561_cell2Voltage 1;
BA_ "Confidence" SG_ 1332 VCFRONT_a561_cell3Voltage 1;
BA_ "Confidence" SG_ 1332 VCFRONT_a561_cell4Voltage 1;
BA_ "Confidence" SG_ 1332 VCFRONT_a562_efuseTemperature 1;
BA_ "Confidence" SG_ 1332 VCFRONT_a562_packTemperature 1;
BA_ "Confidence" SG_ 1332 VCFRONT_a562_ambientTemperature 1;
BA_ "Confidence" SG_ 1332 VCFRONT_a562_cell1Voltage 1;
BA_ "Confidence" SG_ 1332 VCFRONT_a562_cell2Voltage 1;
BA_ "Confidence" SG_ 1332 VCFRONT_a562_cell3Voltage 1;
BA_ "Confidence" SG_ 1332 VCFRONT_a562_cell4Voltage 1;
BA_ "Confidence" SG_ 1332 VCFRONT_a579_leftHeadlightCurren 1;
BA_ "SystemSignalLongSymbol" SG_ 1332 VCFRONT_a579_leftHeadlightCurren "VCFRONT_a579_leftHeadlightCurrent";
BA_ "Confidence" SG_ 1332 VCFRONT_a579_leftHeadlightVoltag 1;
BA_ "SystemSignalLongSymbol" SG_ 1332 VCFRONT_a579_leftHeadlightVoltag "VCFRONT_a579_leftHeadlightVoltage";
BA_ "SystemSignalLongSymbol" SG_ 1332 VCFRONT_a579_leftHeadlightRemain "VCFRONT_a579_leftHeadlightRemainingRetries";
BA_ "Confidence" SG_ 1332 VCFRONT_a580_rightHeadlightCurre 1;
BA_ "SystemSignalLongSymbol" SG_ 1332 VCFRONT_a580_rightHeadlightCurre "VCFRONT_a580_rightHeadlightCurrent";
BA_ "Confidence" SG_ 1332 VCFRONT_a580_rightHeadlightVolta 1;
BA_ "SystemSignalLongSymbol" SG_ 1332 VCFRONT_a580_rightHeadlightVolta "VCFRONT_a580_rightHeadlightVoltage";
BA_ "SystemSignalLongSymbol" SG_ 1332 VCFRONT_a580_rightHeadlightRemai "VCFRONT_a580_rightHeadlightRemainingRetries";
BA_ "Confidence" SG_ 1332 VCFRONT_a582_batterySMState 1;
BA_ "Confidence" SG_ 1332 VCFRONT_a582_PCSCurrent 1;
BA_ "Confidence" SG_ 1332 VCFRONT_a582_LVBusVoltage 1;
BA_ "Confidence" SG_ 1332 VCFRONT_a582_LVBusVoltageSource 1;
BA_ "Confidence" SG_ 1332 VCFRONT_a582_batteryType 1;
BA_ "SystemSignalLongSymbol" SG_ 1332 VCFRONT_a585_leftHeadlampInterna "VCFRONT_a585_leftHeadlampInternalErrorMask";
BA_ "SystemSignalLongSymbol" SG_ 1332 VCFRONT_a585_rightHeadlampIntern "VCFRONT_a585_rightHeadlampInternalErrorMask";
BA_ "Confidence" SG_ 1332 VCFRONT_a592_vcleftCutoffEFuseCu 1;
BA_ "SystemSignalLongSymbol" SG_ 1332 VCFRONT_a592_vcleftCutoffEFuseCu "VCFRONT_a592_vcleftCutoffEFuseCurveType";
BA_ "SystemSignalLongSymbol" SG_ 1332 VCFRONT_a592_vcleftCutoffCurveOf "VCFRONT_a592_vcleftCutoffCurveOffsetChannel";
BA_ "Confidence" SG_ 1332 VCFRONT_a592_vcleftCutoffATerm 1;
BA_ "GenSigSNA" SG_ 1332 VCFRONT_a592_vcleftCutoffATerm "65535";
BA_ "Confidence" SG_ 1332 VCFRONT_a592_vcleftCutoffBTerm 1;
BA_ "GenSigSNA" SG_ 1332 VCFRONT_a592_vcleftCutoffBTerm "128";
BA_ "Confidence" SG_ 1332 VCFRONT_a592_vcleftCutoffCTerm 1;
BA_ "GenSigSNA" SG_ 1332 VCFRONT_a592_vcleftCutoffCTerm "32768";
BA_ "Confidence" SG_ 1332 VCFRONT_a593_vcleftCutoffEFuseFa 1;
BA_ "SystemSignalLongSymbol" SG_ 1332 VCFRONT_a593_vcleftCutoffEFuseFa "VCFRONT_a593_vcleftCutoffEFuseFastBlowType";
BA_ "Confidence" SG_ 1332 VCFRONT_a593_vcleftCutoffCurrent 1;
BA_ "SystemSignalLongSymbol" SG_ 1332 VCFRONT_a593_vcleftCutoffCurrent "VCFRONT_a593_vcleftCutoffCurrentThreshold";
BA_ "SystemSignalLongSymbol" SG_ 1332 VCFRONT_a593_vcleftCutoffTimingT "VCFRONT_a593_vcleftCutoffTimingThresholdMs";
BA_ "SystemSignalLongSymbol" SG_ 1332 VCFRONT_a593_vcleftCutoffMaxCoun "VCFRONT_a593_vcleftCutoffMaxCount";
BA_ "Confidence" SG_ 1332 VCFRONT_a596_vcrightCutoffEFuseC 1;
BA_ "SystemSignalLongSymbol" SG_ 1332 VCFRONT_a596_vcrightCutoffEFuseC "VCFRONT_a596_vcrightCutoffEFuseCurveType";
BA_ "SystemSignalLongSymbol" SG_ 1332 VCFRONT_a596_vcrightCutoffCurveO "VCFRONT_a596_vcrightCutoffCurveOffsetChannel";
BA_ "Confidence" SG_ 1332 VCFRONT_a596_vcrightCutoffATerm 1;
BA_ "GenSigSNA" SG_ 1332 VCFRONT_a596_vcrightCutoffATerm "65535";
BA_ "Confidence" SG_ 1332 VCFRONT_a596_vcrightCutoffBTerm 1;
BA_ "GenSigSNA" SG_ 1332 VCFRONT_a596_vcrightCutoffBTerm "128";
BA_ "Confidence" SG_ 1332 VCFRONT_a596_vcrightCutoffCTerm 1;
BA_ "GenSigSNA" SG_ 1332 VCFRONT_a596_vcrightCutoffCTerm "32768";
BA_ "Confidence" SG_ 1332 VCFRONT_a597_vcrightCutoffEFuseF 1;
BA_ "SystemSignalLongSymbol" SG_ 1332 VCFRONT_a597_vcrightCutoffEFuseF "VCFRONT_a597_vcrightCutoffEFuseFastBlowType";
BA_ "Confidence" SG_ 1332 VCFRONT_a597_vcrightCutoffCurren 1;
BA_ "SystemSignalLongSymbol" SG_ 1332 VCFRONT_a597_vcrightCutoffCurren "VCFRONT_a597_vcrightCutoffCurrentThreshold";
BA_ "SystemSignalLongSymbol" SG_ 1332 VCFRONT_a597_vcrightCutoffTiming "VCFRONT_a597_vcrightCutoffTimingThresholdMs";
BA_ "SystemSignalLongSymbol" SG_ 1332 VCFRONT_a597_vcrightCutoffMaxCou "VCFRONT_a597_vcrightCutoffMaxCount";
BA_ "Confidence" SG_ 1332 VCFRONT_a598_vcleftSelfTestResul 1;
BA_ "GenSigSNA" SG_ 1332 VCFRONT_a598_vcleftSelfTestResul "12";
BA_ "SystemSignalLongSymbol" SG_ 1332 VCFRONT_a598_vcleftSelfTestResul "VCFRONT_a598_vcleftSelfTestResult";
BA_ "Confidence" SG_ 1332 VCFRONT_a599_GTW_twelveVBatteryT 1;
BA_ "SystemSignalLongSymbol" SG_ 1332 VCFRONT_a599_GTW_twelveVBatteryT "VCFRONT_a599_GTW_twelveVBatteryType";
BA_ "Confidence" SG_ 1332 VCFRONT_a599_newLVBatteryType 1;
BA_ "Confidence" SG_ 1332 VCFRONT_a599_initialLVBatteryTyp 1;
BA_ "SystemSignalLongSymbol" SG_ 1332 VCFRONT_a599_initialLVBatteryTyp "VCFRONT_a599_initialLVBatteryType";
BA_ "Confidence" SG_ 1332 VCFRONT_a605_vbatProtVoltage 1;
BA_ "Confidence" SG_ 1332 VCFRONT_a605_sleepBypassVoltage 1;
BA_ "Confidence" SG_ 1332 VCFRONT_a605_sleepBypassCurrent 1;
BA_ "Confidence" SG_ 1332 VCFRONT_a610_switch1State 1;
BA_ "GenSigSNA" SG_ 1332 VCFRONT_a610_switch1State "0";
BA_ "Confidence" SG_ 1332 VCFRONT_a610_switch2State 1;
BA_ "GenSigSNA" SG_ 1332 VCFRONT_a610_switch2State "0";
BA_ "Confidence" SG_ 1332 VCFRONT_a610_temperature 1;
BA_ "GenSigSNA" SG_ 1332 VCFRONT_a610_temperature "0";
BA_ "Confidence" SG_ 1332 VCFRONT_a611_tempCoolantPTInlet 1;
BA_ "Confidence" SG_ 1332 VCFRONT_a611_tempCoolantPTInletE 1;
BA_ "SystemSignalLongSymbol" SG_ 1332 VCFRONT_a611_tempCoolantPTInletE "VCFRONT_a611_tempCoolantPTInletEst";
BA_ "Confidence" SG_ 1332 VCFRONT_a611_tempAmbientRaw 1;
BA_ "Confidence" SG_ 1332 VCFRONT_a611_radFanAvgSpeed 1;
BA_ "Confidence" SG_ 1332 VCFRONT_a611_ptLoopCoolantFlow 1;
BA_ "Confidence" SG_ 1332 VCFRONT_a611_compressorPower 1;
BA_ "Confidence" SG_ 1332 VCFRONT_a611_heatGenTotal 1;
BA_ "Confidence" SG_ 1332 VCFRONT_a611_radCoolantToAirUAEs 1;
BA_ "SystemSignalLongSymbol" SG_ 1332 VCFRONT_a611_radCoolantToAirUAEs "VCFRONT_a611_radCoolantToAirUAEst";
BA_ "Confidence" SG_ 1332 VCFRONT_a612_DI_gear 1;
BA_ "GenSigSNA" SG_ 1332 VCFRONT_a612_DI_gear "7";
BA_ "SystemSignalLongSymbol" SG_ 1332 VCFRONT_a612_manualDrivingProhib "VCFRONT_a612_manualDrivingProhibited";
BA_ "Confidence" SG_ 1332 VCFRONT_a612_vehicleSpeed 1;
BA_ "Confidence" SG_ 1332 VCFRONT_a612_lvHealthStatus 1;
BA_ "SystemSignalLongSymbol" SG_ 1332 VCFRONT_a620_powertrainIsDryRunD "VCFRONT_a620_powertrainIsDryRunDetected";
BA_ "Confidence" SG_ 1332 VCFRONT_a620_powertrainPumpRpm 1;
BA_ "GenSigSNA" SG_ 1332 VCFRONT_a620_powertrainPumpRpm "255";
BA_ "Confidence" SG_ 1332 VCFRONT_a620_powertrainPumpIPhas 1;
BA_ "GenSigSNA" SG_ 1332 VCFRONT_a620_powertrainPumpIPhas "255";
BA_ "SystemSignalLongSymbol" SG_ 1332 VCFRONT_a620_powertrainPumpIPhas "VCFRONT_a620_powertrainPumpIPhaseFiltered";
BA_ "Confidence" SG_ 1332 VCFRONT_a620_powertrainPump_0001 1;
BA_ "GenSigSNA" SG_ 1332 VCFRONT_a620_powertrainPump_0001 "127";
BA_ "SystemSignalLongSymbol" SG_ 1332 VCFRONT_a620_powertrainPump_0001 "VCFRONT_a620_powertrainPumpIPhaseMinFilt";
BA_ "SystemSignalLongSymbol" SG_ 1332 VCFRONT_a620_chillerIsDryRunDete "VCFRONT_a620_chillerIsDryRunDetected";
BA_ "Confidence" SG_ 1332 VCFRONT_a620_chillerPumpRpm 1;
BA_ "GenSigSNA" SG_ 1332 VCFRONT_a620_chillerPumpRpm "255";
BA_ "Confidence" SG_ 1332 VCFRONT_a620_chillerPumpIPhaseFi 1;
BA_ "GenSigSNA" SG_ 1332 VCFRONT_a620_chillerPumpIPhaseFi "255";
BA_ "SystemSignalLongSymbol" SG_ 1332 VCFRONT_a620_chillerPumpIPhaseFi "VCFRONT_a620_chillerPumpIPhaseFiltered";
BA_ "Confidence" SG_ 1332 VCFRONT_a620_chillerPumpIPhaseMi 1;
BA_ "GenSigSNA" SG_ 1332 VCFRONT_a620_chillerPumpIPhaseMi "127";
BA_ "SystemSignalLongSymbol" SG_ 1332 VCFRONT_a620_chillerPumpIPhaseMi "VCFRONT_a620_chillerPumpIPhaseMinFilt";
BA_ "SystemSignalLongSymbol" SG_ 1332 VCFRONT_a622_pumpChLowCoolantFlo "VCFRONT_a622_pumpChLowCoolantFlow";
BA_ "SystemSignalLongSymbol" SG_ 1332 VCFRONT_a622_pumpPtLowCoolantFlo "VCFRONT_a622_pumpPtLowCoolantFlow";
BA_ "Confidence" SG_ 1332 VCFRONT_a622_coolantMode 1;
BA_ "Confidence" SG_ 1332 VCFRONT_a623_DI_gear 1;
BA_ "GenSigSNA" SG_ 1332 VCFRONT_a623_DI_gear "7";
BA_ "SystemSignalLongSymbol" SG_ 1332 VCFRONT_a623_manualDrivingProhib "VCFRONT_a623_manualDrivingProhibited";
BA_ "Confidence" SG_ 1332 VCFRONT_a623_vehicleSpeed 1;
BA_ "Confidence" SG_ 1332 VCFRONT_a623_lvHealthStatus 1;
BA_ "Confidence" SG_ 1332 VCFRONT_a623_unhealthyReason 1;
BA_ "SystemSignalLongSymbol" SG_ 1332 VCFRONT_a623_failureLvBatteryEne "VCFRONT_a623_failureLvBatteryEnergyActiveDecel";
BA_ "SystemSignalLongSymbol" SG_ 1332 VCFRONT_a623_failureLvBatte_0003 "VCFRONT_a623_failureLvBatteryEnergyCritical";
BA_ "SystemSignalLongSymbol" SG_ 1332 VCFRONT_a623_failureReverseBatte "VCFRONT_a623_failureReverseBatteryEfuseOff";
BA_ "SystemSignalLongSymbol" SG_ 1332 VCFRONT_a623_failureLvbmbEfuseOp "VCFRONT_a623_failureLvbmbEfuseOpen";
BA_ "SystemSignalLongSymbol" SG_ 1332 VCFRONT_a623_failureLvBatteryCom "VCFRONT_a623_failureLvBatteryComms";
BA_ "SystemSignalLongSymbol" SG_ 1332 VCFRONT_a623_failureLvBatterySen "VCFRONT_a623_failureLvBatterySensorIbsMia";
BA_ "SystemSignalLongSymbol" SG_ 1332 VCFRONT_a623_failureLvBatte_0001 "VCFRONT_a623_failureLvBatteryConnection";
BA_ "SystemSignalLongSymbol" SG_ 1332 VCFRONT_a623_failureLvBatte_0002 "VCFRONT_a623_failureLvBatteryConnectionUnknown";
BA_ "SystemSignalLongSymbol" SG_ 1332 VCFRONT_a623_failurePcsOpenCircu "VCFRONT_a623_failurePcsOpenCircuit";
BA_ "SystemSignalLongSymbol" SG_ 1332 VCFRONT_a623_failureLvBatteryPow "VCFRONT_a623_failureLvBatteryPowerActiveDecel";
BA_ "SystemSignalLongSymbol" SG_ 1332 VCFRONT_a623_failureLvBatteryCap "VCFRONT_a623_failureLvBatteryCapabilityLowAccuracy";
BA_ "SystemSignalLongSymbol" SG_ 1332 VCFRONT_a623_failureLvBatteryCon "VCFRONT_a623_failureLvBatteryConfiguration";
BA_ "SystemSignalLongSymbol" SG_ 1332 VCFRONT_a623_failureLvBatteryHig "VCFRONT_a623_failureLvBatteryHighImpedance";
BA_ "Confidence" SG_ 1332 VCFRONT_a624_HighBeam_OV 1;
BA_ "Confidence" SG_ 1332 VCFRONT_a624_HighBeam_UV 1;
BA_ "Confidence" SG_ 1332 VCFRONT_a624_HighBeam_short 1;
BA_ "Confidence" SG_ 1332 VCFRONT_a624_HighBeam_compov 1;
BA_ "Confidence" SG_ 1332 VCFRONT_a624_HighBeam_bootuv 1;
BA_ "Confidence" SG_ 1332 VCFRONT_a624_HighBeam_binStatus 1;
BA_ "Confidence" SG_ 1332 VCFRONT_a624_LowBeam_OV 1;
BA_ "Confidence" SG_ 1332 VCFRONT_a624_LowBeam_UV 1;
BA_ "Confidence" SG_ 1332 VCFRONT_a624_LowBeam_short 1;
BA_ "Confidence" SG_ 1332 VCFRONT_a624_LowBeam_compov 1;
BA_ "Confidence" SG_ 1332 VCFRONT_a624_LowBeam_bootuv 1;
BA_ "Confidence" SG_ 1332 VCFRONT_a624_LowBeam_binStatus 1;
BA_ "Confidence" SG_ 1332 VCFRONT_a624_DRL_OV 1;
BA_ "Confidence" SG_ 1332 VCFRONT_a624_DRL_UV 1;
BA_ "Confidence" SG_ 1332 VCFRONT_a624_DRL_short 1;
BA_ "Confidence" SG_ 1332 VCFRONT_a624_DRL_compov 1;
BA_ "Confidence" SG_ 1332 VCFRONT_a624_DRL_bootuv 1;
BA_ "Confidence" SG_ 1332 VCFRONT_a624_DRL_binStatus 1;
BA_ "Confidence" SG_ 1332 VCFRONT_a624_TurnSignal_OV 1;
BA_ "Confidence" SG_ 1332 VCFRONT_a624_TurnSignal_UV 1;
BA_ "Confidence" SG_ 1332 VCFRONT_a624_TurnSignal_short 1;
BA_ "Confidence" SG_ 1332 VCFRONT_a624_TurnSignal_compov 1;
BA_ "Confidence" SG_ 1332 VCFRONT_a624_TurnSignal_bootuv 1;
BA_ "Confidence" SG_ 1332 VCFRONT_a624_TurnSignal_binStatu 1;
BA_ "SystemSignalLongSymbol" SG_ 1332 VCFRONT_a624_TurnSignal_binStatu "VCFRONT_a624_TurnSignal_binStatus";
BA_ "Confidence" SG_ 1332 VCFRONT_a624_SideMarker_OV 1;
BA_ "Confidence" SG_ 1332 VCFRONT_a624_SideMarker_UV 1;
BA_ "Confidence" SG_ 1332 VCFRONT_a624_SideMarker_short 1;
BA_ "Confidence" SG_ 1332 VCFRONT_a624_SideMarker_compov 1;
BA_ "Confidence" SG_ 1332 VCFRONT_a624_SideMarker_bootuv 1;
BA_ "Confidence" SG_ 1332 VCFRONT_a624_SideMarker_binStatu 1;
BA_ "SystemSignalLongSymbol" SG_ 1332 VCFRONT_a624_SideMarker_binStatu "VCFRONT_a624_SideMarker_binStatus";
BA_ "Confidence" SG_ 1332 VCFRONT_a624_boost_OV 1;
BA_ "Confidence" SG_ 1332 VCFRONT_a624_boost_BOOTUV 1;
BA_ "Confidence" SG_ 1332 VCFRONT_a624_boost_ILIM 1;
BA_ "Confidence" SG_ 1332 VCFRONT_a624_boost_ISPUV 1;
BA_ "Confidence" SG_ 1332 VCFRONT_a624_EEPROM_status 1;
BA_ "Confidence" SG_ 1332 VCFRONT_a624_EEPROM_region 1;
BA_ "GenSigSNA" SG_ 1332 VCFRONT_a624_EEPROM_region "0";
BA_ "Confidence" SG_ 1332 VCFRONT_a625_HighBeam_OV 1;
BA_ "Confidence" SG_ 1332 VCFRONT_a625_HighBeam_UV 1;
BA_ "Confidence" SG_ 1332 VCFRONT_a625_HighBeam_short 1;
BA_ "Confidence" SG_ 1332 VCFRONT_a625_HighBeam_compov 1;
BA_ "Confidence" SG_ 1332 VCFRONT_a625_HighBeam_bootuv 1;
BA_ "Confidence" SG_ 1332 VCFRONT_a625_HighBeam_binStatus 1;
BA_ "Confidence" SG_ 1332 VCFRONT_a625_LowBeam_OV 1;
BA_ "Confidence" SG_ 1332 VCFRONT_a625_LowBeam_UV 1;
BA_ "Confidence" SG_ 1332 VCFRONT_a625_LowBeam_short 1;
BA_ "Confidence" SG_ 1332 VCFRONT_a625_LowBeam_compov 1;
BA_ "Confidence" SG_ 1332 VCFRONT_a625_LowBeam_bootuv 1;
BA_ "Confidence" SG_ 1332 VCFRONT_a625_LowBeam_binStatus 1;
BA_ "Confidence" SG_ 1332 VCFRONT_a625_DRL_OV 1;
BA_ "Confidence" SG_ 1332 VCFRONT_a625_DRL_UV 1;
BA_ "Confidence" SG_ 1332 VCFRONT_a625_DRL_short 1;
BA_ "Confidence" SG_ 1332 VCFRONT_a625_DRL_compov 1;
BA_ "Confidence" SG_ 1332 VCFRONT_a625_DRL_bootuv 1;
BA_ "Confidence" SG_ 1332 VCFRONT_a625_DRL_binStatus 1;
BA_ "Confidence" SG_ 1332 VCFRONT_a625_TurnSignal_OV 1;
BA_ "Confidence" SG_ 1332 VCFRONT_a625_TurnSignal_UV 1;
BA_ "Confidence" SG_ 1332 VCFRONT_a625_TurnSignal_short 1;
BA_ "Confidence" SG_ 1332 VCFRONT_a625_TurnSignal_compov 1;
BA_ "Confidence" SG_ 1332 VCFRONT_a625_TurnSignal_bootuv 1;
BA_ "Confidence" SG_ 1332 VCFRONT_a625_TurnSignal_binStatu 1;
BA_ "SystemSignalLongSymbol" SG_ 1332 VCFRONT_a625_TurnSignal_binStatu "VCFRONT_a625_TurnSignal_binStatus";
BA_ "Confidence" SG_ 1332 VCFRONT_a625_SideMarker_OV 1;
BA_ "Confidence" SG_ 1332 VCFRONT_a625_SideMarker_UV 1;
BA_ "Confidence" SG_ 1332 VCFRONT_a625_SideMarker_short 1;
BA_ "Confidence" SG_ 1332 VCFRONT_a625_SideMarker_compov 1;
BA_ "Confidence" SG_ 1332 VCFRONT_a625_SideMarker_bootuv 1;
BA_ "Confidence" SG_ 1332 VCFRONT_a625_SideMarker_binStatu 1;
BA_ "SystemSignalLongSymbol" SG_ 1332 VCFRONT_a625_SideMarker_binStatu "VCFRONT_a625_SideMarker_binStatus";
BA_ "Confidence" SG_ 1332 VCFRONT_a625_boost_OV 1;
BA_ "Confidence" SG_ 1332 VCFRONT_a625_boost_BOOTUV 1;
BA_ "Confidence" SG_ 1332 VCFRONT_a625_boost_ILIM 1;
BA_ "Confidence" SG_ 1332 VCFRONT_a625_boost_ISPUV 1;
BA_ "Confidence" SG_ 1332 VCFRONT_a625_EEPROM_status 1;
BA_ "Confidence" SG_ 1332 VCFRONT_a625_EEPROM_region 1;
BA_ "GenSigSNA" SG_ 1332 VCFRONT_a625_EEPROM_region "0";
BA_ "Confidence" SG_ 1332 VCFRONT_a626_dcrMilliOhms 1;
BA_ "Confidence" SG_ 1332 VCFRONT_a626_elevatedDcrThreshol 1;
BA_ "SystemSignalLongSymbol" SG_ 1332 VCFRONT_a626_elevatedDcrThreshol "VCFRONT_a626_elevatedDcrThreshold";
BA_ "Confidence" SG_ 1332 VCFRONT_a626_avgIntervalCurrent 1;
BA_ "Confidence" SG_ 1332 VCFRONT_a626_intervalCurrentVari 1;
BA_ "SystemSignalLongSymbol" SG_ 1332 VCFRONT_a626_intervalCurrentVari "VCFRONT_a626_intervalCurrentVariance";
BA_ "Confidence" SG_ 1332 VCFRONT_a626_avgPulseCurrent 1;
BA_ "Confidence" SG_ 1332 VCFRONT_a626_pulseCurrentVarianc 1;
BA_ "SystemSignalLongSymbol" SG_ 1332 VCFRONT_a626_pulseCurrentVarianc "VCFRONT_a626_pulseCurrentVariance";
BA_ "Confidence" SG_ 1332 VCFRONT_a626_IBSTemperature 1;
BA_ "Confidence" SG_ 1332 VCFRONT_a626_testCounter 1;
BA_ "Confidence" SG_ 1332 VCFRONT_a627_cell1Voltage 1;
BA_ "Confidence" SG_ 1332 VCFRONT_a627_cell2Voltage 1;
BA_ "Confidence" SG_ 1332 VCFRONT_a627_cell3Voltage 1;
BA_ "Confidence" SG_ 1332 VCFRONT_a627_cell4Voltage 1;
BA_ "Confidence" SG_ 1332 VCFRONT_a627_sumCellVoltage 1;
VAL_ 1332 VCFRONT_a475_drl1Status 6 "DRIVER_STATUS_FALSE_TRIGGER" 5 "UNDERVOLTAGE_FALSE_TRIGGER" 4 "OVERVOLTAGE_FALSE_TRIGGER" 3 "DRIVER_STATUS_FAULT" 2 "UNDERVOLTAGE_FAULT" 1 "OVERVOLTAGE_FAULT" 0 "OK" ;
VAL_ 1332 VCFRONT_a475_drl2Status 6 "DRIVER_STATUS_FALSE_TRIGGER" 5 "UNDERVOLTAGE_FALSE_TRIGGER" 4 "OVERVOLTAGE_FALSE_TRIGGER" 3 "DRIVER_STATUS_FAULT" 2 "UNDERVOLTAGE_FAULT" 1 "OVERVOLTAGE_FAULT" 0 "OK" ;
VAL_ 1332 VCFRONT_a475_drl3Status 6 "DRIVER_STATUS_FALSE_TRIGGER" 5 "UNDERVOLTAGE_FALSE_TRIGGER" 4 "OVERVOLTAGE_FALSE_TRIGGER" 3 "DRIVER_STATUS_FAULT" 2 "UNDERVOLTAGE_FAULT" 1 "OVERVOLTAGE_FAULT" 0 "OK" ;
VAL_ 1332 VCFRONT_a475_turnStatus 6 "DRIVER_STATUS_FALSE_TRIGGER" 5 "UNDERVOLTAGE_FALSE_TRIGGER" 4 "OVERVOLTAGE_FALSE_TRIGGER" 3 "DRIVER_STATUS_FAULT" 2 "UNDERVOLTAGE_FAULT" 1 "OVERVOLTAGE_FAULT" 0 "OK" ;
VAL_ 1332 VCFRONT_a475_fanStatus 1 "FAULT" 0 "OK" ;
VAL_ 1332 VCFRONT_a475_TPS92520_COMPOV 1 "FAULT" 0 "OK" ;
VAL_ 1332 VCFRONT_a475_TPS92520_HSILIM 1 "FAULT" 0 "OK" ;
VAL_ 1332 VCFRONT_a475_TPS92520_BSTUV 1 "FAULT" 0 "OK" ;
VAL_ 1332 VCFRONT_a475_BoostRailStatus 1 "FAULT" 0 "OK" ;
VAL_ 1332 VCFRONT_a475_EEPROM_DataStatus 1 "FAULT" 0 "OK" ;
VAL_ 1332 VCFRONT_a475_LMMVariant 2 "LMM4" 1 "NOT_LMM4_OR_UNKNOWN" 0 "SNA" ;
VAL_ 1332 VCFRONT_a475_headlampECURevision 15 "RESERVED" 8 "GEN_5_REV_E" 7 "GEN_5_REV_D" 6 "GEN_5_REV_C" 5 "GEN_5_REV_A" 4 "GEN_3_REV_F" 3 "GEN_3_REV_E" 2 "GEN_3_REV_D" 1 "GEN_3_REV_C" 0 "UNKNOWN" ;
VAL_ 1332 VCFRONT_a476_vehiclePowerState 3 "DRIVE" 2 "ACCESSORY" 1 "CONDITIONING" 0 "OFF" ;
VAL_ 1332 VCFRONT_a476_batterySMState 10 "EXTERNAL_LV_BUS_CONTROL" 9 "RECOVERY" 8 "FAULT" 7 "SHORTED_CELL_TEST" 6 "DISCONNECTED_BATTERY_TEST" 5 "OTA_STANDBY" 4 "RESISTANCE_ESTIMATION" 3 "STANDBY" 2 "DISCHARGE" 1 "CHARGE" 0 "INIT" ;
VAL_ 1332 VCFRONT_a476_ECPAState 3 "SNA" 2 "INVALID" 1 "CLOSED" 0 "OPEN" ;
VAL_ 1332 VCFRONT_a478_vehiclePowerState 3 "DRIVE" 2 "ACCESSORY" 1 "CONDITIONING" 0 "OFF" ;
VAL_ 1332 VCFRONT_a478_batterySMState 10 "EXTERNAL_LV_BUS_CONTROL" 9 "RECOVERY" 8 "FAULT" 7 "SHORTED_CELL_TEST" 6 "DISCONNECTED_BATTERY_TEST" 5 "OTA_STANDBY" 4 "RESISTANCE_ESTIMATION" 3 "STANDBY" 2 "DISCHARGE" 1 "CHARGE" 0 "INIT" ;
VAL_ 1332 VCFRONT_a478_bmsState 10 "DIAG" 9 "SNA" 8 "TEST" 7 "WELD" 6 "FAULT" 5 "CLEAR_FAULT" 4 "FEIM" 3 "CHARGE" 2 "SUPPORT" 1 "DRIVE" 0 "STANDBY" ;
VAL_ 1332 VCFRONT_a478_dcdcLVSupportStatus 2 "FAULTED" 1 "ACTIVE" 0 "IDLE" ;
VAL_ 1332 VCFRONT_a479_ECPAState 3 "SNA" 2 "INVALID" 1 "CLOSED" 0 "OPEN" ;
VAL_ 1332 VCFRONT_a479_frunkLatchStatus 8 "FAULT" 7 "DEFAULT" 6 "TIMEOUT" 5 "AJAR" 4 "OPENING" 3 "CLOSING" 2 "CLOSED" 1 "OPENED" 0 "SNA" ;
VAL_ 1332 VCFRONT_a479_vehiclePowerState 3 "DRIVE" 2 "ACCESSORY" 1 "CONDITIONING" 0 "OFF" ;
VAL_ 1332 VCFRONT_a479_batterySMState 10 "EXTERNAL_LV_BUS_CONTROL" 9 "RECOVERY" 8 "FAULT" 7 "SHORTED_CELL_TEST" 6 "DISCONNECTED_BATTERY_TEST" 5 "OTA_STANDBY" 4 "RESISTANCE_ESTIMATION" 3 "STANDBY" 2 "DISCHARGE" 1 "CHARGE" 0 "INIT" ;
VAL_ 1332 VCFRONT_a480_channel 7 "INVALID" 6 "IBOOSTER" 5 "HCU_ESP_ABS" 4 "EPAS_2" 3 "EPAS_1" 2 "RIGHT_CONTROLLER" 1 "LEFT_CONTROLLER" 0 "PCS" ;
VAL_ 1332 VCFRONT_a490_coolantPumpType 5 "DUAL_MIX" 4 "DUAL_SAN_P4_LUB" 2 "DUAL_SAN_P4" 1 "SINGLE_PUMP_BATT" 0 "DUAL" ;
VAL_ 1332 VCFRONT_a496_MOSState 3 "SNA" 2 "INVALID" 1 "CLOSED" 0 "OPEN" ;
VAL_ 1332 VCFRONT_a496_bmsState 10 "DIAG" 9 "SNA" 8 "TEST" 7 "WELD" 6 "FAULT" 5 "CLEAR_FAULT" 4 "FEIM" 3 "CHARGE" 2 "SUPPORT" 1 "DRIVE" 0 "STANDBY" ;
VAL_ 1332 VCFRONT_a500_mismatchedState 7 "SELF_TEST" 6 "SELF_TEST_PREP" 5 "LOCKED" 4 "UNLOCKED" 3 "CONFIGURATION" 2 "WAKEUP" 1 "STANDBY" 0 "UNKNOWN" ;
VAL_ 1332 VCFRONT_a511_hvState 6 "UP" 5 "UP_FOR_DC_CHARGE" 4 "UP_FOR_CHARGE" 3 "UP_FOR_DRIVE" 2 "GOING_DOWN" 1 "COMING_UP" 0 "DOWN" ;
VAL_ 1332 VCFRONT_a512_overcurrentDirectio 2 "DISCHARGE" 1 "CHARGE" 0 "INCONCLUSIVE" ;
VAL_ 1332 VCFRONT_a512_vehiclePowerState 3 "DRIVE" 2 "ACCESSORY" 1 "CONDITIONING" 0 "OFF" ;
VAL_ 1332 VCFRONT_a513_vehiclePowerState 3 "DRIVE" 2 "ACCESSORY" 1 "CONDITIONING" 0 "OFF" ;
VAL_ 1332 VCFRONT_a514_vehiclePowerState 3 "DRIVE" 2 "ACCESSORY" 1 "CONDITIONING" 0 "OFF" ;
VAL_ 1332 VCFRONT_a515_vehiclePowerState 3 "DRIVE" 2 "ACCESSORY" 1 "CONDITIONING" 0 "OFF" ;
VAL_ 1332 VCFRONT_a518_vehiclePowerState 3 "DRIVE" 2 "ACCESSORY" 1 "CONDITIONING" 0 "OFF" ;
VAL_ 1332 VCFRONT_a519_MatrixBank1Status 3 "UNRESPONSIVE" 2 "PIXEL_ERROR" 1 "CRC_ERROR" 0 "OK" ;
VAL_ 1332 VCFRONT_a519_MatrixBank2Status 3 "UNRESPONSIVE" 2 "PIXEL_ERROR" 1 "CRC_ERROR" 0 "OK" ;
VAL_ 1332 VCFRONT_a519_MatrixBank3Status 3 "UNRESPONSIVE" 2 "PIXEL_ERROR" 1 "CRC_ERROR" 0 "OK" ;
VAL_ 1332 VCFRONT_a519_MatrixBank4Status 3 "UNRESPONSIVE" 2 "PIXEL_ERROR" 1 "CRC_ERROR" 0 "OK" ;
VAL_ 1332 VCFRONT_a519_TurnSignalStatus 6 "DRIVER_STATUS_FALSE_TRIGGER" 5 "UNDERVOLTAGE_FALSE_TRIGGER" 4 "OVERVOLTAGE_FALSE_TRIGGER" 3 "DRIVER_STATUS_FAULT" 2 "UNDERVOLTAGE_FAULT" 1 "OVERVOLTAGE_FAULT" 0 "OK" ;
VAL_ 1332 VCFRONT_a519_SideMarkerStatus 2 "OVERCURRENT_FAULT" 1 "UNDERCURRENT_FAULT" 0 "OK" ;
VAL_ 1332 VCFRONT_a519_DRLStatus 6 "DRIVER_STATUS_FALSE_TRIGGER" 5 "UNDERVOLTAGE_FALSE_TRIGGER" 4 "OVERVOLTAGE_FALSE_TRIGGER" 3 "DRIVER_STATUS_FAULT" 2 "UNDERVOLTAGE_FAULT" 1 "OVERVOLTAGE_FAULT" 0 "OK" ;
VAL_ 1332 VCFRONT_a519_AmbientStatus 6 "DRIVER_STATUS_FALSE_TRIGGER" 5 "UNDERVOLTAGE_FALSE_TRIGGER" 4 "OVERVOLTAGE_FALSE_TRIGGER" 3 "DRIVER_STATUS_FAULT" 2 "UNDERVOLTAGE_FAULT" 1 "OVERVOLTAGE_FAULT" 0 "OK" ;
VAL_ 1332 VCFRONT_a519_LBFlatSAEStatus 6 "DRIVER_STATUS_FALSE_TRIGGER" 5 "UNDERVOLTAGE_FALSE_TRIGGER" 4 "OVERVOLTAGE_FALSE_TRIGGER" 3 "DRIVER_STATUS_FAULT" 2 "UNDERVOLTAGE_FAULT" 1 "OVERVOLTAGE_FAULT" 0 "OK" ;
VAL_ 1332 VCFRONT_a519_LBFlatECEStatus 6 "DRIVER_STATUS_FALSE_TRIGGER" 5 "UNDERVOLTAGE_FALSE_TRIGGER" 4 "OVERVOLTAGE_FALSE_TRIGGER" 3 "DRIVER_STATUS_FAULT" 2 "UNDERVOLTAGE_FAULT" 1 "OVERVOLTAGE_FAULT" 0 "OK" ;
VAL_ 1332 VCFRONT_a519_TPS92520_COMPOV 1 "FAULT" 0 "OK" ;
VAL_ 1332 VCFRONT_a519_TPS92520_HSILIM 1 "FAULT" 0 "OK" ;
VAL_ 1332 VCFRONT_a519_TPS92520_BSTUV 1 "FAULT" 0 "OK" ;
VAL_ 1332 VCFRONT_a519_CoolingFanStatus 1 "FAULT" 0 "OK" ;
VAL_ 1332 VCFRONT_a519_BoostRailStatus 1 "FAULT" 0 "OK" ;
VAL_ 1332 VCFRONT_a519_EEPROMCurrentBinSta 1 "FAULT" 0 "OK" ;
VAL_ 1332 VCFRONT_a519_EEPROMCalCurrentSta 1 "FAULT" 0 "OK" ;
VAL_ 1332 VCFRONT_a519_HeadlampECURevision 15 "RESERVED" 8 "GEN_5_REV_E" 7 "GEN_5_REV_D" 6 "GEN_5_REV_C" 5 "GEN_5_REV_A" 4 "GEN_3_REV_F" 3 "GEN_3_REV_E" 2 "GEN_3_REV_D" 1 "GEN_3_REV_C" 0 "UNKNOWN" ;
VAL_ 1332 VCFRONT_a519_NonzeroEEPROMRetrie 1 "FAULT" 0 "OK" ;
VAL_ 1332 VCFRONT_a519_MaxEEPROMRetries 1 "FAULT" 0 "OK" ;
VAL_ 1332 VCFRONT_a520_MatrixBank1Status 3 "UNRESPONSIVE" 2 "PIXEL_ERROR" 1 "CRC_ERROR" 0 "OK" ;
VAL_ 1332 VCFRONT_a520_MatrixBank2Status 3 "UNRESPONSIVE" 2 "PIXEL_ERROR" 1 "CRC_ERROR" 0 "OK" ;
VAL_ 1332 VCFRONT_a520_MatrixBank3Status 3 "UNRESPONSIVE" 2 "PIXEL_ERROR" 1 "CRC_ERROR" 0 "OK" ;
VAL_ 1332 VCFRONT_a520_MatrixBank4Status 3 "UNRESPONSIVE" 2 "PIXEL_ERROR" 1 "CRC_ERROR" 0 "OK" ;
VAL_ 1332 VCFRONT_a520_TurnSignalStatus 6 "DRIVER_STATUS_FALSE_TRIGGER" 5 "UNDERVOLTAGE_FALSE_TRIGGER" 4 "OVERVOLTAGE_FALSE_TRIGGER" 3 "DRIVER_STATUS_FAULT" 2 "UNDERVOLTAGE_FAULT" 1 "OVERVOLTAGE_FAULT" 0 "OK" ;
VAL_ 1332 VCFRONT_a520_SideMarkerStatus 2 "OVERCURRENT_FAULT" 1 "UNDERCURRENT_FAULT" 0 "OK" ;
VAL_ 1332 VCFRONT_a520_DRLStatus 6 "DRIVER_STATUS_FALSE_TRIGGER" 5 "UNDERVOLTAGE_FALSE_TRIGGER" 4 "OVERVOLTAGE_FALSE_TRIGGER" 3 "DRIVER_STATUS_FAULT" 2 "UNDERVOLTAGE_FAULT" 1 "OVERVOLTAGE_FAULT" 0 "OK" ;
VAL_ 1332 VCFRONT_a520_AmbientStatus 6 "DRIVER_STATUS_FALSE_TRIGGER" 5 "UNDERVOLTAGE_FALSE_TRIGGER" 4 "OVERVOLTAGE_FALSE_TRIGGER" 3 "DRIVER_STATUS_FAULT" 2 "UNDERVOLTAGE_FAULT" 1 "OVERVOLTAGE_FAULT" 0 "OK" ;
VAL_ 1332 VCFRONT_a520_LBFlatSAEStatus 6 "DRIVER_STATUS_FALSE_TRIGGER" 5 "UNDERVOLTAGE_FALSE_TRIGGER" 4 "OVERVOLTAGE_FALSE_TRIGGER" 3 "DRIVER_STATUS_FAULT" 2 "UNDERVOLTAGE_FAULT" 1 "OVERVOLTAGE_FAULT" 0 "OK" ;
VAL_ 1332 VCFRONT_a520_LBFlatECEStatus 6 "DRIVER_STATUS_FALSE_TRIGGER" 5 "UNDERVOLTAGE_FALSE_TRIGGER" 4 "OVERVOLTAGE_FALSE_TRIGGER" 3 "DRIVER_STATUS_FAULT" 2 "UNDERVOLTAGE_FAULT" 1 "OVERVOLTAGE_FAULT" 0 "OK" ;
VAL_ 1332 VCFRONT_a520_TPS92520_COMPOV 1 "FAULT" 0 "OK" ;
VAL_ 1332 VCFRONT_a520_TPS92520_HSILIM 1 "FAULT" 0 "OK" ;
VAL_ 1332 VCFRONT_a520_TPS92520_BSTUV 1 "FAULT" 0 "OK" ;
VAL_ 1332 VCFRONT_a520_CoolingFanStatus 1 "FAULT" 0 "OK" ;
VAL_ 1332 VCFRONT_a520_BoostRailStatus 1 "FAULT" 0 "OK" ;
VAL_ 1332 VCFRONT_a520_EEPROMCurrentBinSta 1 "FAULT" 0 "OK" ;
VAL_ 1332 VCFRONT_a520_EEPROMCalCurrentSta 1 "FAULT" 0 "OK" ;
VAL_ 1332 VCFRONT_a520_HeadlampECURevision 15 "RESERVED" 8 "GEN_5_REV_E" 7 "GEN_5_REV_D" 6 "GEN_5_REV_C" 5 "GEN_5_REV_A" 4 "GEN_3_REV_F" 3 "GEN_3_REV_E" 2 "GEN_3_REV_D" 1 "GEN_3_REV_C" 0 "UNKNOWN" ;
VAL_ 1332 VCFRONT_a520_NonzeroEEPROMRetrie 1 "FAULT" 0 "OK" ;
VAL_ 1332 VCFRONT_a520_MaxEEPROMRetries 1 "FAULT" 0 "OK" ;
VAL_ 1332 VCFRONT_a525_GTW_twelveVBatteryT 3 "TESLA_16V_LI_ION" 2 "CATL_LI_ION" 1 "CLARIOS_B24_FLOODED" 0 "ATLASBX_B24_FLOODED" ;
VAL_ 1332 VCFRONT_a525_newLVBatteryType 5 "TESLA_48V_LI_ION" 4 "TESLA_16V_LI_ION" 3 "CATL_LI_ION" 2 "CLARIOS_B24_FLOODED" 1 "ATLASBX_B24_FLOODED" 0 "UNKNOWN" ;
VAL_ 1332 VCFRONT_a525_initialLVBatteryTyp 5 "TESLA_48V_LI_ION" 4 "TESLA_16V_LI_ION" 3 "CATL_LI_ION" 2 "CLARIOS_B24_FLOODED" 1 "ATLASBX_B24_FLOODED" 0 "UNKNOWN" ;
VAL_ 1332 VCFRONT_a545_GTW_twelveVBatteryT 3 "TESLA_16V_LI_ION" 2 "CATL_LI_ION" 1 "CLARIOS_B24_FLOODED" 0 "ATLASBX_B24_FLOODED" ;
VAL_ 1332 VCFRONT_a545_newLVBatteryType 5 "TESLA_48V_LI_ION" 4 "TESLA_16V_LI_ION" 3 "CATL_LI_ION" 2 "CLARIOS_B24_FLOODED" 1 "ATLASBX_B24_FLOODED" 0 "UNKNOWN" ;
VAL_ 1332 VCFRONT_a548_vehiclePowerState 3 "DRIVE" 2 "ACCESSORY" 1 "CONDITIONING" 0 "OFF" ;
VAL_ 1332 VCFRONT_a548_DI_gear 7 "SNA" 4 "D" 3 "N" 2 "R" 1 "P" 0 "INVALID" ;
VAL_ 1332 VCFRONT_a548_hvState 6 "UP" 5 "UP_FOR_DC_CHARGE" 4 "UP_FOR_CHARGE" 3 "UP_FOR_DRIVE" 2 "GOING_DOWN" 1 "COMING_UP" 0 "DOWN" ;
VAL_ 1332 VCFRONT_a549_MatrixBank1Status 3 "UNRESPONSIVE" 2 "PIXEL_ERROR" 1 "CRC_ERROR" 0 "OK" ;
VAL_ 1332 VCFRONT_a549_SideMarkerStatus 6 "DRIVER_STATUS_FALSE_TRIGGER" 5 "UNDERVOLTAGE_FALSE_TRIGGER" 4 "OVERVOLTAGE_FALSE_TRIGGER" 3 "DRIVER_STATUS_FAULT" 2 "UNDERVOLTAGE_FAULT" 1 "OVERVOLTAGE_FAULT" 0 "OK" ;
VAL_ 1332 VCFRONT_a549_TurnSignalStatus 6 "DRIVER_STATUS_FALSE_TRIGGER" 5 "UNDERVOLTAGE_FALSE_TRIGGER" 4 "OVERVOLTAGE_FALSE_TRIGGER" 3 "DRIVER_STATUS_FAULT" 2 "UNDERVOLTAGE_FAULT" 1 "OVERVOLTAGE_FAULT" 0 "OK" ;
VAL_ 1332 VCFRONT_a549_DRL1Status 6 "DRIVER_STATUS_FALSE_TRIGGER" 5 "UNDERVOLTAGE_FALSE_TRIGGER" 4 "OVERVOLTAGE_FALSE_TRIGGER" 3 "DRIVER_STATUS_FAULT" 2 "UNDERVOLTAGE_FAULT" 1 "OVERVOLTAGE_FAULT" 0 "OK" ;
VAL_ 1332 VCFRONT_a549_DRL2Status 6 "DRIVER_STATUS_FALSE_TRIGGER" 5 "UNDERVOLTAGE_FALSE_TRIGGER" 4 "OVERVOLTAGE_FALSE_TRIGGER" 3 "DRIVER_STATUS_FAULT" 2 "UNDERVOLTAGE_FAULT" 1 "OVERVOLTAGE_FAULT" 0 "OK" ;
VAL_ 1332 VCFRONT_a549_DRL3Status 6 "DRIVER_STATUS_FALSE_TRIGGER" 5 "UNDERVOLTAGE_FALSE_TRIGGER" 4 "OVERVOLTAGE_FALSE_TRIGGER" 3 "DRIVER_STATUS_FAULT" 2 "UNDERVOLTAGE_FAULT" 1 "OVERVOLTAGE_FAULT" 0 "OK" ;
VAL_ 1332 VCFRONT_a549_LowBeamStatus 6 "DRIVER_STATUS_FALSE_TRIGGER" 5 "UNDERVOLTAGE_FALSE_TRIGGER" 4 "OVERVOLTAGE_FALSE_TRIGGER" 3 "DRIVER_STATUS_FAULT" 2 "UNDERVOLTAGE_FAULT" 1 "OVERVOLTAGE_FAULT" 0 "OK" ;
VAL_ 1332 VCFRONT_a549_TPS92520_COMPOV 1 "FAULT" 0 "OK" ;
VAL_ 1332 VCFRONT_a549_TPS92520_HSILIM 1 "FAULT" 0 "OK" ;
VAL_ 1332 VCFRONT_a549_TPS92520_BSTUV 1 "FAULT" 0 "OK" ;
VAL_ 1332 VCFRONT_a549_BoostRailStatus 1 "FAULT" 0 "OK" ;
VAL_ 1332 VCFRONT_a549_EEPROMDataStatus 1 "FAULT" 0 "OK" ;
VAL_ 1332 VCFRONT_a549_HeadlampECURevision 15 "RESERVED" 8 "GEN_5_REV_E" 7 "GEN_5_REV_D" 6 "GEN_5_REV_C" 5 "GEN_5_REV_A" 4 "GEN_3_REV_F" 3 "GEN_3_REV_E" 2 "GEN_3_REV_D" 1 "GEN_3_REV_C" 0 "UNKNOWN" ;
VAL_ 1332 VCFRONT_a552_vcrightSelfTestResu 12 "SNA" 11 "SKIPPED" 10 "FAILED_NOT_LATCHED" 9 "FAILED_TURN_OFF_PATH_TOO_SLOW" 8 "FAILED_ENABLE_HIGH_MALFUNCTION" 7 "FAILED_POWER_FET_CHANNEL_OPEN" 6 "FAILED_ENABLE_LOW_MALFUNCTION" 5 "FAILED_POWER_FET_STUCK_ON" 4 "FAILED_EFUSE_OUTPUT_SHORT" 3 "FAILED_RAILS_UNSTABLE" 2 "PASSED" 1 "RUNNING" 0 "NOT_RUN" ;
VAL_ 1332 VCFRONT_a552_epas3pSelfTestResul 12 "SNA" 11 "SKIPPED" 10 "FAILED_NOT_LATCHED" 9 "FAILED_TURN_OFF_PATH_TOO_SLOW" 8 "FAILED_ENABLE_HIGH_MALFUNCTION" 7 "FAILED_POWER_FET_CHANNEL_OPEN" 6 "FAILED_ENABLE_LOW_MALFUNCTION" 5 "FAILED_POWER_FET_STUCK_ON" 4 "FAILED_EFUSE_OUTPUT_SHORT" 3 "FAILED_RAILS_UNSTABLE" 2 "PASSED" 1 "RUNNING" 0 "NOT_RUN" ;
VAL_ 1332 VCFRONT_a552_epas3sSelfTestResul 12 "SNA" 11 "SKIPPED" 10 "FAILED_NOT_LATCHED" 9 "FAILED_TURN_OFF_PATH_TOO_SLOW" 8 "FAILED_ENABLE_HIGH_MALFUNCTION" 7 "FAILED_POWER_FET_CHANNEL_OPEN" 6 "FAILED_ENABLE_LOW_MALFUNCTION" 5 "FAILED_POWER_FET_STUCK_ON" 4 "FAILED_EFUSE_OUTPUT_SHORT" 3 "FAILED_RAILS_UNSTABLE" 2 "PASSED" 1 "RUNNING" 0 "NOT_RUN" ;
VAL_ 1332 VCFRONT_a557_MatrixBank1Status 3 "UNRESPONSIVE" 2 "PIXEL_ERROR" 1 "CRC_ERROR" 0 "OK" ;
VAL_ 1332 VCFRONT_a557_SideMarkerStatus 6 "DRIVER_STATUS_FALSE_TRIGGER" 5 "UNDERVOLTAGE_FALSE_TRIGGER" 4 "OVERVOLTAGE_FALSE_TRIGGER" 3 "DRIVER_STATUS_FAULT" 2 "UNDERVOLTAGE_FAULT" 1 "OVERVOLTAGE_FAULT" 0 "OK" ;
VAL_ 1332 VCFRONT_a557_TurnSignalStatus 6 "DRIVER_STATUS_FALSE_TRIGGER" 5 "UNDERVOLTAGE_FALSE_TRIGGER" 4 "OVERVOLTAGE_FALSE_TRIGGER" 3 "DRIVER_STATUS_FAULT" 2 "UNDERVOLTAGE_FAULT" 1 "OVERVOLTAGE_FAULT" 0 "OK" ;
VAL_ 1332 VCFRONT_a557_DRL1Status 6 "DRIVER_STATUS_FALSE_TRIGGER" 5 "UNDERVOLTAGE_FALSE_TRIGGER" 4 "OVERVOLTAGE_FALSE_TRIGGER" 3 "DRIVER_STATUS_FAULT" 2 "UNDERVOLTAGE_FAULT" 1 "OVERVOLTAGE_FAULT" 0 "OK" ;
VAL_ 1332 VCFRONT_a557_DRL2Status 6 "DRIVER_STATUS_FALSE_TRIGGER" 5 "UNDERVOLTAGE_FALSE_TRIGGER" 4 "OVERVOLTAGE_FALSE_TRIGGER" 3 "DRIVER_STATUS_FAULT" 2 "UNDERVOLTAGE_FAULT" 1 "OVERVOLTAGE_FAULT" 0 "OK" ;
VAL_ 1332 VCFRONT_a557_DRL3Status 6 "DRIVER_STATUS_FALSE_TRIGGER" 5 "UNDERVOLTAGE_FALSE_TRIGGER" 4 "OVERVOLTAGE_FALSE_TRIGGER" 3 "DRIVER_STATUS_FAULT" 2 "UNDERVOLTAGE_FAULT" 1 "OVERVOLTAGE_FAULT" 0 "OK" ;
VAL_ 1332 VCFRONT_a557_CenterStatus 6 "DRIVER_STATUS_FALSE_TRIGGER" 5 "UNDERVOLTAGE_FALSE_TRIGGER" 4 "OVERVOLTAGE_FALSE_TRIGGER" 3 "DRIVER_STATUS_FAULT" 2 "UNDERVOLTAGE_FAULT" 1 "OVERVOLTAGE_FAULT" 0 "OK" ;
VAL_ 1332 VCFRONT_a557_LowBeamStatus 6 "DRIVER_STATUS_FALSE_TRIGGER" 5 "UNDERVOLTAGE_FALSE_TRIGGER" 4 "OVERVOLTAGE_FALSE_TRIGGER" 3 "DRIVER_STATUS_FAULT" 2 "UNDERVOLTAGE_FAULT" 1 "OVERVOLTAGE_FAULT" 0 "OK" ;
VAL_ 1332 VCFRONT_a557_TPS92520_COMPOV 1 "FAULT" 0 "OK" ;
VAL_ 1332 VCFRONT_a557_TPS92520_HSILIM 1 "FAULT" 0 "OK" ;
VAL_ 1332 VCFRONT_a557_TPS92520_BSTUV 1 "FAULT" 0 "OK" ;
VAL_ 1332 VCFRONT_a557_BoostRailStatus 1 "FAULT" 0 "OK" ;
VAL_ 1332 VCFRONT_a557_EEPROMDataStatus 1 "FAULT" 0 "OK" ;
VAL_ 1332 VCFRONT_a557_HeadlampECURevision 15 "RESERVED" 8 "GEN_5_REV_E" 7 "GEN_5_REV_D" 6 "GEN_5_REV_C" 5 "GEN_5_REV_A" 4 "GEN_3_REV_F" 3 "GEN_3_REV_E" 2 "GEN_3_REV_D" 1 "GEN_3_REV_C" 0 "UNKNOWN" ;
VAL_ 1332 VCFRONT_a559_vehiclePowerState 3 "DRIVE" 2 "ACCESSORY" 1 "CONDITIONING" 0 "OFF" ;
VAL_ 1332 VCFRONT_a559_batterySMState 10 "EXTERNAL_LV_BUS_CONTROL" 9 "RECOVERY" 8 "FAULT" 7 "SHORTED_CELL_TEST" 6 "DISCONNECTED_BATTERY_TEST" 5 "OTA_STANDBY" 4 "RESISTANCE_ESTIMATION" 3 "STANDBY" 2 "DISCHARGE" 1 "CHARGE" 0 "INIT" ;
VAL_ 1332 VCFRONT_a559_bmsState 10 "DIAG" 9 "SNA" 8 "TEST" 7 "WELD" 6 "FAULT" 5 "CLEAR_FAULT" 4 "FEIM" 3 "CHARGE" 2 "SUPPORT" 1 "DRIVE" 0 "STANDBY" ;
VAL_ 1332 VCFRONT_a559_dcdcLVSupportStatus 2 "FAULTED" 1 "ACTIVE" 0 "IDLE" ;
VAL_ 1332 VCFRONT_a582_batterySMState 10 "EXTERNAL_LV_BUS_CONTROL" 9 "RECOVERY" 8 "FAULT" 7 "SHORTED_CELL_TEST" 6 "DISCONNECTED_BATTERY_TEST" 5 "OTA_STANDBY" 4 "RESISTANCE_ESTIMATION" 3 "STANDBY" 2 "DISCHARGE" 1 "CHARGE" 0 "INIT" ;
VAL_ 1332 VCFRONT_a582_LVBusVoltageSource 3 "LVBMS" 2 "VBAT_MONITOR" 1 "IBS" 0 "NONE" ;
VAL_ 1332 VCFRONT_a582_batteryType 5 "TESLA_48V_LI_ION" 4 "TESLA_16V_LI_ION" 3 "CATL_LI_ION" 2 "CLARIOS_B24_FLOODED" 1 "ATLASBX_B24_FLOODED" 0 "UNKNOWN" ;
VAL_ 1332 VCFRONT_a592_vcleftCutoffEFuseCu 1 "DYNAMIC_EFUSE_CURVE" 0 "STATIC_EFUSE_CURVE" ;
VAL_ 1332 VCFRONT_a592_vcleftCutoffATerm 65535 "SNA" ;
VAL_ 1332 VCFRONT_a592_vcleftCutoffBTerm -128 "SNA" ;
VAL_ 1332 VCFRONT_a592_vcleftCutoffCTerm -32768 "SNA" ;
VAL_ 1332 VCFRONT_a593_vcleftCutoffEFuseFa 1 "DEBOUNCE" 0 "TIMING" ;
VAL_ 1332 VCFRONT_a596_vcrightCutoffEFuseC 1 "DYNAMIC_EFUSE_CURVE" 0 "STATIC_EFUSE_CURVE" ;
VAL_ 1332 VCFRONT_a596_vcrightCutoffATerm 65535 "SNA" ;
VAL_ 1332 VCFRONT_a596_vcrightCutoffBTerm -128 "SNA" ;
VAL_ 1332 VCFRONT_a596_vcrightCutoffCTerm -32768 "SNA" ;
VAL_ 1332 VCFRONT_a597_vcrightCutoffEFuseF 1 "DEBOUNCE" 0 "TIMING" ;
VAL_ 1332 VCFRONT_a598_vcleftSelfTestResul 12 "SNA" 11 "SKIPPED" 10 "FAILED_NOT_LATCHED" 9 "FAILED_TURN_OFF_PATH_TOO_SLOW" 8 "FAILED_ENABLE_HIGH_MALFUNCTION" 7 "FAILED_POWER_FET_CHANNEL_OPEN" 6 "FAILED_ENABLE_LOW_MALFUNCTION" 5 "FAILED_POWER_FET_STUCK_ON" 4 "FAILED_EFUSE_OUTPUT_SHORT" 3 "FAILED_RAILS_UNSTABLE" 2 "PASSED" 1 "RUNNING" 0 "NOT_RUN" ;
VAL_ 1332 VCFRONT_a599_GTW_twelveVBatteryT 3 "TESLA_16V_LI_ION" 2 "CATL_LI_ION" 1 "CLARIOS_B24_FLOODED" 0 "ATLASBX_B24_FLOODED" ;
VAL_ 1332 VCFRONT_a599_newLVBatteryType 5 "TESLA_48V_LI_ION" 4 "TESLA_16V_LI_ION" 3 "CATL_LI_ION" 2 "CLARIOS_B24_FLOODED" 1 "ATLASBX_B24_FLOODED" 0 "UNKNOWN" ;
VAL_ 1332 VCFRONT_a599_initialLVBatteryTyp 5 "TESLA_48V_LI_ION" 4 "TESLA_16V_LI_ION" 3 "CATL_LI_ION" 2 "CLARIOS_B24_FLOODED" 1 "ATLASBX_B24_FLOODED" 0 "UNKNOWN" ;
VAL_ 1332 VCFRONT_a610_switch1State 3 "FAULT" 2 "ON" 1 "OFF" 0 "SNA" ;
VAL_ 1332 VCFRONT_a610_switch2State 3 "FAULT" 2 "ON" 1 "OFF" 0 "SNA" ;
VAL_ 1332 VCFRONT_a610_temperature 0 "SNA" ;
VAL_ 1332 VCFRONT_a612_DI_gear 7 "SNA" 4 "D" 3 "N" 2 "R" 1 "P" 0 "INVALID" ;
VAL_ 1332 VCFRONT_a612_lvHealthStatus 3 "POWER_SUPPLY_COMPROMISED" 2 "ENERGY_RESERVE_CRITICAL" 1 "BACKUP_COMPROMISED" 0 "DOMAIN_HEALTHY" ;
VAL_ 1332 VCFRONT_a620_powertrainPumpRpm 255 "SNA" ;
VAL_ 1332 VCFRONT_a620_powertrainPumpIPhas 255 "SNA" ;
VAL_ 1332 VCFRONT_a620_powertrainPump_0001 127 "SNA" ;
VAL_ 1332 VCFRONT_a620_chillerPumpRpm 255 "SNA" ;
VAL_ 1332 VCFRONT_a620_chillerPumpIPhaseFi 255 "SNA" ;
VAL_ 1332 VCFRONT_a620_chillerPumpIPhaseMi 127 "SNA" ;
VAL_ 1332 VCFRONT_a622_coolantMode 3 "AMBIENT_SOURCE" 2 "BLEND" 1 "PARALLEL" 0 "SERIES" ;
VAL_ 1332 VCFRONT_a623_DI_gear 7 "SNA" 4 "D" 3 "N" 2 "R" 1 "P" 0 "INVALID" ;
VAL_ 1332 VCFRONT_a623_lvHealthStatus 3 "POWER_SUPPLY_COMPROMISED" 2 "ENERGY_RESERVE_CRITICAL" 1 "BACKUP_COMPROMISED" 0 "DOMAIN_HEALTHY" ;
VAL_ 1332 VCFRONT_a623_unhealthyReason 16 "LV_BATTERY_IMPEDANCE" 15 "LV_BATTERY_CONFIGURATION" 14 "LV_BATTERY_ENERGY_ACTIVE_DECEL" 13 "LV_BATTERY_ENERGY_CRITICAL_PULLOVER" 12 "REVERSE_BATTERY_EFUSE_OFF" 11 "LVBMB_EFUSE_OPEN" 10 "LV_BATTERY_COMMS" 9 "LV_BATTERY_SENSOR_IBS_MIA" 8 "LV_BATTERY_ELECTRICAL_CONNECTION" 7 "LV_BATTERY_ELECTRICAL_CONNECTION_UNKNOWN" 6 "PCS_EFUSE_OFF" 5 "PCS_NOT_ACTIVE" 4 "PCS_MIA" 3 "PCS_OPEN_CIRCUIT" 2 "LV_BATTERY_POWER_ACTIVE_DECEL" 1 "LV_BATTERY_CAPABILITY_LOW_ACCURACY" 0 "UNKNOWN" ;
VAL_ 1332 VCFRONT_a624_HighBeam_OV 1 "FAULT" 0 "OK" ;
VAL_ 1332 VCFRONT_a624_HighBeam_UV 1 "FAULT" 0 "OK" ;
VAL_ 1332 VCFRONT_a624_HighBeam_short 1 "FAULT" 0 "OK" ;
VAL_ 1332 VCFRONT_a624_HighBeam_compov 1 "FAULT" 0 "OK" ;
VAL_ 1332 VCFRONT_a624_HighBeam_bootuv 1 "FAULT" 0 "OK" ;
VAL_ 1332 VCFRONT_a624_HighBeam_binStatus 1 "FAULT" 0 "OK" ;
VAL_ 1332 VCFRONT_a624_LowBeam_OV 1 "FAULT" 0 "OK" ;
VAL_ 1332 VCFRONT_a624_LowBeam_UV 1 "FAULT" 0 "OK" ;
VAL_ 1332 VCFRONT_a624_LowBeam_short 1 "FAULT" 0 "OK" ;
VAL_ 1332 VCFRONT_a624_LowBeam_compov 1 "FAULT" 0 "OK" ;
VAL_ 1332 VCFRONT_a624_LowBeam_bootuv 1 "FAULT" 0 "OK" ;
VAL_ 1332 VCFRONT_a624_LowBeam_binStatus 1 "FAULT" 0 "OK" ;
VAL_ 1332 VCFRONT_a624_DRL_OV 1 "FAULT" 0 "OK" ;
VAL_ 1332 VCFRONT_a624_DRL_UV 1 "FAULT" 0 "OK" ;
VAL_ 1332 VCFRONT_a624_DRL_short 1 "FAULT" 0 "OK" ;
VAL_ 1332 VCFRONT_a624_DRL_compov 1 "FAULT" 0 "OK" ;
VAL_ 1332 VCFRONT_a624_DRL_bootuv 1 "FAULT" 0 "OK" ;
VAL_ 1332 VCFRONT_a624_DRL_binStatus 1 "FAULT" 0 "OK" ;
VAL_ 1332 VCFRONT_a624_TurnSignal_OV 1 "FAULT" 0 "OK" ;
VAL_ 1332 VCFRONT_a624_TurnSignal_UV 1 "FAULT" 0 "OK" ;
VAL_ 1332 VCFRONT_a624_TurnSignal_short 1 "FAULT" 0 "OK" ;
VAL_ 1332 VCFRONT_a624_TurnSignal_compov 1 "FAULT" 0 "OK" ;
VAL_ 1332 VCFRONT_a624_TurnSignal_bootuv 1 "FAULT" 0 "OK" ;
VAL_ 1332 VCFRONT_a624_TurnSignal_binStatu 1 "FAULT" 0 "OK" ;
VAL_ 1332 VCFRONT_a624_SideMarker_OV 1 "FAULT" 0 "OK" ;
VAL_ 1332 VCFRONT_a624_SideMarker_UV 1 "FAULT" 0 "OK" ;
VAL_ 1332 VCFRONT_a624_SideMarker_short 1 "FAULT" 0 "OK" ;
VAL_ 1332 VCFRONT_a624_SideMarker_compov 1 "FAULT" 0 "OK" ;
VAL_ 1332 VCFRONT_a624_SideMarker_bootuv 1 "FAULT" 0 "OK" ;
VAL_ 1332 VCFRONT_a624_SideMarker_binStatu 1 "FAULT" 0 "OK" ;
VAL_ 1332 VCFRONT_a624_boost_OV 1 "FAULT" 0 "OK" ;
VAL_ 1332 VCFRONT_a624_boost_BOOTUV 1 "FAULT" 0 "OK" ;
VAL_ 1332 VCFRONT_a624_boost_ILIM 1 "FAULT" 0 "OK" ;
VAL_ 1332 VCFRONT_a624_boost_ISPUV 1 "FAULT" 0 "OK" ;
VAL_ 1332 VCFRONT_a624_EEPROM_status 1 "FAULT" 0 "OK" ;
VAL_ 1332 VCFRONT_a624_EEPROM_region 6 "ECE_RHD_RIGHT" 5 "ECE_RHD_LEFT" 4 "ECE_LHD_RIGHT" 3 "ECE_LHD_LEFT" 2 "SAE_RIGHT" 1 "SAE_LEFT" 0 "SNA" ;
VAL_ 1332 VCFRONT_a625_HighBeam_OV 1 "FAULT" 0 "OK" ;
VAL_ 1332 VCFRONT_a625_HighBeam_UV 1 "FAULT" 0 "OK" ;
VAL_ 1332 VCFRONT_a625_HighBeam_short 1 "FAULT" 0 "OK" ;
VAL_ 1332 VCFRONT_a625_HighBeam_compov 1 "FAULT" 0 "OK" ;
VAL_ 1332 VCFRONT_a625_HighBeam_bootuv 1 "FAULT" 0 "OK" ;
VAL_ 1332 VCFRONT_a625_HighBeam_binStatus 1 "FAULT" 0 "OK" ;
VAL_ 1332 VCFRONT_a625_LowBeam_OV 1 "FAULT" 0 "OK" ;
VAL_ 1332 VCFRONT_a625_LowBeam_UV 1 "FAULT" 0 "OK" ;
VAL_ 1332 VCFRONT_a625_LowBeam_short 1 "FAULT" 0 "OK" ;
VAL_ 1332 VCFRONT_a625_LowBeam_compov 1 "FAULT" 0 "OK" ;
VAL_ 1332 VCFRONT_a625_LowBeam_bootuv 1 "FAULT" 0 "OK" ;
VAL_ 1332 VCFRONT_a625_LowBeam_binStatus 1 "FAULT" 0 "OK" ;
VAL_ 1332 VCFRONT_a625_DRL_OV 1 "FAULT" 0 "OK" ;
VAL_ 1332 VCFRONT_a625_DRL_UV 1 "FAULT" 0 "OK" ;
VAL_ 1332 VCFRONT_a625_DRL_short 1 "FAULT" 0 "OK" ;
VAL_ 1332 VCFRONT_a625_DRL_compov 1 "FAULT" 0 "OK" ;
VAL_ 1332 VCFRONT_a625_DRL_bootuv 1 "FAULT" 0 "OK" ;
VAL_ 1332 VCFRONT_a625_DRL_binStatus 1 "FAULT" 0 "OK" ;
VAL_ 1332 VCFRONT_a625_TurnSignal_OV 1 "FAULT" 0 "OK" ;
VAL_ 1332 VCFRONT_a625_TurnSignal_UV 1 "FAULT" 0 "OK" ;
VAL_ 1332 VCFRONT_a625_TurnSignal_short 1 "FAULT" 0 "OK" ;
VAL_ 1332 VCFRONT_a625_TurnSignal_compov 1 "FAULT" 0 "OK" ;
VAL_ 1332 VCFRONT_a625_TurnSignal_bootuv 1 "FAULT" 0 "OK" ;
VAL_ 1332 VCFRONT_a625_TurnSignal_binStatu 1 "FAULT" 0 "OK" ;
VAL_ 1332 VCFRONT_a625_SideMarker_OV 1 "FAULT" 0 "OK" ;
VAL_ 1332 VCFRONT_a625_SideMarker_UV 1 "FAULT" 0 "OK" ;
VAL_ 1332 VCFRONT_a625_SideMarker_short 1 "FAULT" 0 "OK" ;
VAL_ 1332 VCFRONT_a625_SideMarker_compov 1 "FAULT" 0 "OK" ;
VAL_ 1332 VCFRONT_a625_SideMarker_bootuv 1 "FAULT" 0 "OK" ;
VAL_ 1332 VCFRONT_a625_SideMarker_binStatu 1 "FAULT" 0 "OK" ;
VAL_ 1332 VCFRONT_a625_boost_OV 1 "FAULT" 0 "OK" ;
VAL_ 1332 VCFRONT_a625_boost_BOOTUV 1 "FAULT" 0 "OK" ;
VAL_ 1332 VCFRONT_a625_boost_ILIM 1 "FAULT" 0 "OK" ;
VAL_ 1332 VCFRONT_a625_boost_ISPUV 1 "FAULT" 0 "OK" ;
VAL_ 1332 VCFRONT_a625_EEPROM_status 1 "FAULT" 0 "OK" ;
VAL_ 1332 VCFRONT_a625_EEPROM_region 6 "ECE_RHD_RIGHT" 5 "ECE_RHD_LEFT" 4 "ECE_LHD_RIGHT" 3 "ECE_LHD_LEFT" 2 "SAE_RIGHT" 1 "SAE_LEFT" 0 "SNA" ;
