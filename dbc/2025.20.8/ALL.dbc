VERSION "dbc-export 1 2025.20.8"

NS_ :

BS_:

BU_: ADSP APB APP APS APSB BB BMS CC CMP CMPD CP DAS DI DIF DIR DPB EPAS3P EPAS3S EPASTP EPASTS EPBL EPBR ESP EVSE FC GTW HCML HCMR HVP IBST ICR IDB LS OCS1P PARK PCS PM PMF PMR PNCD PTC RADC RCM RCM2 RCM3 RCU SCCM SCM SCS SDCR TAS TCU TPMS TRCM UI UIS UMC USM VC VCFRONT VCLEFT VCRIGHT VCSEC VEH

BO_ 2011 VCRIGHT_alertLog: 8 VCRIGHT
 SG_ VCRIGHT_alertID M : 0|10@1+ (1,0) [0|1023] "" Vector__XXX
 SG_ VCRIGHT_a248_seatHeatTmpTarget m248 : 40|8@1- (0.5,0) [-64|63.5] "" Vector__XXX
 SG_ VCRIGHT_a249_seatHeatCurrent m249 : 16|12@1+ (0.01,0) [0|40.95] "" Vector__XXX
 SG_ VCRIGHT_a249_seatHeatTmp m249 : 28|12@1- (0.05,0) [-102.4|102.35] "" Vector__XXX
 SG_ VCRIGHT_a250_seatHeatCurrent m250 : 16|12@1+ (0.01,0) [0|40.95] "" Vector__XXX
 SG_ VCRIGHT_a250_seatHeatTmp m250 : 28|12@1- (0.05,0) [-102.4|102.35] "" Vector__XXX
 SG_ VCRIGHT_a250_cushion m250 : 40|1@1+ (1,0) [0|1] "" Vector__XXX
 SG_ VCRIGHT_a250_backrest m250 : 41|1@1+ (1,0) [0|1] "" Vector__XXX
 SG_ VCRIGHT_a251_seatMotorCurrent m251 : 16|12@1- (0.01,0) [-20.48|20.47] "" Vector__XXX
 SG_ VCRIGHT_a251_seatMotorPosReal m251 : 28|12@1- (1,0) [-2048|2047] "" Vector__XXX
 SG_ VCRIGHT_a251_seatMotorState m251 : 40|3@1+ (1,0) [0|7] "" Vector__XXX
 SG_ VCRIGHT_a251_seatSwitchBack m251 : 43|2@1+ (1,0) [0|3] "" Vector__XXX
 SG_ VCRIGHT_a251_seatSwitchForward m251 : 45|2@1+ (1,0) [0|3] "" Vector__XXX
 SG_ VCRIGHT_a252_seatMotorCurrent m252 : 16|12@1- (0.01,0) [-20.48|20.47] "" Vector__XXX
 SG_ VCRIGHT_a252_seatMotorPosReal m252 : 28|12@1- (1,0) [-2048|2047] "" Vector__XXX
 SG_ VCRIGHT_a252_seatMotorState m252 : 40|3@1+ (1,0) [0|7] "" Vector__XXX
 SG_ VCRIGHT_a252_seatSwitchBack m252 : 43|2@1+ (1,0) [0|3] "" Vector__XXX
 SG_ VCRIGHT_a252_seatSwitchForward m252 : 45|2@1+ (1,0) [0|3] "" Vector__XXX
 SG_ VCRIGHT_a253_seatMotorCurrent m253 : 16|12@1- (0.01,0) [-20.48|20.47] "" Vector__XXX
 SG_ VCRIGHT_a253_seatMotorPosReal m253 : 28|12@1- (1,0) [-2048|2047] "" Vector__XXX
 SG_ VCRIGHT_a253_seatMotorState m253 : 40|3@1+ (1,0) [0|7] "" Vector__XXX
 SG_ VCRIGHT_a253_seatSwitchBack m253 : 43|2@1+ (1,0) [0|3] "" Vector__XXX
 SG_ VCRIGHT_a253_seatSwitchForward m253 : 45|2@1+ (1,0) [0|3] "" Vector__XXX
 SG_ VCRIGHT_a254_seatMotorCurrent m254 : 16|12@1- (0.01,0) [-20.48|20.47] "" Vector__XXX
 SG_ VCRIGHT_a254_seatMotorPosReal m254 : 28|12@1- (1,0) [-2048|2047] "" Vector__XXX
 SG_ VCRIGHT_a254_seatMotorState m254 : 40|3@1+ (1,0) [0|7] "" Vector__XXX
 SG_ VCRIGHT_a254_seatSwitchBack m254 : 43|2@1+ (1,0) [0|3] "" Vector__XXX
 SG_ VCRIGHT_a254_seatSwitchForward m254 : 45|2@1+ (1,0) [0|3] "" Vector__XXX
 SG_ VCRIGHT_a255_leftIGBTTemp m255 : 16|8@1- (1,80) [-48|207] "" Vector__XXX
 SG_ VCRIGHT_a255_rightIGBTTemp m255 : 24|8@1- (1,80) [-48|207] "" Vector__XXX
 SG_ VCRIGHT_a255_OCPTemp m255 : 32|8@1- (1,80) [-48|207] "" Vector__XXX
 SG_ VCRIGHT_a255_PCBTemp m255 : 40|8@1- (1,80) [-48|207] "" Vector__XXX
 SG_ VCRIGHT_a256_leftCurrent m256 : 16|8@1+ (0.2,0) [0|51] "" Vector__XXX
 SG_ VCRIGHT_a256_rightCurrent m256 : 24|8@1+ (0.2,0) [0|51] "" Vector__XXX
 SG_ VCRIGHT_a257_MIAStatus m257 : 16|1@1+ (1,0) [0|1] "" Vector__XXX
 SG_ VCRIGHT_a258_bootIdFreq m258 : 16|8@1+ (0.02,0) [0|5.1] "" Vector__XXX
 SG_ VCRIGHT_a262_LVLow m262 : 16|1@1+ (1,0) [0|1] "" Vector__XXX
 SG_ VCRIGHT_a262_LVHigh m262 : 17|1@1+ (1,0) [0|1] "" Vector__XXX
 SG_ VCRIGHT_a262_HVLow m262 : 18|1@1+ (1,0) [0|1] "" Vector__XXX
 SG_ VCRIGHT_a262_HVHigh m262 : 19|1@1+ (1,0) [0|1] "" Vector__XXX
 SG_ VCRIGHT_a262_LeftOverCurrent m262 : 20|1@1+ (1,0) [0|1] "" Vector__XXX
 SG_ VCRIGHT_a262_RightOverCurrent m262 : 21|1@1+ (1,0) [0|1] "" Vector__XXX
 SG_ VCRIGHT_a262_LeftShutOutlet m262 : 22|1@1+ (1,0) [0|1] "" Vector__XXX
 SG_ VCRIGHT_a262_RightShutOutlet m262 : 23|1@1+ (1,0) [0|1] "" Vector__XXX
 SG_ VCRIGHT_a262_ThermalShutPCB m262 : 24|1@1+ (1,0) [0|1] "" Vector__XXX
 SG_ VCRIGHT_a262_LeftThermalShutIGBT m262 : 25|1@1+ (1,0) [0|1] "" Vector__XXX
 SG_ VCRIGHT_a262_RightThermalShutIGB m262 : 26|1@1+ (1,0) [0|1] "" Vector__XXX
 SG_ VCRIGHT_a262_CANTimeout m262 : 27|1@1+ (1,0) [0|1] "" Vector__XXX
 SG_ VCRIGHT_a262_LowVoltageSensor m262 : 28|1@1+ (1,0) [0|1] "" Vector__XXX
 SG_ VCRIGHT_a262_HighVoltageSensor m262 : 29|1@1+ (1,0) [0|1] "" Vector__XXX
 SG_ VCRIGHT_a262_LeftCurrentHVSensor m262 : 30|1@1+ (1,0) [0|1] "" Vector__XXX
 SG_ VCRIGHT_a262_RightCurrentHVSenso m262 : 31|1@1+ (1,0) [0|1] "" Vector__XXX
 SG_ VCRIGHT_a262_LeftTempIGBT m262 : 32|1@1+ (1,0) [0|1] "" Vector__XXX
 SG_ VCRIGHT_a262_TempOCP m262 : 33|1@1+ (1,0) [0|1] "" Vector__XXX
 SG_ VCRIGHT_a262_RightTempIGBT m262 : 34|1@1+ (1,0) [0|1] "" Vector__XXX
 SG_ VCRIGHT_a262_TempPCB m262 : 35|1@1+ (1,0) [0|1] "" Vector__XXX
 SG_ VCRIGHT_a262_LeftIGBTShort m262 : 36|1@1+ (1,0) [0|1] "" Vector__XXX
 SG_ VCRIGHT_a262_RightIGBTShort m262 : 37|1@1+ (1,0) [0|1] "" Vector__XXX
 SG_ VCRIGHT_a262_IGBTDriverTemporary m262 : 38|1@1+ (1,0) [0|1] "" Vector__XXX
 SG_ VCRIGHT_a262_IGBTDriverPermanent m262 : 39|1@1+ (1,0) [0|1] "" Vector__XXX
 SG_ VCRIGHT_a262_LeftIGBTOpen m262 : 40|1@1+ (1,0) [0|1] "" Vector__XXX
 SG_ VCRIGHT_a262_RightIGBTOpen m262 : 41|1@1+ (1,0) [0|1] "" Vector__XXX
 SG_ VCRIGHT_a263_seatMotorCurrent m263 : 16|12@1- (0.01,0) [-20.48|20.47] "" Vector__XXX
 SG_ VCRIGHT_a263_seatMotorDCurrent m263 : 28|12@1- (0.01,0) [-20.48|20.47] "" Vector__XXX
 SG_ VCRIGHT_a263_seatMotorPosReal m263 : 40|12@1- (1,0) [-2048|2047] "" Vector__XXX
 SG_ VCRIGHT_a263_seatMotorState m263 : 52|3@1+ (1,0) [0|7] "" Vector__XXX
 SG_ VCRIGHT_a264_seatMotorCurrent m264 : 16|12@1- (0.01,0) [-20.48|20.47] "" Vector__XXX
 SG_ VCRIGHT_a264_seatMotorDCurrent m264 : 28|12@1- (0.01,0) [-20.48|20.47] "" Vector__XXX
 SG_ VCRIGHT_a264_seatMotorPosReal m264 : 40|12@1- (1,0) [-2048|2047] "" Vector__XXX
 SG_ VCRIGHT_a264_seatMotorState m264 : 52|3@1+ (1,0) [0|7] "" Vector__XXX
 SG_ VCRIGHT_a265_seatMotorCurrent m265 : 16|12@1- (0.01,0) [-20.48|20.47] "" Vector__XXX
 SG_ VCRIGHT_a265_seatMotorDCurrent m265 : 28|12@1- (0.01,0) [-20.48|20.47] "" Vector__XXX
 SG_ VCRIGHT_a265_seatMotorPosReal m265 : 40|12@1- (1,0) [-2048|2047] "" Vector__XXX
 SG_ VCRIGHT_a265_seatMotorState m265 : 52|3@1+ (1,0) [0|7] "" Vector__XXX
 SG_ VCRIGHT_a266_seatMotorCurrent m266 : 16|12@1- (0.01,0) [-20.48|20.47] "" Vector__XXX
 SG_ VCRIGHT_a266_seatMotorDCurrent m266 : 28|12@1- (0.01,0) [-20.48|20.47] "" Vector__XXX
 SG_ VCRIGHT_a266_seatMotorPosReal m266 : 40|12@1- (1,0) [-2048|2047] "" Vector__XXX
 SG_ VCRIGHT_a266_seatMotorState m266 : 52|3@1+ (1,0) [0|7] "" Vector__XXX
 SG_ VCRIGHT_a267_seatMotorCurrent m267 : 16|12@1- (0.01,0) [-20.48|20.47] "" Vector__XXX
 SG_ VCRIGHT_a267_seatMotorDCurrent m267 : 28|12@1- (0.01,0) [-20.48|20.47] "" Vector__XXX
 SG_ VCRIGHT_a267_seatMotorPosReal m267 : 40|12@1- (1,0) [-2048|2047] "" Vector__XXX
 SG_ VCRIGHT_a267_seatMotorState m267 : 52|3@1+ (1,0) [0|7] "" Vector__XXX
 SG_ VCRIGHT_a268_seatMotorCurrent m268 : 16|12@1- (0.01,0) [-20.48|20.47] "" Vector__XXX
 SG_ VCRIGHT_a268_seatMotorDCurrent m268 : 28|12@1- (0.01,0) [-20.48|20.47] "" Vector__XXX
 SG_ VCRIGHT_a268_seatMotorPosReal m268 : 40|12@1- (1,0) [-2048|2047] "" Vector__XXX
 SG_ VCRIGHT_a268_seatMotorState m268 : 52|3@1+ (1,0) [0|7] "" Vector__XXX
 SG_ VCRIGHT_a269_seatMotorCurrent m269 : 16|12@1- (0.01,0) [-20.48|20.47] "" Vector__XXX
 SG_ VCRIGHT_a269_seatMotorDCurrent m269 : 28|12@1- (0.01,0) [-20.48|20.47] "" Vector__XXX
 SG_ VCRIGHT_a269_seatMotorPosReal m269 : 40|12@1- (1,0) [-2048|2047] "" Vector__XXX
 SG_ VCRIGHT_a269_seatMotorState m269 : 52|3@1+ (1,0) [0|7] "" Vector__XXX
 SG_ VCRIGHT_a270_seatMotorCurrent m270 : 16|12@1- (0.01,0) [-20.48|20.47] "" Vector__XXX
 SG_ VCRIGHT_a270_seatMotorDCurrent m270 : 28|12@1- (0.01,0) [-20.48|20.47] "" Vector__XXX
 SG_ VCRIGHT_a270_seatMotorPosReal m270 : 40|12@1- (1,0) [-2048|2047] "" Vector__XXX
 SG_ VCRIGHT_a270_seatMotorState m270 : 52|3@1+ (1,0) [0|7] "" Vector__XXX
 SG_ VCRIGHT_a271_humiditySensorSNA m271 : 16|1@1+ (1,0) [0|1] "" Vector__XXX
 SG_ VCRIGHT_a271_temperatureSensorSN m271 : 17|1@1+ (1,0) [0|1] "" Vector__XXX
 SG_ VCRIGHT_a271_solarVisSensorSNA m271 : 18|1@1+ (1,0) [0|1] "" Vector__XXX
 SG_ VCRIGHT_a271_solarInfSensorSNA m271 : 19|1@1+ (1,0) [0|1] "" Vector__XXX
 SG_ VCRIGHT_a273_handlePWM m273 : 16|7@1+ (1,0) [0|127] "" Vector__XXX
 SG_ VCRIGHT_a273_temperature m273 : 24|8@1+ (0.5,-40) [-40|87.5] "" Vector__XXX
 SG_ VCRIGHT_a274_handlePWM m274 : 16|7@1+ (1,0) [0|127] "" Vector__XXX
 SG_ VCRIGHT_a274_temperature m274 : 24|8@1+ (0.5,-40) [-40|87.5] "" Vector__XXX
 SG_ VCRIGHT_a275_outputFaulted m275 : 16|1@1+ (1,0) [0|1] "" Vector__XXX
 SG_ VCRIGHT_a275_currentSenseFaulted m275 : 17|1@1+ (1,0) [0|1] "" Vector__XXX
 SG_ VCRIGHT_a275_tempSenseFaulted m275 : 18|1@1+ (1,0) [0|1] "" Vector__XXX
 SG_ VCRIGHT_a275_underCurrent m275 : 19|1@1+ (1,0) [0|1] "" Vector__XXX
 SG_ VCRIGHT_a275_overCurrent m275 : 20|1@1+ (1,0) [0|1] "" Vector__XXX
 SG_ VCRIGHT_a275_overTemperature m275 : 21|1@1+ (1,0) [0|1] "" Vector__XXX
 SG_ VCRIGHT_a278_HVLow m278 : 16|1@1+ (1,0) [0|1] "" Vector__XXX
 SG_ VCRIGHT_a278_PTCMIA m278 : 17|1@1+ (1,0) [0|1] "" Vector__XXX
 SG_ VCRIGHT_a284_gloveboxMinCurrent m284 : 16|8@1+ (0.1,0) [0|25.5] "" Vector__XXX
 SG_ VCRIGHT_a284_gloveboxMaxCurrent m284 : 24|8@1+ (0.1,0) [0|25.5] "" Vector__XXX
 SG_ VCRIGHT_a284_cabinTempInterior m284 : 32|8@1+ (0.5,-40) [-40|87.5] "" Vector__XXX
 SG_ VCRIGHT_a285_gloveboxMinCurrent m285 : 16|8@1+ (0.1,0) [0|25.5] "" Vector__XXX
 SG_ VCRIGHT_a285_gloveboxMaxCurrent m285 : 24|8@1+ (0.1,0) [0|25.5] "" Vector__XXX
 SG_ VCRIGHT_a285_cabinTempInterior m285 : 32|8@1+ (0.5,-40) [-40|87.5] "" Vector__XXX
 SG_ VCRIGHT_a290_isNetworkSwitch m290 : 16|1@1+ (1,0) [0|1] "" Vector__XXX
 SG_ VCRIGHT_a290_occupancySensorV m290 : 17|12@1- (0.01,0) [-20.48|20.47] "" Vector__XXX
 SG_ VCRIGHT_a290_railVoltage m290 : 32|12@1- (0.01,0) [-20.48|20.47] "" Vector__XXX
 SG_ VCRIGHT_a291_buckleSensorVoltage m291 : 16|12@1+ (0.01,0) [0|40.95] "" Vector__XXX
 SG_ VCRIGHT_a291_railVoltage m291 : 28|12@1+ (0.01,0) [0|40.95] "" Vector__XXX
 SG_ VCRIGHT_a292_buckleSensorVoltage m292 : 16|12@1- (0.01,0) [-20.48|20.47] "" Vector__XXX
 SG_ VCRIGHT_a292_railV m292 : 28|12@1- (0.01,0) [-20.48|20.47] "" Vector__XXX
 SG_ VCRIGHT_a293_buckleSensorVoltage m293 : 16|12@1- (0.01,0) [-20.48|20.47] "" Vector__XXX
 SG_ VCRIGHT_a293_railV m293 : 28|12@1- (0.01,0) [-20.48|20.47] "" Vector__XXX
 SG_ VCRIGHT_a294_isNetworkSwitch m294 : 16|1@1+ (1,0) [0|1] "" Vector__XXX
 SG_ VCRIGHT_a294_occupancySensorV m294 : 17|12@1- (0.01,0) [-20.48|20.47] "" Vector__XXX
 SG_ VCRIGHT_a294_railV m294 : 32|12@1- (0.01,0) [-20.48|20.47] "" Vector__XXX
 SG_ VCRIGHT_a295_isNetworkSwitch m295 : 16|1@1+ (1,0) [0|1] "" Vector__XXX
 SG_ VCRIGHT_a295_occupancySensorV m295 : 17|12@1- (0.01,0) [-20.48|20.47] "" Vector__XXX
 SG_ VCRIGHT_a295_railV m295 : 32|12@1- (0.01,0) [-20.48|20.47] "" Vector__XXX
 SG_ VCRIGHT_a296_isNetworkSwitch m296 : 16|1@1+ (1,0) [0|1] "" Vector__XXX
 SG_ VCRIGHT_a296_occupancySensorV m296 : 17|12@1- (0.01,0) [-20.48|20.47] "" Vector__XXX
 SG_ VCRIGHT_a296_railV m296 : 32|12@1- (0.01,0) [-20.48|20.47] "" Vector__XXX
 SG_ VCRIGHT_a297_cabinTmp m297 : 16|12@1- (0.1,0) [-204.8|204.7] "" Vector__XXX
 SG_ VCRIGHT_a298_buckleSensorVoltage m298 : 16|12@1- (0.01,0) [-20.48|20.47] "" Vector__XXX
 SG_ VCRIGHT_a298_railV m298 : 28|12@1- (0.01,0) [-20.48|20.47] "" Vector__XXX
 SG_ VCRIGHT_a299_buckleSensorVoltage m299 : 16|12@1- (0.01,0) [-20.48|20.47] "" Vector__XXX
 SG_ VCRIGHT_a299_railV m299 : 28|12@1- (0.01,0) [-20.48|20.47] "" Vector__XXX
 SG_ VCRIGHT_a302_calibrationPositive m302 : 16|1@1+ (1,0) [0|1] "" Vector__XXX
 SG_ VCRIGHT_a302_calibrationNegative m302 : 17|1@1+ (1,0) [0|1] "" Vector__XXX
 SG_ VCRIGHT_a302_uncalibrated m302 : 18|1@1+ (1,0) [0|1] "" Vector__XXX
 SG_ VCRIGHT_a302_driverFault m302 : 19|1@1+ (1,0) [0|1] "" Vector__XXX
 SG_ VCRIGHT_a302_connected m302 : 20|1@1+ (1,0) [0|1] "" Vector__XXX
 SG_ VCRIGHT_a302_targetMissed m302 : 21|1@1+ (1,0) [0|1] "" Vector__XXX
 SG_ VCRIGHT_a302_positionTarget m302 : 24|8@1+ (0.5,0) [0|127.5] "" Vector__XXX
 SG_ VCRIGHT_a302_positionActual m302 : 32|8@1+ (0.5,0) [0|127.5] "" Vector__XXX
 SG_ VCRIGHT_a303_eFuseTripCount m303 : 16|8@1+ (1,0) [0|255] "" Vector__XXX
 SG_ VCRIGHT_a306_disconnectedTime m306 : 16|10@1+ (1,0) [0|1023] "" Vector__XXX
 SG_ VCRIGHT_a307_disconnectedTime m307 : 16|10@1+ (1,0) [0|1023] "" Vector__XXX
 SG_ VCRIGHT_a308_calibrationPositive m308 : 16|1@1+ (1,0) [0|1] "" Vector__XXX
 SG_ VCRIGHT_a308_calibrationNegative m308 : 17|1@1+ (1,0) [0|1] "" Vector__XXX
 SG_ VCRIGHT_a308_uncalibrated m308 : 18|1@1+ (1,0) [0|1] "" Vector__XXX
 SG_ VCRIGHT_a308_driverFault m308 : 19|1@1+ (1,0) [0|1] "" Vector__XXX
 SG_ VCRIGHT_a308_connected m308 : 20|1@1+ (1,0) [0|1] "" Vector__XXX
 SG_ VCRIGHT_a308_targetMissed m308 : 21|1@1+ (1,0) [0|1] "" Vector__XXX
 SG_ VCRIGHT_a308_positionTarget m308 : 24|8@1+ (0.5,0) [0|127.5] "" Vector__XXX
 SG_ VCRIGHT_a308_positionActual m308 : 32|8@1+ (0.5,0) [0|127.5] "" Vector__XXX
 SG_ VCRIGHT_a310_mirrorFoldTime m310 : 16|9@1+ (10,0) [0|5110] "" Vector__XXX
 SG_ VCRIGHT_a310_foldingDirection m310 : 25|1@1+ (1,0) [0|1] "" Vector__XXX
 SG_ VCRIGHT_a310_mirrorMaxFoldCurren m310 : 32|7@1- (0.05,0) [-3.2|3.15] "" Vector__XXX
 SG_ VCRIGHT_a310_ambientTemperature m310 : 40|8@1+ (0.5,-40) [-40|87.5] "" Vector__XXX
 SG_ VCRIGHT_a311_outputFaulted m311 : 16|1@1+ (1,0) [0|1] "" Vector__XXX
 SG_ VCRIGHT_a311_currentSenseFaulted m311 : 17|1@1+ (1,0) [0|1] "" Vector__XXX
 SG_ VCRIGHT_a311_tempSenseFaulted m311 : 18|1@1+ (1,0) [0|1] "" Vector__XXX
 SG_ VCRIGHT_a311_underCurrent m311 : 19|1@1+ (1,0) [0|1] "" Vector__XXX
 SG_ VCRIGHT_a311_overCurrent m311 : 20|1@1+ (1,0) [0|1] "" Vector__XXX
 SG_ VCRIGHT_a311_overTemperature m311 : 21|1@1+ (1,0) [0|1] "" Vector__XXX
 SG_ VCRIGHT_a312_outputFaulted m312 : 16|1@1+ (1,0) [0|1] "" Vector__XXX
 SG_ VCRIGHT_a312_currentSenseFaulted m312 : 17|1@1+ (1,0) [0|1] "" Vector__XXX
 SG_ VCRIGHT_a312_tempSenseFaulted m312 : 18|1@1+ (1,0) [0|1] "" Vector__XXX
 SG_ VCRIGHT_a312_underCurrent m312 : 19|1@1+ (1,0) [0|1] "" Vector__XXX
 SG_ VCRIGHT_a312_overCurrent m312 : 20|1@1+ (1,0) [0|1] "" Vector__XXX
 SG_ VCRIGHT_a312_overTemperature m312 : 21|1@1+ (1,0) [0|1] "" Vector__XXX
 SG_ VCRIGHT_a313_outputFaulted m313 : 16|1@1+ (1,0) [0|1] "" Vector__XXX
 SG_ VCRIGHT_a313_currentSenseFaulted m313 : 17|1@1+ (1,0) [0|1] "" Vector__XXX
 SG_ VCRIGHT_a313_tempSenseFaulted m313 : 18|1@1+ (1,0) [0|1] "" Vector__XXX
 SG_ VCRIGHT_a313_underCurrent m313 : 19|1@1+ (1,0) [0|1] "" Vector__XXX
 SG_ VCRIGHT_a313_overCurrent m313 : 20|1@1+ (1,0) [0|1] "" Vector__XXX
 SG_ VCRIGHT_a313_overTemperature m313 : 21|1@1+ (1,0) [0|1] "" Vector__XXX
 SG_ VCRIGHT_a314_outputFaulted m314 : 16|1@1+ (1,0) [0|1] "" Vector__XXX
 SG_ VCRIGHT_a314_currentSenseFaulted m314 : 17|1@1+ (1,0) [0|1] "" Vector__XXX
 SG_ VCRIGHT_a314_tempSenseFaulted m314 : 18|1@1+ (1,0) [0|1] "" Vector__XXX
 SG_ VCRIGHT_a314_underCurrent m314 : 19|1@1+ (1,0) [0|1] "" Vector__XXX
 SG_ VCRIGHT_a314_overCurrent m314 : 20|1@1+ (1,0) [0|1] "" Vector__XXX
 SG_ VCRIGHT_a314_overTemperature m314 : 21|1@1+ (1,0) [0|1] "" Vector__XXX
 SG_ VCRIGHT_a315_outputFaulted m315 : 16|1@1+ (1,0) [0|1] "" Vector__XXX
 SG_ VCRIGHT_a315_currentSenseFaulted m315 : 17|1@1+ (1,0) [0|1] "" Vector__XXX
 SG_ VCRIGHT_a315_tempSenseFaulted m315 : 18|1@1+ (1,0) [0|1] "" Vector__XXX
 SG_ VCRIGHT_a315_underCurrent m315 : 19|1@1+ (1,0) [0|1] "" Vector__XXX
 SG_ VCRIGHT_a315_overCurrent m315 : 20|1@1+ (1,0) [0|1] "" Vector__XXX
 SG_ VCRIGHT_a315_overTemperature m315 : 21|1@1+ (1,0) [0|1] "" Vector__XXX
 SG_ VCRIGHT_a316_foldState m316 : 16|3@1+ (1,0) [0|7] "" Vector__XXX
 SG_ VCRIGHT_a316_actuationDurationMs m316 : 19|10@1+ (10,0) [0|10230] "" Vector__XXX
 SG_ VCRIGHT_a316_maxCurrentAmps m316 : 32|12@1+ (0.01,0) [0|40.95] "" Vector__XXX
 SG_ VCRIGHT_a316_averageCurrentAmps m316 : 44|12@1+ (0.01,0) [0|40.95] "" Vector__XXX
 SG_ VCRIGHT_a316_ambientTemperatureD m316 : 56|8@1+ (0.5,-40) [-40|87.5] "" Vector__XXX
 SG_ VCRIGHT_a318_outputFaulted m318 : 16|1@1+ (1,0) [0|1] "" Vector__XXX
 SG_ VCRIGHT_a318_currentSenseFaulted m318 : 17|1@1+ (1,0) [0|1] "" Vector__XXX
 SG_ VCRIGHT_a318_tempSenseFaulted m318 : 18|1@1+ (1,0) [0|1] "" Vector__XXX
 SG_ VCRIGHT_a318_underCurrent m318 : 19|1@1+ (1,0) [0|1] "" Vector__XXX
 SG_ VCRIGHT_a318_overCurrent m318 : 20|1@1+ (1,0) [0|1] "" Vector__XXX
 SG_ VCRIGHT_a318_overTemperature m318 : 21|1@1+ (1,0) [0|1] "" Vector__XXX
 SG_ VCRIGHT_a319_outputFaulted m319 : 16|1@1+ (1,0) [0|1] "" Vector__XXX
 SG_ VCRIGHT_a319_currentSenseFaulted m319 : 17|1@1+ (1,0) [0|1] "" Vector__XXX
 SG_ VCRIGHT_a319_tempSenseFaulted m319 : 18|1@1+ (1,0) [0|1] "" Vector__XXX
 SG_ VCRIGHT_a319_underCurrent m319 : 19|1@1+ (1,0) [0|1] "" Vector__XXX
 SG_ VCRIGHT_a319_overCurrent m319 : 20|1@1+ (1,0) [0|1] "" Vector__XXX
 SG_ VCRIGHT_a319_overTemperature m319 : 21|1@1+ (1,0) [0|1] "" Vector__XXX
 SG_ VCRIGHT_a324_mirrorHeatCurrent m324 : 16|10@1+ (0.01,0) [0|10.23] "" Vector__XXX
 SG_ VCRIGHT_a325_calibrationPositive m325 : 16|1@1+ (1,0) [0|1] "" Vector__XXX
 SG_ VCRIGHT_a325_calibrationNegative m325 : 17|1@1+ (1,0) [0|1] "" Vector__XXX
 SG_ VCRIGHT_a325_uncalibrated m325 : 18|1@1+ (1,0) [0|1] "" Vector__XXX
 SG_ VCRIGHT_a325_driverFault m325 : 19|1@1+ (1,0) [0|1] "" Vector__XXX
 SG_ VCRIGHT_a325_connected m325 : 20|1@1+ (1,0) [0|1] "" Vector__XXX
 SG_ VCRIGHT_a325_targetMissed m325 : 21|1@1+ (1,0) [0|1] "" Vector__XXX
 SG_ VCRIGHT_a325_positionTarget m325 : 24|8@1+ (0.5,0) [0|127.5] "" Vector__XXX
 SG_ VCRIGHT_a325_positionActual m325 : 32|8@1+ (0.5,0) [0|127.5] "" Vector__XXX
 SG_ VCRIGHT_a326_calibrationPositive m326 : 16|1@1+ (1,0) [0|1] "" Vector__XXX
 SG_ VCRIGHT_a326_calibrationNegative m326 : 17|1@1+ (1,0) [0|1] "" Vector__XXX
 SG_ VCRIGHT_a326_uncalibrated m326 : 18|1@1+ (1,0) [0|1] "" Vector__XXX
 SG_ VCRIGHT_a326_driverFault m326 : 19|1@1+ (1,0) [0|1] "" Vector__XXX
 SG_ VCRIGHT_a326_connected m326 : 20|1@1+ (1,0) [0|1] "" Vector__XXX
 SG_ VCRIGHT_a326_targetMissed m326 : 21|1@1+ (1,0) [0|1] "" Vector__XXX
 SG_ VCRIGHT_a326_positionTarget m326 : 24|8@1+ (0.5,0) [0|127.5] "" Vector__XXX
 SG_ VCRIGHT_a326_positionActual m326 : 32|8@1+ (0.5,0) [0|127.5] "" Vector__XXX
 SG_ VCRIGHT_a330_voltage m330 : 16|7@1+ (0.15,0) [0|19.05] "" Vector__XXX
 SG_ VCRIGHT_a330_maxCurrent m330 : 24|7@1+ (0.25,0) [0|31.75] "" Vector__XXX
 SG_ VCRIGHT_a330_temperature m330 : 32|8@1+ (0.5,-40) [-40|87.5] "" Vector__XXX
 SG_ VCRIGHT_a331_voltage m331 : 16|7@1+ (0.15,0) [0|19.05] "" Vector__XXX
 SG_ VCRIGHT_a331_maxCurrent m331 : 24|7@1+ (0.25,0) [0|31.75] "" Vector__XXX
 SG_ VCRIGHT_a331_temperature m331 : 32|8@1+ (0.5,-40) [-40|87.5] "" Vector__XXX
 SG_ VCRIGHT_a343_rearDefrostCurrent m343 : 16|9@1+ (0.1,0) [0|51.1] "" Vector__XXX
 SG_ VCRIGHT_a343_batteryVoltage m343 : 25|7@1+ (0.15,0) [0|19.05] "" Vector__XXX
 SG_ VCRIGHT_a343_ambientTemperature m343 : 32|8@1+ (0.5,-40) [-40|87.5] "" Vector__XXX
 SG_ VCRIGHT_a344_rearDefrostCurrent m344 : 16|9@1+ (0.1,0) [0|51.1] "" Vector__XXX
 SG_ VCRIGHT_a344_batteryVoltage m344 : 25|7@1+ (0.15,0) [0|19.05] "" Vector__XXX
 SG_ VCRIGHT_a344_ambientTemperature m344 : 32|8@1+ (0.5,-40) [-40|87.5] "" Vector__XXX
 SG_ VCRIGHT_a345_PTCTHSGBPwrCurrent m345 : 16|10@1+ (0.1,0) [0|102.3] "" Vector__XXX
 SG_ VCRIGHT_a368_snsShortCircuit m368 : 16|1@1+ (1,0) [0|1] "" Vector__XXX
 SG_ VCRIGHT_a368_snsDisconnect m368 : 17|1@1+ (1,0) [0|1] "" Vector__XXX
 SG_ VCRIGHT_a368_snsRateChangeUp m368 : 18|1@1+ (1,0) [0|1] "" Vector__XXX
 SG_ VCRIGHT_a368_snsRateChangeDown m368 : 19|1@1+ (1,0) [0|1] "" Vector__XXX
 SG_ VCRIGHT_a369_snsShortCircuit m369 : 16|1@1+ (1,0) [0|1] "" Vector__XXX
 SG_ VCRIGHT_a369_snsDisconnect m369 : 17|1@1+ (1,0) [0|1] "" Vector__XXX
 SG_ VCRIGHT_a369_snsRateChangeUp m369 : 18|1@1+ (1,0) [0|1] "" Vector__XXX
 SG_ VCRIGHT_a369_snsRateChangeDown m369 : 19|1@1+ (1,0) [0|1] "" Vector__XXX
 SG_ VCRIGHT_a373_windowChannel m373 : 16|2@1+ (1,0) [0|3] "" Vector__XXX
 SG_ VCRIGHT_a375_windowFront m375 : 16|1@1+ (1,0) [0|1] "" Vector__XXX
 SG_ VCRIGHT_a376_2RowSeatTrackActuat m376 : 16|12@1- (0.01,0) [-20.48|20.47] "" Vector__XXX
 SG_ VCRIGHT_a376_2RowSeatTrackA_0001 m376 : 28|12@1- (0.1,0) [-204.8|204.7] "" Vector__XXX
 SG_ VCRIGHT_a376_2RowSeatEasyEntrySt m376 : 40|3@1+ (1,0) [0|7] "" Vector__XXX
 SG_ VCRIGHT_a376_2RowSeatTrackPositi m376 : 43|2@1+ (1,0) [0|3] "" Vector__XXX
 SG_ VCRIGHT_a377_snsShortCircuit m377 : 16|1@1+ (1,0) [0|1] "" Vector__XXX
 SG_ VCRIGHT_a377_snsDisconnect m377 : 17|1@1+ (1,0) [0|1] "" Vector__XXX
 SG_ VCRIGHT_a377_snsRateChangeUp m377 : 18|1@1+ (1,0) [0|1] "" Vector__XXX
 SG_ VCRIGHT_a377_snsRateChangeDown m377 : 19|1@1+ (1,0) [0|1] "" Vector__XXX
 SG_ VCRIGHT_a378_snsShortCircuit m378 : 16|1@1+ (1,0) [0|1] "" Vector__XXX
 SG_ VCRIGHT_a378_snsDisconnect m378 : 17|1@1+ (1,0) [0|1] "" Vector__XXX
 SG_ VCRIGHT_a378_snsRateChangeUp m378 : 18|1@1+ (1,0) [0|1] "" Vector__XXX
 SG_ VCRIGHT_a378_snsRateChangeDown m378 : 19|1@1+ (1,0) [0|1] "" Vector__XXX
 SG_ VCRIGHT_a379_snsShortCircuit m379 : 16|1@1+ (1,0) [0|1] "" Vector__XXX
 SG_ VCRIGHT_a379_snsDisconnect m379 : 17|1@1+ (1,0) [0|1] "" Vector__XXX
 SG_ VCRIGHT_a379_snsRateChangeUp m379 : 18|1@1+ (1,0) [0|1] "" Vector__XXX
 SG_ VCRIGHT_a379_snsRateChangeDown m379 : 19|1@1+ (1,0) [0|1] "" Vector__XXX
 SG_ VCRIGHT_a380_outputFaulted m380 : 16|1@1+ (1,0) [0|1] "" Vector__XXX
 SG_ VCRIGHT_a380_currentSenseFaulted m380 : 17|1@1+ (1,0) [0|1] "" Vector__XXX
 SG_ VCRIGHT_a380_tempSenseFaulted m380 : 18|1@1+ (1,0) [0|1] "" Vector__XXX
 SG_ VCRIGHT_a380_underCurrent m380 : 19|1@1+ (1,0) [0|1] "" Vector__XXX
 SG_ VCRIGHT_a380_overCurrent m380 : 20|1@1+ (1,0) [0|1] "" Vector__XXX
 SG_ VCRIGHT_a380_overTemperature m380 : 21|1@1+ (1,0) [0|1] "" Vector__XXX
 SG_ VCRIGHT_a381_outputFaulted m381 : 16|1@1+ (1,0) [0|1] "" Vector__XXX
 SG_ VCRIGHT_a381_currentSenseFaulted m381 : 17|1@1+ (1,0) [0|1] "" Vector__XXX
 SG_ VCRIGHT_a381_tempSenseFaulted m381 : 18|1@1+ (1,0) [0|1] "" Vector__XXX
 SG_ VCRIGHT_a381_underCurrent m381 : 19|1@1+ (1,0) [0|1] "" Vector__XXX
 SG_ VCRIGHT_a381_overCurrent m381 : 20|1@1+ (1,0) [0|1] "" Vector__XXX
 SG_ VCRIGHT_a381_overTemperature m381 : 21|1@1+ (1,0) [0|1] "" Vector__XXX
 SG_ VCRIGHT_a382_outputFaulted m382 : 16|1@1+ (1,0) [0|1] "" Vector__XXX
 SG_ VCRIGHT_a382_currentSenseFaulted m382 : 17|1@1+ (1,0) [0|1] "" Vector__XXX
 SG_ VCRIGHT_a382_tempSenseFaulted m382 : 18|1@1+ (1,0) [0|1] "" Vector__XXX
 SG_ VCRIGHT_a382_underCurrent m382 : 19|1@1+ (1,0) [0|1] "" Vector__XXX
 SG_ VCRIGHT_a382_overCurrent m382 : 20|1@1+ (1,0) [0|1] "" Vector__XXX
 SG_ VCRIGHT_a382_overTemperature m382 : 21|1@1+ (1,0) [0|1] "" Vector__XXX
 SG_ VCRIGHT_a406_frame1MIA m406 : 16|1@1+ (1,0) [0|1] "" Vector__XXX
 SG_ VCRIGHT_a406_frame2MIA m406 : 17|1@1+ (1,0) [0|1] "" Vector__XXX
 SG_ VCRIGHT_a407_configMismatch m407 : 16|1@1+ (1,0) [0|1] "" Vector__XXX
 SG_ VCRIGHT_a407_counterError m407 : 17|1@1+ (1,0) [0|1] "" Vector__XXX
 SG_ VCRIGHT_a407_checksumError m407 : 18|1@1+ (1,0) [0|1] "" Vector__XXX
 SG_ VCRIGHT_a407_linResponseError m407 : 19|1@1+ (1,0) [0|1] "" Vector__XXX
 SG_ VCRIGHT_a408_generalError m408 : 16|1@1+ (1,0) [0|1] "" Vector__XXX
 SG_ VCRIGHT_a408_seatbeltError m408 : 17|1@1+ (1,0) [0|1] "" Vector__XXX
 SG_ VCRIGHT_a408_doorError m408 : 18|1@1+ (1,0) [0|1] "" Vector__XXX
 SG_ VCRIGHT_a408_ALRError m408 : 19|1@1+ (1,0) [0|1] "" Vector__XXX
 SG_ VCRIGHT_a408_pressureError m408 : 20|1@1+ (1,0) [0|1] "" Vector__XXX
 SG_ VCRIGHT_a408_fluidLevelError m408 : 21|1@1+ (1,0) [0|1] "" Vector__XXX
 SG_ VCRIGHT_a408_temperatureError m408 : 22|1@1+ (1,0) [0|1] "" Vector__XXX
 SG_ VCRIGHT_a408_hardwareInternalErr m408 : 23|1@1+ (1,0) [0|1] "" Vector__XXX
 SG_ VCRIGHT_a408_overvoltageError m408 : 24|1@1+ (1,0) [0|1] "" Vector__XXX
 SG_ VCRIGHT_a408_overcurrentError m408 : 25|1@1+ (1,0) [0|1] "" Vector__XXX
 SG_ VCRIGHT_a408_ignitionError m408 : 26|1@1+ (1,0) [0|1] "" Vector__XXX
 SG_ VCRIGHT_a408_calibrationError m408 : 27|1@1+ (1,0) [0|1] "" Vector__XXX
 SG_ VCRIGHT_a408_trimError m408 : 28|1@1+ (1,0) [0|1] "" Vector__XXX
 SG_ VCRIGHT_a412_outputFaulted m412 : 16|1@1+ (1,0) [0|1] "" Vector__XXX
 SG_ VCRIGHT_a412_currentSenseFaulted m412 : 17|1@1+ (1,0) [0|1] "" Vector__XXX
 SG_ VCRIGHT_a412_tempSenseFaulted m412 : 18|1@1+ (1,0) [0|1] "" Vector__XXX
 SG_ VCRIGHT_a412_underCurrent m412 : 19|1@1+ (1,0) [0|1] "" Vector__XXX
 SG_ VCRIGHT_a412_overCurrent m412 : 20|1@1+ (1,0) [0|1] "" Vector__XXX
 SG_ VCRIGHT_a412_overTemperature m412 : 21|1@1+ (1,0) [0|1] "" Vector__XXX
 SG_ VCRIGHT_a413_outputFaulted m413 : 16|1@1+ (1,0) [0|1] "" Vector__XXX
 SG_ VCRIGHT_a413_currentSenseFaulted m413 : 17|1@1+ (1,0) [0|1] "" Vector__XXX
 SG_ VCRIGHT_a413_tempSenseFaulted m413 : 18|1@1+ (1,0) [0|1] "" Vector__XXX
 SG_ VCRIGHT_a413_underCurrent m413 : 19|1@1+ (1,0) [0|1] "" Vector__XXX
 SG_ VCRIGHT_a413_overCurrent m413 : 20|1@1+ (1,0) [0|1] "" Vector__XXX
 SG_ VCRIGHT_a413_overTemperature m413 : 21|1@1+ (1,0) [0|1] "" Vector__XXX
 SG_ VCRIGHT_a414_outputFaulted m414 : 16|1@1+ (1,0) [0|1] "" Vector__XXX
 SG_ VCRIGHT_a414_currentSenseFaulted m414 : 17|1@1+ (1,0) [0|1] "" Vector__XXX
 SG_ VCRIGHT_a414_tempSenseFaulted m414 : 18|1@1+ (1,0) [0|1] "" Vector__XXX
 SG_ VCRIGHT_a414_underCurrent m414 : 19|1@1+ (1,0) [0|1] "" Vector__XXX
 SG_ VCRIGHT_a414_overCurrent m414 : 20|1@1+ (1,0) [0|1] "" Vector__XXX
 SG_ VCRIGHT_a414_overTemperature m414 : 21|1@1+ (1,0) [0|1] "" Vector__XXX
 SG_ VCRIGHT_a415_outputFaulted m415 : 16|1@1+ (1,0) [0|1] "" Vector__XXX
 SG_ VCRIGHT_a415_currentSenseFaulted m415 : 17|1@1+ (1,0) [0|1] "" Vector__XXX
 SG_ VCRIGHT_a415_tempSenseFaulted m415 : 18|1@1+ (1,0) [0|1] "" Vector__XXX
 SG_ VCRIGHT_a415_underCurrent m415 : 19|1@1+ (1,0) [0|1] "" Vector__XXX
 SG_ VCRIGHT_a415_overCurrent m415 : 20|1@1+ (1,0) [0|1] "" Vector__XXX
 SG_ VCRIGHT_a415_overTemperature m415 : 21|1@1+ (1,0) [0|1] "" Vector__XXX
 SG_ VCRIGHT_a416_outputFaulted m416 : 16|1@1+ (1,0) [0|1] "" Vector__XXX
 SG_ VCRIGHT_a416_currentSenseFaulted m416 : 17|1@1+ (1,0) [0|1] "" Vector__XXX
 SG_ VCRIGHT_a416_tempSenseFaulted m416 : 18|1@1+ (1,0) [0|1] "" Vector__XXX
 SG_ VCRIGHT_a416_underCurrent m416 : 19|1@1+ (1,0) [0|1] "" Vector__XXX
 SG_ VCRIGHT_a416_overCurrent m416 : 20|1@1+ (1,0) [0|1] "" Vector__XXX
 SG_ VCRIGHT_a416_overTemperature m416 : 21|1@1+ (1,0) [0|1] "" Vector__XXX
 SG_ VCRIGHT_a417_outputFaulted m417 : 16|1@1+ (1,0) [0|1] "" Vector__XXX
 SG_ VCRIGHT_a417_currentSenseFaulted m417 : 17|1@1+ (1,0) [0|1] "" Vector__XXX
 SG_ VCRIGHT_a417_tempSenseFaulted m417 : 18|1@1+ (1,0) [0|1] "" Vector__XXX
 SG_ VCRIGHT_a417_underCurrent m417 : 19|1@1+ (1,0) [0|1] "" Vector__XXX
 SG_ VCRIGHT_a417_overCurrent m417 : 20|1@1+ (1,0) [0|1] "" Vector__XXX
 SG_ VCRIGHT_a417_overTemperature m417 : 21|1@1+ (1,0) [0|1] "" Vector__XXX
 SG_ VCRIGHT_a418_outputFaulted m418 : 16|1@1+ (1,0) [0|1] "" Vector__XXX
 SG_ VCRIGHT_a418_currentSenseFaulted m418 : 17|1@1+ (1,0) [0|1] "" Vector__XXX
 SG_ VCRIGHT_a418_tempSenseFaulted m418 : 18|1@1+ (1,0) [0|1] "" Vector__XXX
 SG_ VCRIGHT_a418_underCurrent m418 : 19|1@1+ (1,0) [0|1] "" Vector__XXX
 SG_ VCRIGHT_a418_overCurrent m418 : 20|1@1+ (1,0) [0|1] "" Vector__XXX
 SG_ VCRIGHT_a418_overTemperature m418 : 21|1@1+ (1,0) [0|1] "" Vector__XXX
 SG_ VCRIGHT_a419_outputFaulted m419 : 16|1@1+ (1,0) [0|1] "" Vector__XXX
 SG_ VCRIGHT_a419_currentSenseFaulted m419 : 17|1@1+ (1,0) [0|1] "" Vector__XXX
 SG_ VCRIGHT_a419_tempSenseFaulted m419 : 18|1@1+ (1,0) [0|1] "" Vector__XXX
 SG_ VCRIGHT_a419_underCurrent m419 : 19|1@1+ (1,0) [0|1] "" Vector__XXX
 SG_ VCRIGHT_a419_overCurrent m419 : 20|1@1+ (1,0) [0|1] "" Vector__XXX
 SG_ VCRIGHT_a419_overTemperature m419 : 21|1@1+ (1,0) [0|1] "" Vector__XXX
 SG_ VCRIGHT_a420_outputFaulted m420 : 16|1@1+ (1,0) [0|1] "" Vector__XXX
 SG_ VCRIGHT_a420_currentSenseFaulted m420 : 17|1@1+ (1,0) [0|1] "" Vector__XXX
 SG_ VCRIGHT_a420_tempSenseFaulted m420 : 18|1@1+ (1,0) [0|1] "" Vector__XXX
 SG_ VCRIGHT_a420_underCurrent m420 : 19|1@1+ (1,0) [0|1] "" Vector__XXX
 SG_ VCRIGHT_a420_overCurrent m420 : 20|1@1+ (1,0) [0|1] "" Vector__XXX
 SG_ VCRIGHT_a420_overTemperature m420 : 21|1@1+ (1,0) [0|1] "" Vector__XXX
 SG_ VCRIGHT_a421_outputFaulted m421 : 16|1@1+ (1,0) [0|1] "" Vector__XXX
 SG_ VCRIGHT_a421_currentSenseFaulted m421 : 17|1@1+ (1,0) [0|1] "" Vector__XXX
 SG_ VCRIGHT_a421_tempSenseFaulted m421 : 18|1@1+ (1,0) [0|1] "" Vector__XXX
 SG_ VCRIGHT_a421_underCurrent m421 : 19|1@1+ (1,0) [0|1] "" Vector__XXX
 SG_ VCRIGHT_a421_overCurrent m421 : 20|1@1+ (1,0) [0|1] "" Vector__XXX
 SG_ VCRIGHT_a421_overTemperature m421 : 21|1@1+ (1,0) [0|1] "" Vector__XXX
 SG_ VCRIGHT_a426_seatMotorCalibrated m426 : 16|1@1+ (1,0) [0|1] "" Vector__XXX
 SG_ VCRIGHT_a426_seatMotorCurrent m426 : 17|12@1- (0.01,0) [-20.48|20.47] "" Vector__XXX
 SG_ VCRIGHT_a426_seatMotorPosReal m426 : 32|12@1- (1,0) [-2048|2047] "" Vector__XXX
 SG_ VCRIGHT_a426_seatMotorState m426 : 44|3@1+ (1,0) [0|7] "" Vector__XXX
 SG_ VCRIGHT_a426_seatSwitchBack m426 : 48|2@1+ (1,0) [0|3] "" Vector__XXX
 SG_ VCRIGHT_a426_seatSwitchForward m426 : 50|2@1+ (1,0) [0|3] "" Vector__XXX
 SG_ VCRIGHT_a426_cabinTmp m426 : 52|12@1- (0.1,0) [-204.8|204.7] "" Vector__XXX
 SG_ VCRIGHT_a427_seatMotorCalibrated m427 : 16|1@1+ (1,0) [0|1] "" Vector__XXX
 SG_ VCRIGHT_a427_seatMotorCurrent m427 : 17|12@1- (0.01,0) [-20.48|20.47] "" Vector__XXX
 SG_ VCRIGHT_a427_seatMotorPosReal m427 : 32|12@1- (1,0) [-2048|2047] "" Vector__XXX
 SG_ VCRIGHT_a427_seatMotorState m427 : 44|3@1+ (1,0) [0|7] "" Vector__XXX
 SG_ VCRIGHT_a427_seatSwitchBack m427 : 48|2@1+ (1,0) [0|3] "" Vector__XXX
 SG_ VCRIGHT_a427_seatSwitchForward m427 : 50|2@1+ (1,0) [0|3] "" Vector__XXX
 SG_ VCRIGHT_a427_cabinTmp m427 : 52|12@1- (0.1,0) [-204.8|204.7] "" Vector__XXX
 SG_ VCRIGHT_a428_seatMotorCalibrated m428 : 16|1@1+ (1,0) [0|1] "" Vector__XXX
 SG_ VCRIGHT_a428_seatMotorCurrent m428 : 17|12@1- (0.01,0) [-20.48|20.47] "" Vector__XXX
 SG_ VCRIGHT_a428_seatMotorPosReal m428 : 32|12@1- (1,0) [-2048|2047] "" Vector__XXX
 SG_ VCRIGHT_a428_seatMotorState m428 : 44|3@1+ (1,0) [0|7] "" Vector__XXX
 SG_ VCRIGHT_a428_seatSwitchBack m428 : 48|2@1+ (1,0) [0|3] "" Vector__XXX
 SG_ VCRIGHT_a428_seatSwitchForward m428 : 50|2@1+ (1,0) [0|3] "" Vector__XXX
 SG_ VCRIGHT_a428_cabinTmp m428 : 52|12@1- (0.1,0) [-204.8|204.7] "" Vector__XXX
 SG_ VCRIGHT_a429_seatMotorCalibrated m429 : 16|1@1+ (1,0) [0|1] "" Vector__XXX
 SG_ VCRIGHT_a429_seatMotorCurrent m429 : 17|12@1- (0.01,0) [-20.48|20.47] "" Vector__XXX
 SG_ VCRIGHT_a429_seatMotorPosReal m429 : 32|12@1- (1,0) [-2048|2047] "" Vector__XXX
 SG_ VCRIGHT_a429_seatMotorState m429 : 44|3@1+ (1,0) [0|7] "" Vector__XXX
 SG_ VCRIGHT_a429_seatSwitchBack m429 : 48|2@1+ (1,0) [0|3] "" Vector__XXX
 SG_ VCRIGHT_a429_seatSwitchForward m429 : 50|2@1+ (1,0) [0|3] "" Vector__XXX
 SG_ VCRIGHT_a429_cabinTmp m429 : 52|12@1- (0.1,0) [-204.8|204.7] "" Vector__XXX
 SG_ VCRIGHT_a444_retriesAvailable m444 : 16|8@1+ (1,0) [0|255] "" Vector__XXX
 SG_ VCRIGHT_a444_channel m444 : 24|8@1+ (1,0) [0|255] "" Vector__XXX
 SG_ VCRIGHT_a444_watchdog m444 : 32|1@1+ (1,0) [0|1] "" Vector__XXX
 SG_ VCRIGHT_a444_gateDriver m444 : 33|1@1+ (1,0) [0|1] "" Vector__XXX
 SG_ VCRIGHT_a444_overcurrent m444 : 34|1@1+ (1,0) [0|1] "" Vector__XXX
 SG_ VCRIGHT_a444_supplyUndervoltage m444 : 35|1@1+ (1,0) [0|1] "" Vector__XXX
 SG_ VCRIGHT_a444_cpUndervoltage m444 : 36|1@1+ (1,0) [0|1] "" Vector__XXX
 SG_ VCRIGHT_a444_overTempShutdown m444 : 37|1@1+ (1,0) [0|1] "" Vector__XXX
 SG_ VCRIGHT_a444_overTempWarning m444 : 38|1@1+ (1,0) [0|1] "" Vector__XXX
 SG_ VCRIGHT_a444_highSide2GateDriver m444 : 39|1@1+ (1,0) [0|1] "" Vector__XXX
 SG_ VCRIGHT_a444_lowSide2GateDriver m444 : 40|1@1+ (1,0) [0|1] "" Vector__XXX
 SG_ VCRIGHT_a444_highSide1GateDriver m444 : 41|1@1+ (1,0) [0|1] "" Vector__XXX
 SG_ VCRIGHT_a444_lowSide1GateDriver m444 : 42|1@1+ (1,0) [0|1] "" Vector__XXX
 SG_ VCRIGHT_a444_highSide2OverCurent m444 : 43|1@1+ (1,0) [0|1] "" Vector__XXX
 SG_ VCRIGHT_a444_lowSide2OverCurent m444 : 44|1@1+ (1,0) [0|1] "" Vector__XXX
 SG_ VCRIGHT_a444_highSide1OverCurent m444 : 45|1@1+ (1,0) [0|1] "" Vector__XXX
 SG_ VCRIGHT_a444_lowSide1OverCurent m444 : 46|1@1+ (1,0) [0|1] "" Vector__XXX
 SG_ VCRIGHT_a444_spiInit m444 : 47|1@1+ (1,0) [0|1] "" Vector__XXX
 SG_ VCRIGHT_a444_spiPeriodicCheck m444 : 48|1@1+ (1,0) [0|1] "" Vector__XXX
 SG_ VCRIGHT_a444_spiFault m444 : 49|1@1+ (1,0) [0|1] "" Vector__XXX
 SG_ VCRIGHT_a444_voltageMonitor m444 : 50|1@1+ (1,0) [0|1] "" Vector__XXX
 SG_ VCRIGHT_a444_enableLow m444 : 51|1@1+ (1,0) [0|1] "" Vector__XXX
 SG_ VCRIGHT_a446_caseTempHVACUnavail m446 : 16|1@1+ (1,0) [0|1] "" Vector__XXX
 SG_ VCRIGHT_a446_evapHVACUnavailable m446 : 17|1@1+ (1,0) [0|1] "" Vector__XXX
 SG_ VCRIGHT_a446_evapTempInvalid m446 : 18|1@1+ (1,0) [0|1] "" Vector__XXX
 SG_ VCRIGHT_a446_hvacBlowerFaulted m446 : 19|1@1+ (1,0) [0|1] "" Vector__XXX
 SG_ VCRIGHT_a446_evapOperationNotAll m446 : 20|1@1+ (1,0) [0|1] "" Vector__XXX
 SG_ VCRIGHT_a446_allAirPathsBlocked m446 : 21|1@1+ (1,0) [0|1] "" Vector__XXX
 SG_ VCRIGHT_a446_rawDuctTempInvalidL m446 : 22|1@1+ (1,0) [0|1] "" Vector__XXX
 SG_ VCRIGHT_a446_rawDuctTempInvalidR m446 : 23|1@1+ (1,0) [0|1] "" Vector__XXX
 SG_ VCRIGHT_a448_manACOFFComfortCool m448 : 16|1@1+ (1,0) [0|1] "" Vector__XXX
 SG_ VCRIGHT_a448_manAirflowComfortHe m448 : 17|1@1+ (1,0) [0|1] "" Vector__XXX
 SG_ VCRIGHT_a448_manAirflowFwdL_0001 m448 : 18|1@1+ (1,0) [0|1] "" Vector__XXX
 SG_ VCRIGHT_a448_manAirflowFwdLkComf m448 : 19|1@1+ (1,0) [0|1] "" Vector__XXX
 SG_ VCRIGHT_a448_manACOffFwdLkComfor m448 : 20|1@1+ (1,0) [0|1] "" Vector__XXX
 SG_ VCRIGHT_a448_manFreshComfor_0002 m448 : 21|1@1+ (1,0) [0|1] "" Vector__XXX
 SG_ VCRIGHT_a448_manFreshComfor_0001 m448 : 22|1@1+ (1,0) [0|1] "" Vector__XXX
 SG_ VCRIGHT_a448_manFreshComfortCool m448 : 23|1@1+ (1,0) [0|1] "" Vector__XXX
 SG_ VCRIGHT_a448_manFreshComfortHeat m448 : 24|1@1+ (1,0) [0|1] "" Vector__XXX
 SG_ VCRIGHT_a448_manRecircRHAutoHVAC m448 : 25|1@1+ (1,0) [0|1] "" Vector__XXX
 SG_ VCRIGHT_a448_manRecircFlashFogGe m448 : 26|1@1+ (1,0) [0|1] "" Vector__XXX
 SG_ VCRIGHT_a448_manRecircFlashFogWe m448 : 27|1@1+ (1,0) [0|1] "" Vector__XXX
 SG_ VCRIGHT_a448_manRecircRHManualHV m448 : 28|1@1+ (1,0) [0|1] "" Vector__XXX
 SG_ VCRIGHT_a448_manACoffRHManualHVA m448 : 29|1@1+ (1,0) [0|1] "" Vector__XXX
 SG_ VCRIGHT_a448_warmingUp m448 : 30|1@1+ (1,0) [0|1] "" Vector__XXX
 SG_ VCRIGHT_a448_coolingDown m448 : 31|1@1+ (1,0) [0|1] "" Vector__XXX
 SG_ VCRIGHT_a448_maxHeating m448 : 32|1@1+ (1,0) [0|1] "" Vector__XXX
 SG_ VCRIGHT_a448_maxCooling m448 : 33|1@1+ (1,0) [0|1] "" Vector__XXX
 SG_ VCRIGHT_a448_manHvacOffAutoSteer m448 : 34|1@1+ (1,0) [0|1] "" Vector__XXX
 SG_ VCRIGHT_a448_manHvacOffAuto_0001 m448 : 35|1@1+ (1,0) [0|1] "" Vector__XXX
 SG_ VCRIGHT_a448_manHvacAutoSteerFog m448 : 36|1@1+ (1,0) [0|1] "" Vector__XXX
 SG_ VCRIGHT_a448_manHvacAutoSte_0001 m448 : 37|1@1+ (1,0) [0|1] "" Vector__XXX
 SG_ VCRIGHT_a448_manualHighBlowerSpe m448 : 38|1@1+ (1,0) [0|1] "" Vector__XXX
 SG_ VCRIGHT_a482_channel m482 : 16|6@1+ (1,0) [0|63] "" Vector__XXX
 SG_ VCRIGHT_a482_spiFault m482 : 22|1@1+ (1,0) [0|1] "" Vector__XXX
 SG_ VCRIGHT_a482_resetBar m482 : 23|1@1+ (1,0) [0|1] "" Vector__XXX
 SG_ VCRIGHT_a482_overTempShutdown m482 : 24|1@1+ (1,0) [0|1] "" Vector__XXX
 SG_ VCRIGHT_a482_thermalWarning m482 : 25|1@1+ (1,0) [0|1] "" Vector__XXX
 SG_ VCRIGHT_a482_underOrOverVoltageO m482 : 26|1@1+ (1,0) [0|1] "" Vector__XXX
 SG_ VCRIGHT_a482_underloadDetected m482 : 27|1@1+ (1,0) [0|1] "" Vector__XXX
 SG_ VCRIGHT_a496_cabinTempInterior m496 : 16|8@1+ (0.5,-40) [-40|87.5] "" Vector__XXX
 SG_ VCRIGHT_a520_epbConfig m520 : 16|4@1+ (1,0) [0|15] "" Vector__XXX
 SG_ VCRIGHT_a520_gtwEpbConfig m520 : 20|4@1+ (1,0) [0|15] "" Vector__XXX
 SG_ VCRIGHT_a525_GTW_twelveVBatteryT m525 : 16|3@1+ (1,0) [0|7] "" Vector__XXX
 SG_ VCRIGHT_a525_newLVBatteryType m525 : 19|3@1+ (1,0) [0|7] "" Vector__XXX
 SG_ VCRIGHT_a525_initialLVBatteryTyp m525 : 24|3@1+ (1,0) [0|7] "" Vector__XXX
 SG_ VCRIGHT_a525_serviceMode m525 : 27|1@1+ (1,0) [0|1] "" Vector__XXX
 SG_ VCRIGHT_a525_factoryGated m525 : 28|1@1+ (1,0) [0|1] "" Vector__XXX
 SG_ VCRIGHT_a525_frunkOpen m525 : 29|1@1+ (1,0) [0|1] "" Vector__XXX
 SG_ VCRIGHT_a538_ptcHeaterFault m538 : 16|1@1+ (1,0) [0|1] "" Vector__XXX
 SG_ VCRIGHT_a538_ductTempSensorFault m538 : 17|1@1+ (1,0) [0|1] "" Vector__XXX
 SG_ VCRIGHT_a538_evapTempSensorFault m538 : 18|1@1+ (1,0) [0|1] "" Vector__XXX
 SG_ VCRIGHT_a538_cabinTempSensorFaul m538 : 19|1@1+ (1,0) [0|1] "" Vector__XXX
 SG_ VCRIGHT_a538_cabinModelNotInitia m538 : 20|1@1+ (1,0) [0|1] "" Vector__XXX
 SG_ VCRIGHT_a538_airpathsBlocked m538 : 21|1@1+ (1,0) [0|1] "" Vector__XXX
 SG_ VCRIGHT_a538_blowerFaultOrStoppe m538 : 22|1@1+ (1,0) [0|1] "" Vector__XXX
 SG_ VCRIGHT_a538_compressorFaultOrSt m538 : 23|1@1+ (1,0) [0|1] "" Vector__XXX
 SG_ VCRIGHT_a538_heatPumpModeNotAtta m538 : 24|1@1+ (1,0) [0|1] "" Vector__XXX
 SG_ VCRIGHT_a538_thsVersionMismatch m538 : 25|1@1+ (1,0) [0|1] "" Vector__XXX
 SG_ VCRIGHT_a538_thsMia m538 : 26|1@1+ (1,0) [0|1] "" Vector__XXX
 SG_ VCRIGHT_a538_hvOn m538 : 27|1@1+ (1,0) [0|1] "" Vector__XXX
 SG_ VCRIGHT_a538_hvacPowerOn m538 : 28|1@1+ (1,0) [0|1] "" Vector__XXX
 SG_ VCRIGHT_a538_limpMode m538 : 29|1@1+ (1,0) [0|1] "" Vector__XXX
 SG_ VCRIGHT_a539_hvacSystemNotNomina m539 : 16|1@1+ (1,0) [0|1] "" Vector__XXX
 SG_ VCRIGHT_a539_modeledCabinTempOut m539 : 17|1@1+ (1,0) [0|1] "" Vector__XXX
 SG_ VCRIGHT_a539_modeledCabinTempExc m539 : 18|1@1+ (1,0) [0|1] "" Vector__XXX
 SG_ VCRIGHT_a539_cabinTempSensorFaul m539 : 19|1@1+ (1,0) [0|1] "" Vector__XXX
 SG_ VCRIGHT_a539_cabinTempSensorOutO m539 : 20|1@1+ (1,0) [0|1] "" Vector__XXX
 SG_ VCRIGHT_a539_modeledCabinTempDev m539 : 21|1@1+ (1,0) [0|1] "" Vector__XXX
 SG_ VCRIGHT_a545_GTW_twelveVBatteryT m545 : 16|3@1+ (1,0) [0|7] "" Vector__XXX
 SG_ VCRIGHT_a545_newLVBatteryType m545 : 19|3@1+ (1,0) [0|7] "" Vector__XXX
 SG_ VCRIGHT_a545_serviceMode m545 : 22|1@1+ (1,0) [0|1] "" Vector__XXX
 SG_ VCRIGHT_a545_factoryGated m545 : 23|1@1+ (1,0) [0|1] "" Vector__XXX
 SG_ VCRIGHT_a545_frunkOpen m545 : 24|1@1+ (1,0) [0|1] "" Vector__XXX
 SG_ VCRIGHT_a551_restrictDoorRelease m551 : 16|1@1+ (1,0) [0|1] "" Vector__XXX
 SG_ VCRIGHT_a551_interiorReleaseReqC m551 : 24|8@1+ (1,0) [0|255] "" Vector__XXX
 SG_ VCRIGHT_a551_lastRequestSourceFr m551 : 32|3@1+ (1,0) [0|7] "" Vector__XXX
 SG_ VCRIGHT_a551_restrictDoorRe_0001 m551 : 35|1@1+ (1,0) [0|1] "" Vector__XXX
 SG_ VCRIGHT_a551_interiorReleas_0001 m551 : 40|8@1+ (1,0) [0|255] "" Vector__XXX
 SG_ VCRIGHT_a551_lastRequestSourceRe m551 : 48|3@1+ (1,0) [0|7] "" Vector__XXX
 SG_ VCRIGHT_a560_isRearwardEndstopUn m560 : 16|1@1+ (1,0) [0|1] "" Vector__XXX
 SG_ VCRIGHT_a560_isAbsPosSensorUncal m560 : 17|1@1+ (1,0) [0|1] "" Vector__XXX
 SG_ VCRIGHT_a560_seatState m560 : 18|4@1+ (1,0) [0|15] "" Vector__XXX
 SG_ VCRIGHT_a560_motorType m560 : 22|1@1+ (1,0) [0|1] "" Vector__XXX
 SG_ VCRIGHT_a560_absPosSensState m560 : 24|2@1+ (1,0) [0|3] "" Vector__XXX
 SG_ VCRIGHT_a563_calibrated m563 : 16|1@1+ (1,0) [0|1] "" Vector__XXX
 SG_ VCRIGHT_a563_angle m563 : 17|8@1- (0.5,59) [-5|122.5] "" Vector__XXX
 SG_ VCRIGHT_a563_seatStatePrev m563 : 25|4@1+ (1,0) [0|15] "" Vector__XXX
 SG_ VCRIGHT_a563_obstacleDetectReaso m563 : 29|4@1+ (1,0) [0|15] "" Vector__XXX
 SG_ VCRIGHT_a563_accelLookbackTripDe m563 : 33|7@1+ (1,0) [0|127] "" Vector__XXX
 SG_ VCRIGHT_a563_duty m563 : 40|8@1- (1,0) [-128|127] "" Vector__XXX
 SG_ VCRIGHT_a563_currentAbsFilt m563 : 48|8@1+ (0.25,0) [0|63.75] "" Vector__XXX
 SG_ VCRIGHT_a563_motorType m563 : 56|1@1+ (1,0) [0|1] "" Vector__XXX
 SG_ VCRIGHT_a563_absolutePosSensorFo m563 : 57|1@1+ (1,0) [0|1] "" Vector__XXX
 SG_ VCRIGHT_a563_cabinTemp m563 : 58|6@1- (2,20) [-44|82] "" Vector__XXX
 SG_ VCRIGHT_a567_isRearwardEndstopUn m567 : 16|1@1+ (1,0) [0|1] "" Vector__XXX
 SG_ VCRIGHT_a567_isAbsPosSensorUncal m567 : 17|1@1+ (1,0) [0|1] "" Vector__XXX
 SG_ VCRIGHT_a568_seatState m568 : 16|4@1+ (1,0) [0|15] "" Vector__XXX
 SG_ VCRIGHT_a570_seatHeatCurrent m570 : 16|12@1+ (0.01,0) [0|40.95] "" Vector__XXX
 SG_ VCRIGHT_a570_seatHeatTmp m570 : 28|12@1- (0.05,0) [-102.4|102.35] "" Vector__XXX
 SG_ VCRIGHT_a571_seatHeatCurrent m571 : 16|12@1+ (0.01,0) [0|40.95] "" Vector__XXX
 SG_ VCRIGHT_a571_seatHeatTmp m571 : 28|12@1- (0.05,0) [-102.4|102.35] "" Vector__XXX
 SG_ VCRIGHT_a572_seatHeatCurrent m572 : 16|12@1+ (0.01,0) [0|40.95] "" Vector__XXX
 SG_ VCRIGHT_a572_seatHeatTmp m572 : 28|12@1- (0.05,0) [-102.4|102.35] "" Vector__XXX
 SG_ VCRIGHT_a573_seatHeatCurrent m573 : 16|12@1+ (0.01,0) [0|40.95] "" Vector__XXX
 SG_ VCRIGHT_a573_seatHeatTmp m573 : 28|12@1- (0.05,0) [-102.4|102.35] "" Vector__XXX
 SG_ VCRIGHT_a577_outputFaulted m577 : 16|1@1+ (1,0) [0|1] "" Vector__XXX
 SG_ VCRIGHT_a577_currentSenseFaulted m577 : 17|1@1+ (1,0) [0|1] "" Vector__XXX
 SG_ VCRIGHT_a577_tempSenseFaulted m577 : 18|1@1+ (1,0) [0|1] "" Vector__XXX
 SG_ VCRIGHT_a577_underCurrent m577 : 19|1@1+ (1,0) [0|1] "" Vector__XXX
 SG_ VCRIGHT_a577_overCurrent m577 : 20|1@1+ (1,0) [0|1] "" Vector__XXX
 SG_ VCRIGHT_a577_overTemperature m577 : 21|1@1+ (1,0) [0|1] "" Vector__XXX
 SG_ VCRIGHT_a578_openCircuitDoorFR m578 : 16|1@1+ (1,0) [0|1] "" Vector__XXX
 SG_ VCRIGHT_a578_shortCircuitDoorFR m578 : 17|1@1+ (1,0) [0|1] "" Vector__XXX
 SG_ VCRIGHT_a578_miaDoorFR m578 : 18|1@1+ (1,0) [0|1] "" Vector__XXX
 SG_ VCRIGHT_a578_openCircuitDoorRR m578 : 19|1@1+ (1,0) [0|1] "" Vector__XXX
 SG_ VCRIGHT_a578_shortCircuitDoorRR m578 : 20|1@1+ (1,0) [0|1] "" Vector__XXX
 SG_ VCRIGHT_a578_miaDoorRR m578 : 21|1@1+ (1,0) [0|1] "" Vector__XXX
 SG_ VCRIGHT_a579_liftgateFollowerSto m579 : 16|2@1+ (1,0) [0|3] "" Vector__XXX
 SG_ VCRIGHT_a579_liftgateFollowerPos m579 : 24|7@1- (1,43) [-21|106] "" Vector__XXX
 SG_ VCRIGHT_a579_liftgateFollowerLat m579 : 32|4@1+ (1,0) [0|15] "" Vector__XXX
 SG_ VCRIGHT_a585_ambientTemp m585 : 16|8@1+ (0.5,-40) [-40|87.5] "" Vector__XXX
 SG_ VCRIGHT_a586_ambientTemp m586 : 16|8@1+ (0.5,-40) [-40|87.5] "" Vector__XXX
 SG_ VCRIGHT_a599_GTW_twelveVBatteryT m599 : 16|3@1+ (1,0) [0|7] "" Vector__XXX
 SG_ VCRIGHT_a599_newLVBatteryType m599 : 19|3@1+ (1,0) [0|7] "" Vector__XXX
 SG_ VCRIGHT_a599_initialLVBatteryTyp m599 : 24|3@1+ (1,0) [0|7] "" Vector__XXX
 SG_ VCRIGHT_a599_serviceMode m599 : 27|1@1+ (1,0) [0|1] "" Vector__XXX
 SG_ VCRIGHT_a599_factoryGated m599 : 28|1@1+ (1,0) [0|1] "" Vector__XXX
 SG_ VCRIGHT_a599_frunkOpen m599 : 29|1@1+ (1,0) [0|1] "" Vector__XXX
 SG_ VCRIGHT_a617_VEH_VC_infoMessage m617 : 16|1@1+ (1,0) [0|1] "" Vector__XXX
 SG_ VCRIGHT_a617_BDY_defogInfoMessag m617 : 17|1@1+ (1,0) [0|1] "" Vector__XXX
 SG_ VCRIGHT_a617_VEH_defogInfoMessag m617 : 18|1@1+ (1,0) [0|1] "" Vector__XXX
 SG_ VCRIGHT_a617_VEH_thermalStatus m617 : 19|1@1+ (1,0) [0|1] "" Vector__XXX

BO_ 960 VCRIGHT_alertMatrix: 8 VCRIGHT
 SG_ VCRIGHT_matrixIndex M : 0|4@1+ (1,0) [0|15] "" Vector__XXX
 SG_ VCRIGHT_a001_WatchdogReset m0 : 4|1@1+ (1,0) [0|1] "" Vector__XXX
 SG_ VCRIGHT_a002_PowerLossReset m0 : 5|1@1+ (1,0) [0|1] "" Vector__XXX
 SG_ VCRIGHT_a003_SWAssertion m0 : 6|1@1+ (1,0) [0|1] "" Vector__XXX
 SG_ VCRIGHT_a005_CANTXError m0 : 8|1@1+ (1,0) [0|1] "" Vector__XXX
 SG_ VCRIGHT_a006_CANTX_cyclicError m0 : 9|1@1+ (1,0) [0|1] "" Vector__XXX
 SG_ VCRIGHT_a010_ExtSupplyVoltError m0 : 13|1@1+ (1,0) [0|1] "" Vector__XXX
 SG_ VCRIGHT_a012_CPUReset m0 : 15|1@1+ (1,0) [0|1] "" Vector__XXX
 SG_ VCRIGHT_a013_AlertManagerFault m0 : 16|1@1+ (1,0) [0|1] "" Vector__XXX
 SG_ VCRIGHT_a015_NVMMError m0 : 18|1@1+ (1,0) [0|1] "" Vector__XXX
 SG_ VCRIGHT_a016_NVMMRecordError m0 : 19|1@1+ (1,0) [0|1] "" Vector__XXX
 SG_ VCRIGHT_a017_NVMMStatusDbg m0 : 20|1@1+ (1,0) [0|1] "" Vector__XXX
 SG_ VCRIGHT_a021_TaskSchedulerError m0 : 24|1@1+ (1,0) [0|1] "" Vector__XXX
 SG_ VCRIGHT_a022_TaskInitError m0 : 25|1@1+ (1,0) [0|1] "" Vector__XXX
 SG_ VCRIGHT_a029_CoreDump m0 : 32|1@1+ (1,0) [0|1] "" Vector__XXX
 SG_ VCRIGHT_a030_ECULogUploadRequest m0 : 33|1@1+ (1,0) [0|1] "" Vector__XXX
 SG_ VCRIGHT_a031_UDSActive m0 : 34|1@1+ (1,0) [0|1] "" Vector__XXX
 SG_ VCRIGHT_a041_HighCPULoad m0 : 44|1@1+ (1,0) [0|1] "" Vector__XXX
 SG_ VCRIGHT_a042_HighStackUsage m0 : 45|1@1+ (1,0) [0|1] "" Vector__XXX
 SG_ VCRIGHT_a043_Task1msError m0 : 46|1@1+ (1,0) [0|1] "" Vector__XXX
 SG_ VCRIGHT_a044_Task10msError m0 : 47|1@1+ (1,0) [0|1] "" Vector__XXX
 SG_ VCRIGHT_a045_Task100msError m0 : 48|1@1+ (1,0) [0|1] "" Vector__XXX
 SG_ VCRIGHT_a046_Task1000msError m0 : 49|1@1+ (1,0) [0|1] "" Vector__XXX
 SG_ VCRIGHT_a057_HVP_MIA m0 : 60|1@1+ (1,0) [0|1] "" Vector__XXX
 SG_ VCRIGHT_a058_inputRHighSyncDebug m0 : 61|1@1+ (1,0) [0|1] "" Vector__XXX
 SG_ VCRIGHT_a059_inputResistanceHigh m0 : 62|1@1+ (1,0) [0|1] "" Vector__XXX
 SG_ VCRIGHT_a060_engineeringBuild m0 : 63|1@1+ (1,0) [0|1] "" Vector__XXX
 SG_ VCRIGHT_a061_XCPConnected m1 : 4|1@1+ (1,0) [0|1] "" Vector__XXX
 SG_ VCRIGHT_a062_XCPWasConnected m1 : 5|1@1+ (1,0) [0|1] "" Vector__XXX
 SG_ VCRIGHT_a063_SwitchFault m1 : 6|1@1+ (1,0) [0|1] "" Vector__XXX
 SG_ VCRIGHT_a064_busSleepReqTimeout m1 : 7|1@1+ (1,0) [0|1] "" Vector__XXX
 SG_ VCRIGHT_a065_emiosIsrRateLimited m1 : 8|1@1+ (1,0) [0|1] "" Vector__XXX
 SG_ VCRIGHT_a066_emiosIsrShortPeriod m1 : 9|1@1+ (1,0) [0|1] "" Vector__XXX
 SG_ VCRIGHT_a082_VCRIGHT_IPC_MIA m1 : 25|1@1+ (1,0) [0|1] "" Vector__XXX
 SG_ VCRIGHT_a083_VCLEFT_IPC_MIA m1 : 26|1@1+ (1,0) [0|1] "" Vector__XXX
 SG_ VCRIGHT_a084_TPMS_MIA m1 : 27|1@1+ (1,0) [0|1] "" Vector__XXX
 SG_ VCRIGHT_a085_CCCM_MIA m1 : 28|1@1+ (1,0) [0|1] "" Vector__XXX
 SG_ VCRIGHT_a086_VCBATT_MIA m1 : 29|1@1+ (1,0) [0|1] "" Vector__XXX
 SG_ VCRIGHT_a087_DIREL_MIA m1 : 30|1@1+ (1,0) [0|1] "" Vector__XXX
 SG_ VCRIGHT_a088_DIRER_MIA m1 : 31|1@1+ (1,0) [0|1] "" Vector__XXX
 SG_ VCRIGHT_a089_IBST_MIA m1 : 32|1@1+ (1,0) [0|1] "" Vector__XXX
 SG_ VCRIGHT_a090_APS_MIA m1 : 33|1@1+ (1,0) [0|1] "" Vector__XXX
 SG_ VCRIGHT_a091_CMPD_MIA m1 : 34|1@1+ (1,0) [0|1] "" Vector__XXX
 SG_ VCRIGHT_a092_VCSEATD_MIA m1 : 35|1@1+ (1,0) [0|1] "" Vector__XXX
 SG_ VCRIGHT_a093_VCSEATP_MIA m1 : 36|1@1+ (1,0) [0|1] "" Vector__XXX
 SG_ VCRIGHT_a094_EPAS3P_MIA m1 : 37|1@1+ (1,0) [0|1] "" Vector__XXX
 SG_ VCRIGHT_a095_CHG_MIA m1 : 38|1@1+ (1,0) [0|1] "" Vector__XXX
 SG_ VCRIGHT_a096_OCS1P_MIA m1 : 39|1@1+ (1,0) [0|1] "" Vector__XXX
 SG_ VCRIGHT_a097_CMP_MIA m1 : 40|1@1+ (1,0) [0|1] "" Vector__XXX
 SG_ VCRIGHT_a098_DIR_MIA m1 : 41|1@1+ (1,0) [0|1] "" Vector__XXX
 SG_ VCRIGHT_a099_PARK_MIA m1 : 42|1@1+ (1,0) [0|1] "" Vector__XXX
 SG_ VCRIGHT_a100_CANbus_MIA m1 : 43|1@1+ (1,0) [0|1] "" Vector__XXX
 SG_ VCRIGHT_a101_PM_MIA m1 : 44|1@1+ (1,0) [0|1] "" Vector__XXX
 SG_ VCRIGHT_a102_PTC_MIA m1 : 45|1@1+ (1,0) [0|1] "" Vector__XXX
 SG_ VCRIGHT_a103_CP_MIA m1 : 46|1@1+ (1,0) [0|1] "" Vector__XXX
 SG_ VCRIGHT_a104_DAS_MIA m1 : 47|1@1+ (1,0) [0|1] "" Vector__XXX
 SG_ VCRIGHT_a105_TAS_MIA m1 : 48|1@1+ (1,0) [0|1] "" Vector__XXX
 SG_ VCRIGHT_a106_PCS_MIA m1 : 49|1@1+ (1,0) [0|1] "" Vector__XXX
 SG_ VCRIGHT_a107_BMS_MIA m1 : 50|1@1+ (1,0) [0|1] "" Vector__XXX
 SG_ VCRIGHT_a108_DIF_MIA m1 : 51|1@1+ (1,0) [0|1] "" Vector__XXX
 SG_ VCRIGHT_a109_RCM_MIA m1 : 52|1@1+ (1,0) [0|1] "" Vector__XXX
 SG_ VCRIGHT_a110_GTW_MIA m1 : 53|1@1+ (1,0) [0|1] "" Vector__XXX
 SG_ VCRIGHT_a111_EPBR_MIA m1 : 54|1@1+ (1,0) [0|1] "" Vector__XXX
 SG_ VCRIGHT_a112_EPBL_MIA m1 : 55|1@1+ (1,0) [0|1] "" Vector__XXX
 SG_ VCRIGHT_a113_UI_MIA m1 : 56|1@1+ (1,0) [0|1] "" Vector__XXX
 SG_ VCRIGHT_a114_ESP_MIA m1 : 57|1@1+ (1,0) [0|1] "" Vector__XXX
 SG_ VCRIGHT_a115_VCSEC_MIA m1 : 58|1@1+ (1,0) [0|1] "" Vector__XXX
 SG_ VCRIGHT_a116_VCRIGHT_MIA m1 : 59|1@1+ (1,0) [0|1] "" Vector__XXX
 SG_ VCRIGHT_a117_VCLEFT_MIA m1 : 60|1@1+ (1,0) [0|1] "" Vector__XXX
 SG_ VCRIGHT_a118_VCFRONT_MIA m1 : 61|1@1+ (1,0) [0|1] "" Vector__XXX
 SG_ VCRIGHT_a119_SCCM_MIA m1 : 62|1@1+ (1,0) [0|1] "" Vector__XXX
 SG_ VCRIGHT_a120_DI_DRIVE_MIA m1 : 63|1@1+ (1,0) [0|1] "" Vector__XXX
 SG_ VCRIGHT_a121_ETC_MIA m2 : 4|1@1+ (1,0) [0|1] "" Vector__XXX
 SG_ VCRIGHT_a122_ICR_MIA m2 : 5|1@1+ (1,0) [0|1] "" Vector__XXX
 SG_ VCRIGHT_a124_BB_MIA m2 : 7|1@1+ (1,0) [0|1] "" Vector__XXX
 SG_ VCRIGHT_a125_RCU_MIA m2 : 8|1@1+ (1,0) [0|1] "" Vector__XXX
 SG_ VCRIGHT_a126_hvacActOpenLoadDBG m2 : 9|1@1+ (1,0) [0|1] "" Vector__XXX
 SG_ VCRIGHT_a127_hvacActOvercurrentD m2 : 10|1@1+ (1,0) [0|1] "" Vector__XXX
 SG_ VCRIGHT_a128_hvacActDrvFaultDBG m2 : 11|1@1+ (1,0) [0|1] "" Vector__XXX
 SG_ VCRIGHT_a129_hvacIntakeUncalib m2 : 12|1@1+ (1,0) [0|1] "" Vector__XXX
 SG_ VCRIGHT_a130_hvacLHBleedUncalib m2 : 13|1@1+ (1,0) [0|1] "" Vector__XXX
 SG_ VCRIGHT_a131_hvacRHBleedUncalib m2 : 14|1@1+ (1,0) [0|1] "" Vector__XXX
 SG_ VCRIGHT_a132_hvacLHVaneUncalib m2 : 15|1@1+ (1,0) [0|1] "" Vector__XXX
 SG_ VCRIGHT_a133_hvacRHVaneUncalib m2 : 16|1@1+ (1,0) [0|1] "" Vector__XXX
 SG_ VCRIGHT_a134_hvacUpprModeUncalib m2 : 17|1@1+ (1,0) [0|1] "" Vector__XXX
 SG_ VCRIGHT_a135_hvacLowrModeUncalib m2 : 18|1@1+ (1,0) [0|1] "" Vector__XXX
 SG_ VCRIGHT_a136_hvacIntakeFault m2 : 19|1@1+ (1,0) [0|1] "" Vector__XXX
 SG_ VCRIGHT_a137_hvacLHBleedFault m2 : 20|1@1+ (1,0) [0|1] "" Vector__XXX
 SG_ VCRIGHT_a138_hvacRHBleedFault m2 : 21|1@1+ (1,0) [0|1] "" Vector__XXX
 SG_ VCRIGHT_a139_hvacLHVaneFault m2 : 22|1@1+ (1,0) [0|1] "" Vector__XXX
 SG_ VCRIGHT_a140_hvacRHVaneFault m2 : 23|1@1+ (1,0) [0|1] "" Vector__XXX
 SG_ VCRIGHT_a141_hvacUpperModeFault m2 : 24|1@1+ (1,0) [0|1] "" Vector__XXX
 SG_ VCRIGHT_a142_hvacLowerModeFault m2 : 25|1@1+ (1,0) [0|1] "" Vector__XXX
 SG_ VCRIGHT_a143_mirrorManuallyFolde m2 : 26|1@1+ (1,0) [0|1] "" Vector__XXX
 SG_ VCRIGHT_a144_evaporatorTempSns m2 : 27|1@1+ (1,0) [0|1] "" Vector__XXX
 SG_ VCRIGHT_a145_ductLeftTempSns m2 : 28|1@1+ (1,0) [0|1] "" Vector__XXX
 SG_ VCRIGHT_a146_ductRightTempSns m2 : 29|1@1+ (1,0) [0|1] "" Vector__XXX
 SG_ VCRIGHT_a147_incarProbeTempSns m2 : 30|1@1+ (1,0) [0|1] "" Vector__XXX
 SG_ VCRIGHT_a148_incarMidTempSns m2 : 31|1@1+ (1,0) [0|1] "" Vector__XXX
 SG_ VCRIGHT_a149_incarDeepTempSns m2 : 32|1@1+ (1,0) [0|1] "" Vector__XXX
 SG_ VCRIGHT_a150_windowPinchFront m2 : 33|1@1+ (1,0) [0|1] "" Vector__XXX
 SG_ VCRIGHT_a151_windowPinchRear m2 : 34|1@1+ (1,0) [0|1] "" Vector__XXX
 SG_ VCRIGHT_a152_windowUncalFront m2 : 35|1@1+ (1,0) [0|1] "" Vector__XXX
 SG_ VCRIGHT_a153_windowUncalRear m2 : 36|1@1+ (1,0) [0|1] "" Vector__XXX
 SG_ VCRIGHT_a154_windowThermalFront m2 : 37|1@1+ (1,0) [0|1] "" Vector__XXX
 SG_ VCRIGHT_a155_windowThermalRear m2 : 38|1@1+ (1,0) [0|1] "" Vector__XXX
 SG_ VCRIGHT_a156_windowNoInputFront m2 : 39|1@1+ (1,0) [0|1] "" Vector__XXX
 SG_ VCRIGHT_a157_windowNoInputRear m2 : 40|1@1+ (1,0) [0|1] "" Vector__XXX
 SG_ VCRIGHT_a158_windowPinchOverideF m2 : 41|1@1+ (1,0) [0|1] "" Vector__XXX
 SG_ VCRIGHT_a159_windowPinchOverideR m2 : 42|1@1+ (1,0) [0|1] "" Vector__XXX
 SG_ VCRIGHT_a160_windowUndercurrentF m2 : 43|1@1+ (1,0) [0|1] "" Vector__XXX
 SG_ VCRIGHT_a161_windowUndercurrentR m2 : 44|1@1+ (1,0) [0|1] "" Vector__XXX
 SG_ VCRIGHT_a162_windowEncoderStallF m2 : 45|1@1+ (1,0) [0|1] "" Vector__XXX
 SG_ VCRIGHT_a163_windowEncoderStallR m2 : 46|1@1+ (1,0) [0|1] "" Vector__XXX
 SG_ VCRIGHT_a164_windowFactoryTest m2 : 47|1@1+ (1,0) [0|1] "" Vector__XXX
 SG_ VCRIGHT_a165_windowFactoryTest2 m2 : 48|1@1+ (1,0) [0|1] "" Vector__XXX
 SG_ VCRIGHT_a166_windowDebug m2 : 49|1@1+ (1,0) [0|1] "" Vector__XXX
 SG_ VCRIGHT_a167_windowDebugPinchF m2 : 50|1@1+ (1,0) [0|1] "" Vector__XXX
 SG_ VCRIGHT_a168_windowDebugPinchR m2 : 51|1@1+ (1,0) [0|1] "" Vector__XXX
 SG_ VCRIGHT_a169_windowCurrentPeakF m2 : 52|1@1+ (1,0) [0|1] "" Vector__XXX
 SG_ VCRIGHT_a170_windowCurrentPeakR m2 : 53|1@1+ (1,0) [0|1] "" Vector__XXX
 SG_ VCRIGHT_a172_SPI_MIA m2 : 55|1@1+ (1,0) [0|1] "" Vector__XXX
 SG_ VCRIGHT_a173_windowBtnDoorOpen m2 : 56|1@1+ (1,0) [0|1] "" Vector__XXX
 SG_ VCRIGHT_a174_BLERightPowerCycled m2 : 57|1@1+ (1,0) [0|1] "" Vector__XXX
 SG_ VCRIGHT_a175_windowSealDefectFro m2 : 58|1@1+ (1,0) [0|1] "" Vector__XXX
 SG_ VCRIGHT_a176_windowSealDefectRea m2 : 59|1@1+ (1,0) [0|1] "" Vector__XXX
 SG_ VCRIGHT_a178_trunkSwitchVCBATTMI m2 : 61|1@1+ (1,0) [0|1] "" Vector__XXX
 SG_ VCRIGHT_a179_trunkSwitchVCFRONTM m2 : 62|1@1+ (1,0) [0|1] "" Vector__XXX
 SG_ VCRIGHT_a180_frontDoorLatchRehom m2 : 63|1@1+ (1,0) [0|1] "" Vector__XXX
 SG_ VCRIGHT_a181_rearDoorLatchRehome m3 : 4|1@1+ (1,0) [0|1] "" Vector__XXX
 SG_ VCRIGHT_a182_emergencyLatchRel m3 : 5|1@1+ (1,0) [0|1] "" Vector__XXX
 SG_ VCRIGHT_a183_doorStateFactoryTes m3 : 6|1@1+ (1,0) [0|1] "" Vector__XXX
 SG_ VCRIGHT_a184_trunkFailedOpening m3 : 7|1@1+ (1,0) [0|1] "" Vector__XXX
 SG_ VCRIGHT_a185_summonAborted m3 : 8|1@1+ (1,0) [0|1] "" Vector__XXX
 SG_ VCRIGHT_a186_latchReleaseFailedF m3 : 9|1@1+ (1,0) [0|1] "" Vector__XXX
 SG_ VCRIGHT_a187_latchReleaseFailedR m3 : 10|1@1+ (1,0) [0|1] "" Vector__XXX
 SG_ VCRIGHT_a188_latchUnableToRearmF m3 : 11|1@1+ (1,0) [0|1] "" Vector__XXX
 SG_ VCRIGHT_a189_latchUnableToRearmR m3 : 12|1@1+ (1,0) [0|1] "" Vector__XXX
 SG_ VCRIGHT_a190_eFuseMgmtVbatFused m3 : 13|1@1+ (1,0) [0|1] "" Vector__XXX
 SG_ VCRIGHT_a191_gloveboxPower m3 : 14|1@1+ (1,0) [0|1] "" Vector__XXX
 SG_ VCRIGHT_a192_gloveboxLatchRel m3 : 15|1@1+ (1,0) [0|1] "" Vector__XXX
 SG_ VCRIGHT_a193_amplifierEFuseFault m3 : 16|1@1+ (1,0) [0|1] "" Vector__XXX
 SG_ VCRIGHT_a194_cntctrPwrEFuseFault m3 : 17|1@1+ (1,0) [0|1] "" Vector__XXX
 SG_ VCRIGHT_a195_hvcEFuseFault m3 : 18|1@1+ (1,0) [0|1] "" Vector__XXX
 SG_ VCRIGHT_a196_VEHCANOverterminate m3 : 19|1@1+ (1,0) [0|1] "" Vector__XXX
 SG_ VCRIGHT_a197_VEHCANUndertrminate m3 : 20|1@1+ (1,0) [0|1] "" Vector__XXX
 SG_ VCRIGHT_a198_PRVCANOverterminate m3 : 21|1@1+ (1,0) [0|1] "" Vector__XXX
 SG_ VCRIGHT_a199_PRVCANUndertrminate m3 : 22|1@1+ (1,0) [0|1] "" Vector__XXX
 SG_ VCRIGHT_a200_motorPhantomEncoder m3 : 23|1@1+ (1,0) [0|1] "" Vector__XXX
 SG_ VCRIGHT_a201_motorDutyEncDisabl m3 : 24|1@1+ (1,0) [0|1] "" Vector__XXX
 SG_ VCRIGHT_a202_epbmUnderIStatic m3 : 25|1@1+ (1,0) [0|1] "" Vector__XXX
 SG_ VCRIGHT_a203_epbmOverIStatic m3 : 26|1@1+ (1,0) [0|1] "" Vector__XXX
 SG_ VCRIGHT_a204_epbmUnderIDyn m3 : 27|1@1+ (1,0) [0|1] "" Vector__XXX
 SG_ VCRIGHT_a205_epbmOverIDyn m3 : 28|1@1+ (1,0) [0|1] "" Vector__XXX
 SG_ VCRIGHT_a206_epbWrongDirection m3 : 29|1@1+ (1,0) [0|1] "" Vector__XXX
 SG_ VCRIGHT_a207_epbmEnableWrong m3 : 30|1@1+ (1,0) [0|1] "" Vector__XXX
 SG_ VCRIGHT_a208_epbFaulted m3 : 31|1@1+ (1,0) [0|1] "" Vector__XXX
 SG_ VCRIGHT_a209_epbStateMisTime m3 : 32|1@1+ (1,0) [0|1] "" Vector__XXX
 SG_ VCRIGHT_a210_epbStateTime m3 : 33|1@1+ (1,0) [0|1] "" Vector__XXX
 SG_ VCRIGHT_a211_epbmUnderIStaticNew m3 : 34|1@1+ (1,0) [0|1] "" Vector__XXX
 SG_ VCRIGHT_a212_epbmOverIStaticNew m3 : 35|1@1+ (1,0) [0|1] "" Vector__XXX
 SG_ VCRIGHT_a213_epbmUnderIDynNew m3 : 36|1@1+ (1,0) [0|1] "" Vector__XXX
 SG_ VCRIGHT_a214_epbmOverIDynNew m3 : 37|1@1+ (1,0) [0|1] "" Vector__XXX
 SG_ VCRIGHT_a215_currentDesyncWarnin m3 : 38|1@1+ (1,0) [0|1] "" Vector__XXX
 SG_ VCRIGHT_a216_SPI_MIA_debugData1 m3 : 39|1@1+ (1,0) [0|1] "" Vector__XXX
 SG_ VCRIGHT_a217_SPI_MIA_debugData2 m3 : 40|1@1+ (1,0) [0|1] "" Vector__XXX
 SG_ VCRIGHT_a218_motorDriverFault m3 : 41|1@1+ (1,0) [0|1] "" Vector__XXX
 SG_ VCRIGHT_a219_motorCurrentDropout m3 : 42|1@1+ (1,0) [0|1] "" Vector__XXX
 SG_ VCRIGHT_a224_seatEncStallTrack m3 : 47|1@1+ (1,0) [0|1] "" Vector__XXX
 SG_ VCRIGHT_a225_seatEncStallBack m3 : 48|1@1+ (1,0) [0|1] "" Vector__XXX
 SG_ VCRIGHT_a226_seatEncStallTilt m3 : 49|1@1+ (1,0) [0|1] "" Vector__XXX
 SG_ VCRIGHT_a227_seatEncStallLift m3 : 50|1@1+ (1,0) [0|1] "" Vector__XXX
 SG_ VCRIGHT_a228_seatEncOverTrack m3 : 51|1@1+ (1,0) [0|1] "" Vector__XXX
 SG_ VCRIGHT_a229_seatEncOverBack m3 : 52|1@1+ (1,0) [0|1] "" Vector__XXX
 SG_ VCRIGHT_a230_seatEncOverTilt m3 : 53|1@1+ (1,0) [0|1] "" Vector__XXX
 SG_ VCRIGHT_a231_seatEncOverLift m3 : 54|1@1+ (1,0) [0|1] "" Vector__XXX
 SG_ VCRIGHT_a232_seatCurrUnderTrack m3 : 55|1@1+ (1,0) [0|1] "" Vector__XXX
 SG_ VCRIGHT_a233_seatCurrUnderBack m3 : 56|1@1+ (1,0) [0|1] "" Vector__XXX
 SG_ VCRIGHT_a234_seatCurrUnderTilt m3 : 57|1@1+ (1,0) [0|1] "" Vector__XXX
 SG_ VCRIGHT_a235_seatCurrUnderLift m3 : 58|1@1+ (1,0) [0|1] "" Vector__XXX
 SG_ VCRIGHT_a236_lumbarOverPresA m3 : 59|1@1+ (1,0) [0|1] "" Vector__XXX
 SG_ VCRIGHT_a237_lumbarOverPresB m3 : 60|1@1+ (1,0) [0|1] "" Vector__XXX
 SG_ VCRIGHT_a238_lumbarValveMIA m3 : 61|1@1+ (1,0) [0|1] "" Vector__XXX
 SG_ VCRIGHT_a239_seatHeatIFront m3 : 62|1@1+ (1,0) [0|1] "" Vector__XXX
 SG_ VCRIGHT_a240_seatHeatShortFront m3 : 63|1@1+ (1,0) [0|1] "" Vector__XXX
 SG_ VCRIGHT_a241_seatHeatMIAFront m4 : 4|1@1+ (1,0) [0|1] "" Vector__XXX
 SG_ VCRIGHT_a242_seatHeatIRearL m4 : 5|1@1+ (1,0) [0|1] "" Vector__XXX
 SG_ VCRIGHT_a243_seatHeatShortRearL m4 : 6|1@1+ (1,0) [0|1] "" Vector__XXX
 SG_ VCRIGHT_a244_seatHeatMIARearL m4 : 7|1@1+ (1,0) [0|1] "" Vector__XXX
 SG_ VCRIGHT_a245_seatHeatIRearC m4 : 8|1@1+ (1,0) [0|1] "" Vector__XXX
 SG_ VCRIGHT_a246_seatHeatShortRearC m4 : 9|1@1+ (1,0) [0|1] "" Vector__XXX
 SG_ VCRIGHT_a247_seatHeatMIARearC m4 : 10|1@1+ (1,0) [0|1] "" Vector__XXX
 SG_ VCRIGHT_a248_seatHeatIRearR m4 : 11|1@1+ (1,0) [0|1] "" Vector__XXX
 SG_ VCRIGHT_a249_seatHeatShortRearR m4 : 12|1@1+ (1,0) [0|1] "" Vector__XXX
 SG_ VCRIGHT_a250_seatHeatMIARearR m4 : 13|1@1+ (1,0) [0|1] "" Vector__XXX
 SG_ VCRIGHT_a251_seatUncalTrack m4 : 14|1@1+ (1,0) [0|1] "" Vector__XXX
 SG_ VCRIGHT_a252_seatUncalBack m4 : 15|1@1+ (1,0) [0|1] "" Vector__XXX
 SG_ VCRIGHT_a253_seatUncalTilt m4 : 16|1@1+ (1,0) [0|1] "" Vector__XXX
 SG_ VCRIGHT_a254_seatUncalLift m4 : 17|1@1+ (1,0) [0|1] "" Vector__XXX
 SG_ VCRIGHT_a255_PTCOverTemp m4 : 18|1@1+ (1,0) [0|1] "" Vector__XXX
 SG_ VCRIGHT_a256_PTCCurrentDrawNoReq m4 : 19|1@1+ (1,0) [0|1] "" Vector__XXX
 SG_ VCRIGHT_a257_THSMIA m4 : 20|1@1+ (1,0) [0|1] "" Vector__XXX
 SG_ VCRIGHT_a258_PTCStuckInBoot m4 : 21|1@1+ (1,0) [0|1] "" Vector__XXX
 SG_ VCRIGHT_a259_latchDisarmDelayF m4 : 22|1@1+ (1,0) [0|1] "" Vector__XXX
 SG_ VCRIGHT_a260_latchDisarmDelayR m4 : 23|1@1+ (1,0) [0|1] "" Vector__XXX
 SG_ VCRIGHT_a261_emergencyLatchRelRe m4 : 24|1@1+ (1,0) [0|1] "" Vector__XXX
 SG_ VCRIGHT_a262_PTCFaulted m4 : 25|1@1+ (1,0) [0|1] "" Vector__XXX
 SG_ VCRIGHT_a263_seatTrackStallDebug m4 : 26|1@1+ (1,0) [0|1] "" Vector__XXX
 SG_ VCRIGHT_a264_seatBackStallDebug m4 : 27|1@1+ (1,0) [0|1] "" Vector__XXX
 SG_ VCRIGHT_a265_seatTiltStallDebug m4 : 28|1@1+ (1,0) [0|1] "" Vector__XXX
 SG_ VCRIGHT_a266_seatLiftStallDebug m4 : 29|1@1+ (1,0) [0|1] "" Vector__XXX
 SG_ VCRIGHT_a267_seatTrackHCEncStlDb m4 : 30|1@1+ (1,0) [0|1] "" Vector__XXX
 SG_ VCRIGHT_a268_seatBackHCEncStlDbg m4 : 31|1@1+ (1,0) [0|1] "" Vector__XXX
 SG_ VCRIGHT_a269_seatTiltHCEncStlDbg m4 : 32|1@1+ (1,0) [0|1] "" Vector__XXX
 SG_ VCRIGHT_a270_seatLiftHCEncStlDbg m4 : 33|1@1+ (1,0) [0|1] "" Vector__XXX
 SG_ VCRIGHT_a271_THSSensorFault m4 : 34|1@1+ (1,0) [0|1] "" Vector__XXX
 SG_ VCRIGHT_a272_vhclPwrStateMsmtch m4 : 35|1@1+ (1,0) [0|1] "" Vector__XXX
 SG_ VCRIGHT_a273_handleStuckActiveF m4 : 36|1@1+ (1,0) [0|1] "" Vector__XXX
 SG_ VCRIGHT_a274_handleStuckActiveR m4 : 37|1@1+ (1,0) [0|1] "" Vector__XXX
 SG_ VCRIGHT_a275_rightTurnLightFault m4 : 38|1@1+ (1,0) [0|1] "" Vector__XXX
 SG_ VCRIGHT_a276_mirrorDebug m4 : 39|1@1+ (1,0) [0|1] "" Vector__XXX
 SG_ VCRIGHT_a277_BLERightUnderVoltag m4 : 40|1@1+ (1,0) [0|1] "" Vector__XXX
 SG_ VCRIGHT_a278_hvacPtcHeatingUnava m4 : 41|1@1+ (1,0) [0|1] "" Vector__XXX
 SG_ VCRIGHT_a279_trunkFailedToClose m4 : 42|1@1+ (1,0) [0|1] "" Vector__XXX
 SG_ VCRIGHT_a280_latchDidNotDisarmF m4 : 43|1@1+ (1,0) [0|1] "" Vector__XXX
 SG_ VCRIGHT_a281_latchDidNotDisarmR m4 : 44|1@1+ (1,0) [0|1] "" Vector__XXX
 SG_ VCRIGHT_a282_latchUnexpectedArmF m4 : 45|1@1+ (1,0) [0|1] "" Vector__XXX
 SG_ VCRIGHT_a283_latchUnexpectedArmR m4 : 46|1@1+ (1,0) [0|1] "" Vector__XXX
 SG_ VCRIGHT_a284_gloveboxUnderCurren m4 : 47|1@1+ (1,0) [0|1] "" Vector__XXX
 SG_ VCRIGHT_a285_gloveboxOverCurrent m4 : 48|1@1+ (1,0) [0|1] "" Vector__XXX
 SG_ VCRIGHT_a286_windowSpeedInvalidF m4 : 49|1@1+ (1,0) [0|1] "" Vector__XXX
 SG_ VCRIGHT_a287_windowSpeedInvalidR m4 : 50|1@1+ (1,0) [0|1] "" Vector__XXX
 SG_ VCRIGHT_a288_handlePWMPeriodF m4 : 51|1@1+ (1,0) [0|1] "" Vector__XXX
 SG_ VCRIGHT_a289_handlePWMPeriodR m4 : 52|1@1+ (1,0) [0|1] "" Vector__XXX
 SG_ VCRIGHT_a290_occupancyFaultedFro m4 : 53|1@1+ (1,0) [0|1] "" Vector__XXX
 SG_ VCRIGHT_a291_buckleFaultedFront m4 : 54|1@1+ (1,0) [0|1] "" Vector__XXX
 SG_ VCRIGHT_a292_buckleFaultedRearC m4 : 55|1@1+ (1,0) [0|1] "" Vector__XXX
 SG_ VCRIGHT_a293_buckleFaultedRearR m4 : 56|1@1+ (1,0) [0|1] "" Vector__XXX
 SG_ VCRIGHT_a294_occupancyFaultedRea m4 : 57|1@1+ (1,0) [0|1] "" Vector__XXX
 SG_ VCRIGHT_a295_occupancyFaulted3Ro m4 : 58|1@1+ (1,0) [0|1] "" Vector__XXX
 SG_ VCRIGHT_a296_occupancyFaulted3Ro m4 : 59|1@1+ (1,0) [0|1] "" Vector__XXX
 SG_ VCRIGHT_a297_seatBelowMinPumpTmp m4 : 60|1@1+ (1,0) [0|1] "" Vector__XXX
 SG_ VCRIGHT_a298_buckleFaulted3RowL m4 : 61|1@1+ (1,0) [0|1] "" Vector__XXX
 SG_ VCRIGHT_a299_buckleFaulted3RowR m4 : 62|1@1+ (1,0) [0|1] "" Vector__XXX
 SG_ VCRIGHT_a301_airwaveRightVertica m5 : 4|1@1+ (1,0) [0|1] "" Vector__XXX
 SG_ VCRIGHT_a302_airwaveRightVertica m5 : 5|1@1+ (1,0) [0|1] "" Vector__XXX
 SG_ VCRIGHT_a303_eFuseMgmtWindowLift m5 : 6|1@1+ (1,0) [0|1] "" Vector__XXX
 SG_ VCRIGHT_a304_frontIntHandleShort m5 : 7|1@1+ (1,0) [0|1] "" Vector__XXX
 SG_ VCRIGHT_a305_rearIntHandleShorte m5 : 8|1@1+ (1,0) [0|1] "" Vector__XXX
 SG_ VCRIGHT_a306_handleDisconnectedF m5 : 9|1@1+ (1,0) [0|1] "" Vector__XXX
 SG_ VCRIGHT_a307_handleDisconnectedR m5 : 10|1@1+ (1,0) [0|1] "" Vector__XXX
 SG_ VCRIGHT_a308_airwaveRightLateral m5 : 11|1@1+ (1,0) [0|1] "" Vector__XXX
 SG_ VCRIGHT_a310_mirrorFoldStall m5 : 13|1@1+ (1,0) [0|1] "" Vector__XXX
 SG_ VCRIGHT_a311_rightBrakeLightFaul m5 : 14|1@1+ (1,0) [0|1] "" Vector__XXX
 SG_ VCRIGHT_a312_rightTailLightFault m5 : 15|1@1+ (1,0) [0|1] "" Vector__XXX
 SG_ VCRIGHT_a313_rightFootwellLightF m5 : 16|1@1+ (1,0) [0|1] "" Vector__XXX
 SG_ VCRIGHT_a314_rightMapPocketLight m5 : 17|1@1+ (1,0) [0|1] "" Vector__XXX
 SG_ VCRIGHT_a315_rightInteriorTrunkL m5 : 18|1@1+ (1,0) [0|1] "" Vector__XXX
 SG_ VCRIGHT_a316_mirrorPrematureFold m5 : 19|1@1+ (1,0) [0|1] "" Vector__XXX
 SG_ VCRIGHT_a317_epbmLimpModeEnabled m5 : 20|1@1+ (1,0) [0|1] "" Vector__XXX
 SG_ VCRIGHT_a318_leftExteriorTrunkLi m5 : 21|1@1+ (1,0) [0|1] "" Vector__XXX
 SG_ VCRIGHT_a319_rightExteriorTrunkL m5 : 22|1@1+ (1,0) [0|1] "" Vector__XXX
 SG_ VCRIGHT_a320_windowReportCracked m5 : 23|1@1+ (1,0) [0|1] "" Vector__XXX
 SG_ VCRIGHT_a321_windowRezeroedDebug m5 : 24|1@1+ (1,0) [0|1] "" Vector__XXX
 SG_ VCRIGHT_a322_windowRezeroedDebug m5 : 25|1@1+ (1,0) [0|1] "" Vector__XXX
 SG_ VCRIGHT_a323_mirrorCalibrated m5 : 26|1@1+ (1,0) [0|1] "" Vector__XXX
 SG_ VCRIGHT_a324_mirrorHeatFault m5 : 27|1@1+ (1,0) [0|1] "" Vector__XXX
 SG_ VCRIGHT_a325_airwaveLeftVertical m5 : 28|1@1+ (1,0) [0|1] "" Vector__XXX
 SG_ VCRIGHT_a326_airwaveLeftLateralU m5 : 29|1@1+ (1,0) [0|1] "" Vector__XXX
 SG_ VCRIGHT_a327_airwaveLeftLateralW m5 : 30|1@1+ (1,0) [0|1] "" Vector__XXX
 SG_ VCRIGHT_a328_airwaveLeftVertical m5 : 31|1@1+ (1,0) [0|1] "" Vector__XXX
 SG_ VCRIGHT_a329_airwaveRightLateral m5 : 32|1@1+ (1,0) [0|1] "" Vector__XXX
 SG_ VCRIGHT_a330_shortDropFailedF m5 : 33|1@1+ (1,0) [0|1] "" Vector__XXX
 SG_ VCRIGHT_a331_shortDropFailedR m5 : 34|1@1+ (1,0) [0|1] "" Vector__XXX
 SG_ VCRIGHT_a336_windowDropRevTherma m5 : 39|1@1+ (1,0) [0|1] "" Vector__XXX
 SG_ VCRIGHT_a337_windowDropRevTherma m5 : 40|1@1+ (1,0) [0|1] "" Vector__XXX
 SG_ VCRIGHT_a342_rearDefrostDisabled m5 : 45|1@1+ (1,0) [0|1] "" Vector__XXX
 SG_ VCRIGHT_a343_rearDefrostUndercur m5 : 46|1@1+ (1,0) [0|1] "" Vector__XXX
 SG_ VCRIGHT_a344_rearDefrostOvercurr m5 : 47|1@1+ (1,0) [0|1] "" Vector__XXX
 SG_ VCRIGHT_a345_HVACPTCHeaterPwrEFu m5 : 48|1@1+ (1,0) [0|1] "" Vector__XXX
 SG_ VCRIGHT_a346_cabinRadarEFuseFaul m5 : 49|1@1+ (1,0) [0|1] "" Vector__XXX
 SG_ VCRIGHT_a347_nonContMonitorClear m5 : 50|1@1+ (1,0) [0|1] "" Vector__XXX
 SG_ VCRIGHT_a352_audioCurrentSpikeDa m5 : 55|1@1+ (1,0) [0|1] "" Vector__XXX
 SG_ VCRIGHT_a355_hvacLHBleedWarning m5 : 58|1@1+ (1,0) [0|1] "" Vector__XXX
 SG_ VCRIGHT_a356_hvacRHBleedWarning m5 : 59|1@1+ (1,0) [0|1] "" Vector__XXX
 SG_ VCRIGHT_a357_hvacLHVaneWarning m5 : 60|1@1+ (1,0) [0|1] "" Vector__XXX
 SG_ VCRIGHT_a358_hvacRHVaneWarning m5 : 61|1@1+ (1,0) [0|1] "" Vector__XXX
 SG_ VCRIGHT_a359_hvacUpperModeWarnin m5 : 62|1@1+ (1,0) [0|1] "" Vector__XXX
 SG_ VCRIGHT_a360_detectedStationaryW m5 : 63|1@1+ (1,0) [0|1] "" Vector__XXX
 SG_ VCRIGHT_a361_stationaryThreshold m6 : 4|1@1+ (1,0) [0|1] "" Vector__XXX
 SG_ VCRIGHT_a362_movingThresholdsInc m6 : 5|1@1+ (1,0) [0|1] "" Vector__XXX
 SG_ VCRIGHT_a363_hvacLowerModeWarnin m6 : 6|1@1+ (1,0) [0|1] "" Vector__XXX
 SG_ VCRIGHT_a364_hvacIntakeWarning m6 : 7|1@1+ (1,0) [0|1] "" Vector__XXX
 SG_ VCRIGHT_a365_pitchUnlatchDisable m6 : 8|1@1+ (1,0) [0|1] "" Vector__XXX
 SG_ VCRIGHT_a366_trunkLatchUnhomed m6 : 9|1@1+ (1,0) [0|1] "" Vector__XXX
 SG_ VCRIGHT_a367_trunkLatchSwFault m6 : 10|1@1+ (1,0) [0|1] "" Vector__XXX
 SG_ VCRIGHT_a368_ductLeftLowerTempSn m6 : 11|1@1+ (1,0) [0|1] "" Vector__XXX
 SG_ VCRIGHT_a369_ductRightLowerTempS m6 : 12|1@1+ (1,0) [0|1] "" Vector__XXX
 SG_ VCRIGHT_a370_seat2RowPitchUnlatc m6 : 13|1@1+ (1,0) [0|1] "" Vector__XXX
 SG_ VCRIGHT_a371_seat2RowTrackUnlatc m6 : 14|1@1+ (1,0) [0|1] "" Vector__XXX
 SG_ VCRIGHT_a372_seat2RowBackrestUnl m6 : 15|1@1+ (1,0) [0|1] "" Vector__XXX
 SG_ VCRIGHT_a373_windowSwOpenReqInDo m6 : 16|1@1+ (1,0) [0|1] "" Vector__XXX
 SG_ VCRIGHT_a375_windowPinchOverride m6 : 18|1@1+ (1,0) [0|1] "" Vector__XXX
 SG_ VCRIGHT_a376_seat2RowBridgeCurre m6 : 19|1@1+ (1,0) [0|1] "" Vector__XXX
 SG_ VCRIGHT_a377_ambientTempSns m6 : 20|1@1+ (1,0) [0|1] "" Vector__XXX
 SG_ VCRIGHT_a378_ductLeftUpperTempSn m6 : 21|1@1+ (1,0) [0|1] "" Vector__XXX
 SG_ VCRIGHT_a379_ductRightUpperTempS m6 : 22|1@1+ (1,0) [0|1] "" Vector__XXX
 SG_ VCRIGHT_a380_reverseLightFault m6 : 23|1@1+ (1,0) [0|1] "" Vector__XXX
 SG_ VCRIGHT_a381_rearFogLightFault m6 : 24|1@1+ (1,0) [0|1] "" Vector__XXX
 SG_ VCRIGHT_a382_leftLiftgateTailLig m6 : 25|1@1+ (1,0) [0|1] "" Vector__XXX
 SG_ VCRIGHT_a406_aptivOCSMIA m6 : 49|1@1+ (1,0) [0|1] "" Vector__XXX
 SG_ VCRIGHT_a407_aptivOCSInterfaceEr m6 : 50|1@1+ (1,0) [0|1] "" Vector__XXX
 SG_ VCRIGHT_a408_aptivOCSDeviceError m6 : 51|1@1+ (1,0) [0|1] "" Vector__XXX
 SG_ VCRIGHT_a409_aptivOCSDeviceError m6 : 52|1@1+ (1,0) [0|1] "" Vector__XXX
 SG_ VCRIGHT_a412_rightBrakeTailLight m6 : 55|1@1+ (1,0) [0|1] "" Vector__XXX
 SG_ VCRIGHT_a413_centerHighMountStop m6 : 56|1@1+ (1,0) [0|1] "" Vector__XXX
 SG_ VCRIGHT_a414_rearFasciaReverseLi m6 : 57|1@1+ (1,0) [0|1] "" Vector__XXX
 SG_ VCRIGHT_a415_rearFasciaFogLightF m6 : 58|1@1+ (1,0) [0|1] "" Vector__XXX
 SG_ VCRIGHT_a416_rearFasciaTailLight m6 : 59|1@1+ (1,0) [0|1] "" Vector__XXX
 SG_ VCRIGHT_a417_rearFasciaLeftTurnL m6 : 60|1@1+ (1,0) [0|1] "" Vector__XXX
 SG_ VCRIGHT_a418_rearFasciaRightTurn m6 : 61|1@1+ (1,0) [0|1] "" Vector__XXX
 SG_ VCRIGHT_a419_tailFasciaLeftLight m6 : 62|1@1+ (1,0) [0|1] "" Vector__XXX
 SG_ VCRIGHT_a420_tailFasciaRightLigh m6 : 63|1@1+ (1,0) [0|1] "" Vector__XXX
 SG_ VCRIGHT_a421_leftTailLightFault m7 : 4|1@1+ (1,0) [0|1] "" Vector__XXX
 SG_ VCRIGHT_a426_seatAbuseMotorWarn m7 : 9|1@1+ (1,0) [0|1] "" Vector__XXX
 SG_ VCRIGHT_a427_seatAbuseMotorStop m7 : 10|1@1+ (1,0) [0|1] "" Vector__XXX
 SG_ VCRIGHT_a428_seatAbuseBufferWarn m7 : 11|1@1+ (1,0) [0|1] "" Vector__XXX
 SG_ VCRIGHT_a429_seatAbuseBufferFull m7 : 12|1@1+ (1,0) [0|1] "" Vector__XXX
 SG_ VCRIGHT_a444_drv8703Fault m7 : 27|1@1+ (1,0) [0|1] "" Vector__XXX
 SG_ VCRIGHT_a445_drv8703SpiFaultDBG m7 : 28|1@1+ (1,0) [0|1] "" Vector__XXX
 SG_ VCRIGHT_a446_cabinHVACUnavailabl m7 : 29|1@1+ (1,0) [0|1] "" Vector__XXX
 SG_ VCRIGHT_a448_manualHVACAlert m7 : 31|1@1+ (1,0) [0|1] "" Vector__XXX
 SG_ VCRIGHT_a450_ptcForcedOutOfSeqRo m7 : 33|1@1+ (1,0) [0|1] "" Vector__XXX
 SG_ VCRIGHT_a451_ptcSeqRodOutOfRetri m7 : 34|1@1+ (1,0) [0|1] "" Vector__XXX
 SG_ VCRIGHT_a454_ptcHeaterBadRodDete m7 : 37|1@1+ (1,0) [0|1] "" Vector__XXX
 SG_ VCRIGHT_a482_NCV77XXFault m8 : 5|1@1+ (1,0) [0|1] "" Vector__XXX
 SG_ VCRIGHT_a490_vehicleOccupiedOnOT m8 : 13|1@1+ (1,0) [0|1] "" Vector__XXX
 SG_ VCRIGHT_a491_BPillarCameraHeater m8 : 14|1@1+ (1,0) [0|1] "" Vector__XXX
 SG_ VCRIGHT_a496_gloveboxOpenFailed m8 : 19|1@1+ (1,0) [0|1] "" Vector__XXX
 SG_ VCRIGHT_a498_canAuthenticationFa m8 : 21|1@1+ (1,0) [0|1] "" Vector__XXX
 SG_ VCRIGHT_a499_epbmInvalidateCdp m8 : 22|1@1+ (1,0) [0|1] "" Vector__XXX
 SG_ VCRIGHT_a520_configMismatch m8 : 43|1@1+ (1,0) [0|1] "" Vector__XXX
 SG_ VCRIGHT_a525_LVBatterySWMisconfi m8 : 48|1@1+ (1,0) [0|1] "" Vector__XXX
 SG_ VCRIGHT_a526_pcbaOverTemperature m8 : 49|1@1+ (1,0) [0|1] "" Vector__XXX
 SG_ VCRIGHT_a527_continuousFeedUnexp m8 : 50|1@1+ (1,0) [0|1] "" Vector__XXX
 SG_ VCRIGHT_a528_unableToRunStuckOnT m8 : 51|1@1+ (1,0) [0|1] "" Vector__XXX
 SG_ VCRIGHT_a529_airflowFeedBackMode m8 : 52|1@1+ (1,0) [0|1] "" Vector__XXX
 SG_ VCRIGHT_a531_airflowModelTmpComp m8 : 54|1@1+ (1,0) [0|1] "" Vector__XXX
 SG_ VCRIGHT_a532_airflowModelFeedFor m8 : 55|1@1+ (1,0) [0|1] "" Vector__XXX
 SG_ VCRIGHT_a533_cabinModelDebug m8 : 56|1@1+ (1,0) [0|1] "" Vector__XXX
 SG_ VCRIGHT_a537_solarCalcsNotNomina m8 : 60|1@1+ (1,0) [0|1] "" Vector__XXX
 SG_ VCRIGHT_a538_hvacSystemNotNomina m8 : 61|1@1+ (1,0) [0|1] "" Vector__XXX
 SG_ VCRIGHT_a539_dogModeMonitorTrip m8 : 62|1@1+ (1,0) [0|1] "" Vector__XXX
 SG_ VCRIGHT_a540_hvacActuatorDitherD m8 : 63|1@1+ (1,0) [0|1] "" Vector__XXX
 SG_ VCRIGHT_a542_steeringWheelHeatin m9 : 5|1@1+ (1,0) [0|1] "" Vector__XXX
 SG_ VCRIGHT_a545_LVBatteryTypeUnknow m9 : 8|1@1+ (1,0) [0|1] "" Vector__XXX
 SG_ VCRIGHT_a546_mirrorFoldTypeChang m9 : 9|1@1+ (1,0) [0|1] "" Vector__XXX
 SG_ VCRIGHT_a550_ambientTempDelta m9 : 13|1@1+ (1,0) [0|1] "" Vector__XXX
 SG_ VCRIGHT_a551_interiorDoorRequest m9 : 14|1@1+ (1,0) [0|1] "" Vector__XXX
 SG_ VCRIGHT_a555_RCM2_MIA m9 : 18|1@1+ (1,0) [0|1] "" Vector__XXX
 SG_ VCRIGHT_a556_rcmReportedOCSError m9 : 19|1@1+ (1,0) [0|1] "" Vector__XXX
 SG_ VCRIGHT_a560_2RowSeatUncalibrate m9 : 23|1@1+ (1,0) [0|1] "" Vector__XXX
 SG_ VCRIGHT_a561_2RowSeatPositionNon m9 : 24|1@1+ (1,0) [0|1] "" Vector__XXX
 SG_ VCRIGHT_a562_2RowSeatAbsPosOffse m9 : 25|1@1+ (1,0) [0|1] "" Vector__XXX
 SG_ VCRIGHT_a563_2RowSeatObstacleDet m9 : 26|1@1+ (1,0) [0|1] "" Vector__XXX
 SG_ VCRIGHT_a564_2RowSeatTempHigh m9 : 27|1@1+ (1,0) [0|1] "" Vector__XXX
 SG_ VCRIGHT_a565_2RowSeatAbsPosSenso m9 : 28|1@1+ (1,0) [0|1] "" Vector__XXX
 SG_ VCRIGHT_a566_2RowSeatStatsFromLa m9 : 29|1@1+ (1,0) [0|1] "" Vector__XXX
 SG_ VCRIGHT_a567_2RowSeatRequestWhil m9 : 30|1@1+ (1,0) [0|1] "" Vector__XXX
 SG_ VCRIGHT_a568_2RowSeatClashAvoida m9 : 31|1@1+ (1,0) [0|1] "" Vector__XXX
 SG_ VCRIGHT_a569_2RowSeatOverfolded m9 : 32|1@1+ (1,0) [0|1] "" Vector__XXX
 SG_ VCRIGHT_a570_seatHeatDisabledF m9 : 33|1@1+ (1,0) [0|1] "" Vector__XXX
 SG_ VCRIGHT_a571_seatHeatDisabledRea m9 : 34|1@1+ (1,0) [0|1] "" Vector__XXX
 SG_ VCRIGHT_a572_seatHeatDisabledRea m9 : 35|1@1+ (1,0) [0|1] "" Vector__XXX
 SG_ VCRIGHT_a573_seatHeatDisabledRea m9 : 36|1@1+ (1,0) [0|1] "" Vector__XXX
 SG_ VCRIGHT_a577_bsiHardwareIssue m9 : 40|1@1+ (1,0) [0|1] "" Vector__XXX
 SG_ VCRIGHT_a578_RGBLightFault m9 : 41|1@1+ (1,0) [0|1] "" Vector__XXX
 SG_ VCRIGHT_a579_liftgateFollowerUne m9 : 42|1@1+ (1,0) [0|1] "" Vector__XXX
 SG_ VCRIGHT_a580_debugLiftgateFollow m9 : 43|1@1+ (1,0) [0|1] "" Vector__XXX
 SG_ VCRIGHT_a583_doorRemoteUnlatched m9 : 46|1@1+ (1,0) [0|1] "" Vector__XXX
 SG_ VCRIGHT_a584_doorRemoteUnlatched m9 : 47|1@1+ (1,0) [0|1] "" Vector__XXX
 SG_ VCRIGHT_a585_doorRemoteUnlatchFa m9 : 48|1@1+ (1,0) [0|1] "" Vector__XXX
 SG_ VCRIGHT_a586_doorRemoteUnlatchFa m9 : 49|1@1+ (1,0) [0|1] "" Vector__XXX
 SG_ VCRIGHT_a598_childModeMonitorTri m9 : 61|1@1+ (1,0) [0|1] "" Vector__XXX
 SG_ VCRIGHT_a599_LVBatteryTypeUnsupp m9 : 62|1@1+ (1,0) [0|1] "" Vector__XXX
 SG_ VCRIGHT_a617_APP_MIA m10 : 20|1@1+ (1,0) [0|1] "" Vector__XXX

BO_ 1795 VCRIGHT_debugThermal10Hz: 8 VCRIGHT
 SG_ VCRIGHT_debugThermal10HzIndex M : 0|4@1+ (1,0) [0|15] "" Vector__XXX
 SG_ VCRIGHT_hvacPanelFloorSplitRow1 m2 : 8|8@1+ (0.4,0) [0|100] "%" Vector__XXX
 SG_ VCRIGHT_hvacDefrostPercent m2 : 16|8@1+ (0.4,0) [0|100] "%" Vector__XXX
 SG_ VCRIGHT_hvacRow2Percent m2 : 24|8@1+ (0.4,0) [0|100] "%" Vector__XXX
 SG_ VCRIGHT_hvacPanelFloorSplitRow2 m2 : 32|8@1+ (0.4,0) [0|100] "%" Vector__XXX
 SG_ VCRIGHT_hvacFreshMassCounter m2 : 40|12@1+ (10,0) [0|40000] "kg" Vector__XXX
 SG_ VCRIGHT_hvacRecircMassCounter m2 : 52|12@1+ (10,0) [0|40000] "kg" Vector__XXX
 SG_ VCRIGHT_setTempAdjustmentLeft m3 : 8|7@1+ (0.1,0) [0|12] "degC" Vector__XXX
 SG_ VCRIGHT_setTempAdjustmentRight m3 : 16|7@1+ (0.1,0) [0|12] "degC" Vector__XXX
 SG_ VCRIGHT_hvacLHVaneVelocity m3 : 24|8@1- (0.8,0) [-100|100] "deg/s" Vector__XXX
 SG_ VCRIGHT_hvacRHVaneVelocity m3 : 32|8@1- (0.8,0) [-100|100] "deg/s" Vector__XXX
 SG_ VCRIGHT_hvacMassflowCompensated m3 : 47|8@1+ (1.5,0) [0|250] "g/s" Vector__XXX
 SG_ VCRIGHT_PTCcenterPowerLeft m5 : 8|6@1+ (30,0) [0|1800] "W" Vector__XXX
 SG_ VCRIGHT_PTCouterPowerLeft m5 : 16|6@1+ (30,0) [0|1800] "W" Vector__XXX
 SG_ VCRIGHT_PTCinnerPowerLeft m5 : 24|6@1+ (30,0) [0|1800] "W" Vector__XXX
 SG_ VCRIGHT_PTCcenterPowerRight m5 : 32|6@1+ (30,0) [0|1800] "W" Vector__XXX
 SG_ VCRIGHT_PTCouterPowerRight m5 : 40|6@1+ (30,0) [0|1800] "W" Vector__XXX
 SG_ VCRIGHT_PTCinnerPowerRight m5 : 48|6@1+ (30,0) [0|1800] "W" Vector__XXX
 SG_ VCRIGHT_PTCcenterStoneTempLeft m6 : 8|8@1+ (2,-70) [-70|440] "degC" Vector__XXX
 SG_ VCRIGHT_PTCcenterStoneTempRight m6 : 16|8@1+ (2,-70) [-70|440] "degC" Vector__XXX
 SG_ VCRIGHT_PTCinnerStoneTempLeft m6 : 24|8@1+ (2,-70) [-70|440] "degC" Vector__XXX
 SG_ VCRIGHT_PTCinnerStoneTempRight m6 : 32|8@1+ (2,-70) [-70|440] "degC" Vector__XXX
 SG_ VCRIGHT_PTCouterStoneTempLeft m7 : 8|8@1+ (2,-70) [-70|440] "degC" Vector__XXX
 SG_ VCRIGHT_PTCouterRodTempLeft m7 : 16|8@1+ (2,-70) [-70|440] "degC" Vector__XXX
 SG_ VCRIGHT_PTCouterAirTempLeft m7 : 24|8@1+ (2,-70) [-70|440] "degC" Vector__XXX
 SG_ VCRIGHT_PTCcenterRodTempLeft m7 : 32|8@1+ (2,-70) [-70|440] "degC" Vector__XXX
 SG_ VCRIGHT_PTCinnerRodTempLeft m7 : 40|8@1+ (2,-70) [-70|440] "degC" Vector__XXX
 SG_ VCRIGHT_PTCcenterAirTempLeft m7 : 48|8@1+ (2,-70) [-70|440] "degC" Vector__XXX
 SG_ VCRIGHT_PTCinnerAirTempLeft m7 : 56|8@1+ (2,-70) [-70|440] "degC" Vector__XXX
 SG_ VCRIGHT_PTCouterStoneTempRight m8 : 8|8@1+ (2,-70) [-70|440] "degC" Vector__XXX
 SG_ VCRIGHT_PTCouterRodTempRight m8 : 16|8@1+ (2,-70) [-70|440] "degC" Vector__XXX
 SG_ VCRIGHT_PTCouterAirTempRight m8 : 24|8@1+ (2,-70) [-70|440] "degC" Vector__XXX
 SG_ VCRIGHT_PTCcenterRodTempRight m8 : 32|8@1+ (2,-70) [-70|440] "degC" Vector__XXX
 SG_ VCRIGHT_PTCinnerRodTempRight m8 : 40|8@1+ (2,-70) [-70|440] "degC" Vector__XXX
 SG_ VCRIGHT_PTCcenterAirTempRight m8 : 48|8@1+ (2,-70) [-70|440] "degC" Vector__XXX
 SG_ VCRIGHT_PTCinnerAirTempRight m8 : 56|8@1+ (2,-70) [-70|440] "degC" Vector__XXX

CM_ SG_ 2011 VCRIGHT_a248_seatHeatTmpTarget "Right body controller: a248 seat heat tmp target";
CM_ SG_ 2011 VCRIGHT_a249_seatHeatCurrent "Right body controller: a249 seat heat current";
CM_ SG_ 2011 VCRIGHT_a249_seatHeatTmp "Right body controller: a249 seat heat tmp";
CM_ SG_ 2011 VCRIGHT_a250_seatHeatCurrent "Right body controller: a250 seat heat current";
CM_ SG_ 2011 VCRIGHT_a250_seatHeatTmp "Right body controller: a250 seat heat tmp";
CM_ SG_ 2011 VCRIGHT_a250_cushion "Right body controller: a250 cushion";
CM_ SG_ 2011 VCRIGHT_a250_backrest "Right body controller: a250 backrest";
CM_ SG_ 2011 VCRIGHT_a251_seatMotorCurrent "Right body controller: a251 seat motor current";
CM_ SG_ 2011 VCRIGHT_a251_seatMotorPosReal "Right body controller: a251 seat motor pos real";
CM_ SG_ 2011 VCRIGHT_a251_seatMotorState "Right body controller: a251 seat motor state";
CM_ SG_ 2011 VCRIGHT_a251_seatSwitchBack "Right body controller: a251 seat switch back";
CM_ SG_ 2011 VCRIGHT_a251_seatSwitchForward "Right body controller: a251 seat switch forward";
CM_ SG_ 2011 VCRIGHT_a252_seatMotorCurrent "Right body controller: a252 seat motor current";
CM_ SG_ 2011 VCRIGHT_a252_seatMotorPosReal "Right body controller: a252 seat motor pos real";
CM_ SG_ 2011 VCRIGHT_a252_seatMotorState "Right body controller: a252 seat motor state";
CM_ SG_ 2011 VCRIGHT_a252_seatSwitchBack "Right body controller: a252 seat switch back";
CM_ SG_ 2011 VCRIGHT_a252_seatSwitchForward "Right body controller: a252 seat switch forward";
CM_ SG_ 2011 VCRIGHT_a253_seatMotorCurrent "Right body controller: a253 seat motor current";
CM_ SG_ 2011 VCRIGHT_a253_seatMotorPosReal "Right body controller: a253 seat motor pos real";
CM_ SG_ 2011 VCRIGHT_a253_seatMotorState "Right body controller: a253 seat motor state";
CM_ SG_ 2011 VCRIGHT_a253_seatSwitchBack "Right body controller: a253 seat switch back";
CM_ SG_ 2011 VCRIGHT_a253_seatSwitchForward "Right body controller: a253 seat switch forward";
CM_ SG_ 2011 VCRIGHT_a254_seatMotorCurrent "Right body controller: a254 seat motor current";
CM_ SG_ 2011 VCRIGHT_a254_seatMotorPosReal "Right body controller: a254 seat motor pos real";
CM_ SG_ 2011 VCRIGHT_a254_seatMotorState "Right body controller: a254 seat motor state";
CM_ SG_ 2011 VCRIGHT_a254_seatSwitchBack "Right body controller: a254 seat switch back";
CM_ SG_ 2011 VCRIGHT_a254_seatSwitchForward "Right body controller: a254 seat switch forward";
CM_ SG_ 2011 VCRIGHT_a255_leftIGBTTemp "Right body controller: a255 left IGBT temp";
CM_ SG_ 2011 VCRIGHT_a255_rightIGBTTemp "Right body controller: a255 right IGBT temp";
CM_ SG_ 2011 VCRIGHT_a255_OCPTemp "Right body controller: a255 OCP temp";
CM_ SG_ 2011 VCRIGHT_a255_PCBTemp "Right body controller: a255 PCB temp";
CM_ SG_ 2011 VCRIGHT_a256_leftCurrent "Right body controller: a256 left current";
CM_ SG_ 2011 VCRIGHT_a256_rightCurrent "Right body controller: a256 right current";
CM_ SG_ 2011 VCRIGHT_a257_MIAStatus "Right body controller: a257 MIA status";
CM_ SG_ 2011 VCRIGHT_a258_bootIdFreq "Right body controller: a258 boot id freq";
CM_ SG_ 2011 VCRIGHT_a262_LVLow "Right body controller: a262 LV low";
CM_ SG_ 2011 VCRIGHT_a262_LVHigh "Right body controller: a262 LV high";
CM_ SG_ 2011 VCRIGHT_a262_HVLow "Right body controller: a262 HV low";
CM_ SG_ 2011 VCRIGHT_a262_HVHigh "Right body controller: a262 HV high";
CM_ SG_ 2011 VCRIGHT_a262_LeftOverCurrent "Right body controller: a262 left over current";
CM_ SG_ 2011 VCRIGHT_a262_RightOverCurrent "Right body controller: a262 right over current";
CM_ SG_ 2011 VCRIGHT_a262_LeftShutOutlet "Right body controller: a262 left shut outlet";
CM_ SG_ 2011 VCRIGHT_a262_RightShutOutlet "Right body controller: a262 right shut outlet";
CM_ SG_ 2011 VCRIGHT_a262_ThermalShutPCB "Right body controller: a262 thermal shut PCB";
CM_ SG_ 2011 VCRIGHT_a262_LeftThermalShutIGBT "Right body controller: a262 left thermal shut IGBT";
CM_ SG_ 2011 VCRIGHT_a262_RightThermalShutIGB "Right body controller: a262 right thermal shut IGBT";
CM_ SG_ 2011 VCRIGHT_a262_CANTimeout "Right body controller: a262 CAN timeout";
CM_ SG_ 2011 VCRIGHT_a262_LowVoltageSensor "Right body controller: a262 low voltage sensor";
CM_ SG_ 2011 VCRIGHT_a262_HighVoltageSensor "Right body controller: a262 high voltage sensor";
CM_ SG_ 2011 VCRIGHT_a262_LeftCurrentHVSensor "Right body controller: a262 left current HV sensor";
CM_ SG_ 2011 VCRIGHT_a262_RightCurrentHVSenso "Right body controller: a262 right current HV sensor";
CM_ SG_ 2011 VCRIGHT_a262_LeftTempIGBT "Right body controller: a262 left temp IGBT";
CM_ SG_ 2011 VCRIGHT_a262_TempOCP "Right body controller: a262 temp OCP";
CM_ SG_ 2011 VCRIGHT_a262_RightTempIGBT "Right body controller: a262 right temp IGBT";
CM_ SG_ 2011 VCRIGHT_a262_TempPCB "Right body controller: a262 temp PCB";
CM_ SG_ 2011 VCRIGHT_a262_LeftIGBTShort "Right body controller: a262 left IGBT short";
CM_ SG_ 2011 VCRIGHT_a262_RightIGBTShort "Right body controller: a262 right IGBT short";
CM_ SG_ 2011 VCRIGHT_a262_IGBTDriverTemporary "Right body controller: a262 IGBT driver temporary";
CM_ SG_ 2011 VCRIGHT_a262_IGBTDriverPermanent "Right body controller: a262 IGBT driver permanent";
CM_ SG_ 2011 VCRIGHT_a262_LeftIGBTOpen "Right body controller: a262 left IGBT open";
CM_ SG_ 2011 VCRIGHT_a262_RightIGBTOpen "Right body controller: a262 right IGBT open";
CM_ SG_ 2011 VCRIGHT_a263_seatMotorCurrent "Right body controller: a263 seat motor current";
CM_ SG_ 2011 VCRIGHT_a263_seatMotorDCurrent "Right body controller: a263 seat motor d current";
CM_ SG_ 2011 VCRIGHT_a263_seatMotorPosReal "Right body controller: a263 seat motor pos real";
CM_ SG_ 2011 VCRIGHT_a263_seatMotorState "Right body controller: a263 seat motor state";
CM_ SG_ 2011 VCRIGHT_a264_seatMotorCurrent "Right body controller: a264 seat motor current";
CM_ SG_ 2011 VCRIGHT_a264_seatMotorDCurrent "Right body controller: a264 seat motor d current";
CM_ SG_ 2011 VCRIGHT_a264_seatMotorPosReal "Right body controller: a264 seat motor pos real";
CM_ SG_ 2011 VCRIGHT_a264_seatMotorState "Right body controller: a264 seat motor state";
CM_ SG_ 2011 VCRIGHT_a265_seatMotorCurrent "Right body controller: a265 seat motor current";
CM_ SG_ 2011 VCRIGHT_a265_seatMotorDCurrent "Right body controller: a265 seat motor d current";
CM_ SG_ 2011 VCRIGHT_a265_seatMotorPosReal "Right body controller: a265 seat motor pos real";
CM_ SG_ 2011 VCRIGHT_a265_seatMotorState "Right body controller: a265 seat motor state";
CM_ SG_ 2011 VCRIGHT_a266_seatMotorCurrent "Right body controller: a266 seat motor current";
CM_ SG_ 2011 VCRIGHT_a266_seatMotorDCurrent "Right body controller: a266 seat motor d current";
CM_ SG_ 2011 VCRIGHT_a266_seatMotorPosReal "Right body controller: a266 seat motor pos real";
CM_ SG_ 2011 VCRIGHT_a266_seatMotorState "Right body controller: a266 seat motor state";
CM_ SG_ 2011 VCRIGHT_a267_seatMotorCurrent "Right body controller: a267 seat motor current";
CM_ SG_ 2011 VCRIGHT_a267_seatMotorDCurrent "Right body controller: a267 seat motor d current";
CM_ SG_ 2011 VCRIGHT_a267_seatMotorPosReal "Right body controller: a267 seat motor pos real";
CM_ SG_ 2011 VCRIGHT_a267_seatMotorState "Right body controller: a267 seat motor state";
CM_ SG_ 2011 VCRIGHT_a268_seatMotorCurrent "Right body controller: a268 seat motor current";
CM_ SG_ 2011 VCRIGHT_a268_seatMotorDCurrent "Right body controller: a268 seat motor d current";
CM_ SG_ 2011 VCRIGHT_a268_seatMotorPosReal "Right body controller: a268 seat motor pos real";
CM_ SG_ 2011 VCRIGHT_a268_seatMotorState "Right body controller: a268 seat motor state";
CM_ SG_ 2011 VCRIGHT_a269_seatMotorCurrent "Right body controller: a269 seat motor current";
CM_ SG_ 2011 VCRIGHT_a269_seatMotorDCurrent "Right body controller: a269 seat motor d current";
CM_ SG_ 2011 VCRIGHT_a269_seatMotorPosReal "Right body controller: a269 seat motor pos real";
CM_ SG_ 2011 VCRIGHT_a269_seatMotorState "Right body controller: a269 seat motor state";
CM_ SG_ 2011 VCRIGHT_a270_seatMotorCurrent "Right body controller: a270 seat motor current";
CM_ SG_ 2011 VCRIGHT_a270_seatMotorDCurrent "Right body controller: a270 seat motor d current";
CM_ SG_ 2011 VCRIGHT_a270_seatMotorPosReal "Right body controller: a270 seat motor pos real";
CM_ SG_ 2011 VCRIGHT_a270_seatMotorState "Right body controller: a270 seat motor state";
CM_ SG_ 2011 VCRIGHT_a271_humiditySensorSNA "Right body controller: a271 humidity sensor SNA";
CM_ SG_ 2011 VCRIGHT_a271_temperatureSensorSN "Right body controller: a271 temperature sensor SNA";
CM_ SG_ 2011 VCRIGHT_a271_solarVisSensorSNA "Right body controller: a271 solar vis sensor SNA";
CM_ SG_ 2011 VCRIGHT_a271_solarInfSensorSNA "Right body controller: a271 solar inf sensor SNA";
CM_ SG_ 2011 VCRIGHT_a273_handlePWM "Right body controller: a273 handle PWM";
CM_ SG_ 2011 VCRIGHT_a273_temperature "Right body controller: a273 temperature";
CM_ SG_ 2011 VCRIGHT_a274_handlePWM "Right body controller: a274 handle PWM";
CM_ SG_ 2011 VCRIGHT_a274_temperature "Right body controller: a274 temperature";
CM_ SG_ 2011 VCRIGHT_a275_outputFaulted "Right body controller: a275 output faulted";
CM_ SG_ 2011 VCRIGHT_a275_currentSenseFaulted "Right body controller: a275 current sense faulted";
CM_ SG_ 2011 VCRIGHT_a275_tempSenseFaulted "Right body controller: a275 temp sense faulted";
CM_ SG_ 2011 VCRIGHT_a275_underCurrent "Right body controller: a275 under current";
CM_ SG_ 2011 VCRIGHT_a275_overCurrent "Right body controller: a275 over current";
CM_ SG_ 2011 VCRIGHT_a275_overTemperature "Right body controller: a275 over temperature";
CM_ SG_ 2011 VCRIGHT_a278_HVLow "Right body controller: a278 HV low";
CM_ SG_ 2011 VCRIGHT_a278_PTCMIA "Right body controller: a278 PTCMIA";
CM_ SG_ 2011 VCRIGHT_a284_gloveboxMinCurrent "Right body controller: a284 glovebox min current";
CM_ SG_ 2011 VCRIGHT_a284_gloveboxMaxCurrent "Right body controller: a284 glovebox max current";
CM_ SG_ 2011 VCRIGHT_a284_cabinTempInterior "Right body controller: a284 cabin temp interior";
CM_ SG_ 2011 VCRIGHT_a285_gloveboxMinCurrent "Right body controller: a285 glovebox min current";
CM_ SG_ 2011 VCRIGHT_a285_gloveboxMaxCurrent "Right body controller: a285 glovebox max current";
CM_ SG_ 2011 VCRIGHT_a285_cabinTempInterior "Right body controller: a285 cabin temp interior";
CM_ SG_ 2011 VCRIGHT_a290_isNetworkSwitch "Right body controller: a290 is network switch";
CM_ SG_ 2011 VCRIGHT_a290_occupancySensorV "Right body controller: a290 occupancy sensor v";
CM_ SG_ 2011 VCRIGHT_a290_railVoltage "Right body controller: a290 rail voltage";
CM_ SG_ 2011 VCRIGHT_a291_buckleSensorVoltage "Right body controller: a291 buckle sensor voltage";
CM_ SG_ 2011 VCRIGHT_a291_railVoltage "Right body controller: a291 rail voltage";
CM_ SG_ 2011 VCRIGHT_a292_buckleSensorVoltage "Right body controller: a292 buckle sensor voltage";
CM_ SG_ 2011 VCRIGHT_a292_railV "Right body controller: a292 rail v";
CM_ SG_ 2011 VCRIGHT_a293_buckleSensorVoltage "Right body controller: a293 buckle sensor voltage";
CM_ SG_ 2011 VCRIGHT_a293_railV "Right body controller: a293 rail v";
CM_ SG_ 2011 VCRIGHT_a294_isNetworkSwitch "Right body controller: a294 is network switch";
CM_ SG_ 2011 VCRIGHT_a294_occupancySensorV "Right body controller: a294 occupancy sensor v";
CM_ SG_ 2011 VCRIGHT_a294_railV "Right body controller: a294 rail v";
CM_ SG_ 2011 VCRIGHT_a295_isNetworkSwitch "Right body controller: a295 is network switch";
CM_ SG_ 2011 VCRIGHT_a295_occupancySensorV "Right body controller: a295 occupancy sensor v";
CM_ SG_ 2011 VCRIGHT_a295_railV "Right body controller: a295 rail v";
CM_ SG_ 2011 VCRIGHT_a296_isNetworkSwitch "Right body controller: a296 is network switch";
CM_ SG_ 2011 VCRIGHT_a296_occupancySensorV "Right body controller: a296 occupancy sensor v";
CM_ SG_ 2011 VCRIGHT_a296_railV "Right body controller: a296 rail v";
CM_ SG_ 2011 VCRIGHT_a297_cabinTmp "Right body controller: a297 cabin tmp";
CM_ SG_ 2011 VCRIGHT_a298_buckleSensorVoltage "Right body controller: a298 buckle sensor voltage";
CM_ SG_ 2011 VCRIGHT_a298_railV "Right body controller: a298 rail v";
CM_ SG_ 2011 VCRIGHT_a299_buckleSensorVoltage "Right body controller: a299 buckle sensor voltage";
CM_ SG_ 2011 VCRIGHT_a299_railV "Right body controller: a299 rail v";
CM_ SG_ 2011 VCRIGHT_a302_calibrationPositive "Right body controller: a302 calibration positive direction";
CM_ SG_ 2011 VCRIGHT_a302_calibrationNegative "Right body controller: a302 calibration negative direction";
CM_ SG_ 2011 VCRIGHT_a302_uncalibrated "Right body controller: a302 uncalibrated";
CM_ SG_ 2011 VCRIGHT_a302_driverFault "Right body controller: a302 driver fault";
CM_ SG_ 2011 VCRIGHT_a302_connected "Right body controller: a302 connected";
CM_ SG_ 2011 VCRIGHT_a302_targetMissed "Right body controller: a302 target missed";
CM_ SG_ 2011 VCRIGHT_a302_positionTarget "Right body controller: a302 position target";
CM_ SG_ 2011 VCRIGHT_a302_positionActual "Right body controller: a302 position actual";
CM_ SG_ 2011 VCRIGHT_a303_eFuseTripCount "Right body controller: a303 e fuse trip count";
CM_ SG_ 2011 VCRIGHT_a306_disconnectedTime "Right body controller: a306 disconnected time";
CM_ SG_ 2011 VCRIGHT_a307_disconnectedTime "Right body controller: a307 disconnected time";
CM_ SG_ 2011 VCRIGHT_a308_calibrationPositive "Right body controller: a308 calibration positive direction";
CM_ SG_ 2011 VCRIGHT_a308_calibrationNegative "Right body controller: a308 calibration negative direction";
CM_ SG_ 2011 VCRIGHT_a308_uncalibrated "Right body controller: a308 uncalibrated";
CM_ SG_ 2011 VCRIGHT_a308_driverFault "Right body controller: a308 driver fault";
CM_ SG_ 2011 VCRIGHT_a308_connected "Right body controller: a308 connected";
CM_ SG_ 2011 VCRIGHT_a308_targetMissed "Right body controller: a308 target missed";
CM_ SG_ 2011 VCRIGHT_a308_positionTarget "Right body controller: a308 position target";
CM_ SG_ 2011 VCRIGHT_a308_positionActual "Right body controller: a308 position actual";
CM_ SG_ 2011 VCRIGHT_a310_mirrorFoldTime "Right body controller: a310 mirror fold time";
CM_ SG_ 2011 VCRIGHT_a310_foldingDirection "Right body controller: a310 folding direction";
CM_ SG_ 2011 VCRIGHT_a310_mirrorMaxFoldCurren "Right body controller: a310 mirror max fold current";
CM_ SG_ 2011 VCRIGHT_a310_ambientTemperature "Right body controller: a310 ambient temperature";
CM_ SG_ 2011 VCRIGHT_a311_outputFaulted "Right body controller: a311 output faulted";
CM_ SG_ 2011 VCRIGHT_a311_currentSenseFaulted "Right body controller: a311 current sense faulted";
CM_ SG_ 2011 VCRIGHT_a311_tempSenseFaulted "Right body controller: a311 temp sense faulted";
CM_ SG_ 2011 VCRIGHT_a311_underCurrent "Right body controller: a311 under current";
CM_ SG_ 2011 VCRIGHT_a311_overCurrent "Right body controller: a311 over current";
CM_ SG_ 2011 VCRIGHT_a311_overTemperature "Right body controller: a311 over temperature";
CM_ SG_ 2011 VCRIGHT_a312_outputFaulted "Right body controller: a312 output faulted";
CM_ SG_ 2011 VCRIGHT_a312_currentSenseFaulted "Right body controller: a312 current sense faulted";
CM_ SG_ 2011 VCRIGHT_a312_tempSenseFaulted "Right body controller: a312 temp sense faulted";
CM_ SG_ 2011 VCRIGHT_a312_underCurrent "Right body controller: a312 under current";
CM_ SG_ 2011 VCRIGHT_a312_overCurrent "Right body controller: a312 over current";
CM_ SG_ 2011 VCRIGHT_a312_overTemperature "Right body controller: a312 over temperature";
CM_ SG_ 2011 VCRIGHT_a313_outputFaulted "Right body controller: a313 output faulted";
CM_ SG_ 2011 VCRIGHT_a313_currentSenseFaulted "Right body controller: a313 current sense faulted";
CM_ SG_ 2011 VCRIGHT_a313_tempSenseFaulted "Right body controller: a313 temp sense faulted";
CM_ SG_ 2011 VCRIGHT_a313_underCurrent "Right body controller: a313 under current";
CM_ SG_ 2011 VCRIGHT_a313_overCurrent "Right body controller: a313 over current";
CM_ SG_ 2011 VCRIGHT_a313_overTemperature "Right body controller: a313 over temperature";
CM_ SG_ 2011 VCRIGHT_a314_outputFaulted "Right body controller: a314 output faulted";
CM_ SG_ 2011 VCRIGHT_a314_currentSenseFaulted "Right body controller: a314 current sense faulted";
CM_ SG_ 2011 VCRIGHT_a314_tempSenseFaulted "Right body controller: a314 temp sense faulted";
CM_ SG_ 2011 VCRIGHT_a314_underCurrent "Right body controller: a314 under current";
CM_ SG_ 2011 VCRIGHT_a314_overCurrent "Right body controller: a314 over current";
CM_ SG_ 2011 VCRIGHT_a314_overTemperature "Right body controller: a314 over temperature";
CM_ SG_ 2011 VCRIGHT_a315_outputFaulted "Right body controller: a315 output faulted";
CM_ SG_ 2011 VCRIGHT_a315_currentSenseFaulted "Right body controller: a315 current sense faulted";
CM_ SG_ 2011 VCRIGHT_a315_tempSenseFaulted "Right body controller: a315 temp sense faulted";
CM_ SG_ 2011 VCRIGHT_a315_underCurrent "Right body controller: a315 under current";
CM_ SG_ 2011 VCRIGHT_a315_overCurrent "Right body controller: a315 over current";
CM_ SG_ 2011 VCRIGHT_a315_overTemperature "Right body controller: a315 over temperature";
CM_ SG_ 2011 VCRIGHT_a316_foldState "Right body controller: a316 fold state";
CM_ SG_ 2011 VCRIGHT_a316_actuationDurationMs "Right body controller: a316 actuation duration ms";
CM_ SG_ 2011 VCRIGHT_a316_maxCurrentAmps "Right body controller: a316 max current amps";
CM_ SG_ 2011 VCRIGHT_a316_averageCurrentAmps "Right body controller: a316 average current amps";
CM_ SG_ 2011 VCRIGHT_a316_ambientTemperatureD "Right body controller: a316 ambient temperature deg c";
CM_ SG_ 2011 VCRIGHT_a318_outputFaulted "Right body controller: a318 output faulted";
CM_ SG_ 2011 VCRIGHT_a318_currentSenseFaulted "Right body controller: a318 current sense faulted";
CM_ SG_ 2011 VCRIGHT_a318_tempSenseFaulted "Right body controller: a318 temp sense faulted";
CM_ SG_ 2011 VCRIGHT_a318_underCurrent "Right body controller: a318 under current";
CM_ SG_ 2011 VCRIGHT_a318_overCurrent "Right body controller: a318 over current";
CM_ SG_ 2011 VCRIGHT_a318_overTemperature "Right body controller: a318 over temperature";
CM_ SG_ 2011 VCRIGHT_a319_outputFaulted "Right body controller: a319 output faulted";
CM_ SG_ 2011 VCRIGHT_a319_currentSenseFaulted "Right body controller: a319 current sense faulted";
CM_ SG_ 2011 VCRIGHT_a319_tempSenseFaulted "Right body controller: a319 temp sense faulted";
CM_ SG_ 2011 VCRIGHT_a319_underCurrent "Right body controller: a319 under current";
CM_ SG_ 2011 VCRIGHT_a319_overCurrent "Right body controller: a319 over current";
CM_ SG_ 2011 VCRIGHT_a319_overTemperature "Right body controller: a319 over temperature";
CM_ SG_ 2011 VCRIGHT_a324_mirrorHeatCurrent "Right body controller: a324 mirror heat current";
CM_ SG_ 2011 VCRIGHT_a325_calibrationPositive "Right body controller: a325 calibration positive direction";
CM_ SG_ 2011 VCRIGHT_a325_calibrationNegative "Right body controller: a325 calibration negative direction";
CM_ SG_ 2011 VCRIGHT_a325_uncalibrated "Right body controller: a325 uncalibrated";
CM_ SG_ 2011 VCRIGHT_a325_driverFault "Right body controller: a325 driver fault";
CM_ SG_ 2011 VCRIGHT_a325_connected "Right body controller: a325 connected";
CM_ SG_ 2011 VCRIGHT_a325_targetMissed "Right body controller: a325 target missed";
CM_ SG_ 2011 VCRIGHT_a325_positionTarget "Right body controller: a325 position target";
CM_ SG_ 2011 VCRIGHT_a325_positionActual "Right body controller: a325 position actual";
CM_ SG_ 2011 VCRIGHT_a326_calibrationPositive "Right body controller: a326 calibration positive direction";
CM_ SG_ 2011 VCRIGHT_a326_calibrationNegative "Right body controller: a326 calibration negative direction";
CM_ SG_ 2011 VCRIGHT_a326_uncalibrated "Right body controller: a326 uncalibrated";
CM_ SG_ 2011 VCRIGHT_a326_driverFault "Right body controller: a326 driver fault";
CM_ SG_ 2011 VCRIGHT_a326_connected "Right body controller: a326 connected";
CM_ SG_ 2011 VCRIGHT_a326_targetMissed "Right body controller: a326 target missed";
CM_ SG_ 2011 VCRIGHT_a326_positionTarget "Right body controller: a326 position target";
CM_ SG_ 2011 VCRIGHT_a326_positionActual "Right body controller: a326 position actual";
CM_ SG_ 2011 VCRIGHT_a330_voltage "Right body controller: a330 voltage";
CM_ SG_ 2011 VCRIGHT_a330_maxCurrent "Right body controller: a330 max current";
CM_ SG_ 2011 VCRIGHT_a330_temperature "Right body controller: a330 temperature";
CM_ SG_ 2011 VCRIGHT_a331_voltage "Right body controller: a331 voltage";
CM_ SG_ 2011 VCRIGHT_a331_maxCurrent "Right body controller: a331 max current";
CM_ SG_ 2011 VCRIGHT_a331_temperature "Right body controller: a331 temperature";
CM_ SG_ 2011 VCRIGHT_a343_rearDefrostCurrent "Right body controller: a343 rear defrost current";
CM_ SG_ 2011 VCRIGHT_a343_batteryVoltage "Right body controller: a343 battery voltage";
CM_ SG_ 2011 VCRIGHT_a343_ambientTemperature "Right body controller: a343 ambient temperature";
CM_ SG_ 2011 VCRIGHT_a344_rearDefrostCurrent "Right body controller: a344 rear defrost current";
CM_ SG_ 2011 VCRIGHT_a344_batteryVoltage "Right body controller: a344 battery voltage";
CM_ SG_ 2011 VCRIGHT_a344_ambientTemperature "Right body controller: a344 ambient temperature";
CM_ SG_ 2011 VCRIGHT_a345_PTCTHSGBPwrCurrent "Right body controller: a345 PTCTHSGB pwr current";
CM_ SG_ 2011 VCRIGHT_a368_snsShortCircuit "Right body controller: a368 sns short circuit";
CM_ SG_ 2011 VCRIGHT_a368_snsDisconnect "Right body controller: a368 sns disconnect";
CM_ SG_ 2011 VCRIGHT_a368_snsRateChangeUp "Right body controller: a368 sns rate change up";
CM_ SG_ 2011 VCRIGHT_a368_snsRateChangeDown "Right body controller: a368 sns rate change down";
CM_ SG_ 2011 VCRIGHT_a369_snsShortCircuit "Right body controller: a369 sns short circuit";
CM_ SG_ 2011 VCRIGHT_a369_snsDisconnect "Right body controller: a369 sns disconnect";
CM_ SG_ 2011 VCRIGHT_a369_snsRateChangeUp "Right body controller: a369 sns rate change up";
CM_ SG_ 2011 VCRIGHT_a369_snsRateChangeDown "Right body controller: a369 sns rate change down";
CM_ SG_ 2011 VCRIGHT_a373_windowChannel "Right body controller: a373 window channel";
CM_ SG_ 2011 VCRIGHT_a375_windowFront "Right body controller: a375 window front";
CM_ SG_ 2011 VCRIGHT_a376_2RowSeatTrackActuat "Right body controller: a376 2 row seat track actuator current";
CM_ SG_ 2011 VCRIGHT_a376_2RowSeatTrackA_0001 "Right body controller: a376 2 row seat track actuator duty";
CM_ SG_ 2011 VCRIGHT_a376_2RowSeatEasyEntrySt "Right body controller: a376 2 row seat easy entry state";
CM_ SG_ 2011 VCRIGHT_a376_2RowSeatTrackPositi "Right body controller: a376 2 row seat track position switch";
CM_ SG_ 2011 VCRIGHT_a377_snsShortCircuit "Right body controller: a377 sns short circuit";
CM_ SG_ 2011 VCRIGHT_a377_snsDisconnect "Right body controller: a377 sns disconnect";
CM_ SG_ 2011 VCRIGHT_a377_snsRateChangeUp "Right body controller: a377 sns rate change up";
CM_ SG_ 2011 VCRIGHT_a377_snsRateChangeDown "Right body controller: a377 sns rate change down";
CM_ SG_ 2011 VCRIGHT_a378_snsShortCircuit "Right body controller: a378 sns short circuit";
CM_ SG_ 2011 VCRIGHT_a378_snsDisconnect "Right body controller: a378 sns disconnect";
CM_ SG_ 2011 VCRIGHT_a378_snsRateChangeUp "Right body controller: a378 sns rate change up";
CM_ SG_ 2011 VCRIGHT_a378_snsRateChangeDown "Right body controller: a378 sns rate change down";
CM_ SG_ 2011 VCRIGHT_a379_snsShortCircuit "Right body controller: a379 sns short circuit";
CM_ SG_ 2011 VCRIGHT_a379_snsDisconnect "Right body controller: a379 sns disconnect";
CM_ SG_ 2011 VCRIGHT_a379_snsRateChangeUp "Right body controller: a379 sns rate change up";
CM_ SG_ 2011 VCRIGHT_a379_snsRateChangeDown "Right body controller: a379 sns rate change down";
CM_ SG_ 2011 VCRIGHT_a380_outputFaulted "Right body controller: a380 output faulted";
CM_ SG_ 2011 VCRIGHT_a380_currentSenseFaulted "Right body controller: a380 current sense faulted";
CM_ SG_ 2011 VCRIGHT_a380_tempSenseFaulted "Right body controller: a380 temp sense faulted";
CM_ SG_ 2011 VCRIGHT_a380_underCurrent "Right body controller: a380 under current";
CM_ SG_ 2011 VCRIGHT_a380_overCurrent "Right body controller: a380 over current";
CM_ SG_ 2011 VCRIGHT_a380_overTemperature "Right body controller: a380 over temperature";
CM_ SG_ 2011 VCRIGHT_a381_outputFaulted "Right body controller: a381 output faulted";
CM_ SG_ 2011 VCRIGHT_a381_currentSenseFaulted "Right body controller: a381 current sense faulted";
CM_ SG_ 2011 VCRIGHT_a381_tempSenseFaulted "Right body controller: a381 temp sense faulted";
CM_ SG_ 2011 VCRIGHT_a381_underCurrent "Right body controller: a381 under current";
CM_ SG_ 2011 VCRIGHT_a381_overCurrent "Right body controller: a381 over current";
CM_ SG_ 2011 VCRIGHT_a381_overTemperature "Right body controller: a381 over temperature";
CM_ SG_ 2011 VCRIGHT_a382_outputFaulted "Right body controller: a382 output faulted";
CM_ SG_ 2011 VCRIGHT_a382_currentSenseFaulted "Right body controller: a382 current sense faulted";
CM_ SG_ 2011 VCRIGHT_a382_tempSenseFaulted "Right body controller: a382 temp sense faulted";
CM_ SG_ 2011 VCRIGHT_a382_underCurrent "Right body controller: a382 under current";
CM_ SG_ 2011 VCRIGHT_a382_overCurrent "Right body controller: a382 over current";
CM_ SG_ 2011 VCRIGHT_a382_overTemperature "Right body controller: a382 over temperature";
CM_ SG_ 2011 VCRIGHT_a406_frame1MIA "Right body controller: a406 frame1 MIA";
CM_ SG_ 2011 VCRIGHT_a406_frame2MIA "Right body controller: a406 frame2 MIA";
CM_ SG_ 2011 VCRIGHT_a407_configMismatch "Right body controller: a407 config mismatch";
CM_ SG_ 2011 VCRIGHT_a407_counterError "Right body controller: a407 counter error";
CM_ SG_ 2011 VCRIGHT_a407_checksumError "Right body controller: a407 checksum error";
CM_ SG_ 2011 VCRIGHT_a407_linResponseError "Right body controller: a407 lin response error";
CM_ SG_ 2011 VCRIGHT_a408_generalError "Right body controller: a408 general error";
CM_ SG_ 2011 VCRIGHT_a408_seatbeltError "Right body controller: a408 seatbelt error";
CM_ SG_ 2011 VCRIGHT_a408_doorError "Right body controller: a408 door error";
CM_ SG_ 2011 VCRIGHT_a408_ALRError "Right body controller: a408 ALR error";
CM_ SG_ 2011 VCRIGHT_a408_pressureError "Right body controller: a408 pressure error";
CM_ SG_ 2011 VCRIGHT_a408_fluidLevelError "Right body controller: a408 fluid level error";
CM_ SG_ 2011 VCRIGHT_a408_temperatureError "Right body controller: a408 temperature error";
CM_ SG_ 2011 VCRIGHT_a408_hardwareInternalErr "Right body controller: a408 hardware internal error";
CM_ SG_ 2011 VCRIGHT_a408_overvoltageError "Right body controller: a408 overvoltage error";
CM_ SG_ 2011 VCRIGHT_a408_overcurrentError "Right body controller: a408 overcurrent error";
CM_ SG_ 2011 VCRIGHT_a408_ignitionError "Right body controller: a408 ignition error";
CM_ SG_ 2011 VCRIGHT_a408_calibrationError "Right body controller: a408 calibration error";
CM_ SG_ 2011 VCRIGHT_a408_trimError "Right body controller: a408 trim error";
CM_ SG_ 2011 VCRIGHT_a412_outputFaulted "Right body controller: a412 output faulted";
CM_ SG_ 2011 VCRIGHT_a412_currentSenseFaulted "Right body controller: a412 current sense faulted";
CM_ SG_ 2011 VCRIGHT_a412_tempSenseFaulted "Right body controller: a412 temp sense faulted";
CM_ SG_ 2011 VCRIGHT_a412_underCurrent "Right body controller: a412 under current";
CM_ SG_ 2011 VCRIGHT_a412_overCurrent "Right body controller: a412 over current";
CM_ SG_ 2011 VCRIGHT_a412_overTemperature "Right body controller: a412 over temperature";
CM_ SG_ 2011 VCRIGHT_a413_outputFaulted "Right body controller: a413 output faulted";
CM_ SG_ 2011 VCRIGHT_a413_currentSenseFaulted "Right body controller: a413 current sense faulted";
CM_ SG_ 2011 VCRIGHT_a413_tempSenseFaulted "Right body controller: a413 temp sense faulted";
CM_ SG_ 2011 VCRIGHT_a413_underCurrent "Right body controller: a413 under current";
CM_ SG_ 2011 VCRIGHT_a413_overCurrent "Right body controller: a413 over current";
CM_ SG_ 2011 VCRIGHT_a413_overTemperature "Right body controller: a413 over temperature";
CM_ SG_ 2011 VCRIGHT_a414_outputFaulted "Right body controller: a414 output faulted";
CM_ SG_ 2011 VCRIGHT_a414_currentSenseFaulted "Right body controller: a414 current sense faulted";
CM_ SG_ 2011 VCRIGHT_a414_tempSenseFaulted "Right body controller: a414 temp sense faulted";
CM_ SG_ 2011 VCRIGHT_a414_underCurrent "Right body controller: a414 under current";
CM_ SG_ 2011 VCRIGHT_a414_overCurrent "Right body controller: a414 over current";
CM_ SG_ 2011 VCRIGHT_a414_overTemperature "Right body controller: a414 over temperature";
CM_ SG_ 2011 VCRIGHT_a415_outputFaulted "Right body controller: a415 output faulted";
CM_ SG_ 2011 VCRIGHT_a415_currentSenseFaulted "Right body controller: a415 current sense faulted";
CM_ SG_ 2011 VCRIGHT_a415_tempSenseFaulted "Right body controller: a415 temp sense faulted";
CM_ SG_ 2011 VCRIGHT_a415_underCurrent "Right body controller: a415 under current";
CM_ SG_ 2011 VCRIGHT_a415_overCurrent "Right body controller: a415 over current";
CM_ SG_ 2011 VCRIGHT_a415_overTemperature "Right body controller: a415 over temperature";
CM_ SG_ 2011 VCRIGHT_a416_outputFaulted "Right body controller: a416 output faulted";
CM_ SG_ 2011 VCRIGHT_a416_currentSenseFaulted "Right body controller: a416 current sense faulted";
CM_ SG_ 2011 VCRIGHT_a416_tempSenseFaulted "Right body controller: a416 temp sense faulted";
CM_ SG_ 2011 VCRIGHT_a416_underCurrent "Right body controller: a416 under current";
CM_ SG_ 2011 VCRIGHT_a416_overCurrent "Right body controller: a416 over current";
CM_ SG_ 2011 VCRIGHT_a416_overTemperature "Right body controller: a416 over temperature";
CM_ SG_ 2011 VCRIGHT_a417_outputFaulted "Right body controller: a417 output faulted";
CM_ SG_ 2011 VCRIGHT_a417_currentSenseFaulted "Right body controller: a417 current sense faulted";
CM_ SG_ 2011 VCRIGHT_a417_tempSenseFaulted "Right body controller: a417 temp sense faulted";
CM_ SG_ 2011 VCRIGHT_a417_underCurrent "Right body controller: a417 under current";
CM_ SG_ 2011 VCRIGHT_a417_overCurrent "Right body controller: a417 over current";
CM_ SG_ 2011 VCRIGHT_a417_overTemperature "Right body controller: a417 over temperature";
CM_ SG_ 2011 VCRIGHT_a418_outputFaulted "Right body controller: a418 output faulted";
CM_ SG_ 2011 VCRIGHT_a418_currentSenseFaulted "Right body controller: a418 current sense faulted";
CM_ SG_ 2011 VCRIGHT_a418_tempSenseFaulted "Right body controller: a418 temp sense faulted";
CM_ SG_ 2011 VCRIGHT_a418_underCurrent "Right body controller: a418 under current";
CM_ SG_ 2011 VCRIGHT_a418_overCurrent "Right body controller: a418 over current";
CM_ SG_ 2011 VCRIGHT_a418_overTemperature "Right body controller: a418 over temperature";
CM_ SG_ 2011 VCRIGHT_a419_outputFaulted "Right body controller: a419 output faulted";
CM_ SG_ 2011 VCRIGHT_a419_currentSenseFaulted "Right body controller: a419 current sense faulted";
CM_ SG_ 2011 VCRIGHT_a419_tempSenseFaulted "Right body controller: a419 temp sense faulted";
CM_ SG_ 2011 VCRIGHT_a419_underCurrent "Right body controller: a419 under current";
CM_ SG_ 2011 VCRIGHT_a419_overCurrent "Right body controller: a419 over current";
CM_ SG_ 2011 VCRIGHT_a419_overTemperature "Right body controller: a419 over temperature";
CM_ SG_ 2011 VCRIGHT_a420_outputFaulted "Right body controller: a420 output faulted";
CM_ SG_ 2011 VCRIGHT_a420_currentSenseFaulted "Right body controller: a420 current sense faulted";
CM_ SG_ 2011 VCRIGHT_a420_tempSenseFaulted "Right body controller: a420 temp sense faulted";
CM_ SG_ 2011 VCRIGHT_a420_underCurrent "Right body controller: a420 under current";
CM_ SG_ 2011 VCRIGHT_a420_overCurrent "Right body controller: a420 over current";
CM_ SG_ 2011 VCRIGHT_a420_overTemperature "Right body controller: a420 over temperature";
CM_ SG_ 2011 VCRIGHT_a421_outputFaulted "Right body controller: a421 output faulted";
CM_ SG_ 2011 VCRIGHT_a421_currentSenseFaulted "Right body controller: a421 current sense faulted";
CM_ SG_ 2011 VCRIGHT_a421_tempSenseFaulted "Right body controller: a421 temp sense faulted";
CM_ SG_ 2011 VCRIGHT_a421_underCurrent "Right body controller: a421 under current";
CM_ SG_ 2011 VCRIGHT_a421_overCurrent "Right body controller: a421 over current";
CM_ SG_ 2011 VCRIGHT_a421_overTemperature "Right body controller: a421 over temperature";
CM_ SG_ 2011 VCRIGHT_a426_seatMotorCalibrated "Right body controller: a426 seat motor calibrated";
CM_ SG_ 2011 VCRIGHT_a426_seatMotorCurrent "Right body controller: a426 seat motor current";
CM_ SG_ 2011 VCRIGHT_a426_seatMotorPosReal "Right body controller: a426 seat motor pos real";
CM_ SG_ 2011 VCRIGHT_a426_seatMotorState "Right body controller: a426 seat motor state";
CM_ SG_ 2011 VCRIGHT_a426_seatSwitchBack "Right body controller: a426 seat switch back";
CM_ SG_ 2011 VCRIGHT_a426_seatSwitchForward "Right body controller: a426 seat switch forward";
CM_ SG_ 2011 VCRIGHT_a426_cabinTmp "Right body controller: a426 cabin tmp";
CM_ SG_ 2011 VCRIGHT_a427_seatMotorCalibrated "Right body controller: a427 seat motor calibrated";
CM_ SG_ 2011 VCRIGHT_a427_seatMotorCurrent "Right body controller: a427 seat motor current";
CM_ SG_ 2011 VCRIGHT_a427_seatMotorPosReal "Right body controller: a427 seat motor pos real";
CM_ SG_ 2011 VCRIGHT_a427_seatMotorState "Right body controller: a427 seat motor state";
CM_ SG_ 2011 VCRIGHT_a427_seatSwitchBack "Right body controller: a427 seat switch back";
CM_ SG_ 2011 VCRIGHT_a427_seatSwitchForward "Right body controller: a427 seat switch forward";
CM_ SG_ 2011 VCRIGHT_a427_cabinTmp "Right body controller: a427 cabin tmp";
CM_ SG_ 2011 VCRIGHT_a428_seatMotorCalibrated "Right body controller: a428 seat motor calibrated";
CM_ SG_ 2011 VCRIGHT_a428_seatMotorCurrent "Right body controller: a428 seat motor current";
CM_ SG_ 2011 VCRIGHT_a428_seatMotorPosReal "Right body controller: a428 seat motor pos real";
CM_ SG_ 2011 VCRIGHT_a428_seatMotorState "Right body controller: a428 seat motor state";
CM_ SG_ 2011 VCRIGHT_a428_seatSwitchBack "Right body controller: a428 seat switch back";
CM_ SG_ 2011 VCRIGHT_a428_seatSwitchForward "Right body controller: a428 seat switch forward";
CM_ SG_ 2011 VCRIGHT_a428_cabinTmp "Right body controller: a428 cabin tmp";
CM_ SG_ 2011 VCRIGHT_a429_seatMotorCalibrated "Right body controller: a429 seat motor calibrated";
CM_ SG_ 2011 VCRIGHT_a429_seatMotorCurrent "Right body controller: a429 seat motor current";
CM_ SG_ 2011 VCRIGHT_a429_seatMotorPosReal "Right body controller: a429 seat motor pos real";
CM_ SG_ 2011 VCRIGHT_a429_seatMotorState "Right body controller: a429 seat motor state";
CM_ SG_ 2011 VCRIGHT_a429_seatSwitchBack "Right body controller: a429 seat switch back";
CM_ SG_ 2011 VCRIGHT_a429_seatSwitchForward "Right body controller: a429 seat switch forward";
CM_ SG_ 2011 VCRIGHT_a429_cabinTmp "Right body controller: a429 cabin tmp";
CM_ SG_ 2011 VCRIGHT_a444_retriesAvailable "Right body controller: a444 retries available";
CM_ SG_ 2011 VCRIGHT_a444_channel "Right body controller: a444 channel";
CM_ SG_ 2011 VCRIGHT_a444_watchdog "Right body controller: a444 watchdog";
CM_ SG_ 2011 VCRIGHT_a444_gateDriver "Right body controller: a444 gate driver";
CM_ SG_ 2011 VCRIGHT_a444_overcurrent "Right body controller: a444 overcurrent";
CM_ SG_ 2011 VCRIGHT_a444_supplyUndervoltage "Right body controller: a444 supply undervoltage";
CM_ SG_ 2011 VCRIGHT_a444_cpUndervoltage "Right body controller: a444 cp undervoltage";
CM_ SG_ 2011 VCRIGHT_a444_overTempShutdown "Right body controller: a444 over temp shutdown";
CM_ SG_ 2011 VCRIGHT_a444_overTempWarning "Right body controller: a444 over temp warning";
CM_ SG_ 2011 VCRIGHT_a444_highSide2GateDriver "Right body controller: a444 high side2 gate driver";
CM_ SG_ 2011 VCRIGHT_a444_lowSide2GateDriver "Right body controller: a444 low side2 gate driver";
CM_ SG_ 2011 VCRIGHT_a444_highSide1GateDriver "Right body controller: a444 high side1 gate driver";
CM_ SG_ 2011 VCRIGHT_a444_lowSide1GateDriver "Right body controller: a444 low side1 gate driver";
CM_ SG_ 2011 VCRIGHT_a444_highSide2OverCurent "Right body controller: a444 high side2 over curent";
CM_ SG_ 2011 VCRIGHT_a444_lowSide2OverCurent "Right body controller: a444 low side2 over curent";
CM_ SG_ 2011 VCRIGHT_a444_highSide1OverCurent "Right body controller: a444 high side1 over curent";
CM_ SG_ 2011 VCRIGHT_a444_lowSide1OverCurent "Right body controller: a444 low side1 over curent";
CM_ SG_ 2011 VCRIGHT_a444_spiInit "Right body controller: a444 spi init";
CM_ SG_ 2011 VCRIGHT_a444_spiPeriodicCheck "Right body controller: a444 spi periodic check";
CM_ SG_ 2011 VCRIGHT_a444_spiFault "Right body controller: a444 spi fault";
CM_ SG_ 2011 VCRIGHT_a444_voltageMonitor "Right body controller: a444 voltage monitor";
CM_ SG_ 2011 VCRIGHT_a444_enableLow "Right body controller: a444 enable low";
CM_ SG_ 2011 VCRIGHT_a446_caseTempHVACUnavail "Right body controller: a446 case temp HVAC unavailable";
CM_ SG_ 2011 VCRIGHT_a446_evapHVACUnavailable "Right body controller: a446 evap HVAC unavailable";
CM_ SG_ 2011 VCRIGHT_a446_evapTempInvalid "Right body controller: a446 evap temp invalid";
CM_ SG_ 2011 VCRIGHT_a446_hvacBlowerFaulted "Right body controller: a446 hvac blower faulted";
CM_ SG_ 2011 VCRIGHT_a446_evapOperationNotAll "Right body controller: a446 evap operation not allowed";
CM_ SG_ 2011 VCRIGHT_a446_allAirPathsBlocked "Right body controller: a446 all air paths blocked";
CM_ SG_ 2011 VCRIGHT_a446_rawDuctTempInvalidL "Right body controller: a446 raw duct temp invalid left";
CM_ SG_ 2011 VCRIGHT_a446_rawDuctTempInvalidR "Right body controller: a446 raw duct temp invalid right";
CM_ SG_ 2011 VCRIGHT_a448_manACOFFComfortCool "Right body controller: a448 man ACOFF comfort cool nudge";
CM_ SG_ 2011 VCRIGHT_a448_manAirflowComfortHe "Right body controller: a448 man airflow comfort heat nudge";
CM_ SG_ 2011 VCRIGHT_a448_manAirflowFwdL_0001 "Right body controller: a448 man airflow fwd lk comfort heat nudge";
CM_ SG_ 2011 VCRIGHT_a448_manAirflowFwdLkComf "Right body controller: a448 man airflow fwd lk comfort cool nudge";
CM_ SG_ 2011 VCRIGHT_a448_manACOffFwdLkComfor "Right body controller: a448 man AC off fwd lk comfort cool nudge";
CM_ SG_ 2011 VCRIGHT_a448_manFreshComfor_0002 "Right body controller: a448 man fresh comfort heat manual HVAC intvn";
CM_ SG_ 2011 VCRIGHT_a448_manFreshComfor_0001 "Right body controller: a448 man fresh comfort cool manual HVAC intvn";
CM_ SG_ 2011 VCRIGHT_a448_manFreshComfortCool "Right body controller: a448 man fresh comfort cool auto HVAC intvn";
CM_ SG_ 2011 VCRIGHT_a448_manFreshComfortHeat "Right body controller: a448 man fresh comfort heat auto HVAC intvn";
CM_ SG_ 2011 VCRIGHT_a448_manRecircRHAutoHVAC "Right body controller: a448 man recirc RH auto HVAC intvn";
CM_ SG_ 2011 VCRIGHT_a448_manRecircFlashFogGe "Right body controller: a448 man recirc flash fog generic HVAC intvn";
CM_ SG_ 2011 VCRIGHT_a448_manRecircFlashFogWe "Right body controller: a448 man recirc flash fog wet air HVAC intvn";
CM_ SG_ 2011 VCRIGHT_a448_manRecircRHManualHV "Right body controller: a448 man recirc RH manual HVAC nudge";
CM_ SG_ 2011 VCRIGHT_a448_manACoffRHManualHVA "Right body controller: a448 man a coff RH manual HVAC nudge";
CM_ SG_ 2011 VCRIGHT_a448_warmingUp "Right body controller: a448 warming up";
CM_ SG_ 2011 VCRIGHT_a448_coolingDown "Right body controller: a448 cooling down";
CM_ SG_ 2011 VCRIGHT_a448_maxHeating "Right body controller: a448 max heating";
CM_ SG_ 2011 VCRIGHT_a448_maxCooling "Right body controller: a448 max cooling";
CM_ SG_ 2011 VCRIGHT_a448_manHvacOffAutoSteer "Right body controller: a448 man hvac off auto steer fog intvn";
CM_ SG_ 2011 VCRIGHT_a448_manHvacOffAuto_0001 "Right body controller: a448 man hvac off auto steer fog nudge";
CM_ SG_ 2011 VCRIGHT_a448_manHvacAutoSteerFog "Right body controller: a448 man hvac auto steer fog intvn";
CM_ SG_ 2011 VCRIGHT_a448_manHvacAutoSte_0001 "Right body controller: a448 man hvac auto steer fog nudge";
CM_ SG_ 2011 VCRIGHT_a448_manualHighBlowerSpe "Right body controller: a448 manual high blower speed auto HVAC intvn";
CM_ SG_ 2011 VCRIGHT_a482_channel "Right body controller: a482 channel";
CM_ SG_ 2011 VCRIGHT_a482_spiFault "Right body controller: a482 spi fault";
CM_ SG_ 2011 VCRIGHT_a482_resetBar "Right body controller: a482 reset bar";
CM_ SG_ 2011 VCRIGHT_a482_overTempShutdown "Right body controller: a482 over temp shutdown";
CM_ SG_ 2011 VCRIGHT_a482_thermalWarning "Right body controller: a482 thermal warning";
CM_ SG_ 2011 VCRIGHT_a482_underOrOverVoltageO "Right body controller: a482 under or over voltage or over current";
CM_ SG_ 2011 VCRIGHT_a482_underloadDetected "Right body controller: a482 underload detected";
CM_ SG_ 2011 VCRIGHT_a496_cabinTempInterior "Right body controller: a496 cabin temp interior";
CM_ SG_ 2011 VCRIGHT_a520_epbConfig "Right body controller: a520 epb config";
CM_ SG_ 2011 VCRIGHT_a520_gtwEpbConfig "Right body controller: a520 gtw epb config";
CM_ SG_ 2011 VCRIGHT_a525_GTW_twelveVBatteryT "Right body controller: a525 GTW twelve v battery type";
CM_ SG_ 2011 VCRIGHT_a525_newLVBatteryType "Right body controller: a525 new LV battery type";
CM_ SG_ 2011 VCRIGHT_a525_initialLVBatteryTyp "Right body controller: a525 initial LV battery type";
CM_ SG_ 2011 VCRIGHT_a525_serviceMode "Signal reported by Right body controller";
CM_ SG_ 2011 VCRIGHT_a525_factoryGated "Right body controller: a525 factory gated";
CM_ SG_ 2011 VCRIGHT_a525_frunkOpen "Right body controller: a525 frunk open";
CM_ SG_ 2011 VCRIGHT_a538_ptcHeaterFault "Right body controller: a538 ptc heater fault";
CM_ SG_ 2011 VCRIGHT_a538_ductTempSensorFault "Right body controller: a538 duct temp sensor fault";
CM_ SG_ 2011 VCRIGHT_a538_evapTempSensorFault "Right body controller: a538 evap temp sensor fault";
CM_ SG_ 2011 VCRIGHT_a538_cabinTempSensorFaul "Right body controller: a538 cabin temp sensor fault";
CM_ SG_ 2011 VCRIGHT_a538_cabinModelNotInitia "Right body controller: a538 cabin model not initialized";
CM_ SG_ 2011 VCRIGHT_a538_airpathsBlocked "Right body controller: a538 airpaths blocked";
CM_ SG_ 2011 VCRIGHT_a538_blowerFaultOrStoppe "Right body controller: a538 blower fault or stopped";
CM_ SG_ 2011 VCRIGHT_a538_compressorFaultOrSt "Right body controller: a538 compressor fault or standby";
CM_ SG_ 2011 VCRIGHT_a538_heatPumpModeNotAtta "Right body controller: a538 heat pump mode not attainable";
CM_ SG_ 2011 VCRIGHT_a538_thsVersionMismatch "Right body controller: a538 ths version mismatch";
CM_ SG_ 2011 VCRIGHT_a538_thsMia "Right body controller: a538 ths mia";
CM_ SG_ 2011 VCRIGHT_a538_hvOn "Right body controller: a538 hv on";
CM_ SG_ 2011 VCRIGHT_a538_hvacPowerOn "Right body controller: a538 hvac power on";
CM_ SG_ 2011 VCRIGHT_a538_limpMode "Right body controller: a538 limp mode";
CM_ SG_ 2011 VCRIGHT_a539_hvacSystemNotNomina "Right body controller: a539 hvac system not nominal";
CM_ SG_ 2011 VCRIGHT_a539_modeledCabinTempOut "Right body controller: a539 modeled cabin temp out of range";
CM_ SG_ 2011 VCRIGHT_a539_modeledCabinTempExc "Right body controller: a539 modeled cabin temp exceeding set temp";
CM_ SG_ 2011 VCRIGHT_a539_cabinTempSensorFaul "Right body controller: a539 cabin temp sensor fault";
CM_ SG_ 2011 VCRIGHT_a539_cabinTempSensorOutO "Right body controller: a539 cabin temp sensor out of range";
CM_ SG_ 2011 VCRIGHT_a539_modeledCabinTempDev "Right body controller: a539 modeled cabin temp deviation";
CM_ SG_ 2011 VCRIGHT_a545_GTW_twelveVBatteryT "Right body controller: a545 GTW twelve v battery type";
CM_ SG_ 2011 VCRIGHT_a545_newLVBatteryType "Right body controller: a545 new LV battery type";
CM_ SG_ 2011 VCRIGHT_a545_serviceMode "Signal reported by Right body controller";
CM_ SG_ 2011 VCRIGHT_a545_factoryGated "Right body controller: a545 factory gated";
CM_ SG_ 2011 VCRIGHT_a545_frunkOpen "Right body controller: a545 frunk open";
CM_ SG_ 2011 VCRIGHT_a551_restrictDoorRelease "Right body controller: a551 restrict door release signal front";
CM_ SG_ 2011 VCRIGHT_a551_interiorReleaseReqC "Right body controller: a551 interior release req count front";
CM_ SG_ 2011 VCRIGHT_a551_lastRequestSourceFr "Right body controller: a551 last request source front";
CM_ SG_ 2011 VCRIGHT_a551_restrictDoorRe_0001 "Right body controller: a551 restrict door release signal rear";
CM_ SG_ 2011 VCRIGHT_a551_interiorReleas_0001 "Right body controller: a551 interior release req count rear";
CM_ SG_ 2011 VCRIGHT_a551_lastRequestSourceRe "Right body controller: a551 last request source rear";
CM_ SG_ 2011 VCRIGHT_a560_isRearwardEndstopUn "Right body controller: a560 is rearward endstop uncalibrated";
CM_ SG_ 2011 VCRIGHT_a560_isAbsPosSensorUncal "Right body controller: a560 is abs pos sensor uncalibrated";
CM_ SG_ 2011 VCRIGHT_a560_seatState "Right body controller: a560 seat state";
CM_ SG_ 2011 VCRIGHT_a560_motorType "Right body controller: a560 motor type";
CM_ SG_ 2011 VCRIGHT_a560_absPosSensState "Right body controller: a560 abs pos sens state";
CM_ SG_ 2011 VCRIGHT_a563_calibrated "Right body controller: a563 calibrated";
CM_ SG_ 2011 VCRIGHT_a563_angle "Right body controller: a563 angle";
CM_ SG_ 2011 VCRIGHT_a563_seatStatePrev "Right body controller: a563 seat state prev";
CM_ SG_ 2011 VCRIGHT_a563_obstacleDetectReaso "Right body controller: a563 obstacle detect reason";
CM_ SG_ 2011 VCRIGHT_a563_accelLookbackTripDe "Right body controller: a563 accel lookback trip depth";
CM_ SG_ 2011 VCRIGHT_a563_duty "Right body controller: a563 duty";
CM_ SG_ 2011 VCRIGHT_a563_currentAbsFilt "Right body controller: a563 current abs filt";
CM_ SG_ 2011 VCRIGHT_a563_motorType "Right body controller: a563 motor type";
CM_ SG_ 2011 VCRIGHT_a563_absolutePosSensorFo "Right body controller: a563 absolute pos sensor forward";
CM_ SG_ 2011 VCRIGHT_a563_cabinTemp "Right body controller: a563 cabin temp";
CM_ SG_ 2011 VCRIGHT_a567_isRearwardEndstopUn "Right body controller: a567 is rearward endstop uncalibrated";
CM_ SG_ 2011 VCRIGHT_a567_isAbsPosSensorUncal "Right body controller: a567 is abs pos sensor uncalibrated";
CM_ SG_ 2011 VCRIGHT_a568_seatState "Right body controller: a568 seat state";
CM_ SG_ 2011 VCRIGHT_a570_seatHeatCurrent "Right body controller: a570 seat heat current";
CM_ SG_ 2011 VCRIGHT_a570_seatHeatTmp "Right body controller: a570 seat heat tmp";
CM_ SG_ 2011 VCRIGHT_a571_seatHeatCurrent "Right body controller: a571 seat heat current";
CM_ SG_ 2011 VCRIGHT_a571_seatHeatTmp "Right body controller: a571 seat heat tmp";
CM_ SG_ 2011 VCRIGHT_a572_seatHeatCurrent "Right body controller: a572 seat heat current";
CM_ SG_ 2011 VCRIGHT_a572_seatHeatTmp "Right body controller: a572 seat heat tmp";
CM_ SG_ 2011 VCRIGHT_a573_seatHeatCurrent "Right body controller: a573 seat heat current";
CM_ SG_ 2011 VCRIGHT_a573_seatHeatTmp "Right body controller: a573 seat heat tmp";
CM_ SG_ 2011 VCRIGHT_a577_outputFaulted "Right body controller: a577 output faulted";
CM_ SG_ 2011 VCRIGHT_a577_currentSenseFaulted "Right body controller: a577 current sense faulted";
CM_ SG_ 2011 VCRIGHT_a577_tempSenseFaulted "Right body controller: a577 temp sense faulted";
CM_ SG_ 2011 VCRIGHT_a577_underCurrent "Right body controller: a577 under current";
CM_ SG_ 2011 VCRIGHT_a577_overCurrent "Right body controller: a577 over current";
CM_ SG_ 2011 VCRIGHT_a577_overTemperature "Right body controller: a577 over temperature";
CM_ SG_ 2011 VCRIGHT_a578_openCircuitDoorFR "Right body controller: a578 open circuit door FR";
CM_ SG_ 2011 VCRIGHT_a578_shortCircuitDoorFR "Right body controller: a578 short circuit door FR";
CM_ SG_ 2011 VCRIGHT_a578_miaDoorFR "Right body controller: a578 mia door FR";
CM_ SG_ 2011 VCRIGHT_a578_openCircuitDoorRR "Right body controller: a578 open circuit door RR";
CM_ SG_ 2011 VCRIGHT_a578_shortCircuitDoorRR "Right body controller: a578 short circuit door RR";
CM_ SG_ 2011 VCRIGHT_a578_miaDoorRR "Right body controller: a578 mia door RR";
CM_ SG_ 2011 VCRIGHT_a579_liftgateFollowerSto "Right body controller: a579 liftgate follower stopping condition";
CM_ SG_ 2011 VCRIGHT_a579_liftgateFollowerPos "Right body controller: a579 liftgate follower position";
CM_ SG_ 2011 VCRIGHT_a579_liftgateFollowerLat "Right body controller: a579 liftgate follower latch status";
CM_ SG_ 2011 VCRIGHT_a585_ambientTemp "Right body controller: a585 ambient temp";
CM_ SG_ 2011 VCRIGHT_a586_ambientTemp "Right body controller: a586 ambient temp";
CM_ SG_ 2011 VCRIGHT_a599_GTW_twelveVBatteryT "Right body controller: a599 GTW twelve v battery type";
CM_ SG_ 2011 VCRIGHT_a599_newLVBatteryType "Right body controller: a599 new LV battery type";
CM_ SG_ 2011 VCRIGHT_a599_initialLVBatteryTyp "Right body controller: a599 initial LV battery type";
CM_ SG_ 2011 VCRIGHT_a599_serviceMode "Signal reported by Right body controller";
CM_ SG_ 2011 VCRIGHT_a599_factoryGated "Right body controller: a599 factory gated";
CM_ SG_ 2011 VCRIGHT_a599_frunkOpen "Right body controller: a599 frunk open";
CM_ SG_ 2011 VCRIGHT_a617_VEH_VC_infoMessage "Right body controller: a617 VEH VC info message";
CM_ SG_ 2011 VCRIGHT_a617_BDY_defogInfoMessag "Right body controller: a617 BDY defog info message";
CM_ SG_ 2011 VCRIGHT_a617_VEH_defogInfoMessag "Right body controller: a617 VEH defog info message";
CM_ SG_ 2011 VCRIGHT_a617_VEH_thermalStatus "Right body controller: a617 VEH thermal status";
CM_ BO_ 960 "Right body controller message: alert matrix";
CM_ SG_ 960 VCRIGHT_matrixIndex "Right body controller: matrix index";
CM_ SG_ 960 VCRIGHT_a001_WatchdogReset "Right body controller: a001 watchdog reset";
CM_ SG_ 960 VCRIGHT_a002_PowerLossReset "Right body controller: a002 power loss reset";
CM_ SG_ 960 VCRIGHT_a003_SWAssertion "Right body controller: a003 SW assertion";
CM_ SG_ 960 VCRIGHT_a005_CANTXError "Right body controller: a005 CANTX error";
CM_ SG_ 960 VCRIGHT_a006_CANTX_cyclicError "Right body controller: a006 CANTX cyclic error";
CM_ SG_ 960 VCRIGHT_a010_ExtSupplyVoltError "Right body controller: a010 ext supply volt error";
CM_ SG_ 960 VCRIGHT_a012_CPUReset "Right body controller: a012 CPU reset";
CM_ SG_ 960 VCRIGHT_a013_AlertManagerFault "Right body controller: a013 alert manager fault";
CM_ SG_ 960 VCRIGHT_a015_NVMMError "Right body controller: a015 NVMM error";
CM_ SG_ 960 VCRIGHT_a016_NVMMRecordError "Right body controller: a016 NVMM record error";
CM_ SG_ 960 VCRIGHT_a017_NVMMStatusDbg "Right body controller: a017 NVMM status dbg";
CM_ SG_ 960 VCRIGHT_a021_TaskSchedulerError "Right body controller: a021 task scheduler error";
CM_ SG_ 960 VCRIGHT_a022_TaskInitError "Right body controller: a022 task init error";
CM_ SG_ 960 VCRIGHT_a029_CoreDump "Right body controller: a029 core dump";
CM_ SG_ 960 VCRIGHT_a030_ECULogUploadRequest "Right body controller: a030 ECU log upload request";
CM_ SG_ 960 VCRIGHT_a031_UDSActive "Right body controller: a031 UDS active";
CM_ SG_ 960 VCRIGHT_a041_HighCPULoad "Right body controller: a041 high CPU load";
CM_ SG_ 960 VCRIGHT_a042_HighStackUsage "Right body controller: a042 high stack usage";
CM_ SG_ 960 VCRIGHT_a043_Task1msError "Right body controller: a043 task1ms error";
CM_ SG_ 960 VCRIGHT_a044_Task10msError "Right body controller: a044 task10ms error";
CM_ SG_ 960 VCRIGHT_a045_Task100msError "Right body controller: a045 task100ms error";
CM_ SG_ 960 VCRIGHT_a046_Task1000msError "Right body controller: a046 task1000ms error";
CM_ SG_ 960 VCRIGHT_a057_HVP_MIA "Right body controller: a057 HVP MIA";
CM_ SG_ 960 VCRIGHT_a058_inputRHighSyncDebug "Right body controller: a058 input r high sync debug";
CM_ SG_ 960 VCRIGHT_a059_inputResistanceHigh "Right body controller: a059 input resistance high";
CM_ SG_ 960 VCRIGHT_a060_engineeringBuild "Right body controller: a060 engineering build";
CM_ SG_ 960 VCRIGHT_a061_XCPConnected "Right body controller: a061 XCP connected";
CM_ SG_ 960 VCRIGHT_a062_XCPWasConnected "Right body controller: a062 XCP was connected";
CM_ SG_ 960 VCRIGHT_a063_SwitchFault "Right body controller: a063 switch fault";
CM_ SG_ 960 VCRIGHT_a064_busSleepReqTimeout "Right body controller: a064 bus sleep req timeout";
CM_ SG_ 960 VCRIGHT_a065_emiosIsrRateLimited "Right body controller: a065 emios isr rate limited dbg";
CM_ SG_ 960 VCRIGHT_a066_emiosIsrShortPeriod "Right body controller: a066 emios isr short period detected dbg";
CM_ SG_ 960 VCRIGHT_a082_VCRIGHT_IPC_MIA "Right body controller: a082 VCRIGHT IPC MIA";
CM_ SG_ 960 VCRIGHT_a083_VCLEFT_IPC_MIA "Right body controller: a083 VCLEFT IPC MIA";
CM_ SG_ 960 VCRIGHT_a084_TPMS_MIA "Right body controller: a084 TPMS MIA";
CM_ SG_ 960 VCRIGHT_a085_CCCM_MIA "Right body controller: a085 CCCM MIA";
CM_ SG_ 960 VCRIGHT_a086_VCBATT_MIA "Right body controller: a086 VCBATT MIA";
CM_ SG_ 960 VCRIGHT_a087_DIREL_MIA "Right body controller: a087 DIREL MIA";
CM_ SG_ 960 VCRIGHT_a088_DIRER_MIA "Right body controller: a088 DIRER MIA";
CM_ SG_ 960 VCRIGHT_a089_IBST_MIA "Right body controller: a089 IBST MIA";
CM_ SG_ 960 VCRIGHT_a090_APS_MIA "Right body controller: a090 APS MIA";
CM_ SG_ 960 VCRIGHT_a091_CMPD_MIA "Right body controller: a091 CMPD MIA";
CM_ SG_ 960 VCRIGHT_a092_VCSEATD_MIA "Right body controller: a092 VCSEATD MIA";
CM_ SG_ 960 VCRIGHT_a093_VCSEATP_MIA "Right body controller: a093 VCSEATP MIA";
CM_ SG_ 960 VCRIGHT_a094_EPAS3P_MIA "Right body controller: a094 EPAS3 p MIA";
CM_ SG_ 960 VCRIGHT_a095_CHG_MIA "Right body controller: a095 CHG MIA";
CM_ SG_ 960 VCRIGHT_a096_OCS1P_MIA "Right body controller: a096 OCS1 p MIA";
CM_ SG_ 960 VCRIGHT_a097_CMP_MIA "Right body controller: a097 CMP MIA";
CM_ SG_ 960 VCRIGHT_a098_DIR_MIA "Right body controller: a098 DIR MIA";
CM_ SG_ 960 VCRIGHT_a099_PARK_MIA "Right body controller: a099 PARK MIA";
CM_ SG_ 960 VCRIGHT_a100_CANbus_MIA "Right body controller: a100 CA nbus MIA";
CM_ SG_ 960 VCRIGHT_a101_PM_MIA "Right body controller: a101 PM MIA";
CM_ SG_ 960 VCRIGHT_a102_PTC_MIA "Right body controller: a102 PTC MIA";
CM_ SG_ 960 VCRIGHT_a103_CP_MIA "Right body controller: a103 CP MIA";
CM_ SG_ 960 VCRIGHT_a104_DAS_MIA "Right body controller: a104 DAS MIA";
CM_ SG_ 960 VCRIGHT_a105_TAS_MIA "Right body controller: a105 TAS MIA";
CM_ SG_ 960 VCRIGHT_a106_PCS_MIA "Right body controller: a106 PCS MIA";
CM_ SG_ 960 VCRIGHT_a107_BMS_MIA "Right body controller: a107 BMS MIA";
CM_ SG_ 960 VCRIGHT_a108_DIF_MIA "Right body controller: a108 DIF MIA";
CM_ SG_ 960 VCRIGHT_a109_RCM_MIA "Right body controller: a109 RCM MIA";
CM_ SG_ 960 VCRIGHT_a110_GTW_MIA "Right body controller: a110 GTW MIA";
CM_ SG_ 960 VCRIGHT_a111_EPBR_MIA "Right body controller: a111 EPBR MIA";
CM_ SG_ 960 VCRIGHT_a112_EPBL_MIA "Right body controller: a112 EPBL MIA";
CM_ SG_ 960 VCRIGHT_a113_UI_MIA "Right body controller: a113 UI MIA";
CM_ SG_ 960 VCRIGHT_a114_ESP_MIA "Right body controller: a114 ESP MIA";
CM_ SG_ 960 VCRIGHT_a115_VCSEC_MIA "Right body controller: a115 VCSEC MIA";
CM_ SG_ 960 VCRIGHT_a116_VCRIGHT_MIA "Right body controller: a116 VCRIGHT MIA";
CM_ SG_ 960 VCRIGHT_a117_VCLEFT_MIA "Right body controller: a117 VCLEFT MIA";
CM_ SG_ 960 VCRIGHT_a118_VCFRONT_MIA "Right body controller: a118 VCFRONT MIA";
CM_ SG_ 960 VCRIGHT_a119_SCCM_MIA "Right body controller: a119 SCCM MIA";
CM_ SG_ 960 VCRIGHT_a120_DI_DRIVE_MIA "Right body controller: a120 DI DRIVE MIA";
CM_ SG_ 960 VCRIGHT_a121_ETC_MIA "Right body controller: a121 ETC MIA";
CM_ SG_ 960 VCRIGHT_a122_ICR_MIA "Right body controller: a122 ICR MIA";
CM_ SG_ 960 VCRIGHT_a124_BB_MIA "Right body controller: a124 BB MIA";
CM_ SG_ 960 VCRIGHT_a125_RCU_MIA "Right body controller: a125 RCU MIA";
CM_ SG_ 960 VCRIGHT_a126_hvacActOpenLoadDBG "Right body controller: a126 hvac act open load DBG";
CM_ SG_ 960 VCRIGHT_a127_hvacActOvercurrentD "Right body controller: a127 hvac act overcurrent DBG";
CM_ SG_ 960 VCRIGHT_a128_hvacActDrvFaultDBG "Right body controller: a128 hvac act drv fault DBG";
CM_ SG_ 960 VCRIGHT_a129_hvacIntakeUncalib "Right body controller: a129 hvac intake uncalib";
CM_ SG_ 960 VCRIGHT_a130_hvacLHBleedUncalib "Right body controller: a130 hvac LH bleed uncalib";
CM_ SG_ 960 VCRIGHT_a131_hvacRHBleedUncalib "Right body controller: a131 hvac RH bleed uncalib";
CM_ SG_ 960 VCRIGHT_a132_hvacLHVaneUncalib "Right body controller: a132 hvac LH vane uncalib";
CM_ SG_ 960 VCRIGHT_a133_hvacRHVaneUncalib "Right body controller: a133 hvac RH vane uncalib";
CM_ SG_ 960 VCRIGHT_a134_hvacUpprModeUncalib "Right body controller: a134 hvac uppr mode uncalib";
CM_ SG_ 960 VCRIGHT_a135_hvacLowrModeUncalib "Right body controller: a135 hvac lowr mode uncalib";
CM_ SG_ 960 VCRIGHT_a136_hvacIntakeFault "Right body controller: a136 hvac intake fault";
CM_ SG_ 960 VCRIGHT_a137_hvacLHBleedFault "Right body controller: a137 hvac LH bleed fault";
CM_ SG_ 960 VCRIGHT_a138_hvacRHBleedFault "Right body controller: a138 hvac RH bleed fault";
CM_ SG_ 960 VCRIGHT_a139_hvacLHVaneFault "Right body controller: a139 hvac LH vane fault";
CM_ SG_ 960 VCRIGHT_a140_hvacRHVaneFault "Right body controller: a140 hvac RH vane fault";
CM_ SG_ 960 VCRIGHT_a141_hvacUpperModeFault "Right body controller: a141 hvac upper mode fault";
CM_ SG_ 960 VCRIGHT_a142_hvacLowerModeFault "Right body controller: a142 hvac lower mode fault";
CM_ SG_ 960 VCRIGHT_a143_mirrorManuallyFolde "Right body controller: a143 mirror manually folded";
CM_ SG_ 960 VCRIGHT_a144_evaporatorTempSns "Right body controller: a144 evaporator temp sns";
CM_ SG_ 960 VCRIGHT_a145_ductLeftTempSns "Right body controller: a145 duct left temp sns";
CM_ SG_ 960 VCRIGHT_a146_ductRightTempSns "Right body controller: a146 duct right temp sns";
CM_ SG_ 960 VCRIGHT_a147_incarProbeTempSns "Right body controller: a147 incar probe temp sns";
CM_ SG_ 960 VCRIGHT_a148_incarMidTempSns "Right body controller: a148 incar mid temp sns";
CM_ SG_ 960 VCRIGHT_a149_incarDeepTempSns "Right body controller: a149 incar deep temp sns";
CM_ SG_ 960 VCRIGHT_a150_windowPinchFront "Right body controller: a150 window pinch front";
CM_ SG_ 960 VCRIGHT_a151_windowPinchRear "Right body controller: a151 window pinch rear";
CM_ SG_ 960 VCRIGHT_a152_windowUncalFront "Right body controller: a152 window uncal front";
CM_ SG_ 960 VCRIGHT_a153_windowUncalRear "Right body controller: a153 window uncal rear";
CM_ SG_ 960 VCRIGHT_a154_windowThermalFront "Right body controller: a154 window thermal front";
CM_ SG_ 960 VCRIGHT_a155_windowThermalRear "Right body controller: a155 window thermal rear";
CM_ SG_ 960 VCRIGHT_a156_windowNoInputFront "Right body controller: a156 window no input front";
CM_ SG_ 960 VCRIGHT_a157_windowNoInputRear "Right body controller: a157 window no input rear";
CM_ SG_ 960 VCRIGHT_a158_windowPinchOverideF "Right body controller: a158 window pinch overide f";
CM_ SG_ 960 VCRIGHT_a159_windowPinchOverideR "Right body controller: a159 window pinch overide r";
CM_ SG_ 960 VCRIGHT_a160_windowUndercurrentF "Right body controller: a160 window undercurrent f";
CM_ SG_ 960 VCRIGHT_a161_windowUndercurrentR "Right body controller: a161 window undercurrent r";
CM_ SG_ 960 VCRIGHT_a162_windowEncoderStallF "Right body controller: a162 window encoder stall f";
CM_ SG_ 960 VCRIGHT_a163_windowEncoderStallR "Right body controller: a163 window encoder stall r";
CM_ SG_ 960 VCRIGHT_a164_windowFactoryTest "Right body controller: a164 window factory test";
CM_ SG_ 960 VCRIGHT_a165_windowFactoryTest2 "Right body controller: a165 window factory test2";
CM_ SG_ 960 VCRIGHT_a166_windowDebug "Right body controller: a166 window debug";
CM_ SG_ 960 VCRIGHT_a167_windowDebugPinchF "Right body controller: a167 window debug pinch f";
CM_ SG_ 960 VCRIGHT_a168_windowDebugPinchR "Right body controller: a168 window debug pinch r";
CM_ SG_ 960 VCRIGHT_a169_windowCurrentPeakF "Right body controller: a169 window current peak f";
CM_ SG_ 960 VCRIGHT_a170_windowCurrentPeakR "Right body controller: a170 window current peak r";
CM_ SG_ 960 VCRIGHT_a172_SPI_MIA "Right body controller: a172 SPI MIA";
CM_ SG_ 960 VCRIGHT_a173_windowBtnDoorOpen "Right body controller: a173 window btn door open";
CM_ SG_ 960 VCRIGHT_a174_BLERightPowerCycled "Right body controller: a174 BLE right power cycled";
CM_ SG_ 960 VCRIGHT_a175_windowSealDefectFro "Right body controller: a175 window seal defect front";
CM_ SG_ 960 VCRIGHT_a176_windowSealDefectRea "Right body controller: a176 window seal defect rear";
CM_ SG_ 960 VCRIGHT_a178_trunkSwitchVCBATTMI "Right body controller: a178 trunk switch VCBATTMIA";
CM_ SG_ 960 VCRIGHT_a179_trunkSwitchVCFRONTM "Right body controller: a179 trunk switch VCFRONTMIA";
CM_ SG_ 960 VCRIGHT_a180_frontDoorLatchRehom "Right body controller: a180 front door latch rehome";
CM_ SG_ 960 VCRIGHT_a181_rearDoorLatchRehome "Right body controller: a181 rear door latch rehome";
CM_ SG_ 960 VCRIGHT_a182_emergencyLatchRel "Right body controller: a182 emergency latch rel";
CM_ SG_ 960 VCRIGHT_a183_doorStateFactoryTes "Right body controller: a183 door state factory test";
CM_ SG_ 960 VCRIGHT_a184_trunkFailedOpening "Right body controller: a184 trunk failed opening";
CM_ SG_ 960 VCRIGHT_a185_summonAborted "Right body controller: a185 summon aborted";
CM_ SG_ 960 VCRIGHT_a186_latchReleaseFailedF "Right body controller: a186 latch release failed f";
CM_ SG_ 960 VCRIGHT_a187_latchReleaseFailedR "Right body controller: a187 latch release failed r";
CM_ SG_ 960 VCRIGHT_a188_latchUnableToRearmF "Right body controller: a188 latch unable to rearm f";
CM_ SG_ 960 VCRIGHT_a189_latchUnableToRearmR "Right body controller: a189 latch unable to rearm r";
CM_ SG_ 960 VCRIGHT_a190_eFuseMgmtVbatFused "Right body controller: a190 e fuse mgmt vbat fused";
CM_ SG_ 960 VCRIGHT_a191_gloveboxPower "Right body controller: a191 glovebox power";
CM_ SG_ 960 VCRIGHT_a192_gloveboxLatchRel "Right body controller: a192 glovebox latch rel";
CM_ SG_ 960 VCRIGHT_a193_amplifierEFuseFault "Right body controller: a193 amplifier e fuse fault";
CM_ SG_ 960 VCRIGHT_a194_cntctrPwrEFuseFault "Right body controller: a194 cntctr pwr e fuse fault";
CM_ SG_ 960 VCRIGHT_a195_hvcEFuseFault "Right body controller: a195 hvc e fuse fault";
CM_ SG_ 960 VCRIGHT_a196_VEHCANOverterminate "Right body controller: a196 VEHCAN overterminate";
CM_ SG_ 960 VCRIGHT_a197_VEHCANUndertrminate "Right body controller: a197 VEHCAN undertrminate";
CM_ SG_ 960 VCRIGHT_a198_PRVCANOverterminate "Right body controller: a198 PRVCAN overterminate";
CM_ SG_ 960 VCRIGHT_a199_PRVCANUndertrminate "Right body controller: a199 PRVCAN undertrminate";
CM_ SG_ 960 VCRIGHT_a200_motorPhantomEncoder "Right body controller: a200 motor phantom encoder";
CM_ SG_ 960 VCRIGHT_a201_motorDutyEncDisabl "Right body controller: a201 motor duty enc disabl";
CM_ SG_ 960 VCRIGHT_a202_epbmUnderIStatic "Right body controller: a202 epbm under i static";
CM_ SG_ 960 VCRIGHT_a203_epbmOverIStatic "Right body controller: a203 epbm over i static";
CM_ SG_ 960 VCRIGHT_a204_epbmUnderIDyn "Right body controller: a204 epbm under i dyn";
CM_ SG_ 960 VCRIGHT_a205_epbmOverIDyn "Right body controller: a205 epbm over i dyn";
CM_ SG_ 960 VCRIGHT_a206_epbWrongDirection "Right body controller: a206 epb wrong direction";
CM_ SG_ 960 VCRIGHT_a207_epbmEnableWrong "Right body controller: a207 epbm enable wrong";
CM_ SG_ 960 VCRIGHT_a208_epbFaulted "Right body controller: a208 epb faulted";
CM_ SG_ 960 VCRIGHT_a209_epbStateMisTime "Right body controller: a209 epb state mis time";
CM_ SG_ 960 VCRIGHT_a210_epbStateTime "Right body controller: a210 epb state time";
CM_ SG_ 960 VCRIGHT_a211_epbmUnderIStaticNew "Right body controller: a211 epbm under i static new";
CM_ SG_ 960 VCRIGHT_a212_epbmOverIStaticNew "Right body controller: a212 epbm over i static new";
CM_ SG_ 960 VCRIGHT_a213_epbmUnderIDynNew "Right body controller: a213 epbm under i dyn new";
CM_ SG_ 960 VCRIGHT_a214_epbmOverIDynNew "Right body controller: a214 epbm over i dyn new";
CM_ SG_ 960 VCRIGHT_a215_currentDesyncWarnin "Right body controller: a215 current desync warning";
CM_ SG_ 960 VCRIGHT_a216_SPI_MIA_debugData1 "Right body controller: a216 SPI MIA debug data1";
CM_ SG_ 960 VCRIGHT_a217_SPI_MIA_debugData2 "Right body controller: a217 SPI MIA debug data2";
CM_ SG_ 960 VCRIGHT_a218_motorDriverFault "Right body controller: a218 motor driver fault";
CM_ SG_ 960 VCRIGHT_a219_motorCurrentDropout "Right body controller: a219 motor current dropout";
CM_ SG_ 960 VCRIGHT_a224_seatEncStallTrack "Right body controller: a224 seat enc stall track";
CM_ SG_ 960 VCRIGHT_a225_seatEncStallBack "Right body controller: a225 seat enc stall back";
CM_ SG_ 960 VCRIGHT_a226_seatEncStallTilt "Right body controller: a226 seat enc stall tilt";
CM_ SG_ 960 VCRIGHT_a227_seatEncStallLift "Right body controller: a227 seat enc stall lift";
CM_ SG_ 960 VCRIGHT_a228_seatEncOverTrack "Right body controller: a228 seat enc over track";
CM_ SG_ 960 VCRIGHT_a229_seatEncOverBack "Right body controller: a229 seat enc over back";
CM_ SG_ 960 VCRIGHT_a230_seatEncOverTilt "Right body controller: a230 seat enc over tilt";
CM_ SG_ 960 VCRIGHT_a231_seatEncOverLift "Right body controller: a231 seat enc over lift";
CM_ SG_ 960 VCRIGHT_a232_seatCurrUnderTrack "Right body controller: a232 seat curr under track";
CM_ SG_ 960 VCRIGHT_a233_seatCurrUnderBack "Right body controller: a233 seat curr under back";
CM_ SG_ 960 VCRIGHT_a234_seatCurrUnderTilt "Right body controller: a234 seat curr under tilt";
CM_ SG_ 960 VCRIGHT_a235_seatCurrUnderLift "Right body controller: a235 seat curr under lift";
CM_ SG_ 960 VCRIGHT_a236_lumbarOverPresA "Right body controller: a236 lumbar over pres a";
CM_ SG_ 960 VCRIGHT_a237_lumbarOverPresB "Right body controller: a237 lumbar over pres b";
CM_ SG_ 960 VCRIGHT_a238_lumbarValveMIA "Right body controller: a238 lumbar valve MIA";
CM_ SG_ 960 VCRIGHT_a239_seatHeatIFront "Right body controller: a239 seat heat i front";
CM_ SG_ 960 VCRIGHT_a240_seatHeatShortFront "Right body controller: a240 seat heat short front";
CM_ SG_ 960 VCRIGHT_a241_seatHeatMIAFront "Right body controller: a241 seat heat MIA front";
CM_ SG_ 960 VCRIGHT_a242_seatHeatIRearL "Right body controller: a242 seat heat i rear l";
CM_ SG_ 960 VCRIGHT_a243_seatHeatShortRearL "Right body controller: a243 seat heat short rear l";
CM_ SG_ 960 VCRIGHT_a244_seatHeatMIARearL "Right body controller: a244 seat heat MIA rear l";
CM_ SG_ 960 VCRIGHT_a245_seatHeatIRearC "Right body controller: a245 seat heat i rear c";
CM_ SG_ 960 VCRIGHT_a246_seatHeatShortRearC "Right body controller: a246 seat heat short rear c";
CM_ SG_ 960 VCRIGHT_a247_seatHeatMIARearC "Right body controller: a247 seat heat MIA rear c";
CM_ SG_ 960 VCRIGHT_a248_seatHeatIRearR "Right body controller: a248 seat heat i rear r";
CM_ SG_ 960 VCRIGHT_a249_seatHeatShortRearR "Right body controller: a249 seat heat short rear r";
CM_ SG_ 960 VCRIGHT_a250_seatHeatMIARearR "Right body controller: a250 seat heat MIA rear r";
CM_ SG_ 960 VCRIGHT_a251_seatUncalTrack "Right body controller: a251 seat uncal track";
CM_ SG_ 960 VCRIGHT_a252_seatUncalBack "Right body controller: a252 seat uncal back";
CM_ SG_ 960 VCRIGHT_a253_seatUncalTilt "Right body controller: a253 seat uncal tilt";
CM_ SG_ 960 VCRIGHT_a254_seatUncalLift "Right body controller: a254 seat uncal lift";
CM_ SG_ 960 VCRIGHT_a255_PTCOverTemp "Right body controller: a255 PTC over temp";
CM_ SG_ 960 VCRIGHT_a256_PTCCurrentDrawNoReq "Right body controller: a256 PTC current draw no req";
CM_ SG_ 960 VCRIGHT_a257_THSMIA "Right body controller: a257 THSMIA";
CM_ SG_ 960 VCRIGHT_a258_PTCStuckInBoot "Right body controller: a258 PTC stuck in boot";
CM_ SG_ 960 VCRIGHT_a259_latchDisarmDelayF "Right body controller: a259 latch disarm delay f";
CM_ SG_ 960 VCRIGHT_a260_latchDisarmDelayR "Right body controller: a260 latch disarm delay r";
CM_ SG_ 960 VCRIGHT_a261_emergencyLatchRelRe "Right body controller: a261 emergency latch rel rear";
CM_ SG_ 960 VCRIGHT_a262_PTCFaulted "Right body controller: a262 PTC faulted";
CM_ SG_ 960 VCRIGHT_a263_seatTrackStallDebug "Right body controller: a263 seat track stall debug";
CM_ SG_ 960 VCRIGHT_a264_seatBackStallDebug "Right body controller: a264 seat back stall debug";
CM_ SG_ 960 VCRIGHT_a265_seatTiltStallDebug "Right body controller: a265 seat tilt stall debug";
CM_ SG_ 960 VCRIGHT_a266_seatLiftStallDebug "Right body controller: a266 seat lift stall debug";
CM_ SG_ 960 VCRIGHT_a267_seatTrackHCEncStlDb "Right body controller: a267 seat track HC enc stl dbg";
CM_ SG_ 960 VCRIGHT_a268_seatBackHCEncStlDbg "Right body controller: a268 seat back HC enc stl dbg";
CM_ SG_ 960 VCRIGHT_a269_seatTiltHCEncStlDbg "Right body controller: a269 seat tilt HC enc stl dbg";
CM_ SG_ 960 VCRIGHT_a270_seatLiftHCEncStlDbg "Right body controller: a270 seat lift HC enc stl dbg";
CM_ SG_ 960 VCRIGHT_a271_THSSensorFault "Right body controller: a271 THS sensor fault";
CM_ SG_ 960 VCRIGHT_a272_vhclPwrStateMsmtch "Right body controller: a272 vhcl pwr state msmtch";
CM_ SG_ 960 VCRIGHT_a273_handleStuckActiveF "Right body controller: a273 handle stuck active f";
CM_ SG_ 960 VCRIGHT_a274_handleStuckActiveR "Right body controller: a274 handle stuck active r";
CM_ SG_ 960 VCRIGHT_a275_rightTurnLightFault "Right body controller: a275 right turn light fault";
CM_ SG_ 960 VCRIGHT_a276_mirrorDebug "Right body controller: a276 mirror debug";
CM_ SG_ 960 VCRIGHT_a277_BLERightUnderVoltag "Right body controller: a277 BLE right under voltage";
CM_ SG_ 960 VCRIGHT_a278_hvacPtcHeatingUnava "Right body controller: a278 hvac ptc heating unavailable";
CM_ SG_ 960 VCRIGHT_a279_trunkFailedToClose "Right body controller: a279 trunk failed to close";
CM_ SG_ 960 VCRIGHT_a280_latchDidNotDisarmF "Right body controller: a280 latch did not disarm f";
CM_ SG_ 960 VCRIGHT_a281_latchDidNotDisarmR "Right body controller: a281 latch did not disarm r";
CM_ SG_ 960 VCRIGHT_a282_latchUnexpectedArmF "Right body controller: a282 latch unexpected arm f";
CM_ SG_ 960 VCRIGHT_a283_latchUnexpectedArmR "Right body controller: a283 latch unexpected arm r";
CM_ SG_ 960 VCRIGHT_a284_gloveboxUnderCurren "Right body controller: a284 glovebox under current detected";
CM_ SG_ 960 VCRIGHT_a285_gloveboxOverCurrent "Right body controller: a285 glovebox over current detected";
CM_ SG_ 960 VCRIGHT_a286_windowSpeedInvalidF "Right body controller: a286 window speed invalid f";
CM_ SG_ 960 VCRIGHT_a287_windowSpeedInvalidR "Right body controller: a287 window speed invalid r";
CM_ SG_ 960 VCRIGHT_a288_handlePWMPeriodF "Right body controller: a288 handle PWM period f";
CM_ SG_ 960 VCRIGHT_a289_handlePWMPeriodR "Right body controller: a289 handle PWM period r";
CM_ SG_ 960 VCRIGHT_a290_occupancyFaultedFro "Right body controller: a290 occupancy faulted front";
CM_ SG_ 960 VCRIGHT_a291_buckleFaultedFront "Right body controller: a291 buckle faulted front";
CM_ SG_ 960 VCRIGHT_a292_buckleFaultedRearC "Right body controller: a292 buckle faulted rear c";
CM_ SG_ 960 VCRIGHT_a293_buckleFaultedRearR "Right body controller: a293 buckle faulted rear r";
CM_ SG_ 960 VCRIGHT_a294_occupancyFaultedRea "Right body controller: a294 occupancy faulted rear r";
CM_ SG_ 960 VCRIGHT_a295_occupancyFaulted3Ro "Right body controller: a295 occupancy faulted3 row l";
CM_ SG_ 960 VCRIGHT_a296_occupancyFaulted3Ro "Right body controller: a296 occupancy faulted3 row r";
CM_ SG_ 960 VCRIGHT_a297_seatBelowMinPumpTmp "Right body controller: a297 seat below min pump tmp";
CM_ SG_ 960 VCRIGHT_a298_buckleFaulted3RowL "Right body controller: a298 buckle faulted3 row l";
CM_ SG_ 960 VCRIGHT_a299_buckleFaulted3RowR "Right body controller: a299 buckle faulted3 row r";
CM_ SG_ 960 VCRIGHT_a301_airwaveRightVertica "Right body controller: a301 airwave right vertical warning";
CM_ SG_ 960 VCRIGHT_a302_airwaveRightVertica "Right body controller: a302 airwave right vertical unavailable";
CM_ SG_ 960 VCRIGHT_a303_eFuseMgmtWindowLift "Right body controller: a303 e fuse mgmt window lift";
CM_ SG_ 960 VCRIGHT_a304_frontIntHandleShort "Right body controller: a304 front int handle shorted";
CM_ SG_ 960 VCRIGHT_a305_rearIntHandleShorte "Right body controller: a305 rear int handle shorted";
CM_ SG_ 960 VCRIGHT_a306_handleDisconnectedF "Right body controller: a306 handle disconnected f";
CM_ SG_ 960 VCRIGHT_a307_handleDisconnectedR "Right body controller: a307 handle disconnected r";
CM_ SG_ 960 VCRIGHT_a308_airwaveRightLateral "Right body controller: a308 airwave right lateral unavailable";
CM_ SG_ 960 VCRIGHT_a310_mirrorFoldStall "Right body controller: a310 mirror fold stall";
CM_ SG_ 960 VCRIGHT_a311_rightBrakeLightFaul "Right body controller: a311 right brake light fault";
CM_ SG_ 960 VCRIGHT_a312_rightTailLightFault "Right body controller: a312 right tail light fault";
CM_ SG_ 960 VCRIGHT_a313_rightFootwellLightF "Right body controller: a313 right footwell light fault";
CM_ SG_ 960 VCRIGHT_a314_rightMapPocketLight "Right body controller: a314 right map pocket light fault";
CM_ SG_ 960 VCRIGHT_a315_rightInteriorTrunkL "Right body controller: a315 right interior trunk light fault";
CM_ SG_ 960 VCRIGHT_a316_mirrorPrematureFold "Right body controller: a316 mirror premature fold stall";
CM_ SG_ 960 VCRIGHT_a317_epbmLimpModeEnabled "Right body controller: a317 epbm limp mode enabled";
CM_ SG_ 960 VCRIGHT_a318_leftExteriorTrunkLi "Right body controller: a318 left exterior trunk light fault";
CM_ SG_ 960 VCRIGHT_a319_rightExteriorTrunkL "Right body controller: a319 right exterior trunk light fault";
CM_ SG_ 960 VCRIGHT_a320_windowReportCracked "Right body controller: a320 window report cracked at trim clear";
CM_ SG_ 960 VCRIGHT_a321_windowRezeroedDebug "Right body controller: a321 window rezeroed debug f";
CM_ SG_ 960 VCRIGHT_a322_windowRezeroedDebug "Right body controller: a322 window rezeroed debug r";
CM_ SG_ 960 VCRIGHT_a323_mirrorCalibrated "Right body controller: a323 mirror calibrated";
CM_ SG_ 960 VCRIGHT_a324_mirrorHeatFault "Right body controller: a324 mirror heat fault";
CM_ SG_ 960 VCRIGHT_a325_airwaveLeftVertical "Right body controller: a325 airwave left vertical unavailable";
CM_ SG_ 960 VCRIGHT_a326_airwaveLeftLateralU "Right body controller: a326 airwave left lateral unavailable";
CM_ SG_ 960 VCRIGHT_a327_airwaveLeftLateralW "Right body controller: a327 airwave left lateral warning";
CM_ SG_ 960 VCRIGHT_a328_airwaveLeftVertical "Right body controller: a328 airwave left vertical warning";
CM_ SG_ 960 VCRIGHT_a329_airwaveRightLateral "Right body controller: a329 airwave right lateral warning";
CM_ SG_ 960 VCRIGHT_a330_shortDropFailedF "Right body controller: a330 short drop failed f";
CM_ SG_ 960 VCRIGHT_a331_shortDropFailedR "Right body controller: a331 short drop failed r";
CM_ SG_ 960 VCRIGHT_a336_windowDropRevTherma "Right body controller: a336 window drop rev thermal f";
CM_ SG_ 960 VCRIGHT_a337_windowDropRevTherma "Right body controller: a337 window drop rev thermal r";
CM_ SG_ 960 VCRIGHT_a342_rearDefrostDisabled "Right body controller: a342 rear defrost disabled";
CM_ SG_ 960 VCRIGHT_a343_rearDefrostUndercur "Right body controller: a343 rear defrost undercurrent";
CM_ SG_ 960 VCRIGHT_a344_rearDefrostOvercurr "Right body controller: a344 rear defrost overcurrent";
CM_ SG_ 960 VCRIGHT_a345_HVACPTCHeaterPwrEFu "Right body controller: a345 HVACPTC heater pwr e fuse fault";
CM_ SG_ 960 VCRIGHT_a346_cabinRadarEFuseFaul "Right body controller: a346 cabin radar e fuse fault";
CM_ SG_ 960 VCRIGHT_a347_nonContMonitorClear "Right body controller: a347 non cont monitor cleared DBG";
CM_ SG_ 960 VCRIGHT_a352_audioCurrentSpikeDa "Right body controller: a352 audio current spike data";
CM_ SG_ 960 VCRIGHT_a355_hvacLHBleedWarning "Right body controller: a355 hvac LH bleed warning";
CM_ SG_ 960 VCRIGHT_a356_hvacRHBleedWarning "Right body controller: a356 hvac RH bleed warning";
CM_ SG_ 960 VCRIGHT_a357_hvacLHVaneWarning "Right body controller: a357 hvac LH vane warning";
CM_ SG_ 960 VCRIGHT_a358_hvacRHVaneWarning "Right body controller: a358 hvac RH vane warning";
CM_ SG_ 960 VCRIGHT_a359_hvacUpperModeWarnin "Right body controller: a359 hvac upper mode warning";
CM_ SG_ 960 VCRIGHT_a360_detectedStationaryW "Right body controller: a360 detected stationary while moving";
CM_ SG_ 960 VCRIGHT_a361_stationaryThreshold "Right body controller: a361 stationary thresholds incorrect";
CM_ SG_ 960 VCRIGHT_a362_movingThresholdsInc "Right body controller: a362 moving thresholds incorrect";
CM_ SG_ 960 VCRIGHT_a363_hvacLowerModeWarnin "Right body controller: a363 hvac lower mode warning";
CM_ SG_ 960 VCRIGHT_a364_hvacIntakeWarning "Right body controller: a364 hvac intake warning";
CM_ SG_ 960 VCRIGHT_a365_pitchUnlatchDisable "Right body controller: a365 pitch unlatch disabled";
CM_ SG_ 960 VCRIGHT_a366_trunkLatchUnhomed "Right body controller: a366 trunk latch unhomed";
CM_ SG_ 960 VCRIGHT_a367_trunkLatchSwFault "Right body controller: a367 trunk latch sw fault";
CM_ SG_ 960 VCRIGHT_a368_ductLeftLowerTempSn "Right body controller: a368 duct left lower temp sns";
CM_ SG_ 960 VCRIGHT_a369_ductRightLowerTempS "Right body controller: a369 duct right lower temp sns";
CM_ SG_ 960 VCRIGHT_a370_seat2RowPitchUnlatc "Right body controller: a370 seat2 row pitch unlatched";
CM_ SG_ 960 VCRIGHT_a371_seat2RowTrackUnlatc "Right body controller: a371 seat2 row track unlatched";
CM_ SG_ 960 VCRIGHT_a372_seat2RowBackrestUnl "Right body controller: a372 seat2 row backrest unlatched";
CM_ SG_ 960 VCRIGHT_a373_windowSwOpenReqInDo "Right body controller: a373 window sw open req in dog mode";
CM_ SG_ 960 VCRIGHT_a375_windowPinchOverride "Right body controller: a375 window pinch override nudge";
CM_ SG_ 960 VCRIGHT_a376_seat2RowBridgeCurre "Right body controller: a376 seat2 row bridge current exceeded";
CM_ SG_ 960 VCRIGHT_a377_ambientTempSns "Right body controller: a377 ambient temp sns";
CM_ SG_ 960 VCRIGHT_a378_ductLeftUpperTempSn "Right body controller: a378 duct left upper temp sns";
CM_ SG_ 960 VCRIGHT_a379_ductRightUpperTempS "Right body controller: a379 duct right upper temp sns";
CM_ SG_ 960 VCRIGHT_a380_reverseLightFault "Right body controller: a380 reverse light fault";
CM_ SG_ 960 VCRIGHT_a381_rearFogLightFault "Right body controller: a381 rear fog light fault";
CM_ SG_ 960 VCRIGHT_a382_leftLiftgateTailLig "Right body controller: a382 left liftgate tail light fault";
CM_ SG_ 960 VCRIGHT_a406_aptivOCSMIA "Right body controller: a406 aptiv OCSMIA";
CM_ SG_ 960 VCRIGHT_a407_aptivOCSInterfaceEr "Right body controller: a407 aptiv OCS interface error";
CM_ SG_ 960 VCRIGHT_a408_aptivOCSDeviceError "Right body controller: a408 aptiv OCS device error";
CM_ SG_ 960 VCRIGHT_a409_aptivOCSDeviceError "Right body controller: a409 aptiv OCS device error debug";
CM_ SG_ 960 VCRIGHT_a412_rightBrakeTailLight "Right body controller: a412 right brake tail light fault";
CM_ SG_ 960 VCRIGHT_a413_centerHighMountStop "Right body controller: a413 center high mount stop light fault";
CM_ SG_ 960 VCRIGHT_a414_rearFasciaReverseLi "Right body controller: a414 rear fascia reverse light fault";
CM_ SG_ 960 VCRIGHT_a415_rearFasciaFogLightF "Right body controller: a415 rear fascia fog light fault";
CM_ SG_ 960 VCRIGHT_a416_rearFasciaTailLight "Right body controller: a416 rear fascia tail light fault";
CM_ SG_ 960 VCRIGHT_a417_rearFasciaLeftTurnL "Right body controller: a417 rear fascia left turn light fault";
CM_ SG_ 960 VCRIGHT_a418_rearFasciaRightTurn "Right body controller: a418 rear fascia right turn light fault";
CM_ SG_ 960 VCRIGHT_a419_tailFasciaLeftLight "Right body controller: a419 tail fascia left light fault";
CM_ SG_ 960 VCRIGHT_a420_tailFasciaRightLigh "Right body controller: a420 tail fascia right light fault";
CM_ SG_ 960 VCRIGHT_a421_leftTailLightFault "Right body controller: a421 left tail light fault";
CM_ SG_ 960 VCRIGHT_a426_seatAbuseMotorWarn "Right body controller: a426 seat abuse motor warn";
CM_ SG_ 960 VCRIGHT_a427_seatAbuseMotorStop "Right body controller: a427 seat abuse motor stop";
CM_ SG_ 960 VCRIGHT_a428_seatAbuseBufferWarn "Right body controller: a428 seat abuse buffer warn";
CM_ SG_ 960 VCRIGHT_a429_seatAbuseBufferFull "Right body controller: a429 seat abuse buffer full";
CM_ SG_ 960 VCRIGHT_a444_drv8703Fault "Right body controller: a444 drv8703 fault";
CM_ SG_ 960 VCRIGHT_a445_drv8703SpiFaultDBG "Right body controller: a445 drv8703 spi fault DBG";
CM_ SG_ 960 VCRIGHT_a446_cabinHVACUnavailabl "Right body controller: a446 cabin HVAC unavailable context";
CM_ SG_ 960 VCRIGHT_a448_manualHVACAlert "Right body controller: a448 manual HVAC alert";
CM_ SG_ 960 VCRIGHT_a450_ptcForcedOutOfSeqRo "Right body controller: a450 ptc forced out of seq rod";
CM_ SG_ 960 VCRIGHT_a451_ptcSeqRodOutOfRetri "Right body controller: a451 ptc seq rod out of retries";
CM_ SG_ 960 VCRIGHT_a454_ptcHeaterBadRodDete "Right body controller: a454 ptc heater bad rod detected";
CM_ SG_ 960 VCRIGHT_a482_NCV77XXFault "Right body controller: a482 NCV77 XX fault";
CM_ SG_ 960 VCRIGHT_a490_vehicleOccupiedOnOT "Right body controller: a490 vehicle occupied on OTA start";
CM_ SG_ 960 VCRIGHT_a491_BPillarCameraHeater "Right body controller: a491 b pillar camera heater fault";
CM_ SG_ 960 VCRIGHT_a496_gloveboxOpenFailed "Right body controller: a496 glovebox open failed";
CM_ SG_ 960 VCRIGHT_a498_canAuthenticationFa "Right body controller: a498 can authentication failure";
CM_ SG_ 960 VCRIGHT_a499_epbmInvalidateCdp "Right body controller: a499 epbm invalidate cdp";
CM_ SG_ 960 VCRIGHT_a520_configMismatch "Right body controller: a520 config mismatch";
CM_ SG_ 960 VCRIGHT_a525_LVBatterySWMisconfi "Right body controller: a525 LV battery SW misconfiguration";
CM_ SG_ 960 VCRIGHT_a526_pcbaOverTemperature "Right body controller: a526 pcba over temperature";
CM_ SG_ 960 VCRIGHT_a527_continuousFeedUnexp "Right body controller: a527 continuous feed unexpected voltage";
CM_ SG_ 960 VCRIGHT_a528_unableToRunStuckOnT "Right body controller: a528 unable to run stuck on test";
CM_ SG_ 960 VCRIGHT_a529_airflowFeedBackMode "Right body controller: a529 airflow feed back model error";
CM_ SG_ 960 VCRIGHT_a531_airflowModelTmpComp "Right body controller: a531 airflow model tmp comp disabled";
CM_ SG_ 960 VCRIGHT_a532_airflowModelFeedFor "Right body controller: a532 airflow model feed forward error";
CM_ SG_ 960 VCRIGHT_a533_cabinModelDebug "Right body controller: a533 cabin model debug";
CM_ SG_ 960 VCRIGHT_a537_solarCalcsNotNomina "Right body controller: a537 solar calcs not nominal";
CM_ SG_ 960 VCRIGHT_a538_hvacSystemNotNomina "Right body controller: a538 hvac system not nominal";
CM_ SG_ 960 VCRIGHT_a539_dogModeMonitorTrip "Right body controller: a539 dog mode monitor trip";
CM_ SG_ 960 VCRIGHT_a540_hvacActuatorDitherD "Right body controller: a540 hvac actuator dither debug";
CM_ SG_ 960 VCRIGHT_a542_steeringWheelHeatin "Right body controller: a542 steering wheel heating inhibited";
CM_ SG_ 960 VCRIGHT_a545_LVBatteryTypeUnknow "Right body controller: a545 LV battery type unknown";
CM_ SG_ 960 VCRIGHT_a546_mirrorFoldTypeChang "Right body controller: a546 mirror fold type changed";
CM_ SG_ 960 VCRIGHT_a550_ambientTempDelta "Right body controller: a550 ambient temp delta";
CM_ SG_ 960 VCRIGHT_a551_interiorDoorRequest "Right body controller: a551 interior door request inhibited";
CM_ SG_ 960 VCRIGHT_a555_RCM2_MIA "Right body controller: a555 RCM2 MIA";
CM_ SG_ 960 VCRIGHT_a556_rcmReportedOCSError "Right body controller: a556 rcm reported OCS error";
CM_ SG_ 960 VCRIGHT_a560_2RowSeatUncalibrate "Right body controller: a560 2 row seat uncalibrated";
CM_ SG_ 960 VCRIGHT_a561_2RowSeatPositionNon "Right body controller: a561 2 row seat position nonsensical";
CM_ SG_ 960 VCRIGHT_a562_2RowSeatAbsPosOffse "Right body controller: a562 2 row seat abs pos offset applied";
CM_ SG_ 960 VCRIGHT_a563_2RowSeatObstacleDet "Right body controller: a563 2 row seat obstacle detected";
CM_ SG_ 960 VCRIGHT_a564_2RowSeatTempHigh "Right body controller: a564 2 row seat temp high";
CM_ SG_ 960 VCRIGHT_a565_2RowSeatAbsPosSenso "Right body controller: a565 2 row seat abs pos sensor transition dbg";
CM_ SG_ 960 VCRIGHT_a566_2RowSeatStatsFromLa "Right body controller: a566 2 row seat stats from last state dbg";
CM_ SG_ 960 VCRIGHT_a567_2RowSeatRequestWhil "Right body controller: a567 2 row seat request while uncalibrated";
CM_ SG_ 960 VCRIGHT_a568_2RowSeatClashAvoida "Right body controller: a568 2 row seat clash avoidance blocked";
CM_ SG_ 960 VCRIGHT_a569_2RowSeatOverfolded "Right body controller: a569 2 row seat overfolded";
CM_ SG_ 960 VCRIGHT_a570_seatHeatDisabledF "Right body controller: a570 seat heat disabled f";
CM_ SG_ 960 VCRIGHT_a571_seatHeatDisabledRea "Right body controller: a571 seat heat disabled rear l";
CM_ SG_ 960 VCRIGHT_a572_seatHeatDisabledRea "Right body controller: a572 seat heat disabled rear c";
CM_ SG_ 960 VCRIGHT_a573_seatHeatDisabledRea "Right body controller: a573 seat heat disabled rear r";
CM_ SG_ 960 VCRIGHT_a577_bsiHardwareIssue "Right body controller: a577 bsi hardware issue";
CM_ SG_ 960 VCRIGHT_a578_RGBLightFault "Right body controller: a578 RGB light fault";
CM_ SG_ 960 VCRIGHT_a579_liftgateFollowerUne "Right body controller: a579 liftgate follower unexpected stop";
CM_ SG_ 960 VCRIGHT_a580_debugLiftgateFollow "Right body controller: a580 debug liftgate follower current spike";
CM_ SG_ 960 VCRIGHT_a583_doorRemoteUnlatched "Right body controller: a583 door remote unlatched front";
CM_ SG_ 960 VCRIGHT_a584_doorRemoteUnlatched "Right body controller: a584 door remote unlatched rear";
CM_ SG_ 960 VCRIGHT_a585_doorRemoteUnlatchFa "Right body controller: a585 door remote unlatch failed front";
CM_ SG_ 960 VCRIGHT_a586_doorRemoteUnlatchFa "Right body controller: a586 door remote unlatch failed rear";
CM_ SG_ 960 VCRIGHT_a598_childModeMonitorTri "Right body controller: a598 child mode monitor trip";
CM_ SG_ 960 VCRIGHT_a599_LVBatteryTypeUnsupp "Right body controller: a599 LV battery type unsupported";
CM_ SG_ 960 VCRIGHT_a617_APP_MIA "Right body controller: a617 APP MIA";
CM_ BO_ 1795 "Right body controller message: debug thermal10 hz";
CM_ SG_ 1795 VCRIGHT_debugThermal10HzIndex "Right body controller: debug thermal10 hz index";
CM_ SG_ 1795 VCRIGHT_hvacPanelFloorSplitRow1 "Right body controller: hvac panel floor split row1";
CM_ SG_ 1795 VCRIGHT_hvacDefrostPercent "Right body controller: hvac defrost percent";
CM_ SG_ 1795 VCRIGHT_hvacRow2Percent "Right body controller: hvac row2 percent";
CM_ SG_ 1795 VCRIGHT_hvacPanelFloorSplitRow2 "Right body controller: hvac panel floor split row2";
CM_ SG_ 1795 VCRIGHT_hvacFreshMassCounter "Right body controller: hvac fresh mass counter";
CM_ SG_ 1795 VCRIGHT_hvacRecircMassCounter "Right body controller: hvac recirc mass counter";
CM_ SG_ 1795 VCRIGHT_setTempAdjustmentLeft "Right body controller: set temp adjustment left";
CM_ SG_ 1795 VCRIGHT_setTempAdjustmentRight "Right body controller: set temp adjustment right";
CM_ SG_ 1795 VCRIGHT_hvacLHVaneVelocity "Right body controller: hvac LH vane velocity";
CM_ SG_ 1795 VCRIGHT_hvacRHVaneVelocity "Right body controller: hvac RH vane velocity";
CM_ SG_ 1795 VCRIGHT_hvacMassflowCompensated "Right body controller: hvac massflow compensated";
CM_ SG_ 1795 VCRIGHT_PTCcenterPowerLeft "Right body controller: PT ccenter power left";
CM_ SG_ 1795 VCRIGHT_PTCouterPowerLeft "Right body controller: PT couter power left";
CM_ SG_ 1795 VCRIGHT_PTCinnerPowerLeft "Right body controller: PT cinner power left";
CM_ SG_ 1795 VCRIGHT_PTCcenterPowerRight "Right body controller: PT ccenter power right";
CM_ SG_ 1795 VCRIGHT_PTCouterPowerRight "Right body controller: PT couter power right";
CM_ SG_ 1795 VCRIGHT_PTCinnerPowerRight "Right body controller: PT cinner power right";
CM_ SG_ 1795 VCRIGHT_PTCcenterStoneTempLeft "Right body controller: PT ccenter stone temp left";
CM_ SG_ 1795 VCRIGHT_PTCcenterStoneTempRight "Right body controller: PT ccenter stone temp right";
CM_ SG_ 1795 VCRIGHT_PTCinnerStoneTempLeft "Right body controller: PT cinner stone temp left";
CM_ SG_ 1795 VCRIGHT_PTCinnerStoneTempRight "Right body controller: PT cinner stone temp right";
CM_ SG_ 1795 VCRIGHT_PTCouterStoneTempLeft "Right body controller: PT couter stone temp left";
CM_ SG_ 1795 VCRIGHT_PTCouterRodTempLeft "Right body controller: PT couter rod temp left";
CM_ SG_ 1795 VCRIGHT_PTCouterAirTempLeft "Right body controller: PT couter air temp left";
CM_ SG_ 1795 VCRIGHT_PTCcenterRodTempLeft "Right body controller: PT ccenter rod temp left";
CM_ SG_ 1795 VCRIGHT_PTCinnerRodTempLeft "Right body controller: PT cinner rod temp left";
CM_ SG_ 1795 VCRIGHT_PTCcenterAirTempLeft "Right body controller: PT ccenter air temp left";
CM_ SG_ 1795 VCRIGHT_PTCinnerAirTempLeft "Right body controller: PT cinner air temp left";
CM_ SG_ 1795 VCRIGHT_PTCouterStoneTempRight "Right body controller: PT couter stone temp right";
CM_ SG_ 1795 VCRIGHT_PTCouterRodTempRight "Right body controller: PT couter rod temp right";
CM_ SG_ 1795 VCRIGHT_PTCouterAirTempRight "Right body controller: PT couter air temp right";
CM_ SG_ 1795 VCRIGHT_PTCcenterRodTempRight "Right body controller: PT ccenter rod temp right";
CM_ SG_ 1795 VCRIGHT_PTCinnerRodTempRight "Right body controller: PT cinner rod temp right";
CM_ SG_ 1795 VCRIGHT_PTCcenterAirTempRight "Right body controller: PT ccenter air temp right";
CM_ SG_ 1795 VCRIGHT_PTCinnerAirTempRight "Right body controller: PT cinner air temp right";
BA_DEF_ BO_ "GenMsgCycleTime" INT 0 3600000;
BA_DEF_ BO_ "GenMsgSendType" ENUM "Cyclic","NotUsed","NotUsed","NotUsed","NotUsed","NotUsed","NotUsed","IfActive","NoMsgSendType","NotUsed";
BA_DEF_ BO_ "VFrameFormat" ENUM "StandardCAN","ExtendedCAN","reserved","J1939PG","reserved","reserved","reserved","reserved","reserved","reserved","reserved","reserved","reserved","reserved","StandardCAN_FD","ExtendedCAN_FD";
BA_DEF_ BO_ "CANFD_BRS" ENUM "0","1";
BA_DEF_ SG_ "SystemSignalLongSymbol" STRING;
BA_DEF_ SG_ "Confidence" ENUM "layout-only","plausible","validated";
BA_DEF_DEF_ "GenMsgCycleTime" 0;
BA_DEF_DEF_ "GenMsgSendType" "NoMsgSendType";
BA_DEF_DEF_ "VFrameFormat" "StandardCAN";
BA_DEF_DEF_ "CANFD_BRS" "1";
BA_DEF_DEF_ "SystemSignalLongSymbol" "";
BA_DEF_DEF_ "Confidence" "layout-only";
BA_ "SystemSignalLongSymbol" SG_ 2011 VCRIGHT_a262_RightThermalShutIGB "VCRIGHT_a262_RightThermalShutIGBT";
BA_ "SystemSignalLongSymbol" SG_ 2011 VCRIGHT_a262_RightCurrentHVSenso "VCRIGHT_a262_RightCurrentHVSensor";
BA_ "SystemSignalLongSymbol" SG_ 2011 VCRIGHT_a271_temperatureSensorSN "VCRIGHT_a271_temperatureSensorSNA";
BA_ "SystemSignalLongSymbol" SG_ 2011 VCRIGHT_a302_calibrationPositive "VCRIGHT_a302_calibrationPositiveDirection";
BA_ "SystemSignalLongSymbol" SG_ 2011 VCRIGHT_a302_calibrationNegative "VCRIGHT_a302_calibrationNegativeDirection";
BA_ "SystemSignalLongSymbol" SG_ 2011 VCRIGHT_a308_calibrationPositive "VCRIGHT_a308_calibrationPositiveDirection";
BA_ "SystemSignalLongSymbol" SG_ 2011 VCRIGHT_a308_calibrationNegative "VCRIGHT_a308_calibrationNegativeDirection";
BA_ "SystemSignalLongSymbol" SG_ 2011 VCRIGHT_a310_mirrorMaxFoldCurren "VCRIGHT_a310_mirrorMaxFoldCurrent";
BA_ "SystemSignalLongSymbol" SG_ 2011 VCRIGHT_a316_ambientTemperatureD "VCRIGHT_a316_ambientTemperatureDegC";
BA_ "SystemSignalLongSymbol" SG_ 2011 VCRIGHT_a325_calibrationPositive "VCRIGHT_a325_calibrationPositiveDirection";
BA_ "SystemSignalLongSymbol" SG_ 2011 VCRIGHT_a325_calibrationNegative "VCRIGHT_a325_calibrationNegativeDirection";
BA_ "SystemSignalLongSymbol" SG_ 2011 VCRIGHT_a326_calibrationPositive "VCRIGHT_a326_calibrationPositiveDirection";
BA_ "SystemSignalLongSymbol" SG_ 2011 VCRIGHT_a326_calibrationNegative "VCRIGHT_a326_calibrationNegativeDirection";
BA_ "SystemSignalLongSymbol" SG_ 2011 VCRIGHT_a376_2RowSeatTrackActuat "VCRIGHT_a376_2RowSeatTrackActuatorCurrent";
BA_ "SystemSignalLongSymbol" SG_ 2011 VCRIGHT_a376_2RowSeatTrackA_0001 "VCRIGHT_a376_2RowSeatTrackActuatorDuty";
BA_ "SystemSignalLongSymbol" SG_ 2011 VCRIGHT_a376_2RowSeatEasyEntrySt "VCRIGHT_a376_2RowSeatEasyEntryState";
BA_ "SystemSignalLongSymbol" SG_ 2011 VCRIGHT_a376_2RowSeatTrackPositi "VCRIGHT_a376_2RowSeatTrackPositionSwitch";
BA_ "SystemSignalLongSymbol" SG_ 2011 VCRIGHT_a408_hardwareInternalErr "VCRIGHT_a408_hardwareInternalError";
BA_ "SystemSignalLongSymbol" SG_ 2011 VCRIGHT_a446_caseTempHVACUnavail "VCRIGHT_a446_caseTempHVACUnavailable";
BA_ "SystemSignalLongSymbol" SG_ 2011 VCRIGHT_a446_evapOperationNotAll "VCRIGHT_a446_evapOperationNotAllowed";
BA_ "SystemSignalLongSymbol" SG_ 2011 VCRIGHT_a446_rawDuctTempInvalidL "VCRIGHT_a446_rawDuctTempInvalidLeft";
BA_ "SystemSignalLongSymbol" SG_ 2011 VCRIGHT_a446_rawDuctTempInvalidR "VCRIGHT_a446_rawDuctTempInvalidRight";
BA_ "SystemSignalLongSymbol" SG_ 2011 VCRIGHT_a448_manACOFFComfortCool "VCRIGHT_a448_manACOFFComfortCoolNudge";
BA_ "SystemSignalLongSymbol" SG_ 2011 VCRIGHT_a448_manAirflowComfortHe "VCRIGHT_a448_manAirflowComfortHeatNudge";
BA_ "SystemSignalLongSymbol" SG_ 2011 VCRIGHT_a448_manAirflowFwdL_0001 "VCRIGHT_a448_manAirflowFwdLkComfortHeatNudge";
BA_ "SystemSignalLongSymbol" SG_ 2011 VCRIGHT_a448_manAirflowFwdLkComf "VCRIGHT_a448_manAirflowFwdLkComfortCoolNudge";
BA_ "SystemSignalLongSymbol" SG_ 2011 VCRIGHT_a448_manACOffFwdLkComfor "VCRIGHT_a448_manACOffFwdLkComfortCoolNudge";
BA_ "SystemSignalLongSymbol" SG_ 2011 VCRIGHT_a448_manFreshComfor_0002 "VCRIGHT_a448_manFreshComfortHeatManualHVACIntvn";
BA_ "SystemSignalLongSymbol" SG_ 2011 VCRIGHT_a448_manFreshComfor_0001 "VCRIGHT_a448_manFreshComfortCoolManualHVACIntvn";
BA_ "SystemSignalLongSymbol" SG_ 2011 VCRIGHT_a448_manFreshComfortCool "VCRIGHT_a448_manFreshComfortCoolAutoHVACIntvn";
BA_ "SystemSignalLongSymbol" SG_ 2011 VCRIGHT_a448_manFreshComfortHeat "VCRIGHT_a448_manFreshComfortHeatAutoHVACIntvn";
BA_ "SystemSignalLongSymbol" SG_ 2011 VCRIGHT_a448_manRecircRHAutoHVAC "VCRIGHT_a448_manRecircRHAutoHVACIntvn";
BA_ "SystemSignalLongSymbol" SG_ 2011 VCRIGHT_a448_manRecircFlashFogGe "VCRIGHT_a448_manRecircFlashFogGenericHVACIntvn";
BA_ "SystemSignalLongSymbol" SG_ 2011 VCRIGHT_a448_manRecircFlashFogWe "VCRIGHT_a448_manRecircFlashFogWetAirHVACIntvn";
BA_ "SystemSignalLongSymbol" SG_ 2011 VCRIGHT_a448_manRecircRHManualHV "VCRIGHT_a448_manRecircRHManualHVACNudge";
BA_ "SystemSignalLongSymbol" SG_ 2011 VCRIGHT_a448_manACoffRHManualHVA "VCRIGHT_a448_manACoffRHManualHVACNudge";
BA_ "SystemSignalLongSymbol" SG_ 2011 VCRIGHT_a448_manHvacOffAutoSteer "VCRIGHT_a448_manHvacOffAutoSteerFogIntvn";
BA_ "SystemSignalLongSymbol" SG_ 2011 VCRIGHT_a448_manHvacOffAuto_0001 "VCRIGHT_a448_manHvacOffAutoSteerFogNudge";
BA_ "SystemSignalLongSymbol" SG_ 2011 VCRIGHT_a448_manHvacAutoSteerFog "VCRIGHT_a448_manHvacAutoSteerFogIntvn";
BA_ "SystemSignalLongSymbol" SG_ 2011 VCRIGHT_a448_manHvacAutoSte_0001 "VCRIGHT_a448_manHvacAutoSteerFogNudge";
BA_ "SystemSignalLongSymbol" SG_ 2011 VCRIGHT_a448_manualHighBlowerSpe "VCRIGHT_a448_manualHighBlowerSpeedAutoHVACIntvn";
BA_ "SystemSignalLongSymbol" SG_ 2011 VCRIGHT_a482_underOrOverVoltageO "VCRIGHT_a482_underOrOverVoltageOrOverCurrent";
BA_ "SystemSignalLongSymbol" SG_ 2011 VCRIGHT_a525_GTW_twelveVBatteryT "VCRIGHT_a525_GTW_twelveVBatteryType";
BA_ "SystemSignalLongSymbol" SG_ 2011 VCRIGHT_a525_initialLVBatteryTyp "VCRIGHT_a525_initialLVBatteryType";
BA_ "SystemSignalLongSymbol" SG_ 2011 VCRIGHT_a538_cabinTempSensorFaul "VCRIGHT_a538_cabinTempSensorFault";
BA_ "SystemSignalLongSymbol" SG_ 2011 VCRIGHT_a538_cabinModelNotInitia "VCRIGHT_a538_cabinModelNotInitialized";
BA_ "SystemSignalLongSymbol" SG_ 2011 VCRIGHT_a538_blowerFaultOrStoppe "VCRIGHT_a538_blowerFaultOrStopped";
BA_ "SystemSignalLongSymbol" SG_ 2011 VCRIGHT_a538_compressorFaultOrSt "VCRIGHT_a538_compressorFaultOrStandby";
BA_ "SystemSignalLongSymbol" SG_ 2011 VCRIGHT_a538_heatPumpModeNotAtta "VCRIGHT_a538_heatPumpModeNotAttainable";
BA_ "SystemSignalLongSymbol" SG_ 2011 VCRIGHT_a539_hvacSystemNotNomina "VCRIGHT_a539_hvacSystemNotNominal";
BA_ "SystemSignalLongSymbol" SG_ 2011 VCRIGHT_a539_modeledCabinTempOut "VCRIGHT_a539_modeledCabinTempOutOfRange";
BA_ "SystemSignalLongSymbol" SG_ 2011 VCRIGHT_a539_modeledCabinTempExc "VCRIGHT_a539_modeledCabinTempExceedingSetTemp";
BA_ "SystemSignalLongSymbol" SG_ 2011 VCRIGHT_a539_cabinTempSensorFaul "VCRIGHT_a539_cabinTempSensorFault";
BA_ "SystemSignalLongSymbol" SG_ 2011 VCRIGHT_a539_cabinTempSensorOutO "VCRIGHT_a539_cabinTempSensorOutOfRange";
BA_ "SystemSignalLongSymbol" SG_ 2011 VCRIGHT_a539_modeledCabinTempDev "VCRIGHT_a539_modeledCabinTempDeviation";
BA_ "SystemSignalLongSymbol" SG_ 2011 VCRIGHT_a545_GTW_twelveVBatteryT "VCRIGHT_a545_GTW_twelveVBatteryType";
BA_ "SystemSignalLongSymbol" SG_ 2011 VCRIGHT_a551_restrictDoorRelease "VCRIGHT_a551_restrictDoorReleaseSignalFront";
BA_ "SystemSignalLongSymbol" SG_ 2011 VCRIGHT_a551_interiorReleaseReqC "VCRIGHT_a551_interiorReleaseReqCountFront";
BA_ "SystemSignalLongSymbol" SG_ 2011 VCRIGHT_a551_lastRequestSourceFr "VCRIGHT_a551_lastRequestSourceFront";
BA_ "SystemSignalLongSymbol" SG_ 2011 VCRIGHT_a551_restrictDoorRe_0001 "VCRIGHT_a551_restrictDoorReleaseSignalRear";
BA_ "SystemSignalLongSymbol" SG_ 2011 VCRIGHT_a551_interiorReleas_0001 "VCRIGHT_a551_interiorReleaseReqCountRear";
BA_ "SystemSignalLongSymbol" SG_ 2011 VCRIGHT_a551_lastRequestSourceRe "VCRIGHT_a551_lastRequestSourceRear";
BA_ "SystemSignalLongSymbol" SG_ 2011 VCRIGHT_a560_isRearwardEndstopUn "VCRIGHT_a560_isRearwardEndstopUncalibrated";
BA_ "SystemSignalLongSymbol" SG_ 2011 VCRIGHT_a560_isAbsPosSensorUncal "VCRIGHT_a560_isAbsPosSensorUncalibrated";
BA_ "SystemSignalLongSymbol" SG_ 2011 VCRIGHT_a563_obstacleDetectReaso "VCRIGHT_a563_obstacleDetectReason";
BA_ "SystemSignalLongSymbol" SG_ 2011 VCRIGHT_a563_accelLookbackTripDe "VCRIGHT_a563_accelLookbackTripDepth";
BA_ "SystemSignalLongSymbol" SG_ 2011 VCRIGHT_a563_absolutePosSensorFo "VCRIGHT_a563_absolutePosSensorForward";
BA_ "SystemSignalLongSymbol" SG_ 2011 VCRIGHT_a567_isRearwardEndstopUn "VCRIGHT_a567_isRearwardEndstopUncalibrated";
BA_ "SystemSignalLongSymbol" SG_ 2011 VCRIGHT_a567_isAbsPosSensorUncal "VCRIGHT_a567_isAbsPosSensorUncalibrated";
BA_ "SystemSignalLongSymbol" SG_ 2011 VCRIGHT_a579_liftgateFollowerSto "VCRIGHT_a579_liftgateFollowerStoppingCondition";
BA_ "SystemSignalLongSymbol" SG_ 2011 VCRIGHT_a579_liftgateFollowerPos "VCRIGHT_a579_liftgateFollowerPosition";
BA_ "SystemSignalLongSymbol" SG_ 2011 VCRIGHT_a579_liftgateFollowerLat "VCRIGHT_a579_liftgateFollowerLatchStatus";
BA_ "SystemSignalLongSymbol" SG_ 2011 VCRIGHT_a599_GTW_twelveVBatteryT "VCRIGHT_a599_GTW_twelveVBatteryType";
BA_ "SystemSignalLongSymbol" SG_ 2011 VCRIGHT_a599_initialLVBatteryTyp "VCRIGHT_a599_initialLVBatteryType";
BA_ "SystemSignalLongSymbol" SG_ 2011 VCRIGHT_a617_BDY_defogInfoMessag "VCRIGHT_a617_BDY_defogInfoMessage";
BA_ "SystemSignalLongSymbol" SG_ 2011 VCRIGHT_a617_VEH_defogInfoMessag "VCRIGHT_a617_VEH_defogInfoMessage";
BA_ "SystemSignalLongSymbol" SG_ 960 VCRIGHT_a065_emiosIsrRateLimited "VCRIGHT_a065_emiosIsrRateLimitedDbg";
BA_ "SystemSignalLongSymbol" SG_ 960 VCRIGHT_a066_emiosIsrShortPeriod "VCRIGHT_a066_emiosIsrShortPeriodDetectedDbg";
BA_ "SystemSignalLongSymbol" SG_ 960 VCRIGHT_a127_hvacActOvercurrentD "VCRIGHT_a127_hvacActOvercurrentDBG";
BA_ "SystemSignalLongSymbol" SG_ 960 VCRIGHT_a143_mirrorManuallyFolde "VCRIGHT_a143_mirrorManuallyFolded";
BA_ "SystemSignalLongSymbol" SG_ 960 VCRIGHT_a175_windowSealDefectFro "VCRIGHT_a175_windowSealDefectFront";
BA_ "SystemSignalLongSymbol" SG_ 960 VCRIGHT_a176_windowSealDefectRea "VCRIGHT_a176_windowSealDefectRear";
BA_ "SystemSignalLongSymbol" SG_ 960 VCRIGHT_a178_trunkSwitchVCBATTMI "VCRIGHT_a178_trunkSwitchVCBATTMIA";
BA_ "SystemSignalLongSymbol" SG_ 960 VCRIGHT_a179_trunkSwitchVCFRONTM "VCRIGHT_a179_trunkSwitchVCFRONTMIA";
BA_ "SystemSignalLongSymbol" SG_ 960 VCRIGHT_a180_frontDoorLatchRehom "VCRIGHT_a180_frontDoorLatchRehome";
BA_ "SystemSignalLongSymbol" SG_ 960 VCRIGHT_a183_doorStateFactoryTes "VCRIGHT_a183_doorStateFactoryTest";
BA_ "SystemSignalLongSymbol" SG_ 960 VCRIGHT_a215_currentDesyncWarnin "VCRIGHT_a215_currentDesyncWarning";
BA_ "SystemSignalLongSymbol" SG_ 960 VCRIGHT_a261_emergencyLatchRelRe "VCRIGHT_a261_emergencyLatchRelRear";
BA_ "SystemSignalLongSymbol" SG_ 960 VCRIGHT_a267_seatTrackHCEncStlDb "VCRIGHT_a267_seatTrackHCEncStlDbg";
BA_ "SystemSignalLongSymbol" SG_ 960 VCRIGHT_a277_BLERightUnderVoltag "VCRIGHT_a277_BLERightUnderVoltage";
BA_ "SystemSignalLongSymbol" SG_ 960 VCRIGHT_a278_hvacPtcHeatingUnava "VCRIGHT_a278_hvacPtcHeatingUnavailable";
BA_ "SystemSignalLongSymbol" SG_ 960 VCRIGHT_a284_gloveboxUnderCurren "VCRIGHT_a284_gloveboxUnderCurrentDetected";
BA_ "SystemSignalLongSymbol" SG_ 960 VCRIGHT_a285_gloveboxOverCurrent "VCRIGHT_a285_gloveboxOverCurrentDetected";
BA_ "SystemSignalLongSymbol" SG_ 960 VCRIGHT_a290_occupancyFaultedFro "VCRIGHT_a290_occupancyFaultedFront";
BA_ "SystemSignalLongSymbol" SG_ 960 VCRIGHT_a294_occupancyFaultedRea "VCRIGHT_a294_occupancyFaultedRearR";
BA_ "SystemSignalLongSymbol" SG_ 960 VCRIGHT_a295_occupancyFaulted3Ro "VCRIGHT_a295_occupancyFaulted3RowL";
BA_ "SystemSignalLongSymbol" SG_ 960 VCRIGHT_a296_occupancyFaulted3Ro "VCRIGHT_a296_occupancyFaulted3RowR";
BA_ "SystemSignalLongSymbol" SG_ 960 VCRIGHT_a301_airwaveRightVertica "VCRIGHT_a301_airwaveRightVerticalWarning";
BA_ "SystemSignalLongSymbol" SG_ 960 VCRIGHT_a302_airwaveRightVertica "VCRIGHT_a302_airwaveRightVerticalUnavailable";
BA_ "SystemSignalLongSymbol" SG_ 960 VCRIGHT_a304_frontIntHandleShort "VCRIGHT_a304_frontIntHandleShorted";
BA_ "SystemSignalLongSymbol" SG_ 960 VCRIGHT_a305_rearIntHandleShorte "VCRIGHT_a305_rearIntHandleShorted";
BA_ "SystemSignalLongSymbol" SG_ 960 VCRIGHT_a308_airwaveRightLateral "VCRIGHT_a308_airwaveRightLateralUnavailable";
BA_ "SystemSignalLongSymbol" SG_ 960 VCRIGHT_a311_rightBrakeLightFaul "VCRIGHT_a311_rightBrakeLightFault";
BA_ "SystemSignalLongSymbol" SG_ 960 VCRIGHT_a313_rightFootwellLightF "VCRIGHT_a313_rightFootwellLightFault";
BA_ "SystemSignalLongSymbol" SG_ 960 VCRIGHT_a314_rightMapPocketLight "VCRIGHT_a314_rightMapPocketLightFault";
BA_ "SystemSignalLongSymbol" SG_ 960 VCRIGHT_a315_rightInteriorTrunkL "VCRIGHT_a315_rightInteriorTrunkLightFault";
BA_ "SystemSignalLongSymbol" SG_ 960 VCRIGHT_a316_mirrorPrematureFold "VCRIGHT_a316_mirrorPrematureFoldStall";
BA_ "SystemSignalLongSymbol" SG_ 960 VCRIGHT_a318_leftExteriorTrunkLi "VCRIGHT_a318_leftExteriorTrunkLightFault";
BA_ "SystemSignalLongSymbol" SG_ 960 VCRIGHT_a319_rightExteriorTrunkL "VCRIGHT_a319_rightExteriorTrunkLightFault";
BA_ "SystemSignalLongSymbol" SG_ 960 VCRIGHT_a320_windowReportCracked "VCRIGHT_a320_windowReportCrackedAtTrimClear";
BA_ "SystemSignalLongSymbol" SG_ 960 VCRIGHT_a321_windowRezeroedDebug "VCRIGHT_a321_windowRezeroedDebugF";
BA_ "SystemSignalLongSymbol" SG_ 960 VCRIGHT_a322_windowRezeroedDebug "VCRIGHT_a322_windowRezeroedDebugR";
BA_ "SystemSignalLongSymbol" SG_ 960 VCRIGHT_a325_airwaveLeftVertical "VCRIGHT_a325_airwaveLeftVerticalUnavailable";
BA_ "SystemSignalLongSymbol" SG_ 960 VCRIGHT_a326_airwaveLeftLateralU "VCRIGHT_a326_airwaveLeftLateralUnavailable";
BA_ "SystemSignalLongSymbol" SG_ 960 VCRIGHT_a327_airwaveLeftLateralW "VCRIGHT_a327_airwaveLeftLateralWarning";
BA_ "SystemSignalLongSymbol" SG_ 960 VCRIGHT_a328_airwaveLeftVertical "VCRIGHT_a328_airwaveLeftVerticalWarning";
BA_ "SystemSignalLongSymbol" SG_ 960 VCRIGHT_a329_airwaveRightLateral "VCRIGHT_a329_airwaveRightLateralWarning";
BA_ "SystemSignalLongSymbol" SG_ 960 VCRIGHT_a336_windowDropRevTherma "VCRIGHT_a336_windowDropRevThermalF";
BA_ "SystemSignalLongSymbol" SG_ 960 VCRIGHT_a337_windowDropRevTherma "VCRIGHT_a337_windowDropRevThermalR";
BA_ "SystemSignalLongSymbol" SG_ 960 VCRIGHT_a343_rearDefrostUndercur "VCRIGHT_a343_rearDefrostUndercurrent";
BA_ "SystemSignalLongSymbol" SG_ 960 VCRIGHT_a344_rearDefrostOvercurr "VCRIGHT_a344_rearDefrostOvercurrent";
BA_ "SystemSignalLongSymbol" SG_ 960 VCRIGHT_a345_HVACPTCHeaterPwrEFu "VCRIGHT_a345_HVACPTCHeaterPwrEFuseFault";
BA_ "SystemSignalLongSymbol" SG_ 960 VCRIGHT_a346_cabinRadarEFuseFaul "VCRIGHT_a346_cabinRadarEFuseFault";
BA_ "SystemSignalLongSymbol" SG_ 960 VCRIGHT_a347_nonContMonitorClear "VCRIGHT_a347_nonContMonitorClearedDBG";
BA_ "SystemSignalLongSymbol" SG_ 960 VCRIGHT_a352_audioCurrentSpikeDa "VCRIGHT_a352_audioCurrentSpikeData";
BA_ "SystemSignalLongSymbol" SG_ 960 VCRIGHT_a359_hvacUpperModeWarnin "VCRIGHT_a359_hvacUpperModeWarning";
BA_ "SystemSignalLongSymbol" SG_ 960 VCRIGHT_a360_detectedStationaryW "VCRIGHT_a360_detectedStationaryWhileMoving";
BA_ "SystemSignalLongSymbol" SG_ 960 VCRIGHT_a361_stationaryThreshold "VCRIGHT_a361_stationaryThresholdsIncorrect";
BA_ "SystemSignalLongSymbol" SG_ 960 VCRIGHT_a362_movingThresholdsInc "VCRIGHT_a362_movingThresholdsIncorrect";
BA_ "SystemSignalLongSymbol" SG_ 960 VCRIGHT_a363_hvacLowerModeWarnin "VCRIGHT_a363_hvacLowerModeWarning";
BA_ "SystemSignalLongSymbol" SG_ 960 VCRIGHT_a365_pitchUnlatchDisable "VCRIGHT_a365_pitchUnlatchDisabled";
BA_ "SystemSignalLongSymbol" SG_ 960 VCRIGHT_a368_ductLeftLowerTempSn "VCRIGHT_a368_ductLeftLowerTempSns";
BA_ "SystemSignalLongSymbol" SG_ 960 VCRIGHT_a369_ductRightLowerTempS "VCRIGHT_a369_ductRightLowerTempSns";
BA_ "SystemSignalLongSymbol" SG_ 960 VCRIGHT_a370_seat2RowPitchUnlatc "VCRIGHT_a370_seat2RowPitchUnlatched";
BA_ "SystemSignalLongSymbol" SG_ 960 VCRIGHT_a371_seat2RowTrackUnlatc "VCRIGHT_a371_seat2RowTrackUnlatched";
BA_ "SystemSignalLongSymbol" SG_ 960 VCRIGHT_a372_seat2RowBackrestUnl "VCRIGHT_a372_seat2RowBackrestUnlatched";
BA_ "SystemSignalLongSymbol" SG_ 960 VCRIGHT_a373_windowSwOpenReqInDo "VCRIGHT_a373_windowSwOpenReqInDogMode";
BA_ "SystemSignalLongSymbol" SG_ 960 VCRIGHT_a375_windowPinchOverride "VCRIGHT_a375_windowPinchOverrideNudge";
BA_ "SystemSignalLongSymbol" SG_ 960 VCRIGHT_a376_seat2RowBridgeCurre "VCRIGHT_a376_seat2RowBridgeCurrentExceeded";
BA_ "SystemSignalLongSymbol" SG_ 960 VCRIGHT_a378_ductLeftUpperTempSn "VCRIGHT_a378_ductLeftUpperTempSns";
BA_ "SystemSignalLongSymbol" SG_ 960 VCRIGHT_a379_ductRightUpperTempS "VCRIGHT_a379_ductRightUpperTempSns";
BA_ "SystemSignalLongSymbol" SG_ 960 VCRIGHT_a382_leftLiftgateTailLig "VCRIGHT_a382_leftLiftgateTailLightFault";
BA_ "SystemSignalLongSymbol" SG_ 960 VCRIGHT_a407_aptivOCSInterfaceEr "VCRIGHT_a407_aptivOCSInterfaceError";
BA_ "SystemSignalLongSymbol" SG_ 960 VCRIGHT_a409_aptivOCSDeviceError "VCRIGHT_a409_aptivOCSDeviceErrorDebug";
BA_ "SystemSignalLongSymbol" SG_ 960 VCRIGHT_a412_rightBrakeTailLight "VCRIGHT_a412_rightBrakeTailLightFault";
BA_ "SystemSignalLongSymbol" SG_ 960 VCRIGHT_a413_centerHighMountStop "VCRIGHT_a413_centerHighMountStopLightFault";
BA_ "SystemSignalLongSymbol" SG_ 960 VCRIGHT_a414_rearFasciaReverseLi "VCRIGHT_a414_rearFasciaReverseLightFault";
BA_ "SystemSignalLongSymbol" SG_ 960 VCRIGHT_a415_rearFasciaFogLightF "VCRIGHT_a415_rearFasciaFogLightFault";
BA_ "SystemSignalLongSymbol" SG_ 960 VCRIGHT_a416_rearFasciaTailLight "VCRIGHT_a416_rearFasciaTailLightFault";
BA_ "SystemSignalLongSymbol" SG_ 960 VCRIGHT_a417_rearFasciaLeftTurnL "VCRIGHT_a417_rearFasciaLeftTurnLightFault";
BA_ "SystemSignalLongSymbol" SG_ 960 VCRIGHT_a418_rearFasciaRightTurn "VCRIGHT_a418_rearFasciaRightTurnLightFault";
BA_ "SystemSignalLongSymbol" SG_ 960 VCRIGHT_a419_tailFasciaLeftLight "VCRIGHT_a419_tailFasciaLeftLightFault";
BA_ "SystemSignalLongSymbol" SG_ 960 VCRIGHT_a420_tailFasciaRightLigh "VCRIGHT_a420_tailFasciaRightLightFault";
BA_ "SystemSignalLongSymbol" SG_ 960 VCRIGHT_a446_cabinHVACUnavailabl "VCRIGHT_a446_cabinHVACUnavailableContext";
BA_ "SystemSignalLongSymbol" SG_ 960 VCRIGHT_a450_ptcForcedOutOfSeqRo "VCRIGHT_a450_ptcForcedOutOfSeqRod";
BA_ "SystemSignalLongSymbol" SG_ 960 VCRIGHT_a451_ptcSeqRodOutOfRetri "VCRIGHT_a451_ptcSeqRodOutOfRetries";
BA_ "SystemSignalLongSymbol" SG_ 960 VCRIGHT_a454_ptcHeaterBadRodDete "VCRIGHT_a454_ptcHeaterBadRodDetected";
BA_ "SystemSignalLongSymbol" SG_ 960 VCRIGHT_a490_vehicleOccupiedOnOT "VCRIGHT_a490_vehicleOccupiedOnOTAStart";
BA_ "SystemSignalLongSymbol" SG_ 960 VCRIGHT_a491_BPillarCameraHeater "VCRIGHT_a491_BPillarCameraHeaterFault";
BA_ "SystemSignalLongSymbol" SG_ 960 VCRIGHT_a498_canAuthenticationFa "VCRIGHT_a498_canAuthenticationFailure";
BA_ "SystemSignalLongSymbol" SG_ 960 VCRIGHT_a525_LVBatterySWMisconfi "VCRIGHT_a525_LVBatterySWMisconfiguration";
BA_ "SystemSignalLongSymbol" SG_ 960 VCRIGHT_a527_continuousFeedUnexp "VCRIGHT_a527_continuousFeedUnexpectedVoltage";
BA_ "SystemSignalLongSymbol" SG_ 960 VCRIGHT_a528_unableToRunStuckOnT "VCRIGHT_a528_unableToRunStuckOnTest";
BA_ "SystemSignalLongSymbol" SG_ 960 VCRIGHT_a529_airflowFeedBackMode "VCRIGHT_a529_airflowFeedBackModelError";
BA_ "SystemSignalLongSymbol" SG_ 960 VCRIGHT_a531_airflowModelTmpComp "VCRIGHT_a531_airflowModelTmpCompDisabled";
BA_ "SystemSignalLongSymbol" SG_ 960 VCRIGHT_a532_airflowModelFeedFor "VCRIGHT_a532_airflowModelFeedForwardError";
BA_ "SystemSignalLongSymbol" SG_ 960 VCRIGHT_a537_solarCalcsNotNomina "VCRIGHT_a537_solarCalcsNotNominal";
BA_ "SystemSignalLongSymbol" SG_ 960 VCRIGHT_a538_hvacSystemNotNomina "VCRIGHT_a538_hvacSystemNotNominal";
BA_ "SystemSignalLongSymbol" SG_ 960 VCRIGHT_a540_hvacActuatorDitherD "VCRIGHT_a540_hvacActuatorDitherDebug";
BA_ "SystemSignalLongSymbol" SG_ 960 VCRIGHT_a542_steeringWheelHeatin "VCRIGHT_a542_steeringWheelHeatingInhibited";
BA_ "SystemSignalLongSymbol" SG_ 960 VCRIGHT_a545_LVBatteryTypeUnknow "VCRIGHT_a545_LVBatteryTypeUnknown";
BA_ "SystemSignalLongSymbol" SG_ 960 VCRIGHT_a546_mirrorFoldTypeChang "VCRIGHT_a546_mirrorFoldTypeChanged";
BA_ "SystemSignalLongSymbol" SG_ 960 VCRIGHT_a551_interiorDoorRequest "VCRIGHT_a551_interiorDoorRequestInhibited";
BA_ "SystemSignalLongSymbol" SG_ 960 VCRIGHT_a560_2RowSeatUncalibrate "VCRIGHT_a560_2RowSeatUncalibrated";
BA_ "SystemSignalLongSymbol" SG_ 960 VCRIGHT_a561_2RowSeatPositionNon "VCRIGHT_a561_2RowSeatPositionNonsensical";
BA_ "SystemSignalLongSymbol" SG_ 960 VCRIGHT_a562_2RowSeatAbsPosOffse "VCRIGHT_a562_2RowSeatAbsPosOffsetApplied";
BA_ "SystemSignalLongSymbol" SG_ 960 VCRIGHT_a563_2RowSeatObstacleDet "VCRIGHT_a563_2RowSeatObstacleDetected";
BA_ "SystemSignalLongSymbol" SG_ 960 VCRIGHT_a565_2RowSeatAbsPosSenso "VCRIGHT_a565_2RowSeatAbsPosSensorTransitionDbg";
BA_ "SystemSignalLongSymbol" SG_ 960 VCRIGHT_a566_2RowSeatStatsFromLa "VCRIGHT_a566_2RowSeatStatsFromLastStateDbg";
BA_ "SystemSignalLongSymbol" SG_ 960 VCRIGHT_a567_2RowSeatRequestWhil "VCRIGHT_a567_2RowSeatRequestWhileUncalibrated";
BA_ "SystemSignalLongSymbol" SG_ 960 VCRIGHT_a568_2RowSeatClashAvoida "VCRIGHT_a568_2RowSeatClashAvoidanceBlocked";
BA_ "SystemSignalLongSymbol" SG_ 960 VCRIGHT_a571_seatHeatDisabledRea "VCRIGHT_a571_seatHeatDisabledRearL";
BA_ "SystemSignalLongSymbol" SG_ 960 VCRIGHT_a572_seatHeatDisabledRea "VCRIGHT_a572_seatHeatDisabledRearC";
BA_ "SystemSignalLongSymbol" SG_ 960 VCRIGHT_a573_seatHeatDisabledRea "VCRIGHT_a573_seatHeatDisabledRearR";
BA_ "SystemSignalLongSymbol" SG_ 960 VCRIGHT_a579_liftgateFollowerUne "VCRIGHT_a579_liftgateFollowerUnexpectedStop";
BA_ "SystemSignalLongSymbol" SG_ 960 VCRIGHT_a580_debugLiftgateFollow "VCRIGHT_a580_debugLiftgateFollowerCurrentSpike";
BA_ "SystemSignalLongSymbol" SG_ 960 VCRIGHT_a583_doorRemoteUnlatched "VCRIGHT_a583_doorRemoteUnlatchedFront";
BA_ "SystemSignalLongSymbol" SG_ 960 VCRIGHT_a584_doorRemoteUnlatched "VCRIGHT_a584_doorRemoteUnlatchedRear";
BA_ "SystemSignalLongSymbol" SG_ 960 VCRIGHT_a585_doorRemoteUnlatchFa "VCRIGHT_a585_doorRemoteUnlatchFailedFront";
BA_ "SystemSignalLongSymbol" SG_ 960 VCRIGHT_a586_doorRemoteUnlatchFa "VCRIGHT_a586_doorRemoteUnlatchFailedRear";
BA_ "SystemSignalLongSymbol" SG_ 960 VCRIGHT_a598_childModeMonitorTri "VCRIGHT_a598_childModeMonitorTrip";
BA_ "SystemSignalLongSymbol" SG_ 960 VCRIGHT_a599_LVBatteryTypeUnsupp "VCRIGHT_a599_LVBatteryTypeUnsupported";
BA_ "Confidence" SG_ 1795 VCRIGHT_hvacPanelFloorSplitRow1 1;
BA_ "Confidence" SG_ 1795 VCRIGHT_hvacDefrostPercent 1;
BA_ "Confidence" SG_ 1795 VCRIGHT_hvacRow2Percent 1;
BA_ "Confidence" SG_ 1795 VCRIGHT_hvacPanelFloorSplitRow2 1;
BA_ "Confidence" SG_ 1795 VCRIGHT_hvacFreshMassCounter 1;
BA_ "Confidence" SG_ 1795 VCRIGHT_hvacRecircMassCounter 1;
BA_ "Confidence" SG_ 1795 VCRIGHT_setTempAdjustmentLeft 1;
BA_ "Confidence" SG_ 1795 VCRIGHT_setTempAdjustmentRight 1;
BA_ "Confidence" SG_ 1795 VCRIGHT_hvacLHVaneVelocity 1;
BA_ "Confidence" SG_ 1795 VCRIGHT_hvacRHVaneVelocity 1;
BA_ "Confidence" SG_ 1795 VCRIGHT_hvacMassflowCompensated 1;
BA_ "Confidence" SG_ 1795 VCRIGHT_PTCcenterPowerLeft 1;
BA_ "Confidence" SG_ 1795 VCRIGHT_PTCouterPowerLeft 1;
BA_ "Confidence" SG_ 1795 VCRIGHT_PTCinnerPowerLeft 1;
BA_ "Confidence" SG_ 1795 VCRIGHT_PTCcenterPowerRight 1;
BA_ "Confidence" SG_ 1795 VCRIGHT_PTCouterPowerRight 1;
BA_ "Confidence" SG_ 1795 VCRIGHT_PTCinnerPowerRight 1;
BA_ "Confidence" SG_ 1795 VCRIGHT_PTCcenterStoneTempLeft 1;
BA_ "Confidence" SG_ 1795 VCRIGHT_PTCcenterStoneTempRight 1;
BA_ "Confidence" SG_ 1795 VCRIGHT_PTCinnerStoneTempLeft 1;
BA_ "Confidence" SG_ 1795 VCRIGHT_PTCinnerStoneTempRight 1;
BA_ "Confidence" SG_ 1795 VCRIGHT_PTCouterStoneTempLeft 1;
BA_ "Confidence" SG_ 1795 VCRIGHT_PTCouterRodTempLeft 1;
BA_ "Confidence" SG_ 1795 VCRIGHT_PTCouterAirTempLeft 1;
BA_ "Confidence" SG_ 1795 VCRIGHT_PTCcenterRodTempLeft 1;
BA_ "Confidence" SG_ 1795 VCRIGHT_PTCinnerRodTempLeft 1;
BA_ "Confidence" SG_ 1795 VCRIGHT_PTCcenterAirTempLeft 1;
BA_ "Confidence" SG_ 1795 VCRIGHT_PTCinnerAirTempLeft 1;
BA_ "Confidence" SG_ 1795 VCRIGHT_PTCouterStoneTempRight 1;
BA_ "Confidence" SG_ 1795 VCRIGHT_PTCouterRodTempRight 1;
BA_ "Confidence" SG_ 1795 VCRIGHT_PTCouterAirTempRight 1;
BA_ "Confidence" SG_ 1795 VCRIGHT_PTCcenterRodTempRight 1;
BA_ "Confidence" SG_ 1795 VCRIGHT_PTCinnerRodTempRight 1;
BA_ "Confidence" SG_ 1795 VCRIGHT_PTCcenterAirTempRight 1;
BA_ "Confidence" SG_ 1795 VCRIGHT_PTCinnerAirTempRight 1;
